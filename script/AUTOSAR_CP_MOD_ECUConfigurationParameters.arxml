[part 9 of 14: package /AUTOSAR/EcucDefs]
AUTOSAR XML (schema 00053)
package /AUTOSAR/EcucDefs  (continued)
  module definition IEEE1722Tp [0..1]: post-build-variant-support=true, variants link-time/post-build/pre-compile  # Configuration of the IEEE1722Tp module. Tags: atp.Status=draft
    container IEEE1722TpConfig  # This container contains the configuration parameters and sub containers of the AUTOSAR IEEE1722Tp module. Tags: atp.Status=draft
      container IEEE1722TpLowerLayerPduPool [1..*]: multiplicity set at pre-compile  # Each container defines one lower layer Pdu pool (either for Tx or Rx). Each Stream then may select over which Pdu pool their transport shall be done. Tags: atp.Status=draft
        container IEEE1722TpLowerLayerRxPduPoolEntry [0..*]: multiplicity set at pre-compile  # This container defines one entry in the IEEE1722TpLowerLayerPduPool for Rx direction to be used for the transport of Rx Pdus from the lower layer. Tags: atp.Status=draft | This container is only required if at least one stream is consumed by the IEEE1722Tp module. Supported MetaData entry: * TIMETUPLE_TYPE_PTR
          integer IEEE1722TpLowerLayerRxPduId: 0..65535, scope=ECU, post-build-variant-value=true, set at link in variant link-time / post-build in variant post-build / pre-compile in variant pre-compile, symbolic-name-value=true, with-auto=true  # Definition of the Handle Pdu Id used by the lower layer for Rx Pdu indication. Tags: atp.Status=draft
          reference IEEE1722TpLowerLayerRxPduRef: scope=ECU, post-build-variant-value=true, set at link in variant link-time / post-build in variant post-build / pre-compile in variant pre-compile, destination=Pdu  # Reference to the EcuC Pdu used for the transport of Rx Pdu from the lower layer. Tags: atp.Status=draft
        container IEEE1722TpLowerLayerTxPduPoolEntry [0..*]: multiplicity set at pre-compile  # This container defines one entry in the IEEE1722TpLowerLayerPduPool for Tx direction to be used for the transport of Tx Pdus to the lower layer. Tags: atp.Status=draft | This container is only required if at least one stream is produced by the IEEE1722Tp module. Supported MetaData entries: * LISTELEM_PTR * ETHERNET_MAC_64
          integer IEEE1722TpLowerLayerTxPduId [0..1]: 0..65535, scope=ECU, multiplicity set at pre-compile, post-build-variant-value=true, set at link in variant link-time / post-build in variant post-build / pre-compile in variant pre-compile, symbolic-name-value=true, with-auto=true  # Definition of the Handle Pdu Id used by the lower layer for Tx Pdu confirmation. Tags: atp.Status=draft
          reference IEEE1722TpLowerLayerTxPduRef: scope=ECU, post-build-variant-value=true, set at link in variant link-time / post-build in variant post-build / pre-compile in variant pre-compile, destination=Pdu  # Reference to the EcuC Pdu used for the transport of Tx Pdu to the lower layer. Tags: atp.Status=draft
      container IEEE1722TpStream [1..*]: multiplicity set at link in variant link-time / post-build in variant post-build / pre-compile in variant pre-compile, post-build-variant-multiplicity=true  # Definition of an IEEE1722Tp stream. Tags: atp.Status=draft
        string IEEE1722TpStreamIdMacAddress [0..1]: multiplicity set at link in variant link-time / post-build in variant post-build / pre-compile in variant pre-compile, post-build-variant-multiplicity=true, post-build-variant-value=true, set at link in variant link-time / post-build in variant post-build / pre-compile in variant pre-compile, max-length=17, min-length=17, regular-expression=[0-9a-fA-F]{2}[[:-][0-9a-fA-F]{2}]{5}  # Definition of the MAC address part of the Stream Id. Tags: atp.Status=draft
        integer IEEE1722TpStreamIdUniquePart: 0..65535, post-build-variant-value=true, set at link in variant link-time / post-build in variant post-build / pre-compile in variant pre-compile  # Definition of the unique ID part of the Stream Id. Tags: atp.Status=draft
        integer IEEE1722TpStreamIndex: 0..65535, scope=ECU, post-build-variant-value=true, set at link in variant link-time / post-build in variant post-build / pre-compile in variant pre-compile, symbolic-name-value=true, with-auto=true  # Definition of the Handle Index to identify this stream for API access in the communication stack. Tags: atp.Status=draft | This value is NOT related to the stream id combined out of IEEE1722TpStreamIdUniquePart and IEEE1722TpStreamIdMacAddress.
        float IEEE1722TpStreamMaxTransitTime: post-build-variant-value=true, set at link in variant link-time / post-build in variant post-build / pre-compile in variant pre-compile  # Definition of the max transit time for the stream. Tags: atp.Status=draft | Value in seconds.
        integer IEEE1722TpStreamVersion: 0..7, post-build-variant-value=true, set at link in variant link-time / post-build in variant post-build / pre-compile in variant pre-compile  # Definition of the stream version. Tags: atp.Status=draft
        reference IEEE1722TpEthIfClkUnitRef: scope=ECU, set at pre-compile, requires-symbolic-name-value=true, destination=EthIfClkUnit  # Reference to the EthIfClkUnit from which the current synchronized time could be retrieved (e.g. determine avtp timestamp for transmission). Tags: atp.Status=draft
        reference IEEE1722TpStbMSynchronizedTimeBaseRef: scope=ECU, set at pre-compile, requires-symbolic-name-value=true, destination=StbMSynchronizedTimeBase  # Reference to the StbMSynchronizedTimeBase from which the current synchronized time could be retrieved (e.g. determine avtp timestamp for transmission). Tags: atp.Status=draft
        reference IEEE1722TpStreamLowerLayerPduPoolRef: scope=ECU, post-build-variant-value=true, set at link in variant link-time / post-build in variant post-build / pre-compile in variant pre-compile, destination=IEEE1722TpLowerLayerPduPool  # Reference to one Pdu collection for the transport towards/from the lower layer. Tags: atp.Status=draft
        choice container IEEE1722TpStreamDirection  # Choice of the IEEE1722 stream direction, either Tx or Rx is configurable. Tags: atp.Status=draft
          container IEEE1722TpStreamRx [0..1]: multiplicity set at pre-compile  # This container defines exclusive parameters for Tx direction. Tags: atp.Status=draft
            container IEEE1722TpStreamRxQueue [0..1]: multiplicity set at pre-compile  # Definition of an IEEE1722Tp stream Rx queue. Tags: atp.Status=draft
              integer IEEE1722TpStreamRxQueueSize: 0..255, post-build-variant-value=true, set at link in variant link-time / post-build in variant post-build / pre-compile in variant pre-compile  # Definition of the queue size for the stream Rx queue. The queue is configured in number of to be queued elements. Tags: atp.Status=draft
            container IEEE1722TpUpperLayerRxPduPoolEntry [0..*]: multiplicity set at pre-compile  # This container defines one entry in the IEEE1722TpUpperLayerRxPduPool for Rx direction to be used for the transport of Rx Pdus to the upper layer. Tags: atp.Status=draft | This container is only required if the stream is consumed by the IEEE1722Tp module and is not an ACF stream. Supported MetaData entries: * IEEE1722TP_COMMON_STREAM_HEADER_PTR * IEEE1722TP_RX_IEC68133_IIDC_PTR * IEEE1722TP_RX_IEC68133_PTR * IEEE1722TP_RX_IEC68133_CIP_NO_SPH_PTR * IEEE1722TP_RX_IEC68133_CIP_WITH_SPH_PTR * IEEE1722TP_RX_AAF_PCM_PTR * IEEE1722TP_RX_AAF_AES3_PTR * IEEE1722TP_RX_RVF_PTR * IEEE1722TP_RX_CRF_PTR
              integer IEEE1722TpStreamRxPduId: 0..65535, scope=ECU, post-build-variant-value=true, set at link in variant link-time / post-build in variant post-build / pre-compile in variant pre-compile, symbolic-name-value=true, with-auto=true  # Definition of the Handle Pdu Id used by the upper layer for Rx Pdu indication. Tags: atp.Status=draft | This handle Id is only required if the stream is consumed by the IEEE1722Tp module.
              reference IEEE1722TpStreamRxPduRef: scope=ECU, post-build-variant-value=true, set at link in variant link-time / post-build in variant post-build / pre-compile in variant pre-compile, destination=Pdu  # Reference to the EcuC Pdu used for the transport of Rx stream Pdu to the upper layer. Tags: atp.Status=draft
          container IEEE1722TpStreamTx [0..1]: multiplicity set at pre-compile  # This container defines exclusive parameters for Tx direction. Tags: atp.Status=draft
            container IEEE1722TpStreamTxQueue [0..1]: multiplicity set at pre-compile  # Definition of an IEEE1722Tp stream Tx queue. Tags: atp.Status=draft
              integer IEEE1722TpStreamTxQueueSize: 0..255, post-build-variant-value=true, set at link in variant link-time / post-build in variant post-build / pre-compile in variant pre-compile  # Definition of the queue size for the stream Tx queue. The queue is configured in number of to be queued elements. Tags: atp.Status=draft
            container IEEE1722TpUpperLayerTxPduPoolEntry [0..*]: multiplicity set at pre-compile  # This container defines one entry in the IEEE1722TpUpperLayerPduPool for Tx direction to be used for the transport of Tx Pdus from the upper layer. Tags: atp.Status=draft | This container is only required if the stream is produced by the IEEE1722Tp module and is not an ACF stream. Supported MetaData entries: * IEEE1722TP_COMMON_STREAM_HEADER_PTR * IEEE1722TP_TX_IEC68133_IIDC_PTR * IEEE1722TP_TX_IEC68133_PTR * IEEE1722TP_TX_IEC68133_CIP_NO_SPH_PTR * IEEE1722TP_TX_IEC68133_CIP_WITH_SPH_PTR * IEEE1722TP_TX_AAF_PCM_PTR * IEEE1722TP_TX_AAF_AES3_PTR * IEEE1722TP_TX_RVF_PTR * IEEE1722TP_TX_CRF_PTR
              integer IEEE1722TpStreamTxPduId [0..1]: 0..65535, scope=ECU, multiplicity set at pre-compile, post-build-variant-value=true, set at link in variant link-time / post-build in variant post-build / pre-compile in variant pre-compile, symbolic-name-value=true, with-auto=true  # Definition of the Handle Pdu Id used by the upper layer for Tx Pdu confirmation. Tags: atp.Status=draft
              reference IEEE1722TpStreamTxPduRef: scope=ECU, post-build-variant-value=true, set at link in variant link-time / post-build in variant post-build / pre-compile in variant pre-compile, destination=Pdu  # Reference to the EcuC Pdu used for the transport of Tx stream Pdu from the upper layer. Tags: atp.Status=draft
        choice container IEEE1722TpStreamSubtype  # Choice of the IEEE1722 stream subtype. Tags: atp.Status=draft
          container IEEE1722TpStreamAAF [0..1]  # Definition of an IEEE1722 AVTP Audio Format (AAF) stream. Tags: atp.Status=draft
            integer IEEE1722TpStreamAafAes3DataTypeH [0..1]: 0..255, multiplicity set at pre-compile, post-build-variant-value=true, set at link in variant link-time / post-build in variant post-build / pre-compile in variant pre-compile, default-value=0  # Definition of the AAF AES3 aes3_data_type_h default value. Tags: atp.Status=draft
            integer IEEE1722TpStreamAafAes3DataTypeL [0..1]: 0..255, multiplicity set at pre-compile, post-build-variant-value=true, set at link in variant link-time / post-build in variant post-build / pre-compile in variant pre-compile, default-value=0  # Definition of the AAF AES3 aes3_data_type_l default value. Tags: atp.Status=draft
            enumeration IEEE1722TpStreamAafAes3DataTypeRef [0..1]: multiplicity set at pre-compile, post-build-variant-value=true, set at link in variant link-time / post-build in variant post-build / pre-compile in variant pre-compile  # Definition of the AAF AES3 stream aes3_data_type reference (aes3_dt_ref). Tags: atp.Status=draft
              IEC61937  # Tags: atp.Status=draft
              PCM  # Tags: atp.Status=draft
              SMPTE338  # Tags: atp.Status=draft
              UNSPECIFIED  # Tags: atp.Status=draft
              VENDOR  # Tags: atp.Status=draft
            enumeration IEEE1722TpStreamAafAes3NominalFrameRate [0..1]: multiplicity set at pre-compile, post-build-variant-value=true, set at link in variant link-time / post-build in variant post-build / pre-compile in variant pre-compile  # Definition of the AAF AES3 stream nominal frame rate (nfr). Tags: atp.Status=draft
              R_16kHz  # Tags: atp.Status=draft
              R_176_4kHz  # Tags: atp.Status=draft
              R_192kHz  # Tags: atp.Status=draft
              R_24kHz  # Tags: atp.Status=draft
              R_32kHz  # Tags: atp.Status=draft
              R_44_1kHz  # Tags: atp.Status=draft
              R_48kHz  # Tags: atp.Status=draft
              R_88_2kHz  # Tags: atp.Status=draft
              R_8kHz  # Tags: atp.Status=draft
              R_96kHz  # Tags: atp.Status=draft
              R_USER  # Tags: atp.Status=draft
            integer IEEE1722TpStreamAafAes3StreamsPerFrame [0..1]: 0..1023, multiplicity set at pre-compile, post-build-variant-value=true, set at link in variant link-time / post-build in variant post-build / pre-compile in variant pre-compile  # Definition of the AAF AES3 stream streams_per_frame. Tags: atp.Status=draft
            integer IEEE1722TpStreamAafEventDefault: 0..15, post-build-variant-value=true, set at link in variant link-time / post-build in variant post-build / pre-compile in variant pre-compile, default-value=0  # Definition of the AAF stream event (evt) default value. Tags: atp.Status=draft
            enumeration IEEE1722TpStreamAafFormat: post-build-variant-value=true, set at link in variant link-time / post-build in variant post-build / pre-compile in variant pre-compile  # Definition of the AAF stream format. Tags: atp.Status=draft
              AES3_32BIT  # Tags: atp.Status=draft
              FLOAT_32BIT  # Tags: atp.Status=draft
              INT_16BIT  # Tags: atp.Status=draft
              INT_24BIT  # Tags: atp.Status=draft
              INT_32BIT  # Tags: atp.Status=draft
              USER  # Tags: atp.Status=draft
            integer IEEE1722TpStreamAafPcmBitDepth [0..1]: 0..255, multiplicity set at pre-compile, post-build-variant-value=true, set at link in variant link-time / post-build in variant post-build / pre-compile in variant pre-compile  # Definition of the AAF PCM stream bit_depth. Tags: atp.Status=draft | e.g. 16, 24, 32
            integer IEEE1722TpStreamAafPcmChannelsPerFrame [0..1]: 0..1023, multiplicity set at pre-compile, post-build-variant-value=true, set at link in variant link-time / post-build in variant post-build / pre-compile in variant pre-compile  # Definition of the AAF PCM stream channels_per_frame. Tags: atp.Status=draft | e.g. 1: mono, 2: stereo, 8: 7.1 multicannel
            enumeration IEEE1722TpStreamAafPcmNominalSampleRate [0..1]: multiplicity set at pre-compile, post-build-variant-value=true, set at link in variant link-time / post-build in variant post-build / pre-compile in variant pre-compile  # Definition of the AAF PCM stream nominal sample rate (nsr). Tags: atp.Status=draft
              R_16kHz  # Tags: atp.Status=draft
              R_176_4kHz  # Tags: atp.Status=draft
              R_192kHz  # Tags: atp.Status=draft
              R_24kHz  # Tags: atp.Status=draft
              R_32kHz  # Tags: atp.Status=draft
              R_44_1kHz  # Tags: atp.Status=draft
              R_48kHz  # Tags: atp.Status=draft
              R_88_2kHz  # Tags: atp.Status=draft
              R_8kHz  # Tags: atp.Status=draft
              R_96kHz  # Tags: atp.Status=draft
              R_USER  # Tags: atp.Status=draft
            boolean IEEE1722TpStreamAafSparseTimestamp: post-build-variant-value=true, set at link in variant link-time / post-build in variant post-build / pre-compile in variant pre-compile  # Defines the CRF stream sparce timestamp (sp). Tags: atp.Status=draft | true = 1 false = 0
          container IEEE1722TpStreamACF [0..1]  # Definition of an IEEE1722 AVTP Control Format (ACF) stream. Tags: atp.Status=draft
            integer IEEE1722TpAcfCollectionThreshold [0..1]: 0..65535, multiplicity set at pre-compile, post-build-variant-value=true, set at link in variant link-time / post-build in variant post-build / pre-compile in variant pre-compile  # Defines the size threshold in bytes which, when exceeded, triggers the sending of the ACF message. Tags: atp.Status=draft
            float IEEE1722TpAcfCollectionTimeout [0..1]: 0..65.535, multiplicity set at pre-compile, post-build-variant-value=true, set at link in variant link-time / post-build in variant post-build / pre-compile in variant pre-compile  # Defines a timeout which, when exceeded, triggers the sending of the ACF message. Tags: atp.Status=draft | Defined in seconds.
            enumeration IEEE1722TpStreamAcfHeaderType: post-build-variant-value=true, set at link in variant link-time / post-build in variant post-build / pre-compile in variant pre-compile  # Definition of the ACF stream header format. Tags: atp.Status=draft | Depending on this selection the AVTP stream data subtype will be defined.
              NON_TIME_SYNCHRONOUS  # Tags: atp.Status=draft
              TIME_SYNCHRONOUS  # Tags: atp.Status=draft
            boolean IEEE1722TpStreamAcfMixedBusTypeCollection: set at pre-compile  # Defines if this ACF-stream is allowed to collect ACF-messages of different bus kinds (i.e. whether it is allowed to collect CAN and LIN ACF-messages in one ACF-stream message). Tags: atp.Status=draft | For the ACF-stream producer this configures the collection behavior. For an ACF-stream consumer this configures that this ACF-stream was produced with this assumption. true = 1: mixed collection is allowed false = 0 : mixed collection is not allowed
            choice container IEEE1722TpStreamAcfPayload [1..*]: multiplicity set at pre-compile  # Definition of an IEEE1722Tp AVTP Control Format (ACF) stream payload. Tags: atp.Status=draft
              container IEEE1722TpStreamAcfCan [0..1]  # Definition of an IEEE1722Tp AVTP Control Format (ACF) stream payload for CAN and CAN_BRIEF. Tags: atp.Status=draft
                integer IEEE1722TpStreamAcfBusId: 0..31, post-build-variant-value=true, set at link in variant link-time / post-build in variant post-build / pre-compile in variant pre-compile  # Definition of the ACF stream bus_id. Tags: atp.Status=draft
                enumeration IEEE1722TpStreamAcfCanMessageType: post-build-variant-value=true, set at link in variant link-time / post-build in variant post-build / pre-compile in variant pre-compile  # Definition of the ACF CAN stream message type. Tags: atp.Status=draft | Depending on this selection the ACF stream acf_msg_type will be defined.
                  CAN  # Tags: atp.Status=draft
                  CAN_BRIEF  # Tags: atp.Status=draft
                container IEEE1722TpStreamAcfCanPdu [1..*]: multiplicity set at pre-compile  # Definition of a CAN Pdu transported on this ACF stream. Identification can be done by either explicit CAN Id or via meta-data. Tags: atp.Status=draft
                  boolean IEEE1722TpStreamAcfCanExtendedFrameFormat [0..1]: multiplicity set at pre-compile, post-build-variant-value=true, set at link in variant link-time / post-build in variant post-build / pre-compile in variant pre-compile  # Defines the ACF CAN stream extended_frame_format (eff). Tags: atp.Status=draft | true = 1 false = 0
                  boolean IEEE1722TpStreamAcfCanFDBitDataRateFormat [0..1]: multiplicity set at pre-compile, post-build-variant-value=true, set at link in variant link-time / post-build in variant post-build / pre-compile in variant pre-compile  # Represents the CAN-FD Data-rate (FD) format (fdf) switch. This is used, when a PDU is produced by an upper layer and transferred as encapsulated ACF_CAN via an Ethernet network. Tags: atp.Status=draft
                  boolean IEEE1722TpStreamAcfCanFDBitRateSwitch [0..1]: multiplicity set at pre-compile, post-build-variant-value=true, set at link in variant link-time / post-build in variant post-build / pre-compile in variant pre-compile  # Represents the CAN-FD bit rate switch (brs). This is used, if a PDU is produced by an upper layer and transferred as encapsulated ACF_CAN via an Ethernet network. Tags: atp.Status=draft
                  integer IEEE1722TpStreamAcfCanId [0..1]: 0..536870911, multiplicity set at pre-compile, post-build-variant-value=true, set at link in variant link-time / post-build in variant post-build / pre-compile in variant pre-compile  # Definition of the ACF stream CAN Id in case CAN Id is not taken from meta-data. Tags: atp.Status=draft
                  enumeration IEEE1722TpStreamAcfTriggerMode: post-build-variant-value=true, set at link in variant link-time / post-build in variant post-build / pre-compile in variant pre-compile  # Defines whether putting this Can/Lin Pdu to the ACF message Tags: atp.Status=draft | * always or * never triggers immediate sending of the ACF message.
                    TRIGGER_ALWAYS  # Tags: atp.Status=draft
                    TRIGGER_NEVER  # Tags: atp.Status=draft
                  container IEEE1722TpStreamAcfCanPduFilter [0..1]: multiplicity set at link in variant link-time / post-build in variant post-build / pre-compile in variant pre-compile, post-build-variant-multiplicity=true  # Optional definition of a Can Id filter. This specifically applies to the case where the Can Id is taken from the meta-data and only certain PDUs shall actually pass. Tags: atp.Status=draft | If the definition is from Can network to stream, then this filter selects which PDUs shall be put to the stream. If the definition is from stream to Can network, then this filter selects which PDUs shall be put on the Can network.
                    integer IEEE1722TpStreamAcfCanIdMask [0..1]: 0..536870911, scope=ECU, multiplicity set at link in variant link-time / post-build in variant post-build / pre-compile in variant pre-compile, post-build-variant-multiplicity=true, post-build-variant-value=true, set at link in variant link-time / post-build in variant post-build / pre-compile in variant pre-compile, default-value=536870911  # Identifier mask which denotes relevant bits in the CAN Identifier. This parameter defines a CAN Identifier range in an alternative way to IEEE1722TpStreamAcfCanIdRange. It identifies the bits of the configured CAN Identifier that must match the received CAN Identifier. Tags: atp.Status=draft | Range: 11 bits for Standard CAN Identifier, 29 bits for Extended CAN Identifier.
                    container IEEE1722TpStreamAcfCanIdRange [0..1]: multiplicity set at link in variant link-time / post-build in variant post-build / pre-compile in variant pre-compile, post-build-variant-multiplicity=true  # Identifier range definition. This parameter defines a CAN Identifier range in an alternative way to IEEE1722TpStreamAcfCanIdMask.
                      integer IEEE1722TpStreamAcfCanIdRangeLowerCanId: 0..536870911, post-build-variant-value=true, set at link in variant link-time / post-build in variant post-build / pre-compile in variant pre-compile  # Lower CAN Identifier of a receive CAN L-PDU for identifier range definition, in which all CAN Ids are mapped to one PduId.
                      integer IEEE1722TpStreamAcfCanIdRangeUpperCanId: 0..536870911, post-build-variant-value=true, set at link in variant link-time / post-build in variant post-build / pre-compile in variant pre-compile  # Upper CAN Identifier of a receive CAN L-PDU for identifier range definition, in which all CAN Ids are mapped to one PduId.
                  container IEEE1722TpStreamAcfRxPdu [0..1]: multiplicity set at pre-compile  # This container defines the EcuC Rx Pdu used for the transport of the network specific payload (Can or Lin). Tags: atp.Status=draft | Dependency: Either IEEE1722TpStreamAcfTxPdu or IEEE1722TpStreamAcfRxPdu shall be provided. Supported MetaData entries for CAN: * IEEE1722TP_COMMON_STREAM_HEADER_PTR * MESSAGE_TIMESTAMP_64 * MESSAGE_TIMESTAMP_VALID_8 * CAN_ID_32 * CAN_ID_PROPS_8 Supported MetaData entries for LIN: * IEEE1722TP_COMMON_STREAM_HEADER_PTR * MESSAGE_TIMESTAMP_64 * MESSAGE_TIMESTAMP_VALID_8 * LIN_NAD_8
                    integer IEEE1722TpStreamAcfPduId [0..1]: 0..65535, scope=ECU, multiplicity set at pre-compile, post-build-variant-value=true, set at link in variant link-time / post-build in variant post-build / pre-compile in variant pre-compile, symbolic-name-value=true, with-auto=true  # Definition of the Handle Pdu Id. Tags: atp.Status=draft
                    reference IEEE1722TpStreamAcfPduRef: scope=ECU, post-build-variant-value=true, set at link in variant link-time / post-build in variant post-build / pre-compile in variant pre-compile, destination=Pdu  # Reference to the EcuC Pdu. Tags: atp.Status=draft
                  container IEEE1722TpStreamAcfTxPdu [0..1]: multiplicity set at pre-compile  # This container defines the EcuC Tx Pdu used for the transport of the network specific payload (Can or Lin). Tags: atp.Status=draft | Dependency: Either IEEE1722TpStreamAcfTxPdu or IEEE1722TpStreamAcfRxPdu shall be provided. Supported MetaData entries for CAN: * CAN_ID_32 * CAN_ID_PROPS_8 Supported MetaData entries for LIN: * LIN_NAD_8
                    integer IEEE1722TpStreamAcfPduId [0..1]: 0..65535, scope=ECU, multiplicity set at pre-compile, post-build-variant-value=true, set at link in variant link-time / post-build in variant post-build / pre-compile in variant pre-compile, symbolic-name-value=true, with-auto=true  # Definition of the Handle Pdu Id. Tags: atp.Status=draft
                    reference IEEE1722TpStreamAcfPduRef: scope=ECU, post-build-variant-value=true, set at link in variant link-time / post-build in variant post-build / pre-compile in variant pre-compile, destination=Pdu  # Reference to the EcuC Pdu. Tags: atp.Status=draft
              container IEEE1722TpStreamAcfLin [0..1]  # Definition of an IEEE1722Tp AVTP Control Format (ACF) stream payload for LIN. Tags: atp.Status=draft | ACF message type = 0x03.
                integer IEEE1722TpStreamAcfBusId: 0..31, post-build-variant-value=true, set at link in variant link-time / post-build in variant post-build / pre-compile in variant pre-compile  # Definition of the ACF stream bus_id. Tags: atp.Status=draft
                container IEEE1722TpStreamAcfLinPdu [1..*]: multiplicity set at pre-compile  # Definition of a LIN Pdu transported on this ACF stream. Identification can be done by either explicit LIN Id or via meta-data. Tags: atp.Status=draft
                  integer IEEE1722TpStreamAcfLinId: 0..63, post-build-variant-value=true, set at link in variant link-time / post-build in variant post-build / pre-compile in variant pre-compile  # Definition of the ACF stream Lin Id. Tags: atp.Status=draft
                  enumeration IEEE1722TpStreamAcfTriggerMode: post-build-variant-value=true, set at link in variant link-time / post-build in variant post-build / pre-compile in variant pre-compile  # Defines whether putting this Can/Lin Pdu to the ACF message Tags: atp.Status=draft | * always or * never triggers immediate sending of the ACF message.
                    TRIGGER_ALWAYS  # Tags: atp.Status=draft
                    TRIGGER_NEVER  # Tags: atp.Status=draft
                  container IEEE1722TpStreamAcfRxPdu [0..1]: multiplicity set at pre-compile  # This container defines the EcuC Rx Pdu used for the transport of the network specific payload (Can or Lin). Tags: atp.Status=draft | Dependency: Either IEEE1722TpStreamAcfTxPdu or IEEE1722TpStreamAcfRxPdu shall be provided. Supported MetaData entries for CAN: * IEEE1722TP_COMMON_STREAM_HEADER_PTR * MESSAGE_TIMESTAMP_64 * MESSAGE_TIMESTAMP_VALID_8 * CAN_ID_32 * CAN_ID_PROPS_8 Supported MetaData entries for LIN: * IEEE1722TP_COMMON_STREAM_HEADER_PTR * MESSAGE_TIMESTAMP_64 * MESSAGE_TIMESTAMP_VALID_8 * LIN_NAD_8
                    integer IEEE1722TpStreamAcfPduId [0..1]: 0..65535, scope=ECU, multiplicity set at pre-compile, post-build-variant-value=true, set at link in variant link-time / post-build in variant post-build / pre-compile in variant pre-compile, symbolic-name-value=true, with-auto=true  # Definition of the Handle Pdu Id. Tags: atp.Status=draft
                    reference IEEE1722TpStreamAcfPduRef: scope=ECU, post-build-variant-value=true, set at link in variant link-time / post-build in variant post-build / pre-compile in variant pre-compile, destination=Pdu  # Reference to the EcuC Pdu. Tags: atp.Status=draft
                  container IEEE1722TpStreamAcfTxPdu [0..1]: multiplicity set at pre-compile  # This container defines the EcuC Tx Pdu used for the transport of the network specific payload (Can or Lin). Tags: atp.Status=draft | Dependency: Either IEEE1722TpStreamAcfTxPdu or IEEE1722TpStreamAcfRxPdu shall be provided. Supported MetaData entries for CAN: * CAN_ID_32 * CAN_ID_PROPS_8 Supported MetaData entries for LIN: * LIN_NAD_8
                    integer IEEE1722TpStreamAcfPduId [0..1]: 0..65535, scope=ECU, multiplicity set at pre-compile, post-build-variant-value=true, set at link in variant link-time / post-build in variant post-build / pre-compile in variant pre-compile, symbolic-name-value=true, with-auto=true  # Definition of the Handle Pdu Id. Tags: atp.Status=draft
                    reference IEEE1722TpStreamAcfPduRef: scope=ECU, post-build-variant-value=true, set at link in variant link-time / post-build in variant post-build / pre-compile in variant pre-compile, destination=Pdu  # Reference to the EcuC Pdu. Tags: atp.Status=draft
          container IEEE1722TpStreamCRF [0..1]  # Definition of an IEEE1722 Clock Reference Format (CRF) stream. Tags: atp.Status=draft
            integer IEEE1722TpStreamCrfBaseFrequency: 0..536870911, post-build-variant-value=true, set at link in variant link-time / post-build in variant post-build / pre-compile in variant pre-compile  # Definition of the CRF stream base frequency. This is defined in Hz. Tags: atp.Status=draft
            boolean IEEE1722TpStreamCrfFrameSync: post-build-variant-value=true, set at link in variant link-time / post-build in variant post-build / pre-compile in variant pre-compile  # Defines the CRF stream frame sync (fs). Tags: atp.Status=draft | true = 1 false = 0
            enumeration IEEE1722TpStreamCrfPull: post-build-variant-value=true, set at link in variant link-time / post-build in variant post-build / pre-compile in variant pre-compile  # Definition of the CRF stream pull value. Tags: atp.Status=draft
              PULL_1_0  # Tags: atp.Status=draft
              PULL_1_001  # Tags: atp.Status=draft
              PULL_1_1_001  # Tags: atp.Status=draft
              PULL_1_8  # Tags: atp.Status=draft
              PULL_24_25  # Tags: atp.Status=draft
              PULL_25_24  # Tags: atp.Status=draft
            integer IEEE1722TpStreamCrfTimestampInterval: 0..65535, post-build-variant-value=true, set at link in variant link-time / post-build in variant post-build / pre-compile in variant pre-compile  # Definition of the CRF stream timestamp interval. This is defined as multiple of base frequency. Tags: atp.Status=draft
            enumeration IEEE1722TpStreamCrfType: post-build-variant-value=true, set at link in variant link-time / post-build in variant post-build / pre-compile in variant pre-compile  # Definition of the CRF stream type. Tags: atp.Status=draft
              AUDIO_SAMPLE  # Tags: atp.Status=draft
              MACHINE_CYCLE  # Tags: atp.Status=draft
              USER  # Tags: atp.Status=draft
              VIDEO_FRAME  # Tags: atp.Status=draft
              VIDEO_LINE  # Tags: atp.Status=draft
          container IEEE1722TpStreamIIDC [0..1]  # Definition of an IEEE1722 61883_IIDC (IEC 61883/IIDC over AVTP) stream. Tags: atp.Status=draft
            integer IEEE1722TpStreamIidcChannel: 0..31, post-build-variant-value=true, set at link in variant link-time / post-build in variant post-build / pre-compile in variant pre-compile  # Definition of the IIDC channel. Tags: atp.Status=draft
            integer IEEE1722TpStreamIidcDataBlockSize: 0..255, post-build-variant-value=true, set at link in variant link-time / post-build in variant post-build / pre-compile in variant pre-compile  # Definition of the IIDC data block size (DBS). Tags: atp.Status=draft
            integer IEEE1722TpStreamIidcFractionNumber: 0..255, post-build-variant-value=true, set at link in variant link-time / post-build in variant post-build / pre-compile in variant pre-compile  # Definition of the IIDC fractionNumber (FN). Tags: atp.Status=draft
            boolean IEEE1722TpStreamIidcSourcePacketHeader: post-build-variant-value=true, set at link in variant link-time / post-build in variant post-build / pre-compile in variant pre-compile  # Defines the IIDC source packet header (SPH). Tags: atp.Status=draft | true = 1 false = 0
            integer IEEE1722TpStreamIidcStreamFormat: 0..63, post-build-variant-value=true, set at link in variant link-time / post-build in variant post-build / pre-compile in variant pre-compile  # Definition of the IIDC stream format (FMT). Tags: atp.Status=draft
            integer IEEE1722TpStreamIidcSy: 0..15, post-build-variant-value=true, set at link in variant link-time / post-build in variant post-build / pre-compile in variant pre-compile  # Definition of the IIDC sy. Tags: atp.Status=draft
            integer IEEE1722TpStreamIidcTag: 0..3, post-build-variant-value=true, set at link in variant link-time / post-build in variant post-build / pre-compile in variant pre-compile  # Definition of the IIDC tag. Tags: atp.Status=draft
            integer IEEE1722TpStreamIidcTCode: 0..31, post-build-variant-value=true, set at link in variant link-time / post-build in variant post-build / pre-compile in variant pre-compile  # Definition of the IIDC tcode. Tags: atp.Status=draft
          container IEEE1722TpStreamRVF [0..1]  # Definition of an IEEE1722 Raw Video Format (RVF) stream. Tags: atp.Status=draft
            integer IEEE1722TpStreamRvfActivePixels: 0..65535, post-build-variant-value=true, set at link in variant link-time / post-build in variant post-build / pre-compile in variant pre-compile  # Definition of the RVF stream active_pixels. Tags: atp.Status=draft
            enumeration IEEE1722TpStreamRvfColorSpace: post-build-variant-value=true, set at link in variant link-time / post-build in variant post-build / pre-compile in variant pre-compile  # Definition of the RVF stream colorspace. Tags: atp.Status=draft
              BT_Rec_601  # Tags: atp.Status=draft
              BT_Rec_709  # Tags: atp.Status=draft
              Grayscale  # Tags: atp.Status=draft
              ITU_BT_2020  # Tags: atp.Status=draft
              User  # Tags: atp.Status=draft
              XYZ  # Tags: atp.Status=draft
              YCM  # Tags: atp.Status=draft
              YCbCr  # Tags: atp.Status=draft
              YCgCo  # Tags: atp.Status=draft
              sRGB  # Tags: atp.Status=draft
            integer IEEE1722TpStreamRvfEventDefault: 0..15, post-build-variant-value=true, set at link in variant link-time / post-build in variant post-build / pre-compile in variant pre-compile, default-value=0  # Definition of the RVF stream event (evt) default value. Tags: atp.Status=draft
            enumeration IEEE1722TpStreamRvfFrameRate: post-build-variant-value=true, set at link in variant link-time / post-build in variant post-build / pre-compile in variant pre-compile  # Definition of the RVF stream frame_rate. Tags: atp.Status=draft
              FR_1  # Tags: atp.Status=draft
              FR_10  # Tags: atp.Status=draft
              FR_100  # Tags: atp.Status=draft
              FR_120  # Tags: atp.Status=draft
              FR_15  # Tags: atp.Status=draft
              FR_150  # Tags: atp.Status=draft
              FR_2  # Tags: atp.Status=draft
              FR_20  # Tags: atp.Status=draft
              FR_200  # Tags: atp.Status=draft
              FR_24  # Tags: atp.Status=draft
              FR_240  # Tags: atp.Status=draft
              FR_25  # Tags: atp.Status=draft
              FR_30  # Tags: atp.Status=draft
              FR_300  # Tags: atp.Status=draft
              FR_48  # Tags: atp.Status=draft
              FR_5  # Tags: atp.Status=draft
              FR_50  # Tags: atp.Status=draft
              FR_60  # Tags: atp.Status=draft
              FR_72  # Tags: atp.Status=draft
              FR_85  # Tags: atp.Status=draft
              FR_User  # Tags: atp.Status=draft
            boolean IEEE1722TpStreamRvfInterlaced: post-build-variant-value=true, set at link in variant link-time / post-build in variant post-build / pre-compile in variant pre-compile  # Defines the RVF stream interlaced (i). Tags: atp.Status=draft | true = 1 false = 0
            enumeration IEEE1722TpStreamRvfPixelDepth: post-build-variant-value=true, set at link in variant link-time / post-build in variant post-build / pre-compile in variant pre-compile  # Definition of the RVF stream pixel_depth. Tags: atp.Status=draft
              PD_10  # Tags: atp.Status=draft
              PD_12  # Tags: atp.Status=draft
              PD_16  # Tags: atp.Status=draft
              PD_8  # Tags: atp.Status=draft
              User  # Tags: atp.Status=draft
            enumeration IEEE1722TpStreamRvfPixelFormat: post-build-variant-value=true, set at link in variant link-time / post-build in variant post-build / pre-compile in variant pre-compile  # Definition of the RVF stream pixel_format. Tags: atp.Status=draft
              PF_4_1_1  # Tags: atp.Status=draft
              PF_4_2_0  # Tags: atp.Status=draft
              PF_4_2_2  # Tags: atp.Status=draft
              PF_4_2_2_4  # Tags: atp.Status=draft
              PF_4_4_4  # Tags: atp.Status=draft
              PF_4_4_4_4  # Tags: atp.Status=draft
              PF_Bayer_bggr  # Tags: atp.Status=draft
              PF_Bayer_gbrg  # Tags: atp.Status=draft
              PF_Bayer_grbg  # Tags: atp.Status=draft
              PF_Bayer_rggb  # Tags: atp.Status=draft
              PF_Monochrome  # Tags: atp.Status=draft
              PF_User  # Tags: atp.Status=draft
            integer IEEE1722TpStreamRvfTotalLines: 0..65535, post-build-variant-value=true, set at link in variant link-time / post-build in variant post-build / pre-compile in variant pre-compile  # Definition of the RVF stream total_lines. Tags: atp.Status=draft
    container IEEE1722TpGeneral  # Specifies the general configuration parameters of the IEEE1722Tp. Tags: atp.Status=draft
      boolean IEEE1722TpDevErrorDetect: set at pre-compile, default-value=false  # Switches the development error detection and notification on or off. Tags: atp.Status=draft | * true: detection and notification is enabled. * false: detection and notification is disabled.
      boolean IEEE1722TpVersionInfoApi: set at pre-compile, default-value=false  # If true the IEEE1722Tp_GetVersionInfo API is available. Tags: atp.Status=draft
      container IEEE1722TpMainFunctionRx  # Defines the IEEE1722TpMainFunctionRx. Tags: atp.Status=draft
        float IEEE1722TpMainFunctionRxPeriod: 0..INF, set at pre-compile  # Specifies the period of the Rx main function IEEE1722Tp_MainFunctionRx in seconds. Tags: atp.Status=draft
        reference IEEE1722TpMainFunctionRxPartitionRef [0..1]: scope=ECU, multiplicity set at pre-compile, set at pre-compile, destination=EcucPartition  # Reference to EcucPartition, where the IEEE1722Tp_MainFunctionRx is assigned to. Tags: atp.Status=draft
      container IEEE1722TpMainFunctionTx  # Defines the IEEE1722TpMainFunctionTx. Tags: atp.Status=draft
        float IEEE1722TpMainFunctionTxPeriod: 0..INF, set at pre-compile  # Specifies the period of the Tx main function IEEE1722Tp_MainFunctionTx in seconds. Tags: atp.Status=draft
        reference IEEE1722TpMainFunctionTxPartitionRef [0..1]: scope=ECU, multiplicity set at pre-compile, set at pre-compile, destination=EcucPartition  # Reference to EcucPartition, where the IEEE1722Tp_MainFunctionTx is assigned to. Tags: atp.Status=draft
  module definition IKE [0..1]: variants pre-compile  # Description for the Internet Key Exchange.
    container IKECertificates  # Container for configuration of IKE certificates.
      integer IKEMaxPublicKeyLength: 64..4096, multiplicity set at pre-compile, set at pre-compile, default-value=96  # The maximum length of the public key in a certificate. | Choose 64 for ECDSA-256, 96 for ECDSA-384, etc.
      integer IKEMaxSubjectNameSize: 32..1024, multiplicity set at pre-compile, set at pre-compile, default-value=256  # The maximum size of the Subject Name field in certificates.
      reference IKECertificateBufferRef [2..2]: multiplicity set at pre-compile, set at pre-compile, requires-symbolic-name-value=true, destination=CsmKey  # The referenced keys are used as buffers for temporarily storing the peer certificates.
      container IKECertificate [2..65534]: multiplicity set at pre-compile  # Container for configuration of an identity certificate and its issuer certificate. | Use this container to configure a valid chain of certificates. The top-level certificate must be a self-signed certificate.
        reference IKEIssuerCertificateRef: multiplicity set at pre-compile, set at pre-compile, destination=IKECertificate  # The referenced certificate is the Issuer Certificate. The Issuer Certificate is used to identifiy the certificate authority (CA) which is the issuer of the Identity Certificate. The associated public key is used for verification of the certificate.
        reference KEIdentityCertificateRef: multiplicity set at pre-compile, set at pre-compile, requires-symbolic-name-value=true, destination=CsmKey  # The referenced key is the Identity Certificate which is used to identifiy an entity and to associate that identiy with a public key.
    container IKEConnections  # Container for configuration of IKE connections.
      float IKEConnectionTimeout: 1..60, multiplicity set at pre-compile, set at pre-compile, default-value=30  # Timeout for etsablishing a connection in order to handle a "half open" state.
      integer IKEFragmentSize: 576..4096, multiplicity set at pre-compile, set at pre-compile, default-value=1280  # The maximum size of IKE fragment messages when fragmentation is used. | The resulting buffer size for subsequent fragment messages is (Number of Fragments * Fragment Size). This fragment size is the maximum IP datagram size, used for both RX and TX.
      integer IKELocalPort: 0..65535, multiplicity set at pre-compile, set at pre-compile, default-value=500  # The local port is the UDP port to listen to.
      integer IKEMaxNumFragments: 1..10, multiplicity set at pre-compile, set at pre-compile, default-value=3  # The maximum number of fragment messages into which the an IKE message might be divided. If this value is set to 1, fragmentation is not supported. | The resulting buffer size for subsequent fragment messages is (Number of Fragments * Fragment Size). Used for both RX and TX and affects size of TX buffer.
      float IKEReassemblingTimeout: 0.1..60, multiplicity set at pre-compile, set at pre-compile, default-value=0.5  # The timeout for reassembling a fragmented message. All fragments of a message must be received within this interval, Otherwise all so far received fragments are discarded.
      float IKERetransmitBase: 1..2, multiplicity set at pre-compile, set at pre-compile, default-value=1.3  # The base used for calculation of the exponantioal back-off of the retransmit timeouts.
      float IKERetransmitTimeout: 1..60, multiplicity set at pre-compile, set at pre-compile, default-value=1.5  # The initial retransmit timeout.
      integer IKERetransmitTries: 0..255, multiplicity set at pre-compile, set at pre-compile, default-value=10  # The maximum number of retransmits of a request before giving up.
      container IKEConnection [1..*]: multiplicity set at pre-compile  # Container for configuration of IKE connection.
        boolean IKEAutostart: multiplicity set at pre-compile, set at pre-compile, default-value=true  # If enabled, IKE wil automatically initiate an IKE SA on this connection after start-up of the module.
        integer IKEConnectionId: 0..4294967295, multiplicity set at pre-compile, set at pre-compile, default-value=0  # Identifier of the connection.
        float IKEDpdDelay: 0..1000000000, multiplicity set at pre-compile, set at pre-compile, default-value=30  # Specifies the interval in which Dead Peer Detection (DPD) packets shall be sent in the absence of other traffic | Set to 0 to disable sending DPD packets.
        float IKEIkeLifetime: 0..1000000000, multiplicity set at pre-compile, set at pre-compile, default-value=86400  # Specifies the time after which an IKE SA is terminated. | Set to 0 if IKE SA never expires.
        float IKEIkeMarginTime: 10..1000000000, multiplicity set at pre-compile, set at pre-compile, default-value=600  # Specifies how many seconds before expiry an IKE SA should be renegotiated.
        string IKERemoteAddress: multiplicity set at pre-compile, set at pre-compile  # The remote address is the IP address of the ECU which a IKE connection shall be established with, e.g. 192.168.50.101.
        integer IKERemotePort: 0..65535, multiplicity set at pre-compile, set at pre-compile, default-value=500  # The remote port is the UDP port of the ECU which a IKE connection shall be established with.
        reference IKEECUCertificateRef [0..1]: multiplicity set at pre-compile, set at pre-compile, destination=IKECertificate  # The ECU certificate is the end-entity certificate. | The referenced certificate is the ECU certificate which cortains the public key used for authentication during the IKE connection setup.
        reference IKEECUPreSharedKeyRef [0..1]: multiplicity set at pre-compile, set at pre-compile, requires-symbolic-name-value=true, destination=CsmKey  # The ECU's pre-shared key.
        reference IKERemotePreSharedKeyRef [0..1]: multiplicity set at pre-compile, set at pre-compile, requires-symbolic-name-value=true, destination=CsmKey  # The referenced key is the key which is used to identify the remote ECU during the IKE connection setup.
        reference IKETcpIpLocalAddressRef: multiplicity set at pre-compile, set at pre-compile, requires-symbolic-name-value=true, destination=TcpIpLocalAddr  # IP address table identifier assigned by TCP/IP stack.
        reference IKETrustAnchorCertificateRef [0..1]: multiplicity set at pre-compile, set at pre-compile, destination=IKECertificate  # The referenced certificate is the Trust Anchor certificate which is used to identify the trusted Certification Authorities during the IKE connection setup.
        container IKESession [1..255]: multiplicity set at pre-compile  # Container for configuration of IKE session.
          container IKEChildSaProposal [1..65536]: multiplicity set at pre-compile  # Container for configuration of IKE Authentication Header (AH) or Encapsulating Security Payload (ESP) Security Association Proposals.
            enumeration IKESecurityProtocol: {IKE_PROTOCOL_AH, IKE_PROTOCOL_ESP}, multiplicity set at pre-compile, set at pre-compile, default-value=IKE_PROTOCOL_AH  # The security protocol (i.e., AH or ESP) to be used for this Child SA.
            boolean IKEUseExtendedSequenceNumbers: multiplicity set at pre-compile, set at pre-compile, default-value=true  # Whether this Child SA should use Extended Sequence Numbers (ESN), i.e., 64-Bit instead of 32-Bit sequence numbers.
            reference IKEEncrTransformRef [0..1]: multiplicity set at pre-compile, set at pre-compile, destination=TcpIpEncryptionAlgorithm  # The referenced Encryption Algorithm is added to this proposal. | Leave empty for AH and ESP in authentication-only mode.
            reference IKEIntegTransformRef: multiplicity set at pre-compile, set at pre-compile, destination=TcpIpIntegrityAlgorithm  # The referenced Integrity Algorithm is added to this proposal.
          container IKEIkeSaProposal [1..*]: multiplicity set at pre-compile  # Container for configuration of IKE IKE Security Association Proposal.
            reference IKEDhTransformRef: multiplicity set at pre-compile, set at pre-compile, destination=IKEDhTransform  # The referenced Diffie-Hellman Group Transform is added to this proposal.
            reference IKEEncrTransformRef: multiplicity set at pre-compile, set at pre-compile, destination=IKEEncrTransform  # The referenced Encryption Algorithm Transform is added to this proposal.
            reference IKEIntegTransformRef: multiplicity set at pre-compile, set at pre-compile, destination=IKEIntegTransform  # The referenced Integrity Algorithm Transform is added to this proposal.
            reference IKEPrfTransformRef: multiplicity set at pre-compile, set at pre-compile, destination=IKEPrfTransform  # The referenced Pseudorandom Function Transform is added to this proposal.
          container IKESignatureAuthenticationVariant [1..*]: multiplicity set at pre-compile  # Defining variants for the IKEv2 Authentication Method "Digitial Signature".
            enumeration IKEHashAlgorithm: {IKE_HASH_ALGO_SHA1, IKE_HASH_ALGO_SHA2_256, IKE_HASH_ALGO_SHA2_384, IKE_HASH_ALGO_SHA2_512}, multiplicity set at pre-compile, set at pre-compile, default-value=IKE_HASH_ALGO_SHA1  # Pre-hashing Algorithm. | Please adapt to the referenced Csm jobs.
            enumeration IKESignatureAlgorithm: {IKE_SIGNATURE_DSA, IKE_SIGNATURE_ECDSA, IKE_SIGNATURE_RSASSA_PSS, IKE_SIGNATURE_RSA_ENCRYPTION}, multiplicity set at pre-compile, set at pre-compile, default-value=IKE_SIGNATURE_ECDSA  # Signature Algorithm. | Please adapt to the referenced Csm jobs.
            integer IKESignatureLength: 64..1024, multiplicity set at pre-compile, set at pre-compile, default-value=96  # The length of a signature generated by the configured generation job and verified by the configured verification job. | E.g. 64 for ECDSA-256 or 96 for ECDSA-386.
            reference IKESignatureGenerateJobRef: multiplicity set at pre-compile, set at pre-compile, requires-symbolic-name-value=true, destination=CsmJob  # The referenced Csm job is used for the execution of the CsmSignatureGenerate primitive needed for this transform.
            reference IKESignatureVerifyJobRef: multiplicity set at pre-compile, set at pre-compile, requires-symbolic-name-value=true, destination=CsmJob  # The referenced Csm job is used for the execution of the CsmSignatureVerify primitive needed for this transform.
    container IKEGeneral  # General module settings.
      boolean IKEVersionInfoApi: multiplicity set at pre-compile, set at pre-compile, default-value=false  # Pre-processor switch to enable and disable availability of the API IKE_GetVersionInfo(). | * True: API IKE_GetVersionInfo() is available. * False: API IKE_GetVersionInfo() is not available.
      reference IKEHashJobRef: requires-symbolic-name-value=true, destination=CsmJob  # The referenced crypto job is used to calculate the SHA-1 hash of the Subject Public Key Info element needed for the encoding of the certification authorities.
      reference IKERandomJobRef: multiplicity set at pre-compile, set at pre-compile, requires-symbolic-name-value=true, destination=CsmJob  # The referenced crypto job is used for random number generation.
      reference IKETcpIpSocketOwner: multiplicity set at pre-compile, set at pre-compile, requires-symbolic-name-value=true, destination=TcpIpSocketOwner  # The ID of the socket user.
      container IKEMessageFormat: multiplicity set at pre-compile  # In order to deserialize the byte stream of IKE messages to data structures memory is statically allocated. Use the parameters in this container to minimize the used memory. But, configuring too low maximum values might result in unsuccessful deserializations of received IKE messages.
        integer IKEMaxAttributesPerTransform: 1..2, multiplicity set at pre-compile, set at pre-compile, default-value=2  # The maximum number of attributes a transform may contain.
        integer IKEMaxCertPayloadsPerMessage: 1..4, multiplicity set at pre-compile, set at pre-compile, default-value=4  # The maximum number of Certificate payloads an IKE message may contain.
        integer IKEMaxCertreqPayloadsPerMessage: 1..4, multiplicity set at pre-compile, set at pre-compile, default-value=4  # The maximum number of Certificate Request payloads an IKE message may contain.
        integer IKEMaxDeletePayloadsPerMessage: 1..2, multiplicity set at pre-compile, set at pre-compile, default-value=2  # The maximum number of Delete payloads an IKE message may contain.
        integer IKEMaxInitMessageSize: 256..3000, multiplicity set at pre-compile, set at pre-compile, default-value=512  # The maximum size of incoming IKE_INIT messages.
        integer IKEMaxNonceSize: 32..512, multiplicity set at pre-compile, set at pre-compile, default-value=64  # The maximum size of incoming nonces. | Must be be at least 32 bytes and at least half the key size of the largest configured pseudorandom function (PRF).
        integer IKEMaxNotifyPayloadsPerMessage: 1..10, multiplicity set at pre-compile, set at pre-compile, default-value=10  # The maximum number of Notify payloads an IKE message may contain.
        integer IKEMaxPayloadsPerMessage: 1..20, multiplicity set at pre-compile, set at pre-compile, default-value=20  # The maximum number of payloads an IKE message may contain.
        integer IKEMaxProposalsPerSaPayload: 1..5, multiplicity set at pre-compile, set at pre-compile, default-value=5  # The maximum number of proposals a SA payload may contain.
        integer IKEMaxSpisPerDeletePayload: 1..2, multiplicity set at pre-compile, set at pre-compile, default-value=2  # The maximum number of SPIs a Delete payload may contain.
        integer IKEMaxTrafficSelectorsPerTsPayload: 1..2, multiplicity set at pre-compile, set at pre-compile, default-value=2  # The maximum number of traffic selectors a Traffic Selector payload may contain.
        integer IKEMaxTransformsPerProp: 1..5, multiplicity set at pre-compile, set at pre-compile, default-value=5  # The maximum number of transforms a proposal may contain.
    container IKETransforms  # Container for configuration of IKE transforms.
      container IKEDhTransform [1..*]: multiplicity set at pre-compile  # Container for configuration of Diffie-Hellman Group Transform.
        enumeration IKETransformId: {IKE_TRANSFORM_DH_1024_BIT_MODP_GROUP, IKE_TRANSFORM_DH_1024_BIT_MODP_GROUP_WITH_160_BIT_PRIME_ORDER_SUBGROUP, IKE_TRANSFORM_DH_1536_BIT_MODP_GROUP, IKE_TRANSFORM_DH_192_BIT_RANDOM_ECP_GROUP, IKE_TRANSFORM_DH_2048_BIT_MODP_GROUP, IKE_TRANSFORM_DH_2048_BIT_MODP_GROUP_WITH_224_BIT_PRIME_ORDER_SUBGROUP, IKE_TRANSFORM_DH_2048_BIT_MODP_GROUP_WITH_256_BIT_PRIME_ORDER_SUBGROUP, IKE_TRANSFORM_DH_224_BIT_RANDOM_ECP_GROUP, IKE_TRANSFORM_DH_256_BIT_RANDOM_ECP_GROUP, IKE_TRANSFORM_DH_3072_BIT_MODP_GROUP, IKE_TRANSFORM_DH_384_BIT_RANDOM_ECP_GROUP, IKE_TRANSFORM_DH_4096_BIT_MODP_GROUP, IKE_TRANSFORM_DH_521_BIT_RANDOM_ECP_GROUP, IKE_TRANSFORM_DH_6144_BIT_MODP_GROUP, IKE_TRANSFORM_DH_768_BIT_MODP_GROUP, IKE_TRANSFORM_DH_8192_BIT_MODP_GROUP, IKE_TRANSFORM_DH_BRAINPOOLP224R1, IKE_TRANSFORM_DH_BRAINPOOLP256R1, IKE_TRANSFORM_DH_BRAINPOOLP384R1, IKE_TRANSFORM_DH_BRAINPOOLP512R1, IKE_TRANSFORM_DH_CURVE25519, IKE_TRANSFORM_DH_CURVE448}, multiplicity set at pre-compile, set at pre-compile, default-value=IKE_TRANSFORM_DH_256_BIT_RANDOM_ECP_GROUP  # Diffie-Hellman Group Transform ID.
        reference IKEKeyRef: multiplicity set at pre-compile, set at pre-compile, requires-symbolic-name-value=true, destination=CsmKey  # The referenced Csm key is used for the execution of key management functions needed for this transform.
      container IKEEncrTransform [1..*]: multiplicity set at pre-compile  # Container for configuration of Encryption Algorithm Transform.
        integer IKEKeyLength: 0..255, multiplicity set at pre-compile, set at pre-compile, default-value=16  # The key length of the encryption algorithm in bytes.
        enumeration IKETransformId: {IKE_TRANSFORM_ENCR_3DES, IKE_TRANSFORM_ENCR_3IDEA, IKE_TRANSFORM_ENCR_AES_CBC, IKE_TRANSFORM_ENCR_AES_CCM_12, IKE_TRANSFORM_ENCR_AES_CCM_16, IKE_TRANSFORM_ENCR_AES_CCM_8, IKE_TRANSFORM_ENCR_AES_CTR, IKE_TRANSFORM_ENCR_AES_GCM_12, IKE_TRANSFORM_ENCR_AES_GCM_16, IKE_TRANSFORM_ENCR_AES_GCM_8, IKE_TRANSFORM_ENCR_BLOWFISH, IKE_TRANSFORM_ENCR_CAMELLIA_CBC, IKE_TRANSFORM_ENCR_CAMELLIA_CCM_12, IKE_TRANSFORM_ENCR_CAMELLIA_CCM_16, IKE_TRANSFORM_ENCR_CAMELLIA_CCM_8, IKE_TRANSFORM_ENCR_CAMELLIA_CTR, IKE_TRANSFORM_ENCR_CAST, IKE_TRANSFORM_ENCR_CHACHA20_POLY1305, IKE_TRANSFORM_ENCR_DES, IKE_TRANSFORM_ENCR_DES_IV32, IKE_TRANSFORM_ENCR_DES_IV64, IKE_TRANSFORM_ENCR_IDEA, IKE_TRANSFORM_ENCR_RC5}, multiplicity set at pre-compile, set at pre-compile, default-value=IKE_TRANSFORM_ENCR_AES_CBC  # Encryption Algorithm Transform ID.
        reference IKEDecryptJobRef: multiplicity set at pre-compile, set at pre-compile, requires-symbolic-name-value=true, destination=CsmJob  # The referenced Csm job is used for the execution of the CsmDecrypt primitive needed for this transform.
        reference IKEEncryptJobRef: multiplicity set at pre-compile, set at pre-compile, requires-symbolic-name-value=true, destination=CsmJob  # The referenced Csm job is used for the execution of the CsmEncrypt primitive needed for this transform.
      container IKEIntegTransform [1..*]: multiplicity set at pre-compile  # Container for configuration of Integrity Algorithm Transform.
        enumeration IKETransformId: {IKE_TRANSFORM_AUTH_AES_CMAC_96, IKE_TRANSFORM_AUTH_AES_XCBC_96, IKE_TRANSFORM_AUTH_DES_MAC, IKE_TRANSFORM_AUTH_HMAC_MD5_128, IKE_TRANSFORM_AUTH_HMAC_MD5_96, IKE_TRANSFORM_AUTH_HMAC_SHA1_160, IKE_TRANSFORM_AUTH_HMAC_SHA1_96, IKE_TRANSFORM_AUTH_HMAC_SHA2_256_128, IKE_TRANSFORM_AUTH_HMAC_SHA2_384_192, IKE_TRANSFORM_AUTH_HMAC_SHA2_512_256, IKE_TRANSFORM_AUTH_KPDK_MD5}, multiplicity set at pre-compile, set at pre-compile, default-value=IKE_TRANSFORM_AUTH_AES_CMAC_96  # Integrity Algorithm Transform ID.
        reference IKEGenerateJobRef: multiplicity set at pre-compile, set at pre-compile, requires-symbolic-name-value=true, destination=CsmJob  # The referenced Csm job is used for the execution of the CsmMacGenerate primitive needed for this transform.
        reference IKEVerifyJobRef: multiplicity set at pre-compile, set at pre-compile, requires-symbolic-name-value=true, destination=CsmJob  # The referenced Csm job is used for the execution of the CsmMacVerify primitive needed for this transform.
      container IKEPrfTransform [1..*]: multiplicity set at pre-compile  # Container for configuration of Pseudorandom Function Transform.
        enumeration IKETransformId: {IKE_TRANSFORM_PRF_AES128_CMAC, IKE_TRANSFORM_PRF_AES128_XCBC, IKE_TRANSFORM_PRF_HMAC_MD5, IKE_TRANSFORM_PRF_HMAC_SHA1, IKE_TRANSFORM_PRF_HMAC_SHA2_256, IKE_TRANSFORM_PRF_HMAC_SHA2_384, IKE_TRANSFORM_PRF_HMAC_SHA2_512, IKE_TRANSFORM_PRF_HMAC_TIGER}, multiplicity set at pre-compile, set at pre-compile, default-value=IKE_TRANSFORM_PRF_HMAC_SHA2_256  # Pseudorandom Function Transform ID.
        reference IKEJobRef: multiplicity set at pre-compile, set at pre-compile, requires-symbolic-name-value=true, destination=CsmJob  # The referenced Csm job is used for the execution of the CsmMacGenerate primitive needed for this transform.
  module definition ISO15118Chrg [0..1]: variants pre-compile  # Configuration of the ISO15118 module. Tags: atp.Status=draft
    container ISO15118ChrgGeneral  # General configuration of the ISO15118 module. Tags: atp.Status=draft
      boolean ISO15118ChrgDevErrorDetect: set at pre-compile, default-value=false  # Switches the development error detection and notification on or off. Tags: atp.Status=draft | * true: detection and notification is enabled. * false: detection and notification is disabled.
      float ISO15118ChrgMainFunctionCycleTime: 0..INF, set at pre-compile  # This parameter defines the cycle time in seconds of the periodic calling of ISO15118Chrg main function. Tags: atp.Status=draft
      boolean ISO15118ChrgVersionInfoApi: set at pre-compile, default-value=false  # Enables and disables the version info API. Tags: atp.Status=draft
    container ISO15118ChrgService  # Configuration paramters to configure the ISO15118ChrgService Tags: atp.Status=draft
      reference ISO15118ChrgSoAdSocketConnectionRef: scope=ECU, set at pre-compile, requires-symbolic-name-value=true, destination=SoAdSocketConnection  # Reference to SoAdSocketConnection, which specifies the socket connection of the socket connection group. The ISO15118Chrg receives the SoConId for API calls between ISO15118Chrg and SoAd. The ISO15118Chrg shall use this parameter to access TLS information. Since the referenced SoAdSocketConnection is part of a SoAdSocketConnectionGroup the SoAdSocketTcpTlsConnectionRef of the same SoAdSocketConnectionGroup can be used to retrieve the TLS information. Tags: atp.Status=draft
    container ISO15118ChrgTimer [0..*]  # Configuration of ISO15118Chrg Timers. Tags: atp.Status=draft
      float ISO15118ChrgV2gEvccMsgTimeout: scope=ECU  # This parameter define the maximum time that is allowed between a request and its corresponding response message. Tags: atp.Status=draft
    container ISO15118ChrgV2GTP [0..1]  # Configuration of the Vehicle to Grid Transport Protocol Tags: atp.Status=draft
      reference ISO15118ChrgV2GSrcTcpDataRef: scope=ECU, multiplicity set at pre-compile, set at pre-compile, destination=SoAdSocketConnectionGroup  # Reference to SoAdSocketConnectionGroup to access the local IP address and TCP port for building the endpoint option to send V2G messages. Tags: atp.Status=draft
      reference ISO15118ChrgV2GUdpSdpClientRef [0..1]: scope=ECU, multiplicity set at pre-compile, set at pre-compile, destination=SoAdSocketConnectionGroup  # Reference to SoAdSocketConnectionGroup to access the local IP address and Udp port for building the endpoint option for SECC discovery process. Tags: atp.Status=draft
      container ISO15118ChrgV2GTPPdu [0..1]: multiplicity set at pre-compile, post-build-variant-multiplicity=true  # Contains the configuration parameters of the ISO15118 module's Pdus that are exchanged between ISO15118 and the PduR. Tags: atp.Status=draft
        integer ISO15118ChrgV2GTPPduHandleId [0..1]: 0..65535, scope=ECU, multiplicity set at pre-compile, set at pre-compile, symbolic-name-value=true  # PDU identifier assigned by ISO15118Chrg module. Tags: atp.Status=draft | The parameter is required by the API calls ISO15118_V2GTpRxIndication, ISO15118_V2GTpCopyRxData, ISO15118_V2GTpStartOfReception to receive I-PDUs from the PduR. For Tx-I-PDUs this handle Id is used for the APIs calls ISO15118_V2GTpTxConfirmation, ISO15118_V2GTpCopyTxData to transmit respectively confirm transmissions of I-PDUs.
        integer ISO15118ChrgV2GTPPduPayloadType: 0..65535  # This parameter contains the information about how to decode the payload following the V2GTP header. Tags: atp.Status=draft
        integer ISO15118ChrgV2GTPPduProtocolVersion: 0..255  # This parameter specifies the protocol version of the V2GTP message that is transmitted in the Pdu. Tags: atp.Status=draft
        reference ISO15118ChrgV2GTPPduRef: set at pre-compile, destination=Pdu  # Reference to the "global" Pdu structure to allow harmonization of handle IDs in the COM-Stack. Tags: atp.Status=draft
  module definition Icu [0..1]: post-build-variant-support=true, variants post-build/pre-compile  # Configuration of the Icu (Input Capture Unit) module.
    container IcuConfigSet  # This container contains the configuration parameters and sub containers of the AUTOSAR Icu module.
      integer IcuMaxChannel: 0..65535, post-build-variant-value=true, set at post-build in variant post-build / pre-compile in variant pre-compile  # This parameter contains the number of Channels configured. It will be gathered by tools during the configuration stage. | calculationFormula = Number of configured Icu Channels Implementation Type: Icu_ChannelType
      container IcuChannel [1..*]  # Configuration of an individual ICU channel.
        integer IcuChannelId: 0..65535, scope=ECU, set at pre-compile, symbolic-name-value=true  # Channel Id of the ICU channel. This value will be assigned to the symbolic name derived of the IcuChannel container short name.
        enumeration IcuDefaultStartEdge: {ICU_BOTH_EDGES, ICU_FALLING_EDGE, ICU_RISING_EDGE}, post-build-variant-value=true, set at post-build in variant post-build / pre-compile in variant pre-compile  # Configures the default-activation-edge which shall be used for this channel if there was no activation-edge configured by the call of service Icu_SetActivationCondition(). | In case the Measurement Mode is "IcuSignalMeasurement" and the properties "DutyCycle" or "Period" are set, the edge configured here is used as Default Period Start Edge. Implementation Type: Icu_ActivationType
        enumeration IcuMeasurementMode: {ICU_MODE_EDGE_COUNTER, ICU_MODE_SIGNAL_EDGE_DETECT, ICU_MODE_SIGNAL_MEASUREMENT, ICU_MODE_TIMESTAMP}, post-build-variant-value=true, set at post-build in variant post-build / pre-compile in variant pre-compile  # Configures the measurement mode of this channel. | Implementation Type: Icu_MeasurementModeType
        boolean IcuWakeupCapability: post-build-variant-value=true, set at post-build in variant post-build / pre-compile in variant pre-compile  # Information about the wakeup-capability of this channel. | true: Channel is wakeup capable. false: Channel is not wakeup capable.
        reference IcuChannelEcucPartitionRef [0..*]: scope=ECU, multiplicity set at pre-compile, post-build-variant-multiplicity=true, post-build-variant-value=true, set at pre-compile, destination=EcucPartition  # Maps an ICU channel to zero or multiple ECUC partitions to limit the access to this channel. The ECUC partitions referenced are a subset of the ECUC partitions where the ICU driver is mapped to.
        container IcuSignalEdgeDetection [0..1]  # This container contains the configuration (parameters) in case the measurement mode is "IcuSignalEdgeDetection"
          function name IcuSignalNotification [0..1]: multiplicity set at post-build in variant post-build / pre-compile in variant pre-compile, post-build-variant-multiplicity=true, post-build-variant-value=true, set at post-build in variant post-build / pre-compile in variant pre-compile  # Notification function for signal notification.
        container IcuSignalMeasurement [0..1]  # This container contains the configuration (parameters) in case the measurement mode is "IcuSignalMeasurement"
          enumeration IcuSignalMeasurementProperty: {ICU_DUTY_CYCLE, ICU_HIGH_TIME, ICU_LOW_TIME, ICU_PERIOD_TIME}, post-build-variant-value=true, set at post-build in variant post-build / pre-compile in variant pre-compile  # Configures the property that could be measured in case the mode is "IcuSignalMeasurement". | This property can not be changed during runtime. Implementation Type: Icu_SignalMeasurementPropertyType
        container IcuTimestampMeasurement [0..1]  # This container contains the configuration (parameters) in case the measurement mode is "IcuTimestamp"
          enumeration IcuTimestampMeasurementProperty: {ICU_CIRCULAR_BUFFER, ICU_LINEAR_BUFFER}, post-build-variant-value=true, set at post-build in variant post-build / pre-compile in variant pre-compile  # Configures the handling of the buffer in case the mode is "Timestamp" | Implementation Type: Icu_TimestampBufferType
          function name IcuTimestampNotification [0..1]: multiplicity set at post-build in variant post-build / pre-compile in variant pre-compile, post-build-variant-multiplicity=true, post-build-variant-value=true, set at post-build in variant post-build / pre-compile in variant pre-compile  # Notification function if the number of requested timestamps | (Notification interval > 0) are acquired.
        container IcuWakeup [0..1]  # This container contains the configuration (parameters) needed to configure a wakeup capable channel
          reference IcuChannelWakeupInfo [0..1]: multiplicity set at post-build in variant post-build / pre-compile in variant pre-compile, post-build-variant-multiplicity=true, post-build-variant-value=true, set at post-build in variant post-build / pre-compile in variant pre-compile, requires-symbolic-name-value=true, destination=EcuMWakeupSource  # If the wakeup-capability is true the wakeup source referenced is transmitted to the ECU State Manager (EcuM) . | Implementation Type: reference to EcuM_WakeupSourceType
    container IcuGeneral  # Configuration of general ICU parameters.
      boolean IcuDevErrorDetect: set at pre-compile, default-value=false  # Switches the development error detection and notification on or off. | * true: detection and notification is enabled. * false: detection and notification is disabled.
      boolean IcuReportWakeupSource: set at pre-compile  # Switch for enabling Wakeup source reporting. | true: Report Wakeup source. false: Do not report Wakeup source.
      reference IcuEcucPartitionRef [0..*]: scope=ECU, multiplicity set at pre-compile, post-build-variant-multiplicity=true, post-build-variant-value=true, set at pre-compile, destination=EcucPartition  # Maps the ICU driver to zero or multiple ECUC partitions to make the driver API available in the according partition.
      reference IcuKernelEcucPartitionRef [0..1]: scope=ECU, multiplicity set at pre-compile, post-build-variant-multiplicity=true, post-build-variant-value=true, set at pre-compile, destination=EcucPartition  # Maps the ICU kernel to zero or one ECUC partitions to assign the driver kernel to a certain core. The ECUC partition referenced is a subset of the ECUC partitions where the ICU driver is mapped to.
    container IcuOptionalApis  # This container contains all configuration switches for configuring optional API services of the ICU driver.
      boolean IcuDeInitApi: set at pre-compile  # Adds / removes the service Icu_DeInit() from the code. | true: Icu_DeInit() can be used. false: Icu_DeInit() can not be used.
      boolean IcuDisableWakeupApi: set at pre-compile  # Adds / removes the service Icu_DisableWakeup() from the code. | true: Icu_DisableWakeup() can be used. false: Icu_DisableWakeup() can not be used.
      boolean IcuEdgeCountApi: set at pre-compile  # Adds / removes all services related to the edge counting functionality as listed below, from the code: Icu_ResetEdgeCount(), Icu_EnableEdgeCount(), Icu_DisableEdgeCount(), Icu_GetEdgeNumbers(). | true: The services listed above can be used. false: The services listed above can not be used.
      boolean IcuEdgeDetectApi: set at pre-compile  # Adds / removes the services related to the edge detection functionality, from the code: | Icu_EnableEdgeDetection() and Icu_DisableEdgeDetection(). true: These services can be used. false: These services can not be used.
      boolean IcuEnableWakeupApi: set at pre-compile  # Adds / removes the service Icu_EnableWakeup() from the code. | true: Icu_EnableWakeup() can be used. false: Icu_EnableWakeup() can not be used.
      boolean IcuGetDutyCycleValuesApi: set at pre-compile  # Adds / removes the service Icu_GetDutyCycleValues() from the code. | true: Icu_GetDutyCycleValues() can be used. false: Icu_GetDutyCycleValues() can not be used.
      boolean IcuGetInputStateApi: set at pre-compile  # Adds / removes the service Icu_GetInputState() from the code. | true: Icu_GetInputState() can be used. false: Icu_GetInputState() can not be used.
      boolean IcuGetTimeElapsedApi: set at pre-compile  # Adds / removes the service Icu_GetTimeElapsed() from the code. | true: Icu_GetTimeElapsed() can be used. false: Icu_GetTimeElapsed() can not be used.
      boolean IcuGetVersionInfoApi: set at pre-compile, default-value=false  # Adds / removes the service Icu_GetVersionInfo() from the code. | true: Icu_GetVersionInfo() can be used. false: Icu_GetVersionInfo() can not be used.
      boolean IcuSetModeApi: set at pre-compile  # Adds / removes the service Icu_SetMode() from the code. | true: Icu_SetMode() can be used. false: Icu_SetMode() can not be used.
      boolean IcuSignalMeasurementApi: set at pre-compile  # Adds / removes the services Icu_StartSignalMeasurement() and Icu_StopSignalMeasurement() from the code. | true: Icu_StartSignalMeasurement() and Icu_StopSignalMeasurement() can be used. false: Icu_StartSignalMeasurement() and Icu_StopSignalMeasurement() can not be used.
      boolean IcuTimestampApi: set at pre-compile  # Adds / removes all services related to the timestamping functionality as listed below from the code: Icu_StartTimestamp(), Icu_StopTimestamp(), Icu_GetTimestampIndex(). | true: The services listed above can be used. false: The services listed above can not be used.
      boolean IcuWakeupFunctionalityApi: set at pre-compile  # Adds / removes the service Icu_CheckWakeup() from the code. | true: Icu_CheckWakeup() can be used. false: Icu_CheckWakeup() cannot be used.
  module definition IdsM [0..1]: variants pre-compile  # Configuration of the IdsM module. Tags: atp.Status=draft
    container IdsMConfiguration  # Configuration parameters of the module IdsM. Tags: atp.Status=draft
      container IdsMBlockState [0..16]: multiplicity set at pre-compile  # Configuration of an IdsM blocking state used in the IdsMStateBlockFilter to suspend the collection of security events. Tags: atp.Status=draft | The active state is reported by the BswM via IdsM_BswM_StateChanged().
        integer IdsMBlockStateID: 0..15, scope=ECU, set at pre-compile, symbolic-name-value=true  # This value specifies the identifier of this block state. Tags: atp.Status=draft
      container IdsMBufferConfiguration  # Configuration of the event buffers and context data buffers used by IdsM. Tags: atp.Status=draft
        enumeration IdsMEventDisplacementStrategy: {IDSM_BUFFER_DISPLACEMENT_DROP_LATEST, IDSM_BUFFER_DISPLACEMENT_SEVERITY_BASED}, set at pre-compile  # his parameter specifies the IdsM the displacement approach in the IdsMEventBuffer and IdsMQualifiedEventBuffers.
        container IdsMContextDataBuffer [0..65535]: multiplicity set at pre-compile  # Buffer that is reserved to store the context data of SEvs. Tags: atp.Status=draft | Depending on the type of SEv that is processed, there can be significant differences in sizes of the context data.
          integer IdsMContextDataBufferSize: 1..1500, set at pre-compile  # Size of the context data buffer in bytes. Tags: atp.Status=draft | It is recommended to configure buffers with an appropriate size depending on the configured SEvs.
          integer IdsMNumberOfContextDataBuffers: 1..65535, set at pre-compile  # The number of buffers with the configured buffer size specified in IdsMContextDataBufferSize. Tags: atp.Status=draft | It is recommended to configure an appropriate number of buffers depending on the configured SEvs.
        container IdsMEventBuffers  # Buffers used to store the SEvs. Tags: atp.Status=draft
          integer IdsMNumberOfEventBuffers: 1..65535, set at pre-compile  # The number of event buffers used to store the SEvs. Tags: atp.Status=draft | The suggested number of buffers can be calculated as follows: IdsMNumberOfBuffers = Number of Aggregation Filter Instances + Upper bound of parallel processed SEvs. Number of Aggregation Filter Instances = The number of configured SEvs that use a filter chain that contains an aggregation filter. Upper bound of parallel processed SEvs = 10% of the number of configured SEvs.
        container IdsMQualifiedEventBuffers  # Buffers used to store the QSEvs.
          integer IdsMNumberOfQualifiedEventBuffers: 1..65535, set at pre-compile  # The number of qualified event buffers used to store the SEvs. Tags: atp.Status=draft | Depending on the rate at which QSEvs are generated and the rate at which the sinks can consume them successfully, the number of QSEv buffers can be determined, e.g., assuming the sink SinkIdsR has a worst-case TxConfirmation latency of "k" milliseconds, if for every "n" millisecond period where "n" is considerably larger than "k", at the maximum "m" QSEv can be generated, IdsM would need at least "m" IdsMNumberOfQualifiedEventBuffers to prevent dropping QSEvs. The window "n" can be chosen as any interval considerably larger than "k" and where the peak QSEv generation rate can be estimated. Therefore IdsMNumberOfQualifiedEventBuffers >= n/k.
      container IdsMContextDataModification [0..1]: multiplicity set at pre-compile  # Configuration of context data modifier callouts.
        string IdsMGlobalContextDataHeaderFileIncludes [0..*]: multiplicity set at pre-compile, set at pre-compile, min-length=0  # List of optional header files which contains the prototypes of the context data modifier callouts.
        function name IdsMGlobalContextDataModifierCalloutFct [0..1]: multiplicity set at pre-compile, set at pre-compile  # Global context data modifier callout function. This callout can be overruled by event-specific context data modifier callouts.
        integer IdsMGlobalContextDataSizeModifier [0..1]: -1499..1499, multiplicity set at pre-compile, set at pre-compile, default-value=0  # Global context data size modifier used in combination with global context data size modifier callout function.
        container IdsMContextDataModifierCallout [0..65535]: multiplicity set at pre-compile  # Configuration of event specific context data modifier callouts.
          function name IdsMContextDataModifierCalloutFct: set at pre-compile  # Event specific context data modifier callout function. If the global context data modifier callout is configured, it can be overruled by this event-specific callout.
          integer IdsMContextDataSizeModifier: -1499..1499, set at pre-compile, default-value=0  # Event specific context data size modifier used in combination with event specific context data size modifier callout function.
      container IdsMEvent [1..65535]: multiplicity set at pre-compile  # Configuration of the IdsM Event unit which is reported by a sensor and its parameters.
        integer IdsMEventSeverity [0..1]: 0..255, multiplicity set at pre-compile, set at pre-compile, default-value=0  # The severity level of a security event. | The severity of the event is used for determining the event to be dropped when buffers are full. Severity 0 is interpreted as the lowest and 255 as the highest severity.
        integer IdsMExternalEventId: 0..65534, set at pre-compile  # The external security event ID which is reported to the sink.There are two different value ranges depending on the referencing module: Tags: atp.Status=draft | Standarized SEv ID is defined by the AUTOSAR specification.This ID is usually derived from the SecXT. Standard ID range: 0x0000 - 0x8000 Generic User Event ID is defined by the user. Used when the SEv is not defined by the AUTOSAR specification, for example from a SW-C or a CDD. Generic ID range: 0x8000 - 0xFFFE. 0xFFFF is considered an invalid ID
        integer IdsMInternalEventId: 0..65535, scope=ECU, set at pre-compile, symbolic-name-value=true, default-value=65535  # Consecutive number used internally as an identifier by the IdsM module. Tags: atp.Status=draft | This number is calculated internally and shall not be configured manually. This parameter is only available to publish the result of this calculation. Applications using IdsM APIs shall not rely on the value of this parameter. Instead, they shall use the symbolic name value.
        enumeration IdsMReportingModeFilter: set at pre-compile  # The reporting mode filter defines the level of detail of the reporting. Whether SEv should be dropped, forwarded with context data or forwarded without context data. Tags: atp.Status=draft | The parameter determines if the SEv is either: - dropped (OFF) - sent without context data (BRIEF) - sent with context data (DETAILED) - sent without context data, ignoring the rest of the filter chain (BRIEF_BYPASSING_FILTERS) - sent with context data ignoring the rest of the filter chain (DETAILED_BYPASSING_FILTERS)
          BRIEF  # Tags: atp.Status=draft
          BRIEF_BYPASSING_FILTERS  # Tags: atp.Status=draft
          DETAILED  # Tags: atp.Status=draft
          DETAILED_BYPASSING_FILTERS  # Tags: atp.Status=draft
          OFF  # Tags: atp.Status=draft
        integer IdsMSensorInstanceId: 0..65535, set at pre-compile, default-value=0  # The instance ID of the sensor which reports security events to the IdsM. Tags: atp.Status=draft | If there is only one instance of a sensor, the default ID is 0.
        boolean IdsMSinkDem: set at pre-compile, default-value=false  # The QSEv will be sent to the Dem Module into a Security Event Memory (Sem) to persist it on the local ECU. Tags: atp.Status=draft
        boolean IdsMSinkIdsR: set at pre-compile, default-value=false  # The QSEv will be sent to the IDS Reporter. Tags: atp.Status=draft
        reference IdsMDemEventReference [0..1]: scope=ECU, multiplicity set at pre-compile, set at pre-compile, requires-symbolic-name-value=true, destination=DemEventParameter  # Reference to DemEventParameter used for sinking QSEv into Dem.
        reference IdsMFilterChainRef [0..1]: multiplicity set at pre-compile, set at pre-compile, destination=IdsMFilterChain  # Reference to a configured IdsM filter chain. Tags: atp.Status=draft
        container IdsMContextDataModifierOptions [0..1]: multiplicity set at pre-compile  # Adittional configuration parameters of a SEv to be able to modify incoming context data.
          reference IdsMContextDataModifierCalloutRef: set at pre-compile, destination=IdsMContextDataModifierCallout  # Reference to event specific context data modifier callout function.
        container IdsMServiceInterfaceOptions [0..1]: multiplicity set at pre-compile  # Adittional configuration parameters of a SEv when the sensor is a SW-C or application. Tags: atp.Status=draft
          boolean IdsMEventEnableTimestampReporting: scope=ECU, set at pre-compile  # Enables/disables reporting of timestamps over C/S interfaces. | * true: reporting is enabled. * false: reporting is disabled.
          integer IdsMEventMaxContextDataSize: 0..1500, set at pre-compile, default-value=0  # Maximum number of bytes used by the IdsM and the RTE when forwarding context data of the corresponding security event. Tags: atp.Status=draft | This parameter is only used for SW-C use cases. This is the maximum amount of bytes defined for transmission of the context data. In case this is a Basic Software Module SEv, the configuration of this parameter is not necessary and will be ignored.
      container IdsMFilterChain [0..*]: multiplicity set at pre-compile  # A filter chain is a combination of filters that affects one or more SEvs. Tags: atp.Status=draft | A filter receives a SEv, checks condition(s) and, e.g. - forwards SEv immediately/later - drops SEv - stores SEv - modifies SEv Consider that the filter order is defined as follows: - Reporting Mode Level (per SEv ID) - Block State (per SEv ID) - Forward Every nth (per SEv ID) - Event Aggregation (per SEv ID) - Event Threshold (per SEv ID) - Event Rate Limitation (per IdsM Instance) - Traffic Limitation (per IdsM Instance)
        container IdsMBlockStateFilter [0..1]: multiplicity set at pre-compile  # This state filter drops SEvs if the current State reported by the BswM is in this state filter list. Tags: atp.Status=draft
          reference IdsMBlockStateReference [1..16]: multiplicity set at pre-compile, set at pre-compile, destination=IdsMBlockState  # The collection of SEvs during this state will be suspended. Tags: atp.Status=draft
        container IdsMEventAggregationFilter [0..1]: multiplicity set at pre-compile  # All received events of a certain event ID that are received by this filter during a single aggregation time interval are not forwarded immediately. Tags: atp.Status=draft | Instead, only the last or the first received SEv is stored in an aggregation buffer, depending on the configuration of "IdsMContextDataSourceSelector". The counter field of the SEv is modified so that it contains the sum of the counter fields of all incoming SEvs during the current aggregation time interval. At the end of the aggregation time interval, the buffered SEv is sent out and the aggregation buffer is cleared. If there was no incoming SEv until the end of the aggregation time interval, no message will be sent.
          enumeration IdsMContextDataSourceSelector: set at pre-compile  # The resulting SEv from the aggregation filter contains the context data from one of the following two sources: Tags: atp.Status=draft | IDSM_FILTERS_CTX_USE_FIRST = ContextData of first received SEv is used for resulting QSEv. IDSM_FILTERS_CTX_USE_LAST = ContextData of last received SEv is used for resulting QSEv.
            IDSM_FILTERS_CTX_USE_FIRST  # Tags: atp.Status=draft
            IDSM_FILTERS_CTX_USE_LAST  # Tags: atp.Status=draft
          float IdsMEventAggregationTimeInterval: 0..INF, set at pre-compile  # Length of the aggregation time interval (as float in seconds). Tags: atp.Status=draft | Note: Shall be configured as a multiple of the IdsM main function period.
        container IdsMEventThresholdFilter [0..1]: multiplicity set at pre-compile  # During each time interval "IdsMEventThresholdTimeInterval", the filter drops the first "IdsMEventThresholdNumber - 1" SEvs and forwards all other incoming SEvs immediately until the end of the time interval. Tags: atp.Status=draft
          integer IdsMEventThresholdNumber: 2..65535, set at pre-compile  # This parameter assigns the threshold 'p' for each SEv ID affected by this threshold filter. Tags: atp.Status=draft | All SEvs ' p-1' are dropped, SEvs equal or greater than 'p' are forwarded.
          float IdsMEventThresholdTimeInterval: 0..INF, set at pre-compile  # Length of the threshold time interval (as float in seconds). Tags: atp.Status=draft | Note: Shall be configured as a multiple of the IdsM main function period.
        container IdsMForwardEveryNthFilter [0..1]: multiplicity set at pre-compile  # Out of all incoming SEVs, drop all but every nth. Those will be forwarded without modification. Tags: atp.Status=draft
          integer IdsMNthParameter: 2..65535, set at pre-compile  # For each SEv ID for which this filter is configured, this parameter assigns the appropriate n. Tags: atp.Status=draft | Only 1 from n SEvs will be forwarded.
      container IdsMPdus [0..1]: multiplicity set at pre-compile  # Configuration of the PDU references used to send the events data. Tags: atp.Status=draft
        container IdsMIfTxPdu [0..1]: multiplicity set at pre-compile  # IF PDU used to transmit a QSEv via the PduR to the IdsR. Tags: atp.Status=draft | If the total size of the QSEv's data to be transmitted fits in a single frame of the underlying bus, the IF PDU is used.
          integer IdsMIfTxPduHandleId: 0..0, scope=ECU, set at pre-compile, symbolic-name-value=true, default-value=0  # IdsM does not use this parameter, content will be ignored. Tags: atp.Status=draft | The existence of this parameter is needed by PduR.
          reference IdsMIfTxPduRef: scope=ECU, set at pre-compile, destination=Pdu  # Reference to the IF PDU used for transmission of the QSEvs. Tags: atp.Status=draft
        container IdsMTpTxPdu [0..1]: multiplicity set at pre-compile  # TP PDU used to transmit a QSEv via the PduR to the IdsR. Tags: atp.Status=draft | If the total size of the QSEv's data to be transmitted is bigger than the size of a single frame of the underlying bus, the TP PDU is used.
          integer IdsMTpTxPduHandleId: 0..0, scope=ECU, set at pre-compile, symbolic-name-value=true, default-value=0  # IdsM does not use this parameter, content will be ignored. Tags: atp.Status=draft | The existence of this parameter is needed by PduR.
          reference IdsMTpTxPduRef: scope=ECU, set at pre-compile, destination=Pdu  # Reference to the TP PDU used for transmission of the QSEvs. Tags: atp.Status=draft
    container IdsMGeneral  # General configuration parameters of IdsM. Tags: atp.Status=draft
      boolean IdsMDevErrorDetect: set at pre-compile  # This parameter enables/disables the Development Error Detection and Notification. Tags: atp.Status=draft | true: Development error detection is enabled. false: Development error detection is disabled. Note: In general, the development error detection is recommended during pre-test phase. It is not recommended to enable the development error detection in production code due to increased runtime and ROM needs.
      boolean IdsMDiagnosticSupport: set at pre-compile, default-value=false  # Enables or disables the Dcm APIs which are used to read and write certain values of the IdsM module through the diagnostic communication manager. Tags: atp.Status=draft | true: Dcm APIs are enabled false: Dcm APIs are disabled
      boolean IdsMEnableSecurityEventReporting: set at pre-compile, default-value=false  # Switches the reporting of internal security events. Tags: atp.Status=draft | * true: reporting is enabled. * false: reporting is disabled.
      integer IdsMInstanceId: 0..1023, set at pre-compile  # The unique identifier of the sending IdsM instance. Tags: atp.Status=draft | This ID helps identifying the origin of a SEv, together with the SEv configuration parameters: ExternalEventId and the IdsMSensorInstanceId. Note: There is only one IdsM (from the AUTOSAR Classic Platform) instance per ECU.
      float IdsMMainFunctionPeriod: 0..INF, scope=ECU, set at pre-compile, default-value=0.01  # The period between successive calls to the IdsM main function (as float in seconds). Tags: atp.Status=draft
      boolean IdsMSignatureSupport: set at pre-compile, default-value=false  # This parameter enables/disables the functionality of sending messages to the network with a signature of encryption calculated by the crypto services. Tags: atp.Status=draft
      boolean IdsMTimestampSupport: set at pre-compile, default-value=false  # This parameter enables/disables the functionality of timestamping and accepting timestamps for reported SEvs. Tags: atp.Status=draft
      boolean IdsMVersionInfoApi: set at pre-compile  # This parameter enables/disables the function IdsM_GetVersionInfo() to get major, minor and patch version information of the module. Tags: atp.Status=draft
      reference IdsMNvmBlockDescriptor [0..1]: multiplicity set at pre-compile, set at pre-compile, destination=NvMBlockDescriptor  # Choose a NvM block descriptor reference, that is used to load and store the non-volatile data of IdsM module. Tags: atp.Status=draft | The supported NvM block names are: RAM: IdsM_NvMRamBlockData ROM: IdsM_NvMRomBlockData
      container IdsMGlobalRateLimitationFilters [0..1]: multiplicity set at pre-compile  # Global rate limitation filters for all SEvs. Tags: atp.Status=draft
        container IdsMFilterEventRateLimitation [0..1]: multiplicity set at pre-compile  # For configurable time intervals of length "IdsMRateLimitationTimeInterval" this filter forwards all the SEvs until reaching the limit "IdsMRateLimitationMaximumEvents". Tags: atp.Status=draft | The limit is measured in number of incoming SEvs. Until the end of the time interval, all subsequent SEvs are dropped. This is helpful to cap the load that the IdsM generates unto information sinks like the IdsR. This filter is not specific to a single SEv but it applies to all SEvs handled by the current IdsM instance. Note: Each possible SEv counts as a single one, regardless of its counter value.
          integer IdsMRateLimitationMaximumEvents: 1..65535, set at pre-compile  # The maximum number of SEvs which are passed on by this filter in a single rate limitation time interval. Tags: atp.Status=draft
          float IdsMRateLimitationTimeInterval: 0..INF, set at pre-compile  # Time interval length of the event rate limitation filter (as float in seconds). Tags: atp.Status=draft | Note: Shall be configured as a multiple of the IdsM main function period.
        container IdsMFilterTrafficLimitation [0..1]: multiplicity set at pre-compile  # The traffic limitation filter forwards all the incoming SEvs until reaching the limit "IdsMTrafficLimitationMaximumBytes". Tags: atp.Status=draft | The limit is measured in incoming amount of bytes. This filter forwards SEvs only, if the accumulated sizes of all incoming SEvs in the current traffic limitation time interval up until the current SEv is smaller or equal than a configurable maximum number of bytes "IdsMTrafficLimitationMaximumBytes". The length of the traffic limitation time interval is configurable in "IdsMTrafficLimitationTimeInterval". This filter is not specific to a single SEv but it applies to all SEvs handled by the current IdsM instance.
          integer IdsMTrafficLimitationMaximumBytes: 1..65535, set at pre-compile  # The maximum number of bytes to be sent out by the IdsM in a single traffic limitation time interval. Tags: atp.Status=draft
          float IdsMTrafficLimitationTimeInterval: 0..INF, set at pre-compile  # Length of the traffic limitation time interval (as float in seconds). Tags: atp.Status=draft | Note: Shall be configured as a multiple of the IdsM main function period.
      container IdsMSecurityEventRefs [0..1]: multiplicity set at pre-compile  # Container for the references to IdsMEvent elements representing the security events that the IdsM module shall report to itself in case the corresponding security related event occurs. Tags: atp.Status=draft
        reference SEV_IDSM_COMMUNICATION_ERROR [0..1]: multiplicity set at pre-compile, set at pre-compile, requires-symbolic-name-value=true, destination=IdsMEvent  # An error occurred when sending a QSEv via PDU. Tags: atp.Status=draft
        reference SEV_IDSM_NO_CONTEXT_DATA_BUFFER_AVAILABLE [0..1]: multiplicity set at pre-compile, set at pre-compile, requires-symbolic-name-value=true, destination=IdsMEvent  # The context data of an incoming event cannot be stored because there are no more context data buffers available. Tags: atp.Status=draft
        reference SEV_IDSM_NO_EVENT_BUFFER_AVAILABLE [0..1]: multiplicity set at pre-compile, set at pre-compile, requires-symbolic-name-value=true, destination=IdsMEvent  # A SEv cannot be handled because there are no more event buffers available to process the event. Tags: atp.Status=draft
        reference SEV_IDSM_NO_QUALIFIED_EVENT_BUFFER_AVAILABLE [0..1]: multiplicity set at pre-compile, set at pre-compile, requires-symbolic-name-value=true, destination=IdsMEvent  # A security event is raised when a QSEv has to be dropped due to insufficient QSEv buffers available. Tags: atp.Status=draft
        reference SEV_IDSM_TRAFFIC_LIMITATION_EXCEEDED [0..1]: multiplicity set at pre-compile, set at pre-compile, requires-symbolic-name-value=true, destination=IdsMEvent  # The current traffic exceeds a configured traffic limitation. Tags: atp.Status=draft
      container IdsMSignature [0..1]: multiplicity set at pre-compile  # If this container exists all qualified security events are signed by the crypto service. Tags: atp.Status=draft
        integer IdsMSignatureLength: 1..4294967295, multiplicity set at pre-compile, set at pre-compile  # This parameter defines the length of the signature in bytes calculated by the crypto service. Tags: atp.Status=draft
        reference IdsMCsmJobReference: multiplicity set at pre-compile, set at pre-compile, destination=CsmJob  # This parameter references the Csm job that is used to generate signatures when qualified security events must be signed. Tags: atp.Status=draft
      container IdsMTimestamp [0..1]: multiplicity set at pre-compile  # If this container exists a timestamp field is added to all qualified security events. Tags: atp.Status=draft
        enumeration IdsMTimestampOption: set at pre-compile  # This parameter speciies if the origin of the timestamp is from the AUTOSAR stack or from the application (custom timestamp). Tags: atp.Status=draft
          AUTOSAR  # Tags: atp.Status=draft
          Custom  # Tags: atp.Status=draft
        reference IdsMStbmTimeBaseReference [0..1]: multiplicity set at pre-compile, set at pre-compile, destination=StbMSynchronizedTimeBase  # This parameter references the time source when the origin of the timestamp is AUTOSAR. Tags: atp.Status=draft
  module definition IpduM [0..1]: post-build-variant-support=true, variants link-time/post-build/pre-compile  # Configuration of the IpduM (Ipdu Multiplexer) module.
    container IpduMConfig  # This container contains the sub containers of the IpduM module. | * The IpduMTxPathway subcontainer includes information about sent I-PDUs. * The IpduMRxPathway includes information about received I-PDUs. * The IpduMContainerTxPdu and IpduMContainedTxPdu include information about the sending of ContainerPdus. * The IpduMContainerRxPdu and IpduMContainedRxPdu include information about the reception of ContainerPdus.
      integer IpduMMaxTxBufferSize [0..1]: 0..65535, multiplicity set at link in variant link-time+post-build / pre-compile in variant pre-compile, set at link in variant link-time+post-build / pre-compile in variant pre-compile  # Maximum total size of all Tx buffers. This parameter is needed only in case of post-build loadable implementation using static memory allocation.
      integer IpduMMaxTxPathwayCnt [0..1]: 0..65535, multiplicity set at link in variant link-time+post-build / pre-compile in variant pre-compile, set at link in variant link-time+post-build / pre-compile in variant pre-compile  # Maximum number of transmitted IPdus. This parameter is needed only in case of post-build loadable implementation using static memory allocation.
      container IpduMContainedRxPdu [0..*]: multiplicity set at link in variant link-time / post-build in variant post-build / pre-compile in variant pre-compile, post-build-variant-multiplicity=true  # Configuration of a received contained Pdu.
        integer IpduMContainedPduOffset [0..1]: 0..4294967295, scope=ECU, post-build-variant-value=true, set at link in variant link-time / post-build in variant post-build / pre-compile in variant pre-compile  # Static offset (in bytes) of the ContainedPdu. Tags: atp.Status=draft
        integer IpduMContainedRxPduLongHeaderId [0..1]: 1..4294967295, multiplicity set at link in variant link-time / post-build in variant post-build / pre-compile in variant pre-compile, post-build-variant-multiplicity=true, post-build-variant-value=true, set at link in variant link-time / post-build in variant post-build / pre-compile in variant pre-compile  # LongHeader Id which is part of the ContainerPdu when this ContainedPdu is inside.
        integer IpduMContainedRxPduShortHeaderId [0..1]: 1..16777215, multiplicity set at link in variant link-time / post-build in variant post-build / pre-compile in variant pre-compile, post-build-variant-multiplicity=true, post-build-variant-value=true, set at link in variant link-time / post-build in variant post-build / pre-compile in variant pre-compile  # ShortHeader Id which is part of the ContainerPdu when this ContainedPdu is inside.
        integer IpduMPduUpdateBitPosition [0..1]: 0..4294967295, post-build-variant-value=true, set at link in variant link-time / post-build in variant post-build / pre-compile in variant pre-compile  # This value specifies where the PDU's Update-Bit is stored in the Container PDU (bit location of PDU's Update-Bit in the Container PDU). Tags: atp.Status=draft
        reference IpduMContainedRxInContainerPduRef [0..1]: multiplicity set at link in variant link-time / post-build in variant post-build / pre-compile in variant pre-compile, post-build-variant-multiplicity=true, post-build-variant-value=true, set at link in variant link-time / post-build in variant post-build / pre-compile in variant pre-compile, destination=IpduMContainerRxPdu  # Optional reference to an IpduMContainerRxPdu this IpduMContainedRxPdu may be received in. | If this IpduMContainedRxPdu shall be received in exactly one IpduMContainerRxPdu with IpduMContainerRxAcceptContainedPdu=IPDUM_ACCEPT_CONFIGURED then the IpduMContainedRxInContainerPduRef shall be defined. If this IpduMContainedRxPdu can be received in any IpduMContainerRxPdu with IpduMContainerRxAcceptContainedPdu=IPDUM_ACCEPT_ALL then the IpduMContainedRxInContainerPduRef shall NOT be defined.
        reference IpduMContainedRxPduRef: scope=ECU, post-build-variant-value=true, set at link in variant link-time / post-build in variant post-build / pre-compile in variant pre-compile, destination=Pdu  # Reference to the Pdu which represents this ContainedPdu and is used for reception indication.
      container IpduMContainedTxPdu [0..*]: multiplicity set at link in variant link-time / post-build in variant post-build / pre-compile in variant pre-compile, post-build-variant-multiplicity=true  # Configuration of a sender ContainedPdu.
        integer IpduMContainedPduHeaderId [0..1]: 1..4294967295, post-build-variant-value=true, set at link in variant link-time / post-build in variant post-build / pre-compile in variant pre-compile  # Header Id which is part of the ContainerPdu when this ContainedPdu is inside.
        integer IpduMContainedPduOffset [0..1]: 0..4294967295, scope=ECU, post-build-variant-value=true, set at link in variant link-time / post-build in variant post-build / pre-compile in variant pre-compile  # Static offset (in bytes) of the ContainedPdu. Tags: atp.Status=draft
        enumeration IpduMContainedTxPduCollectionSemantics: {IPDUM_COLLECT_LAST_IS_BEST, IPDUM_COLLECT_QUEUED}, post-build-variant-value=true, set at link in variant link-time / post-build in variant post-build / pre-compile in variant pre-compile  # Defines whether this IpduMContainedTxPdu shall be collected using a last-is-best or queued semantics.
        boolean IpduMContainedTxPduConfirmation [0..1]: multiplicity set at pre-compile, set at pre-compile, default-value=false  # This Parameter determines whether for this contained I-PDU a TxConfirmation shall be provided. If set to TRUE a TxConfirmation is issued. It is not used when an I-PDU is requested using the trigger transmit API. | If this Parameter is omitted, the default value shall be used.
        integer IpduMContainedTxPduHandleId: 0..65535, scope=ECU, set at pre-compile, symbolic-name-value=true, with-auto=true  # Handle Id of the ContainedPdu.
        integer IpduMContainedTxPduPriority [0..1]: 0..255, multiplicity set at link in variant link-time / post-build in variant post-build / pre-compile in variant pre-compile, post-build-variant-multiplicity=true, post-build-variant-value=true, set at link in variant link-time / post-build in variant post-build / pre-compile in variant pre-compile, default-value=255  # Defines a priority of a ContainedTxPdu. 255 represents the lowest priority and 0 represent the highest priority.
        float IpduMContainedTxPduSendTimeout [0..1]: 0..65.535, multiplicity set at link in variant link-time / post-build in variant post-build / pre-compile in variant pre-compile, post-build-variant-multiplicity=true, post-build-variant-value=true, set at link in variant link-time / post-build in variant post-build / pre-compile in variant pre-compile  # Defines a ContainedPdu specific sender timeout which can reduce the ContainerPdu timer when this ContainedPdu is put inside the ContainerPdu. | Defined in seconds.
        enumeration IpduMContainedTxPduTrigger: {IPDUM_TRIGGER_ALWAYS, IPDUM_TRIGGER_NEVER}, post-build-variant-value=true, set at link in variant link-time / post-build in variant post-build / pre-compile in variant pre-compile  # Defines whether this Pdu triggers the sending of the ContainerPdu.
        integer IpduMPduUpdateBitPosition [0..1]: 0..4294967295, post-build-variant-value=true, set at link in variant link-time / post-build in variant post-build / pre-compile in variant pre-compile  # This value specifies where the PDU's Update-Bit is stored in the Container PDU (bit location of PDU's Update-Bit in the Container PDU). Tags: atp.Status=draft
        reference IpduMContainedTxInContainerPduRef: post-build-variant-value=true, set at link in variant link-time / post-build in variant post-build / pre-compile in variant pre-compile, destination=IpduMContainerTxPdu  # Reference to the container Pdu which this contained Pdu shall be collected in.
        reference IpduMContainedTxPduRef: scope=ECU, post-build-variant-value=true, set at link in variant link-time / post-build in variant post-build / pre-compile in variant pre-compile, destination=Pdu  # Reference to the Pdu which represents this ContainedPdu and is used for transmission.
      container IpduMContainerRxPdu [0..*]: multiplicity set at link in variant link-time / post-build in variant post-build / pre-compile in variant pre-compile, post-build-variant-multiplicity=true  # Configuration of a receiver ContainerPdu which may collect several ContainedPdus.
        enumeration IpduMContainerHeaderSize: post-build-variant-value=true, set at link in variant link-time / post-build in variant post-build / pre-compile in variant pre-compile  # Defines the layout of the header information (header id and length).
          IPDUM_HEADERTYPE_LONG
          IPDUM_HEADERTYPE_NONE  # Tags: atp.Status=draft
          IPDUM_HEADERTYPE_SHORT
        enumeration IpduMContainerPduProcessing: {IPDUM_PROCESSING_DEFERRED, IPDUM_PROCESSING_IMMEDIATE}, post-build-variant-value=true, set at link in variant link-time / post-build in variant post-build / pre-compile in variant pre-compile  # Defines whether the handling of this ContainerPdu shall be done in the context of the caller (IMMEDIATE) or in the next call to IpduM_MainFunctionRx (DEFERRED).
        integer IpduMContainerQueueSize [0..1]: 1..255, multiplicity set at link in variant link-time / post-build in variant post-build / pre-compile in variant pre-compile, post-build-variant-multiplicity=true, post-build-variant-value=true, set at link in variant link-time / post-build in variant post-build / pre-compile in variant pre-compile, default-value=1  # Defines a local queue for handling of each ContainerPdu. | Defined in number of instances of this ContainerPdu.
        enumeration IpduMContainerRxAcceptContainedPdu: {IPDUM_ACCEPT_ALL, IPDUM_ACCEPT_CONFIGURED}, post-build-variant-value=true, set at link in variant link-time / post-build in variant post-build / pre-compile in variant pre-compile  # Defines for the received IpduMContainerRxPdu whether the list of referencing IpduMContainedRxPdus (via the reference IpduMContainedPduContainerRefRx) is a closed set.
        integer IpduMContainerRxHandleId: 0..65535, scope=ECU, set at pre-compile, symbolic-name-value=true, with-auto=true  # Handle Id used by the PduR for RxIndication.
        reference IpduMContainerRxPduRef: scope=ECU, post-build-variant-value=true, set at link in variant link-time / post-build in variant post-build / pre-compile in variant pre-compile, destination=Pdu  # Reference to the Pdu which represents the container and is used for reception.
        reference IpduMMainFunctionRxRef [0..1]: multiplicity set at pre-compile, post-build-variant-multiplicity=true, post-build-variant-value=true, set at pre-compile, destination=IpduMMainFunctionRx  # Reference to the IpduM_MainFunctionRx instance this container PDU belongs to. | Mandatory, if more than one IpduM_MainFunctionRx is defined.
      container IpduMContainerTxPdu [0..*]: multiplicity set at link in variant link-time / post-build in variant post-build / pre-compile in variant pre-compile, post-build-variant-multiplicity=true  # Configuration of a transmitted container Pdu.
        enumeration IpduMContainerHeaderSize: post-build-variant-value=true, set at link in variant link-time / post-build in variant post-build / pre-compile in variant pre-compile  # Defines the layout of the header information (header id and length).
          IPDUM_HEADERTYPE_LONG
          IPDUM_HEADERTYPE_NONE  # Tags: atp.Status=draft
          IPDUM_HEADERTYPE_SHORT
        integer IpduMContainerQueueSize [0..1]: 1..255, multiplicity set at link in variant link-time / post-build in variant post-build / pre-compile in variant pre-compile, post-build-variant-multiplicity=true, post-build-variant-value=true, set at link in variant link-time / post-build in variant post-build / pre-compile in variant pre-compile, default-value=1  # Defines a local queue for handling of each ContainerPdu. | Defined in number of instances of this ContainerPdu.
        boolean IpduMContainerTxFirstContainedPduTrigger: post-build-variant-value=true, set at link in variant link-time / post-build in variant post-build / pre-compile in variant pre-compile  # Defines if the transmission of this IpduMContainerTxPdu shall be requested right after the first IpduMContainedTxPdu was put into it.
        integer IpduMContainerTxHandleId [0..1]: 0..65535, scope=ECU, multiplicity set at pre-compile, set at pre-compile, symbolic-name-value=true, with-auto=true  # Handle Id used by the PduR for TxConfirmation and for TriggerTransmit of the ContainerPdu.
        float IpduMContainerTxSendTimeout [0..1]: 0..65.535, multiplicity set at link in variant link-time / post-build in variant post-build / pre-compile in variant pre-compile, post-build-variant-multiplicity=true, post-build-variant-value=true, set at link in variant link-time / post-build in variant post-build / pre-compile in variant pre-compile  # When this timeout expires the ContainerPdu is triggered for sending. The respective timer is started when the first Pdu is put into the ContainerPdu. | Defined in seconds.
        integer IpduMContainerTxSizeThreshold [0..1]: 0..4294967295, multiplicity set at link in variant link-time / post-build in variant post-build / pre-compile in variant pre-compile, post-build-variant-multiplicity=true, post-build-variant-value=true, set at link in variant link-time / post-build in variant post-build / pre-compile in variant pre-compile  # Defines the size threshold in bytes which, when exceeded, triggers the sending of the ContainerPdu although the maxium Pdu size (PduLength parameter of Pdu object) has not been reached yet.
        enumeration IpduMContainerTxTriggerMode: {IPDUM_DIRECT, IPDUM_TRIGGERTRANSMIT}, post-build-variant-value=true, set at link in variant link-time / post-build in variant post-build / pre-compile in variant pre-compile  # Defines whether this ContainerPdu is fetched via trigger transmit.
        integer IpduMUnusedAreasDefault [0..1]: 0..255, scope=ECU, post-build-variant-value=true, set at link in variant link-time / post-build in variant post-build / pre-compile in variant pre-compile  # IpduM fills not updated areas of the Container PDU with this byte-pattern. Tags: atp.Status=draft
        reference IpduMContainerTxPduRef: scope=ECU, post-build-variant-value=true, set at link in variant link-time / post-build in variant post-build / pre-compile in variant pre-compile, destination=Pdu  # Reference to the Pdu which represents the container and is used for transmission.
        reference IpduMMainFunctionTxRef [0..1]: multiplicity set at pre-compile, post-build-variant-multiplicity=true, post-build-variant-value=true, set at pre-compile, destination=IpduMMainFunctionTx  # Reference to the IpduM_MainFunctionTx instance this container PDU belongs to. | Mandatory, if more than one IpduM_MainFunctionTx is defined.
      container IpduMMainFunctionRx [0..*]: multiplicity set at pre-compile, post-build-variant-multiplicity=true  # Each element of this container defines one instance IpduM_MainFunctionRx, in case multi-core distribution feature is active.
        float IpduMMainRxTimeBase: 0..INF, set at pre-compile  # The period between successive calls to according instance of IpduM_MainFunctionRx in seconds. This parameter may be used by the IpduM generator to transform the values of the reception related timing configuration parameters of the IpduM module to internal implementation specific counter or tick values. The IpduM module's internal timing handling is implementation specific. | The IpduM module (generator) may rely on the fact that IpduM_MainFunctionRx is scheduled according to the value configured here.
        reference IpduMMainRxPartitionRef [0..1]: multiplicity set at pre-compile, set at pre-compile, destination=EcucPartition  # Reference to EcucPartition, where the according IpduM_MainFunction instance is assigned to.
      container IpduMMainFunctionTx [0..*]: multiplicity set at pre-compile, post-build-variant-multiplicity=true  # Each element of this container defines one instance IpduM_MainFunctionTx, in case multi-core distribution feature is active (mutual exclusive to ComTimeBase).
        float IpduMMainTxTimeBase: 0..INF, set at pre-compile  # The period between successive calls to IpduM_MainFunctionTx in seconds. This parameter may be used by the IpduM generator to transform the values of the reception related timing configuration parameters of the IpduM module to internal implementation specific counter or tick values. The IpduM module's internal timing handling is implementation specific. | The IpduM module (generator) may rely on the fact that IpduM_MainFunctionTx is scheduled according to the value configured here.
        reference IpduMMainTxPartitionRef [0..1]: multiplicity set at pre-compile, set at pre-compile, destination=EcucPartition  # Reference to EcucPartition, where the according IpduM_MainFunction instance is assigned to.
      container IpduMRxPathway [0..*]: multiplicity set at link in variant link-time / post-build in variant post-build / pre-compile in variant pre-compile, post-build-variant-multiplicity=true  # Contains the configuration parameters received I-PDUs by the IpduM module.
        container IpduMRxIndication  # Contains the configuration for incoming RxIndication calls.
          enumeration IpduMByteOrder: {BIG_ENDIAN, LITTLE_ENDIAN}, post-build-variant-value=true, set at link in variant link-time / post-build in variant post-build / pre-compile in variant pre-compile  # This parameter defines the ByteOrder for all segments (static and dynamic part) and for the selectorField within the MultiplexedPdu. | The absolute position of a segment in the MultiplexedIPdu is determined by the definition of the ByteOrder parameter: If BIG_ENDIAN is specified, the SegmentPosition indicates the bit position of the most significant bit in an IPDU. If LITTLE_ENDIAN is specified, the SegmentPosition indicates the bit position of the least significant bit in an IPDU.
          integer IpduMRxHandleId: 0..65535, scope=ECU, set at pre-compile, symbolic-name-value=true, with-auto=true  # This is the I-PDU ID of the incoming I-PDU. If an incoming RxIndication's I-PDU ID matches this value then it is unpacked according to the specification in this container.
          reference IpduMRxIndicationPduRef: scope=ECU, post-build-variant-value=true, set at link in variant link-time / post-build in variant post-build / pre-compile in variant pre-compile, destination=Pdu  # Reference to the received Pdu representation in the ECU Configuration Description exchange file.
          container IpduMRxDynamicPart [0..*]: multiplicity set at link in variant link-time / post-build in variant post-build / pre-compile in variant pre-compile, post-build-variant-multiplicity=true  # This container contains the configuration for the dynamic part of incoming RxIndication calls. When an incoming received I-PDU's selector field matches the IpduMRxSelectorValue, the new outgoing I-PDU for the dynamic part is constructed as defined by the segments (defined in the IpduMDynamicSegment container) and sent out with the I-PDU ID referenced by IpduMOutgoingDynamicPduRef. | In case no dynamic part shall be extracted from this received I-PDU this container does not exist. This use-case can occur in case a MultiplexedIPdu is received by an ECU which is only interested in the static part of the MultiplexedIPdu.
            integer IpduMRxSelectorValue: 0..65535, post-build-variant-value=true, set at link in variant link-time / post-build in variant post-build / pre-compile in variant pre-compile  # This is the selector value that this container refers to.
            reference IpduMOutgoingDynamicPduRef: scope=ECU, post-build-variant-value=true, set at link in variant link-time / post-build in variant post-build / pre-compile in variant pre-compile, destination=Pdu  # When the new I-PDU is sent out it is sent with this I-PDU ID. Reference to the sent PDU representation in the ECU Configuration Description exchange file.
          container IpduMRxDynamicSegment [0..*]: multiplicity set at link in variant link-time / post-build in variant post-build / pre-compile in variant pre-compile, post-build-variant-multiplicity=true  # The dynamic part of the multiplexed incoming I-Pdu (referenced by IpduMRxIndicationPduRef) can be separated into several segments. | For each segment one IpduMRxDynamicSegment container shall be created that contains the location and the length of the segment. Please note that each configured segment will be copied into the destination I-Pdu that is referenced in the IpduMRxDynamicPart container and will be copied from the same location in the multiplexed incoming I-Pdu. The segment layout for all dynamic Parts is always identical.
            integer IpduMSegmentLength: 1..2032, post-build-variant-value=true, set at link in variant link-time / post-build in variant post-build / pre-compile in variant pre-compile  # Length of the segment in bits.
            integer IpduMSegmentPosition: 0..2031, post-build-variant-value=true, set at link in variant link-time / post-build in variant post-build / pre-compile in variant pre-compile  # Segments bit position in the multiplexed Pdu.
          container IpduMRxStaticPart [0..1]: multiplicity set at link in variant link-time / post-build in variant post-build / pre-compile in variant pre-compile, post-build-variant-multiplicity=true  # This container contains the configuration for the static part of incoming RxIndication calls. On reception, the new outgoing I-PDU for the static part is constructed as defined by the segments (defined in the IpduMStaticSegment container) and sent out with the I-PDU ID referenced by IpduMOutgoingStaticPduRef.
            reference IpduMOutgoingStaticPduRef: scope=ECU, post-build-variant-value=true, set at link in variant link-time / post-build in variant post-build / pre-compile in variant pre-compile, destination=Pdu  # When the new I-PDU is sent out it is sent with this I-PDU ID. Reference to the sent Pdu representation in the ECU Configuration Description exchange file.
          container IpduMRxStaticSegment [0..*]: multiplicity set at link in variant link-time / post-build in variant post-build / pre-compile in variant pre-compile, post-build-variant-multiplicity=true  # The static part of the multiplexed incoming I-Pdu (referenced by IpduMRxIndicationPduRef) can be separated into several segments. | For each segment one IpduMRxStaticSegment container shall be created that contains the location and the length of the segment. Please note that each configured segment will be copied into the destination I-Pdu that is referenced in the IpduMRxStaticPart container and will be copied from the same location in the multiplexed incoming I-Pdu.
            integer IpduMSegmentLength: 1..2032, post-build-variant-value=true, set at link in variant link-time / post-build in variant post-build / pre-compile in variant pre-compile  # Length of the segment in bits.
            integer IpduMSegmentPosition: 0..2031, post-build-variant-value=true, set at link in variant link-time / post-build in variant post-build / pre-compile in variant pre-compile  # Segments bit position in the multiplexed Pdu.
          container IpduMSelectorField  # This contains the location and the length of the selector field.
            integer IpduMSelectorFieldLength: 1..16, post-build-variant-value=true, set at link in variant link-time / post-build in variant post-build / pre-compile in variant pre-compile  # Length of the selector field in bits.
            integer IpduMSelectorFieldPosition: 0..2031, post-build-variant-value=true, set at link in variant link-time / post-build in variant post-build / pre-compile in variant pre-compile  # Selector field bit position in the multiplexed Pdu. | Range: 0..63 for CAN/ LIN I-PDUs, 0..511 for CAN FD I-PDUs, 0..2031 for FlexRay I-PDUs.
      container IpduMTxPathway [0..*]: multiplicity set at link in variant link-time / post-build in variant post-build / pre-compile in variant pre-compile, post-build-variant-multiplicity=true  # Contains the configuration parameters transmitted I-PDUs by the IpduM module.
        container IpduMTxRequest  # This container is used to specify the configuration for Transmit requests. | There will be one instance of this container for each I-PDU that can be requested for transmission (the outgoing I-PDUs) by the IpduM.
          enumeration IpduMByteOrder: {BIG_ENDIAN, LITTLE_ENDIAN}, post-build-variant-value=true, set at link in variant link-time / post-build in variant post-build / pre-compile in variant pre-compile  # This parameter defines the ByteOrder for all segments (static and dynamic part) and for the selectorField within the MultiplexedPdu. | The absolute position of a segment in the MultiplexedIPdu is determined by the definition of the ByteOrder parameter: If BIG_ENDIAN is specified, the SegmentPosition indicates the bit position of the most significant bit in an IPDU. If LITTLE_ENDIAN is specified, the SegmentPosition indicates the bit position of the least significant bit in an IPDU.
          integer IpduMIPduUnusedAreasDefault [0..1]: 0..255, multiplicity set at link in variant link-time / post-build in variant post-build / pre-compile in variant pre-compile, post-build-variant-multiplicity=true, post-build-variant-value=true, set at link in variant link-time / post-build in variant post-build / pre-compile in variant pre-compile  # IpduM module fills not used areas of an I-PDU with this bit-pattern | If this attribute is omitted the IpduM module does not fill the I-PDU.
          integer IpduMTxConfirmationPduId [0..1]: 0..65535, multiplicity set at pre-compile, set at pre-compile, symbolic-name-value=true, with-auto=true  # Handle Id used by the PduR for confirmation (IpduM_TxConfirmation) and for TriggerTransmit (IpduM_TriggerTransmit). | The existence of this parameter is essential for the PduR generation tool to actually find a symbolicNameValue for the OutgoingPdu.
          enumeration IpduMTxTriggerMode: {DYNAMIC_PART_TRIGGER, NONE, STATIC_OR_DYNAMIC_PART_TRIGGER, STATIC_PART_TRIGGER}, post-build-variant-value=true, set at link in variant link-time / post-build in variant post-build / pre-compile in variant pre-compile  # Selects whether to send the multiplexed I-PDU immediately or at some later date.
          reference IpduMInitialDynamicPart: post-build-variant-value=true, set at link in variant link-time / post-build in variant post-build / pre-compile in variant pre-compile, destination=IpduMTxDynamicPart  # Reference to the dynamic part that shall be used to initialize this multiplexed TX-I-PDU.
          reference IpduMOutgoingPduRef: scope=ECU, post-build-variant-value=true, set at link in variant link-time / post-build in variant post-build / pre-compile in variant pre-compile, destination=Pdu  # Reference to the PDU defining the outgoing I-PDU. | When the outgoing I-PDU is sent this is the I-PDU ID to give it. It is the IpduM I-PDU ID of the assembled I-PDU.
          container IpduMSelectorField  # This contains the location and the length of the selector field.
            integer IpduMSelectorFieldLength: 1..16, post-build-variant-value=true, set at link in variant link-time / post-build in variant post-build / pre-compile in variant pre-compile  # Length of the selector field in bits.
            integer IpduMSelectorFieldPosition: 0..2031, post-build-variant-value=true, set at link in variant link-time / post-build in variant post-build / pre-compile in variant pre-compile  # Selector field bit position in the multiplexed Pdu. | Range: 0..63 for CAN/ LIN I-PDUs, 0..511 for CAN FD I-PDUs, 0..2031 for FlexRay I-PDUs.
          container IpduMTxDynamicPart [1..*]: multiplicity set at link in variant link-time / post-build in variant post-build / pre-compile in variant pre-compile, post-build-variant-multiplicity=true  # Configuration parameters for an instance of a TxRequest call into the IpduM. When a Tx Request with the IpduMTxDynamicHandleId is received by the IpduM, all segments (defined in the IpduMDynamicSegment container) are copied from the incoming I-PDU into the outgoing I-PDU buffer and then the send mode honored. This container is used by the dynamic part of a TxRequest configuration. Therefore, for each outgoing I-PDU there will be one instance of this container for the dynamic part.
            boolean IpduMJitUpdate [0..1]: multiplicity set at link in variant link-time / post-build in variant post-build / pre-compile in variant pre-compile, post-build-variant-multiplicity=true, post-build-variant-value=true, set at link in variant link-time / post-build in variant post-build / pre-compile in variant pre-compile, default-value=false  # If configured to true fetch the data of this part Just-In-Time via the triggerTransmit API of the PduR.
            boolean IpduMTxDynamicConfirmation: post-build-variant-value=true, set at link in variant link-time / post-build in variant post-build / pre-compile in variant pre-compile  # A transmit request can be confirmed by the lower layer. If this parameter is set to true a confirmation of the I-PDU in COM representing the dynamic part is generated.
            integer IpduMTxDynamicHandleId: 0..65535, scope=ECU, set at pre-compile, symbolic-name-value=true, with-auto=true  # This defines an incoming handle id. When the handle of an incoming Tx Request matches this id, the configured dynamic segments are copied and the IpduMTxTriggerMode is honored.
            reference IpduMTxDynamicPduRef: scope=ECU, post-build-variant-value=true, set at link in variant link-time / post-build in variant post-build / pre-compile in variant pre-compile, destination=Pdu  # Reference to the Pdu representation in the ECU Configuration Description exchange file to be transmitted.
          container IpduMTxDynamicSegment [1..*]: multiplicity set at link in variant link-time / post-build in variant post-build / pre-compile in variant pre-compile, post-build-variant-multiplicity=true  # The dynamic part of the multiplexed outgoing I-Pdu (referenced by IpduMOutgoingPduRef) can be separated into several segments. | For each segment one IpduMTxDynamicSegment container shall be created that contains the location and the length of the segment. Please note that each configured segment will be copied out of the source I-Pdu that is referenced in the IpduMTxDynamicPart container and will be copied to the same location in the multiplexed outgoing I-Pdu. The segment layout for all dynamic Parts is always identical.
            integer IpduMSegmentLength: 1..2032, post-build-variant-value=true, set at link in variant link-time / post-build in variant post-build / pre-compile in variant pre-compile  # Length of the segment in bits.
            integer IpduMSegmentPosition: 0..2031, post-build-variant-value=true, set at link in variant link-time / post-build in variant post-build / pre-compile in variant pre-compile  # Segments bit position in the multiplexed Pdu.
          container IpduMTxStaticPart [0..1]: multiplicity set at link in variant link-time / post-build in variant post-build / pre-compile in variant pre-compile, post-build-variant-multiplicity=true  # Configuration parameters for an instance of a Tx_Request call into the IpduM. When a Tx Request with the IpduMTxStaticHandleId is received by the IpduM, all segments (defined in the IpduMStaticSegment container) are copied from the incoming I-PDU into the outgoing I-PDU buffer and then the send mode honored. This container is used for the static part of a TxRequest configuration. Therefore, for each outgoing I-PDU there will be one instance of this container for the static part if it exists.
            boolean IpduMJitUpdate [0..1]: multiplicity set at link in variant link-time / post-build in variant post-build / pre-compile in variant pre-compile, post-build-variant-multiplicity=true, post-build-variant-value=true, set at link in variant link-time / post-build in variant post-build / pre-compile in variant pre-compile, default-value=false  # If configured to true fetch the data of this part Just-In-Time via the triggerTransmit API of the PduR.
            boolean IpduMTxStaticConfirmation: post-build-variant-value=true, set at link in variant link-time / post-build in variant post-build / pre-compile in variant pre-compile  # A transmit request can be confirmed by the lower layer. If this parameter is set to true a confirmation of the I-PDU in COM representing the static part is generated.
            integer IpduMTxStaticHandleId: 0..65535, scope=ECU, set at pre-compile, symbolic-name-value=true, with-auto=true  # This defines an incoming handle id. When the handle of an incoming Tx Request matches this id, the configured static segments are copied and the IpduMTxTriggerMode is honored.
            reference IpduMTxStaticPduRef: scope=ECU, post-build-variant-value=true, set at link in variant link-time / post-build in variant post-build / pre-compile in variant pre-compile, destination=Pdu  # Reference to the Pdu representation in the ECU Configuration Description exchange file to be transmitted.
          container IpduMTxStaticSegment [0..*]: multiplicity set at link in variant link-time / post-build in variant post-build / pre-compile in variant pre-compile, post-build-variant-multiplicity=true  # The static part of the multiplexed outgoing I-Pdu (referenced by IpduMOutgoingPduRef) can be separated into several segments. | For each segment one IpduMTxStaticSegment container shall be created that contains the location and the length of the segment. Please note that each segment in the source I-Pdu that is referenced in the IpduMTxStaticPart container will be copied to the same location in the multiplexed outgoing I-Pdu.
            integer IpduMSegmentLength: 1..2032, post-build-variant-value=true, set at link in variant link-time / post-build in variant post-build / pre-compile in variant pre-compile  # Length of the segment in bits.
            integer IpduMSegmentPosition: 0..2031, post-build-variant-value=true, set at link in variant link-time / post-build in variant post-build / pre-compile in variant pre-compile  # Segments bit position in the multiplexed Pdu.
    container IpduMGeneral  # Contains the general configuration parameters of IpduM.
      boolean IpduMContainedTxPduPriorityHandling [0..1]: scope=ECU, multiplicity set at pre-compile, set at pre-compile, default-value=false  # This parameter enables/disables handling of priority for IpduMContainedTxPdu's with IpduMContainedTxPduCollectionSemantics IPDUM_LAST_IS_BEST. | true: enabled false: disabled
      boolean IpduMDevErrorDetect: set at pre-compile, default-value=false  # Switches the development error detection and notification on or off. | * true: detection and notification is enabled. * false: detection and notification is disabled.
      enumeration IpduMHeaderByteOrder [0..1]: {IPDUM_BIG_ENDIAN, IPDUM_LITTLE_ENDIAN}, set at pre-compile  # This parameter defines the ByteOrder of the headers inside a Container I-PDU.
      integer IpduMMaxTransmitRetries: 0..65535, set at pre-compile, default-value=10  # Maximum number of retries to send a container message in case PduR_IPduMTransmit returns E_NOT_OK.
      boolean IpduMMetaDataSupport [0..1]: scope=ECU, multiplicity set at pre-compile, set at pre-compile, default-value=false  # This parameter enables/disables the support of meta-data feature. | true: enabled false: disabled
      boolean IpduMStaticPartExists: set at pre-compile  # This is to allow optimizations in the case the IpduM will never be used with a static part. | Note that this is a pre-compile option. If this is set to False then it will not be possible to add static parts after compilation. True: A static part may exist. False: A static part will never exist.
      boolean IpduMVersionInfoApi: set at pre-compile, default-value=false  # Active/Deactivate the version information API. | true: version information activated false: version information deactivated
    container IpduMPublishedInformation  # Additional published parameters not covered by | CommonPublishedInformation container. Note that these parameters do not have any configuration class setting, since they are published information.
      boolean IpduMRxDirectComInvocation: set at published-information  # If set to TRUE the COM invocation optimization as defined in | IPDUM140 is implemented.
  module definition J1939Dcm [0..1]: post-build-variant-support=true, variants link-time/post-build/pre-compile  # The SAE J1939 Dcm module
    container J1939DcmConfigSet  # This container contains the configuration parameters and sub containers of the AUTOSAR J1939Dcm module.
      container J1939DcmChannel [1..*]  # Contains the J1939DcmChannel parameters.
        enumeration J1939DcmBusType: {J1939DCM_ISO9141, J1939DCM_J1587, J1939DCM_J1850, J1939DCM_J1922, J1939DCM_J1939_NETWORK_1, J1939DCM_J1939_NETWORK_2, J1939DCM_J1939_NETWORK_3, J1939DCM_J1939_NETWORK_4, J1939DCM_OTHER, J1939DCM_PROPRIETARY_NETWORK_1, J1939DCM_PROPRIETARY_NETWORK_2}, set at pre-compile  # Identifies the communication port
        reference J1939DcmComMChannelRef: scope=ECU, post-build-variant-value=true, set at link in variant link-time / post-build in variant post-build / pre-compile in variant pre-compile, requires-symbolic-name-value=true, destination=ComMChannel  # Reference to the ComMChannel.
      choice container J1939DcmDspExternalSRDataElementClass [0..1]  # This container defines the source of data in a provided port which shall be read respectively the target of data in a required port which shall be written. | This container shall contain either one J1939DcmSubElementInDataElementInstance OR J1939DcmDataElementInstance OR J1939DcmSubElementInImplDataElementInstance reference.
        container J1939DcmDataElementInstance [0..1]  # Instance Reference to the primitive data in a port where the data element is typed with an ApplicationPrimitveDataType or an ImplementationDataType.
          instance reference J1939DcmDataElementInstanceRef: set at pre-compile, destination-context=ROOT-SW-COMPOSITION-PROTOTYPE SW-COMPONENT-PROTOTYPE PORT-PROTOTYPE, destination-type=AUTOSAR-DATA-PROTOTYPE  # Instance Reference to the primitive data which shall be read or written. | Supported are VariableDataPrototypes in SenderReceiverInterfaces and NvDataInterfaces and ParameterDataPrototypes in ParameterInterfaces (read only). This reference is applicable if the AutosarDataPrototype is typed with a ApplicationPrimitiveDataType of category VALUE or BOOLEAN or if the AutosarDataPrototype is typed with a ImplementationDataType of category VALUE or TYPE_REFERENCE that in turn boils down to VALUE
        container J1939DcmSubElementInDataElementInstance [0..1]  # Instance Reference to the primitve sub-element (at any level) of composite data in a port where the data element is typed with an ApplicationCompositeDataType.
          instance reference J1939DcmSubElementInDataElementInstanceRef: set at pre-compile, destination-context=ROOT-SW-COMPOSITION-PROTOTYPE SW-COMPONENT-PROTOTYPE PORT-PROTOTYPE AUTOSAR-DATA-PROTOTYPE APPLICATION-COMPOSITE-ELEMENT-DATA-PROTOTYPE*, destination-type=APPLICATION-COMPOSITE-ELEMENT-DATA-PROTOTYPE  # Instance Reference to the primitve sub-element (at any level) of composite data in a port which shall be read. | Supported are VariableDataPrototypes in SenderReceiverInterfaces and NvDataInterfaces and ParameterDataPrototypes in ParameterInterfaces (read only). This reference is applicable if the AutosarDataPrototype is typed with a ApplicationCompositeDataType.
        container J1939DcmSubElementInImplDataElementInstance [0..1]  # Instance Reference to the primitve sub-element (at any level) of composite data in a port where the data element is typed with an ImplementationDataType.
          instance reference J1939DcmSubElementInImplDataElementInstanceRef: set at pre-compile, destination-context=ROOT-SW-COMPOSITION-PROTOTYPE SW-COMPONENT-PROTOTYPE PORT-PROTOTYPE AUTOSAR-DATA-PROTOTYPE IMPLEMENTATION-DATA-TYPE-ELEMENT*, destination-type=IMPLEMENTATION-DATA-TYPE-ELEMENT  # Instance Reference to the primitve sub-element (at any level) of composite data in a port which shall be read. | Supported are VariableDataPrototypes in SenderReceiverInterfaces and NvDataInterfaces and ParameterDataPrototypes in ParameterInterfaces (read only). This reference is applicable if the AutosarDataPrototype is typed with a ImplementationDataType of category STRUCTURE or ARRAY. Please note that in case of ARRAY the index attribute in the target reference has to be set to select a single array element.
      container J1939DcmNode [1..*]  # Contains the parameters for the support of a logical J1939 node.
        function name J1939DcmGenericDMxCopyRxDataFunction [0..1]: multiplicity set at pre-compile, set at pre-compile  # Provides part of the data of an unsupported DMx message. Required if J1939DcmGenericDMxSupport is enabled.
        function name J1939DcmGenericDMxCopyTxDataFunction [0..1]: multiplicity set at pre-compile, set at pre-compile  # Requests to provide part of the data of an unsupported DMx message, following a call to J1939Dcm_GenericDMxTransmit. Required if J1939DcmGenericDMxSupport is enabled.
        function name J1939DcmGenericDMxRequestFunction [0..1]: multiplicity set at pre-compile, set at pre-compile  # Indicates the reception of a request for an unsupported DMx message. Required if J1939DcmGenericDMxSupport is enabled.
        function name J1939DcmGenericDMxRxIndicationFunction [0..1]: multiplicity set at pre-compile, set at pre-compile  # Confirms complete reception of an unsupported DMx message. Required if J1939DcmGenericDMxSupport is enabled.
        function name J1939DcmGenericDMxStartOfReceptionFunction [0..1]: multiplicity set at pre-compile, set at pre-compile  # Indicates reception of an unsupported DMx message. Required if J1939DcmGenericDMxSupport is enabled.
        function name J1939DcmGenericDMxTxConfirmationFunction [0..1]: multiplicity set at pre-compile, set at pre-compile  # Confirms transmission of an unsupported DMx message. Required if J1939DcmGenericDMxSupport is enabled.
        integer J1939DcmSPNsInDataStream [0..*]: 0..524287, multiplicity set at pre-compile, set at pre-compile  # Defines the SPNs available in data stream for use in DM24.
        reference J1939DcmDemClientRef: set at link in variant link-time+post-build / pre-compile in variant pre-compile, requires-symbolic-name-value=true, destination=DemClient  # Reference to the corresponding Dem Client.
        reference J1939DcmNmNodeRef: set at link in variant link-time+post-build / pre-compile in variant pre-compile, requires-symbolic-name-value=true, destination=J1939NmNode  # Reference to the corresponding J1939Nm node.
        reference J1939DcmNodeRmUserRef: post-build-variant-value=true, set at link in variant link-time / post-build in variant post-build / pre-compile in variant pre-compile, requires-symbolic-name-value=true, destination=J1939RmDcmUser  # Reference to the J1939RmUser used by J1939Dcm.
        reference J1939DcmServiceOnlyDTCsMemoryDestinationRef [0..1]: set at pre-compile, requires-symbolic-name-value=true, destination=DemUserDefinedMemory  # Reference to the user defined memory used for the Service Only DTCs handled by DM53, DM54, and DM55.
        container J1939DcmDiagnosticMessageSupport [1..*]  # Contains parameters to configure the diagnostic message support
          enumeration J1939DcmDmxSupport: {J1939DCM_DM01_SUPPORT, J1939DCM_DM02_SUPPORT, J1939DCM_DM03_SUPPORT, J1939DCM_DM04_SUPPORT, J1939DCM_DM05_SUPPORT, J1939DCM_DM06_SUPPORT, J1939DCM_DM07_SUPPORT, J1939DCM_DM08_SUPPORT, J1939DCM_DM09_SUPPORT, J1939DCM_DM10_SUPPORT, J1939DCM_DM11_SUPPORT, J1939DCM_DM12_SUPPORT, J1939DCM_DM13_SUPPORT, J1939DCM_DM14_SUPPORT, J1939DCM_DM15_SUPPORT, J1939DCM_DM16_SUPPORT, J1939DCM_DM17_SUPPORT, J1939DCM_DM18_SUPPORT, J1939DCM_DM19_SUPPORT, J1939DCM_DM20_SUPPORT, J1939DCM_DM21_SUPPORT, J1939DCM_DM22_SUPPORT, J1939DCM_DM23_SUPPORT, J1939DCM_DM24_SUPPORT, J1939DCM_DM25_SUPPORT, J1939DCM_DM26_SUPPORT, J1939DCM_DM27_SUPPORT, J1939DCM_DM28_SUPPORT, J1939DCM_DM29_SUPPORT, J1939DCM_DM30_SUPPORT, J1939DCM_DM31_SUPPORT, J1939DCM_DM32_SUPPORT, J1939DCM_DM33_SUPPORT, J1939DCM_DM34_SUPPORT, J1939DCM_DM35_SUPPORT, J1939DCM_DM36_SUPPORT, J1939DCM_DM37_SUPPORT, J1939DCM_DM38_SUPPORT, J1939DCM_DM39_SUPPORT, J1939DCM_DM40_SUPPORT, J1939DCM_DM41_SUPPORT, J1939DCM_DM42_SUPPORT, J1939DCM_DM43_SUPPORT, J1939DCM_DM44_SUPPORT, J1939DCM_DM45_SUPPORT, J1939DCM_DM46_SUPPORT, J1939DCM_DM47_SUPPORT, J1939DCM_DM48_SUPPORT, J1939DCM_DM49_SUPPORT, J1939DCM_DM50_SUPPORT, J1939DCM_DM51_SUPPORT, J1939DCM_DM52_SUPPORT, J1939DCM_DM53_SUPPORT, J1939DCM_DM54_SUPPORT, J1939DCM_DM55_SUPPORT, J1939DCM_DM56_SUPPORT, J1939DCM_DM57_SUPPORT}, set at pre-compile  # This parameter is used to identify the actual DMx message.
          reference J1939DcmDiagnosticMessageModeRuleRef [0..1]: scope=ECU, multiplicity set at link in variant link-time / pre-compile in variant post-build+pre-compile, set at link in variant link-time / pre-compile in variant post-build+pre-compile, destination=J1939DcmModeRule  # Reference to a J1939DcmModeRule which controls the execution of a DiagnosticMessage.
          reference J1939DcmDiagnosticMessageSupportChannelRef: set at link in variant link-time+post-build / pre-compile in variant pre-compile, destination=J1939DcmChannel  # Reference to J1939DcmChannel for which this diagnostic message is supported.
          container J1939DcmRxPdu [0..1]  # Contains parameters to configure the J1939DcmRxPdu. | This PDU consumes meta data items of type CAN_ID_32 for PDUs received from CanIf, and of type SOURCE_ADDRESS_16, TARGET_ADDRESS_16, and PRIORITY_8 for PDUs received from J1939Tp.
            integer J1939DcmRxPduId: 0..65535, scope=ECU, set at pre-compile, symbolic-name-value=true, with-auto=true  # The I-PDU identifier used for communication with PduR.
            reference J1939DcmRxPduRef: post-build-variant-value=true, set at link in variant link-time / post-build in variant post-build / pre-compile in variant pre-compile, destination=Pdu  # Reference to the global Pdu element in the Ecuc module.
          container J1939DcmTxPdu [0..1]  # Contains parameters to configure the J1939DcmTxPdu. | This PDU produces meta data items of type CAN_ID_32 for PDUs transmitted via CanIf, and of type SOURCE_ADDRESS_16, TARGET_ADDRESS_16, and PRIORITY_8 for PDUs transmitted via J1939Tp.
            integer J1939DcmTxPduId: 0..65535, scope=ECU, set at pre-compile, symbolic-name-value=true, with-auto=true  # The I-PDU identifier used to identify the Tx message.
            reference J1939DcmTxPduRef: post-build-variant-value=true, set at link in variant link-time / post-build in variant post-build / pre-compile in variant pre-compile, destination=Pdu  # Reference to the global Pdu element in the Ecuc module.
      container J1939DcmProcessingConditions [0..1]  # This container contains the configuration for mode arbitration functionality of the J1939Dcm
        container J1939DcmModeCondition [1..*]  # This container contains the configuration of a mode condition or an environmental conditions which can be used as argument in J1939DcmModeRules. | One J1939DcmModeCondition shall contain either one J1939DcmSwcModeRef or one J1939DcmBswModeRef or one J1939DcmSwcSRDataElementRef. Please note that the J1939Dcm acts as well as mode manager. Therefore the references J1939DcmSwcModeRef or one J1939DcmBswModeRef might point to provided ModeDeclarationGroupPrototypes of the J1939Dcm itself as well as to provided ModeDeclarationGroupPrototypes of other Bsw Modules or software components. In case of a configured J1939DcmSwcModeRef or J1939DcmBswModeRef only the J1939DcmConditionType J1939DCM_EQUALS or J1939DCM_EQUALS_NOT are applicable. In case of J1939DcmSwcSRDataElementRef all literals of J1939DcmConditionType are possible.
          enumeration J1939DcmConditionType: {J1939DCM_EQUALS, J1939DCM_EQUALS_NOT, J1939DCM_GREATER_OR_EQUAL, J1939DCM_GREATER_THAN, J1939DCM_LESS_OR_EQUAL, J1939DCM_LESS_THAN}, set at pre-compile  # This parameter specifies what kind of comparison that is made for the evaluation of the mode condition.
          instance reference J1939DcmBswModeRef [0..1]: multiplicity set at pre-compile, set at pre-compile, destination-context=MODE-DECLARATION-GROUP-PROTOTYPE, destination-type=MODE-DECLARATION  # This parameter references a mode of a ModeDeclarationGroupPrototype provided by a Basic Software Module used for the condition. | Please note that such ModeDeclarationGroupPrototype are owned by a Basic Software Module Description in the role providedModeGroup.
          instance reference J1939DcmSwcModeRef [0..1]: multiplicity set at pre-compile, set at pre-compile, destination-context=ROOT-SW-COMPOSITION-PROTOTYPE SW-COMPONENT-PROTOTYPE P-PORT-PROTOTYPE MODE-DECLARATION-GROUP-PROTOTYPE, destination-type=MODE-DECLARATION  # This parameter references a mode in a particular mode request port of a software component that is used for the condition.
          reference J1939DcmSwcSRDataElementRef [0..1]: multiplicity set at pre-compile, set at pre-compile, destination=J1939DcmDspExternalSRDataElementClass  # Reference to environmental conditions. | It is possible to reference a S/R Receiver-Port to read physical values and compare (equal, greater, less,...) them with a configured value that is defined by J1939DcmSwcSRDataElementValue.
          choice container J1939DcmSwcSRDataElementValue  # This container contains the configuration of a S/R compare value.
            container J1939DcmSwcSRDataElementArray [0..1]  # This container contains the configuration of a array SR data element compare value.
              container J1939DcmSwcSRDataElementArrayElement [0..*]  # This container contains the configuration of a array element SR data element compare value.
                integer J1939DcmSwcSRDataElementArrayElementIndex: 0..18446744073709551615, set at pre-compile  # Index to an array SR data element.
                integer J1939DcmSwcSRDataElementArrayElementValue: 0..18446744073709551615, set at pre-compile  # Value of an array SR data element compare value.
            container J1939DcmSwcSRDataElementPrimitive [0..1]  # This container contains the configuration of a primitive SR data element compare value.
              integer J1939DcmSwcSRDataElementPrimitiveValue: 0..18446744073709551615, set at pre-compile  # Reference to a primitive SR data element compare value.
        container J1939DcmModeRule [1..*]  # This container contains the configuration of a mode rule which represents a logical expression with J1939DcmModeConditions or other J1939DcmModeRules as arguments. | All arguments are processed with the operator defined by DcmLogicalOperator, for instance: Argument_A AND Argument_B AND Argument_C
          enumeration J1939DcmLogicalOperator [0..1]: {J1939DCM_AND, J1939DCM_OR}, multiplicity set at pre-compile, set at pre-compile  # This parameter specifies the logical operator to be used in the logical expression. If the expression only consists of a single condition this parameter shall not be used.
          integer J1939DcmModeRuleNrcValue [0..1]: 1..255, scope=ECU, multiplicity set at link in variant link-time / pre-compile in variant pre-compile, set at link in variant link-time / pre-compile in variant pre-compile  # Optional parameter which defines the NRC to be sent in case the mode rule condition is not valid.
          choice reference J1939DcmArgumentRef [1..*]: multiplicity set at pre-compile, requires-index=true, set at pre-compile, destination=[J1939DcmModeCondition, J1939DcmModeRule]  # This is a choice reference either to a mode condition or a an other mode rule serving as sub-expression.
    container J1939DcmGeneral  # Contains the general configuration parameters of the module.
      integer J1939DcmCommonBufferSize: 1..65535, set at pre-compile  # Size of common buffer (in Bytes). The buffer size should be as large as the longest command or response message.
      boolean J1939DcmDevErrorDetect: set at pre-compile, default-value=false  # Switches the development error detection and notification on or off. | * true: detection and notification is enabled. * false: detection and notification is disabled.
      integer J1939DcmDM01BufferSize [0..1]: 1..65535, multiplicity set at pre-compile, set at pre-compile  # Size of DM01 buffer (in Bytes). The buffer size should be as large as the longest DM01 response message.
      integer J1939DcmDM01MaxDTCs [0..1]: 1..255, set at pre-compile, default-value=20  # Configuration value of limitation of maximum DTCs to be reported in the DM01 message.
      integer J1939DcmDM35BufferSize [0..1]: 1..65535, multiplicity set at pre-compile, set at pre-compile  # Size of DM35 buffer (in Bytes). The buffer size should be as large as the longest DM35 response message.
      boolean J1939DcmGenericDMxSupport: set at pre-compile, default-value=false  # Switches the support for all DMx messages that are not directly implemented in J1939Dcm. True: Unsupported DMx messages are handled by a CDD. False: Unsupported DMx messages are ignored/rejected.
      float J1939DcmMainFunctionPeriod: 0..INF, scope=ECU, set at link in variant link-time+post-build / pre-compile in variant pre-compile  # Call cycle in seconds of J1939Dcm_MainFunction.
      integer J1939DcmMaxDTCsPerMainFunction [0..1]: 1..255, multiplicity set at pre-compile, set at pre-compile  # Maximum threshold of DTCs filtered in a single MainFunction cycle.
      integer J1939DcmMaxFreezeFramesPerMainFunction [0..1]: 1..255, multiplicity set at pre-compile, set at pre-compile  # Maximum threshold of FreezeFrames filtered in a single MainFunction cycle.
      integer J1939DcmMaxRatiosPerMainFunction [0..1]: 1..255, multiplicity set at pre-compile, set at pre-compile  # Maximum threshold of Ratios filtered in a single MainFunction cycle.
      integer J1939DcmMaxTransmitRetries: 0..255, set at pre-compile, default-value=10  # Maximum number of retries to send a diagnostic message in case PduR_J1939DcmTransmit returns E_NOT_OK.
      boolean J1939DcmVersionInfoApi: set at pre-compile, default-value=false  # Pre-processor switch for enabling version info API support.
  module definition J1939Fscp [0..1]: variants link-time/post-build/pre-compile  # The J1939 Functional Safety Communication Protocol covers the handling of SHM and SDM messages for E2E protected communication according to SAE J1939-76. Tags: atp.Status=draft
    container J1939FscpConfigSet  # Configuration parameters and sub containers of the J1939Fscp module. Tags: atp.Status=draft
      container J1939FscpRxChannel [0..*]: multiplicity set at link in variant link-time / post-build in variant post-build / pre-compile in variant pre-compile, post-build-variant-multiplicity=true  # Physical CAN channel used for reception by J1939Fscp. Tags: atp.Status=draft
        reference J1939FscpRxChannelComMNetworkHandleRef: set at link in variant link-time+post-build / pre-compile in variant pre-compile, requires-symbolic-name-value=true, destination=ComMChannel  # Reference to the ComMChannel which corresponds to the J1939FscpRxChannel. This parameter is useful for the validation of the J1939Fscp configuration. Tags: atp.Status=draft
        container J1939FscpRxPg [1..*]: multiplicity set at link in variant link-time / post-build in variant post-build / pre-compile in variant pre-compile, post-build-variant-multiplicity=true  # Contains the configuration of the received SDM and of the upper layer PDU. Tags: atp.Status=draft
          integer J1939FscpRxInstances: 0..64009, multiplicity set at link in variant link-time / post-build in variant post-build / pre-compile in variant pre-compile, post-build-variant-multiplicity=true, set at link in variant link-time+post-build / pre-compile in variant pre-compile  # Configures the maximum number of SDGs that can be received in parallel with the same PGN. This parameter is only relevant if MetaData is configured for the J1939FscpSdgRxPdu. Tags: atp.Status=draft
          float J1939FscpRxSrvt: 0..INF, post-build-variant-value=true, set at link in variant link-time / post-build in variant post-build / pre-compile in variant pre-compile  # This parameter sets the maximum for the Safety-Relevant Validation Time (SRVT_Maximum), which is used to determine a timeout of the corresponding SDM message after reception of an SHM message. After this timeout, the whole SDG is dropped. Tags: atp.Status=draft
          container J1939FscpSdgRxPdu  # Contains the configuration of the PDU used to forward the received SDG to the upper layer. Tags: atp.Status=draft | This PDU can produce a meta data item of type CAN_ID_32.
            integer J1939FscpSdgRxPduId: 0..65535, scope=ECU, set at pre-compile, symbolic-name-value=true, with-auto=true  # The PDU identifier used for RxIndication to PduR. Tags: atp.Status=draft
            reference J1939FscpSdgRxPduRef: set at link in variant link-time+post-build / pre-compile in variant pre-compile, destination=Pdu  # Reference to the global PDU. Tags: atp.Status=draft
          container J1939FscpSdmRxPdu  # Contains the configuration of the PDU used to receive the SDM PG. Tags: atp.Status=draft | This PDU can consume a meta data item of type CAN_ID_32.
            integer J1939FscpSdmRxPduId: 0..65535, scope=ECU, symbolic-name-value=true, with-auto=true  # The PDU identifier used for RxIndication from PduR. Tags: atp.Status=draft
            reference J1939FscpSdmRxPduRef: set at link in variant link-time+post-build / pre-compile in variant pre-compile, destination=Pdu  # Reference to the global PDU. Tags: atp.Status=draft
        container J1939FscpShmRxPdu  # Contains the configuration of the PDU used to receive the SHM PG. Tags: atp.Status=draft | This PDU consumes a meta data item of type CAN_ID_32.
          integer J1939FscpShmRxPduId: 0..65535, scope=ECU, set at pre-compile, symbolic-name-value=true, with-auto=true  # The PDU identifier used for RxIndication from PduR. Tags: atp.Status=draft
          reference J1939FscpShmRxPduRef: set at link in variant link-time+post-build / pre-compile in variant pre-compile, destination=Pdu  # Reference to the global PDU. Tags: atp.Status=draft
      container J1939FscpTxChannel [0..*]: multiplicity set at link in variant link-time / post-build in variant post-build / pre-compile in variant pre-compile, post-build-variant-multiplicity=true  # Physical CAN channel used for transmission by J1939Fscp. Tags: atp.Status=draft
        reference J1939FscpTxChannelComMNetworkHandleRef: set at link in variant link-time+post-build / pre-compile in variant pre-compile, requires-symbolic-name-value=true, destination=ComMChannel  # Reference to the ComMChannel which corresponds to the J1939FscpTxChannel. This parameter is useful for the validation of the J1939Fscp configuration. Tags: atp.Status=draft
        container J1939FscpShmTxPdu  # Contains the configuration of the PDU used to transmit the SHM PG. Tags: atp.Status=draft | This PDU produces a meta data item of type CAN_ID_32.
          integer J1939FscpShmTxPduId: 0..65535, scope=ECU, set at pre-compile, symbolic-name-value=true, with-auto=true  # The PDU identifier used for TxConfirmation to PduR. Tags: atp.Status=draft
          reference J1939FscpShmTxPduRef: set at link in variant link-time+post-build / pre-compile in variant pre-compile, destination=Pdu  # Reference to the global PDU. Tags: atp.Status=draft
        container J1939FscpTxPg [1..*]: multiplicity set at link in variant link-time / post-build in variant post-build / pre-compile in variant pre-compile, post-build-variant-multiplicity=true  # Contains the configuration of the transmitted SDM and of the upper layer PDU. Tags: atp.Status=draft
          integer J1939FscpShmTxPriority [0..1]: 0..7, multiplicity set at link in variant link-time / post-build in variant post-build / pre-compile in variant pre-compile, post-build-variant-multiplicity=true, post-build-variant-value=true, set at link in variant link-time / post-build in variant post-build / pre-compile in variant pre-compile  # Configures the priority to be used for transmission of the SHM message. This parameter can be used to override the priority provided with MetaData from the J1939FscpSdgTxPdu. Tags: atp.Status=draft
          float J1939FscpTxSrvt: 0..INF, post-build-variant-value=true, set at link in variant link-time / post-build in variant post-build / pre-compile in variant pre-compile  # This parameter sets the maximum for the Safety-Relevant Validation Time (SRVT_Maximum), which is used to determine a time limit for the transmission of the corresponding SDM message after transmission of an SHM message. After this time, the SDM is dropped. Tags: atp.Status=draft
          container J1939FscpSdgTxPdu  # Contains the configuration of the PDU used to accept the transmitted SDG from the upper layer. Tags: atp.Status=draft | This PDU can consume a meta data item of type CAN_ID_32.
            integer J1939FscpSdgTxPduId: 0..65535, scope=ECU, set at pre-compile, symbolic-name-value=true, with-auto=true  # The PDU identifier used for Transmit from PduR. Tags: atp.Status=draft
            reference J1939FscpSdgTxPduRef: set at link in variant link-time+post-build / pre-compile in variant pre-compile, destination=Pdu  # Reference to the global PDU. Tags: atp.Status=draft
          container J1939FscpSdmTxPdu  # Contains the configuration of the PDU used to transmit the SDM PG. Tags: atp.Status=draft | This PDU can produce a meta data item of type CAN_ID_32.
            integer J1939FscpSdmTxPduId: 0..65535, scope=ECU, set at pre-compile, symbolic-name-value=true, with-auto=true  # The PDU identifier used for TxConfirmation to PduR. Tags: atp.Status=draft
            reference J1939FscpSdmTxPduRef: set at link in variant link-time+post-build / pre-compile in variant pre-compile, destination=Pdu  # Reference to the global PDU. Tags: atp.Status=draft
    container J1939FscpGeneral  # General configuration parameters of the J1939Fscp module. Tags: atp.Status=draft
      boolean J1939FscpDevErrorDetect: set at pre-compile, default-value=false  # Enables/disables the development error detection. Tags: atp.Status=draft
      float J1939FscpMainFunctionPeriod: 0..INF, scope=ECU, set at pre-compile  # Execution cycle of J1939Fscp_MainFunction. Tags: atp.Status=draft
      boolean J1939FscpVersionInfoApi: set at pre-compile, default-value=false  # Enables/disables the function J1939Fscp_GetVersionInfo() to get major, minor and patch version information. Tags: atp.Status=draft
  module definition J1939Nm [0..1]: post-build-variant-support=true, variants link-time/post-build/pre-compile  # Configuration of the J1939 Network Management module.
    container J1939NmConfigSet  # This container contains the configuration parameters and sub containers of the AUTOSAR J1939Nm module.
      container J1939NmChannel [1..*]: multiplicity set at link in variant link-time / post-build in variant post-build / pre-compile in variant pre-compile, post-build-variant-multiplicity=true  # Physical CAN channel handled by J1939Nm.
        boolean J1939NmChannelUsesAddressArbitration: post-build-variant-value=true, set at link in variant link-time / post-build in variant post-build / pre-compile in variant pre-compile, default-value=true  # Defines whether the nodes attached to this channel use an initial address claim, and whether they react to contending address claims of other nodes. | True: The initial address claim is sent, and the node reacts to address claims of other nodes. False: The node only sends an address claim upon request, and does not react to other address claims.
        boolean J1939NmChannelUsesDynamicAddressing [0..1]: post-build-variant-value=true, set at link in variant link-time / post-build in variant post-build / pre-compile in variant pre-compile, default-value=false  # Defines whether fully dynamic address resolution according to SAE J1939-81 shall be supported on this channel. | * True: The dynamically allocated addresses on the bus are matched at runtime to the configured addresses (see J1939NmNode.J1939NmNodePreferredAddress and J1939NmExternalNode.J1939NmExternalNodePreferredAddress). J1939NmNodes with J1939NmAddressConfigurationCapability set to J1939NM_AAC will change their addresses dynamically in case of an address conflict. * False: The addresses on the bus resemble the configured addresses. J1939NmAddressConfigurationCapability shall not be set to J1939NM_AAC.
        reference J1939NmComMNetworkHandleRef: set at link in variant link-time+post-build / pre-compile in variant pre-compile, requires-symbolic-name-value=true, destination=ComMChannel  # Reference to the channel defined by the ComMChannel providing access to the unique channel index ComMChannelId.
        container J1939NmNodeSpecificDemEventParameterRefs [0..*]: multiplicity set at link in variant link-time / post-build in variant post-build / pre-compile in variant pre-compile, post-build-variant-multiplicity=true  # Container for the references to DemEventParameter elements related to one J1939NmNode which shall be invoked using the API Dem_SetEventStatus in case the corresponding error occurs. The EventId is taken from the referenced DemEventParameter's DemEventId symbolic value. The standardized errors are provided in this container and can be extended by vendor-specific error references.
          reference J1939NM_E_ADDRESS_LOST: set at pre-compile, requires-symbolic-name-value=true, destination=DemEventParameter  # Reference to the DemEventParameter which shall be issued when the ECU failed to claim one of its addresses.
          reference J1939NmNodeRef: post-build-variant-value=true, set at link in variant link-time / post-build in variant post-build / pre-compile in variant pre-compile, destination=J1939NmNode  # Reference to J1939NmNode.
        container J1939NmRxPdu  # Contains the configuration of the PDU used to receive the AddressClaimed PG. This PDU consumes a meta data item of type CAN_ID_32.
          integer J1939NmRxPduId: 0..65535, scope=ECU, set at pre-compile, symbolic-name-value=true, with-auto=true  # The PDU identifier used for RxIndication from LSduR.
          reference J1939NmRxPduRef: set at link in variant link-time+post-build / pre-compile in variant pre-compile, destination=Pdu  # Reference to the Pdu object representing the PDU.
        container J1939NmTxPdu  # Contains the configuration of the PDU used to transmit the AddressClaimed PG. This PDU produces a meta data item of type CAN_ID_32.
          integer J1939NmTxPduId: 0..65535, scope=ECU, set at pre-compile, symbolic-name-value=true, with-auto=true  # The PDU identifier used for TxConfirmation from LSduR.
          reference J1939NmTxPduRef: set at link in variant link-time+post-build / pre-compile in variant pre-compile, destination=Pdu  # Reference to the Pdu object representing the PDU.
      container J1939NmExternalNode [0..*]: multiplicity set at pre-compile  # Logical node implemented in another ECU. Configures potential communication partners. If this container is connected to more than one channel, the external ECU is linked to the local ECU by each of these channels.
        integer J1939NmExternalNodeId: 0..65535, scope=ECU, set at pre-compile, symbolic-name-value=true, with-auto=true  # Unique identifier of this external node.
        boolean J1939NmExternalNodeNameArbitraryAddressCapable: post-build-variant-value=true, set at link in variant link-time / post-build in variant post-build / pre-compile in variant pre-compile  # Arbitrary Address Capable field of the NAME of this external node.
        integer J1939NmExternalNodeNameECUInstance: 0..7, post-build-variant-value=true, set at link in variant link-time / post-build in variant post-build / pre-compile in variant pre-compile  # ECU Instance field of the NAME of this external node.
        integer J1939NmExternalNodeNameFunction: 0..255, post-build-variant-value=true, set at link in variant link-time / post-build in variant post-build / pre-compile in variant pre-compile  # Function field of the NAME of this external node.
        integer J1939NmExternalNodeNameFunctionInstance: 0..31, post-build-variant-value=true, set at link in variant link-time / post-build in variant post-build / pre-compile in variant pre-compile  # Function Instance field of the NAME of this external node.
        integer J1939NmExternalNodeNameIdentityNumber: 0..2097151, post-build-variant-value=true, set at link in variant link-time / post-build in variant post-build / pre-compile in variant pre-compile  # Identity Number field of the NAME of this external node.
        integer J1939NmExternalNodeNameIndustryGroup: 0..7, post-build-variant-value=true, set at link in variant link-time / post-build in variant post-build / pre-compile in variant pre-compile  # Industry Group field of the NAME of this external node.
        integer J1939NmExternalNodeNameManufacturerCode: 0..2047, post-build-variant-value=true, set at link in variant link-time / post-build in variant post-build / pre-compile in variant pre-compile  # Manufacturer Code field of the NAME of this external node.
        integer J1939NmExternalNodeNameVehicleSystem: 0..127, post-build-variant-value=true, set at link in variant link-time / post-build in variant post-build / pre-compile in variant pre-compile  # Vehicle System field of the NAME of this external node.
        integer J1939NmExternalNodeNameVehicleSystemInstance: 0..15, post-build-variant-value=true, set at link in variant link-time / post-build in variant post-build / pre-compile in variant pre-compile  # Vehicle System Instance field of the NAME of this external node.
        integer J1939NmExternalNodePreferredAddress: 0..253, scope=ECU, post-build-variant-value=true, set at link in variant link-time / post-build in variant post-build / pre-compile in variant pre-compile  # Source address of this external node.
        reference J1939NmExternalNodeChannelRef [1..*]: multiplicity set at link in variant link-time / post-build in variant post-build / pre-compile in variant pre-compile, post-build-variant-multiplicity=true, post-build-variant-value=true, set at link in variant link-time / post-build in variant post-build / pre-compile in variant pre-compile, destination=J1939NmChannel  # Reference to the channels of the local ECU this external node has access to.
        reference J1939NmExternalNodeGatewayedChannelRef [0..*]: multiplicity set at link in variant link-time / post-build in variant post-build / pre-compile in variant pre-compile, post-build-variant-multiplicity=true, post-build-variant-value=true, set at link in variant link-time / post-build in variant post-build / pre-compile in variant pre-compile, destination=J1939NmChannel  # Reference to the channels on which messages to/from this external node shall be gatewayed. The address claim from the external node will be replicated on these channels.
      container J1939NmNode [1..*]: multiplicity set at link in variant link-time / post-build in variant post-build / pre-compile in variant pre-compile, post-build-variant-multiplicity=true  # Logical node representing one function handled by J1939Nm.
        enumeration J1939NmAddressConfigurationCapability [0..1]: {J1939NM_AAC, J1939NM_CCA, J1939NM_NCA, J1939NM_SCA, J1939NM_SVCA}, post-build-variant-value=true, set at link in variant link-time / post-build in variant post-build / pre-compile in variant pre-compile, default-value=J1939NM_NCA  # Defines the Address Configuration Capability of the J1939NmNode (corresponding to an SAE J1939 Controller Application, CA).
        integer J1939NmNodeId: 0..255, scope=ECU, set at pre-compile, symbolic-name-value=true, with-auto=true  # Unique identifier of this node.
        boolean J1939NmNodeNameArbitraryAddressCapable: set at pre-compile  # Arbitrary Address Capable field of the NAME of this node.
        integer J1939NmNodeNameECUInstance: 0..7, post-build-variant-value=true, set at link in variant link-time / post-build in variant post-build / pre-compile in variant pre-compile  # ECU Instance field of the NAME of this node.
        integer J1939NmNodeNameFunction: 0..255, post-build-variant-value=true, set at link in variant link-time / post-build in variant post-build / pre-compile in variant pre-compile  # Function field of the NAME of this node.
        integer J1939NmNodeNameFunctionInstance: 0..31, post-build-variant-value=true, set at link in variant link-time / post-build in variant post-build / pre-compile in variant pre-compile  # Function Instance field of the NAME of this node.
        integer J1939NmNodeNameIdentityNumber: 0..2097151, post-build-variant-value=true, set at link in variant link-time / post-build in variant post-build / pre-compile in variant pre-compile  # Identity Number field of the NAME of this node.
        integer J1939NmNodeNameIndustryGroup: 0..7, post-build-variant-value=true, set at link in variant link-time / post-build in variant post-build / pre-compile in variant pre-compile  # Industry Group field of the NAME of this node.
        integer J1939NmNodeNameManufacturerCode: 0..2047, post-build-variant-value=true, set at link in variant link-time / post-build in variant post-build / pre-compile in variant pre-compile  # Manufacturer Code field of the NAME of this node.
        integer J1939NmNodeNameVehicleSystem: 0..127, post-build-variant-value=true, set at link in variant link-time / post-build in variant post-build / pre-compile in variant pre-compile  # Vehicle System field of the NAME of this node.
        integer J1939NmNodeNameVehicleSystemInstance: 0..15, post-build-variant-value=true, set at link in variant link-time / post-build in variant post-build / pre-compile in variant pre-compile  # Vehicle System Instance field of the NAME of this node.
        integer J1939NmNodePreferredAddress: 0..253, scope=ECU, post-build-variant-value=true, set at link in variant link-time / post-build in variant post-build / pre-compile in variant pre-compile  # Source address of this node used for address claiming.
        boolean J1939NmNodeStartUpDelay: set at pre-compile, default-value=true  # If enabled, the node will start communication after a delay of 250ms after transmission of the initial AddressClaimed, depending on the configured J1939NmNodePreferredAddress. If disabled, the node will start communication immediately at network start-up. | Please note: According to J1939/81, the 250ms delay is not required for single address CAs with desired source addresses in the ranges 0..127 or 248..253.
        reference J1939NmNodeChannelRef [1..*]: multiplicity set at link in variant link-time+post-build / pre-compile in variant pre-compile, set at link in variant link-time+post-build / pre-compile in variant pre-compile, destination=J1939NmChannel  # Reference to the channels this node has access to.
      container J1939NmSharedAddressSpace [0..*]: multiplicity set at link in variant link-time / post-build in variant post-build / pre-compile in variant pre-compile, post-build-variant-multiplicity=true  # Set of J1939NmChannels that share a common address space. Address claims will be routed between these channels.
        reference J1939NmSharedChannelRef [2..*]: multiplicity set at link in variant link-time / post-build in variant post-build / pre-compile in variant pre-compile, post-build-variant-multiplicity=true, post-build-variant-value=true, set at link in variant link-time / post-build in variant post-build / pre-compile in variant pre-compile, destination=J1939NmChannel  # Reference to a channel that belongs to the shared address space.
    container J1939NmGeneral  # Contains the general configuration parameters of the module.
      float J1939NmBusOffDelayTickPeriod [0..1]: 0..INF, multiplicity set at link in variant link-time+post-build / pre-compile in variant pre-compile, set at link in variant link-time+post-build / pre-compile in variant pre-compile, default-value=0.02  # Duration of ticks that are used to time BusOff delays after conflicting address claims. This parameter must be synchronized with the main function period of the CAN State Manager.
      boolean J1939NmDevErrorDetect: set at pre-compile, default-value=false  # Switches the development error detection and notification on or off. | * true: detection and notification is enabled. * false: detection and notification is disabled.
      boolean J1939NmGatewaySupport: set at pre-compile  # Enables/disables support for claiming the addresses of routed messages.
      float J1939NmMainFunctionPeriod: 0..INF, scope=ECU, set at link in variant link-time+post-build / pre-compile in variant pre-compile, default-value=0.01  # Call cycle in seconds of J1939Nm_MainFunction.
      function name J1939NmUserCallout [0..1]: multiplicity set at pre-compile, set at pre-compile  # Pre-processor switch for enabling the <User_AddressClaimedIndication> and defining the name of the callout function.
      boolean J1939NmVersionInfoApi: set at pre-compile, default-value=false  # Pre-processor switch for enabling version info API support.
