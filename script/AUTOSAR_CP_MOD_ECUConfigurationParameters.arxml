[part 3 of 14: package /AUTOSAR/EcucDefs]
AUTOSAR XML (schema 00053)
package /AUTOSAR/EcucDefs  (continued)
  module definition CnV2xSec [0..1]: variants pre-compile  # Configuration of the CnV2xSec module. Tags: atp.Status=draft
    container CnV2xSecGeneral  # This container contains the configuration parameters of the security module CnV2xSec. Tags: atp.Status=draft
      reference CnV2xSecHashConfigRef: set at pre-compile, requires-symbolic-name-value=true, destination=CsmJob  # Select Csm service configuration that is used for hash. Tags: atp.Status=draft
      reference CnV2xSecNvMBlockDescriptorLongTermCertificateRef: set at pre-compile, requires-symbolic-name-value=true, destination=NvMBlockDescriptor  # Reference to NVRAM block containing the none volatile data of long term certificates Tags: atp.Status=draft
      reference CnV2xSecNvMBlockDescriptorPseudonymCertificateRef: set at pre-compile, requires-symbolic-name-value=true, destination=NvMBlockDescriptor  # Reference to NVRAM block containing the none volatile data of pseudonym certificates. Tags: atp.Status=draft
      reference CnV2xSecNvMBlockDescriptorRef: set at pre-compile, requires-symbolic-name-value=true, destination=NvMBlockDescriptor  # Reference to NVRAM block containing the none volatile data. Tags: atp.Status=draft
      reference CnV2xSecSignatureGenerationConfigRef: set at pre-compile, requires-symbolic-name-value=true, destination=CsmJob  # Select Csm service configuration that is used for signature generation. Tags: atp.Status=draft
      reference CnV2xSecSignatureVerifyConfigRef: set at pre-compile, requires-symbolic-name-value=true, destination=CsmJob  # Select Csm service configuration that is used for signature verification Tags: atp.Status=draft
  module definition Com [0..1]: post-build-variant-support=true, variants link-time/post-build/pre-compile  # Configuration of the AUTOSAR COM module.
    container ComConfig  # This container contains the configuration parameters and sub containers of the AUTOSAR COM module.
      integer ComDataMemSize [0..1]: 0..18446744073709551615, multiplicity set at link in variant link-time+post-build / pre-compile in variant pre-compile, set at link in variant link-time+post-build / pre-compile in variant pre-compile  # Size of internal Com data in units of bytes (static memory allocation) - memory required by post-build configuration must be smaller than this constant. This parameter is needed only in case of post-build loadable implementation using static memory allocation.
      integer ComMaxIPduCnt [0..1]: 0..18446744073709551615, multiplicity set at link in variant link-time+post-build / pre-compile in variant pre-compile, set at link in variant link-time+post-build / pre-compile in variant pre-compile  # Maximum number of IPdus. This parameter is needed only in case of post-build loadable implementation using static memory allocation.
      container ComGwMapping [0..*]: multiplicity set at link in variant link-time / post-build in variant post-build / pre-compile in variant pre-compile, post-build-variant-multiplicity=true  # Each instance of this container defines one mapping of the integrated Signal Gateway.
        choice container ComGwDestination [1..*]: multiplicity set at link in variant link-time / post-build in variant post-build / pre-compile in variant pre-compile, post-build-variant-multiplicity=true  # Each instance of this choice container allows to define one routing destination either by reference to an already configured COM signal / group signal or by a destination description container.
          container ComGwDestinationDescription [0..1]  # Description of a gateway destination. This container allows defining a gateway destination without the configuration of a complete COM signal. This allows adding / changing gateway relations post build without the configuration of new signals.
            integer ComBitPosition: 0..4294967295, post-build-variant-value=true, set at link in variant link-time / post-build in variant post-build / pre-compile in variant pre-compile  # Starting position within the I-PDU. This parameter refers to the position in the I-PDU and not in the shadow buffer. If the endianness conversion is configured to Opaque the parameter ComBitPosition shall define the bit0 of the first byte like in little endian byte order
            enumeration ComSignalEndianness: {BIG_ENDIAN, LITTLE_ENDIAN, OPAQUE}, post-build-variant-value=true, set at link in variant link-time / post-build in variant post-build / pre-compile in variant pre-compile  # Defines the endianness of the signal's network representation.
            string ComSignalInitValue [0..1]: multiplicity set at link in variant link-time / post-build in variant post-build / pre-compile in variant pre-compile, post-build-variant-multiplicity=true, post-build-variant-value=true, set at link in variant link-time / post-build in variant post-build / pre-compile in variant pre-compile, default-value=0  # Initial value for this signal. In case of UINT8_N the default value is a string of length ComSignalLength with all bytes set to 0x00. In case of UINT8_DYN the initial size shall be 0. | In case the ComSignalType is UINT8, UINT16, UINT32, UINT64, SINT8, SINT16, SINT32, SINT64 the string shall be interpreted as defined in the chapter Integer Type in the AUTOSAR EcuC specification. In case the ComSignalType is FLOAT32, FLOAT64 the string shall be interpreted as defined in the chapter Float Type in the AUTOSAR EcuC specification. In case the ComSignalType is BOOLEAN the string shall be interpreted as defined in the chapter Boolean Type in the AUTOSAR EcuC specification. In case the ComSignal is a UINT8_N, UINT8_DYN the string shall be interpreted as a decimal representation of the characters separated by blanks, e.g. "97 98 100" means a string "abd", where the char "a" is in byte 0(lowest address), "b" is in byte 1, and "d" is in byte 2 and (highest address). For the ComSignalType UINT8_DYN the dynamic length shall be set to the number of configured characters. An empty string "" shall be interpreted as 0-sized dynamic signal.
            enumeration ComTransferProperty [0..1]: {PENDING, TRIGGERED, TRIGGERED_ON_CHANGE, TRIGGERED_ON_CHANGE_WITHOUT_REPETITION, TRIGGERED_WITHOUT_REPETITION}, multiplicity set at link in variant link-time / post-build in variant post-build / pre-compile in variant pre-compile, post-build-variant-multiplicity=true, post-build-variant-value=true, set at link in variant link-time / post-build in variant post-build / pre-compile in variant pre-compile  # Defines if a write access to this signal can trigger the transmission of the corresponding I-PDU. If the I-PDU is triggered, depends also on the transmission mode of the corresponding I-PDU.
            integer ComUpdateBitPosition [0..1]: 0..4294967295, multiplicity set at link in variant link-time / post-build in variant post-build / pre-compile in variant pre-compile, post-build-variant-multiplicity=true, post-build-variant-value=true, set at link in variant link-time / post-build in variant post-build / pre-compile in variant pre-compile  # Bit position of update-bit inside I-PDU. | If this attribute is omitted then there is no update-bit. This setting must be consistently on sender and on receiver side. Range: 0..63 for CAN and LIN, 0..511 for CAN FD, 0..2031 for FlexRay, 0..4294967295 for TP.
            reference ComGwIPduRef: post-build-variant-value=true, set at link in variant link-time / post-build in variant post-build / pre-compile in variant pre-compile, destination=ComIPdu  # Reference to an I-PDU of a Signal Gateway source or destination description.
            container ComFilter [0..1]  # This container contains the configuration parameters of the AUTOSAR COM module's Filters. | Note: On sender side the container is used to specify the transmission mode conditions.
              enumeration ComFilterAlgorithm: {ALWAYS, MASKED_NEW_DIFFERS_MASKED_OLD, MASKED_NEW_DIFFERS_X, MASKED_NEW_EQUALS_X, NEVER, NEW_IS_OUTSIDE, NEW_IS_WITHIN, ONE_EVERY_N}, set at link in variant link-time+post-build / pre-compile in variant pre-compile  # The range of values is specified in the [17] specification, chapter 2.2.2, Reception Filtering.
              integer ComFilterMask [0..1]: -2147483648..4294967295, multiplicity set at link in variant link-time+post-build / pre-compile in variant pre-compile, set at link in variant link-time+post-build / pre-compile in variant pre-compile  # The name of this attribute corresponds to the parameter name in the [17] specification of Reception Filtering.
              integer ComFilterMax [0..1]: -2147483648..4294967295, multiplicity set at link in variant link-time+post-build / pre-compile in variant pre-compile, set at link in variant link-time+post-build / pre-compile in variant pre-compile  # The name of this attribute corresponds to the parameter name in the [17] specification of Reception Filtering.
              integer ComFilterMin [0..1]: -2147483648..4294967295, multiplicity set at link in variant link-time+post-build / pre-compile in variant pre-compile, set at link in variant link-time+post-build / pre-compile in variant pre-compile  # The name of this attribute corresponds to the parameter name in the [17] specification of Reception Filtering.
              integer ComFilterOffset [0..1]: 0..4294967294, multiplicity set at link in variant link-time+post-build / pre-compile in variant pre-compile, set at link in variant link-time+post-build / pre-compile in variant pre-compile  # The name of this attribute corresponds to the parameter name in the [17] specification of Reception Filtering. | Range = 0..(ComFilterPeriod-1)
              integer ComFilterPeriod [0..1]: 2..4294967295, multiplicity set at link in variant link-time / post-build in variant post-build / pre-compile in variant pre-compile, post-build-variant-multiplicity=true, post-build-variant-value=true, set at link in variant link-time / post-build in variant post-build / pre-compile in variant pre-compile  # This parameter defines the period of the ComFilterAlgorithm ONE_EVERY_N.
              integer ComFilterX [0..1]: -2147483648..4294967295, multiplicity set at link in variant link-time+post-build / pre-compile in variant pre-compile, set at link in variant link-time+post-build / pre-compile in variant pre-compile  # The name of this attribute corresponds to the parameter name in the [17] specification of Reception Filtering.
          container ComGwSignal [0..1]  # This container allows specifying a gateway source or destination respectively with a reference to a ComSignal or a ComGroupSignal.
            choice reference ComGwSignalRef: post-build-variant-value=true, set at link in variant link-time / post-build in variant post-build / pre-compile in variant pre-compile, destination=[ComGroupSignal, ComSignal]  # Reference to an object of a gateway relation. Either to a ComSignal or a ComGroupSignal.
        choice container ComGwSource  # This choice container allows the definition of the gateway source signal either by reference to an already configured COM signal / group signal or by a source description container.
          container ComGwSignal [0..1]  # This container allows specifying a gateway source or destination respectively with a reference to a ComSignal or a ComGroupSignal.
            choice reference ComGwSignalRef: post-build-variant-value=true, set at link in variant link-time / post-build in variant post-build / pre-compile in variant pre-compile, destination=[ComGroupSignal, ComSignal]  # Reference to an object of a gateway relation. Either to a ComSignal or a ComGroupSignal.
          container ComGwSourceDescription [0..1]  # Description of a gateway source. This container allows defining a gateway source without the configuration of a complete COM signal. This allows adding / changing gateway relations post build without the configuration of new signals.
            integer ComBitPosition: 0..4294967295, post-build-variant-value=true, set at link in variant link-time / post-build in variant post-build / pre-compile in variant pre-compile  # Starting position within the I-PDU. This parameter refers to the position in the I-PDU and not in the shadow buffer. If the endianness conversion is configured to Opaque the parameter ComBitPosition shall define the bit0 of the first byte like in little endian byte order
            integer ComBitSize [0..1]: 0..64, multiplicity set at link in variant link-time / post-build in variant post-build / pre-compile in variant pre-compile, post-build-variant-multiplicity=true, post-build-variant-value=true, set at link in variant link-time / post-build in variant post-build / pre-compile in variant pre-compile  # Size in bits, for integer signal types. For ComSignalType UINT8_N and UINT8_DYN | the size shall be configured by ComSignalLength. For ComSignalTypes FLOAT32 and FLOAT64 the size is already defined by the signal type and therefore may be omitted.
            enumeration ComSignalEndianness: {BIG_ENDIAN, LITTLE_ENDIAN, OPAQUE}, post-build-variant-value=true, set at link in variant link-time / post-build in variant post-build / pre-compile in variant pre-compile  # Defines the endianness of the signal's network representation.
            integer ComSignalLength [0..1]: 0..4294967295, multiplicity set at link in variant link-time+post-build / pre-compile in variant pre-compile, set at link in variant link-time+post-build / pre-compile in variant pre-compile  # Description: | For ComSignalType UINT8_N this parameter specifies the length n in bytes. For ComSignalType UINT8_DYN it specifies the maximum length in bytes. For all other types this parameter shall be ignored. The supported maximum length is restricted by the used transportation system. For non TP-PDUs the maximum size of a PDU, and therefore also of any included signal, is limited by the concrete bus characteristic. For example, the limit is 8 bytes for CAN and LIN, 64 bytes for CAN FD and 254 for FlexRay.
            enumeration ComSignalType: {BOOLEAN, FLOAT32, FLOAT64, SINT16, SINT32, SINT64, SINT8, UINT16, UINT32, UINT64, UINT8, UINT8_DYN, UINT8_N}, set at link in variant link-time+post-build / pre-compile in variant pre-compile  # The AUTOSAR type of the signal. Whether or not the signal is signed or unsigned can be found by examining the value of this attribute. | This type could also be used to reserved appropriate storage in AUTOSAR COM.
            integer ComUpdateBitPosition [0..1]: 0..4294967295, multiplicity set at link in variant link-time / post-build in variant post-build / pre-compile in variant pre-compile, post-build-variant-multiplicity=true, post-build-variant-value=true, set at link in variant link-time / post-build in variant post-build / pre-compile in variant pre-compile  # Bit position of update-bit inside I-PDU. | If this attribute is omitted then there is no update-bit. This setting must be consistently on sender and on receiver side. Range: 0..63 for CAN and LIN, 0..511 for CAN FD, 0..2031 for FlexRay, 0..4294967295 for TP.
            reference ComGwIPduRef: post-build-variant-value=true, set at link in variant link-time / post-build in variant post-build / pre-compile in variant pre-compile, destination=ComIPdu  # Reference to an I-PDU of a Signal Gateway source or destination description.
      container ComIPdu [0..*]: multiplicity set at link in variant link-time / post-build in variant post-build / pre-compile in variant pre-compile, post-build-variant-multiplicity=true  # Contains the configuration parameters of the AUTOSAR COM module's I-PDUs.
        function name ComIPduCallout [0..1]: multiplicity set at pre-compile, set at pre-compile  # This parameter defines the existence and the name of a callout function for the corresponding I-PDU. If this parameter is omitted no I-PDU callout shall take place for the corresponding I-PDU.
        boolean ComIPduCancellationSupport [0..1]: scope=ECU, multiplicity set at post-build in variant post-build / pre-compile in variant pre-compile, post-build-variant-multiplicity=true, post-build-variant-value=true, set at post-build in variant post-build / pre-compile in variant pre-compile, default-value=false  # Defines for I-PDUs with ComIPduType NORMAL: If the underlying IF-modul supports cancellation of transmit requests. | Defines for I-PDUs with ComIPduType TP: If the underlying TP-module supports RX and TX cancellation of ongoing requests.
        enumeration ComIPduDirection: {RECEIVE, SEND}, set at link in variant link-time+post-build / pre-compile in variant pre-compile  # The direction defines if this I-PDU, and therefore the contributing signals and signal groups, shall be sent or received.
        integer ComIPduHandleId [0..1]: 0..65535, scope=ECU, multiplicity set at pre-compile, set at pre-compile, symbolic-name-value=true, with-auto=true  # The numerical value used as the ID of this I-PDU. The ComIPduHandleId is required by the API calls Com_RxIndication, Com_TpRxIndication, Com_StartOfReception and Com_CopyRxData to receive I-PDUs from the PduR (ComIP-duDirection: Receive), as well as the PduId passed to an Rx-I-PDU-callout. For Tx-I-PDUs (ComIPduDirection: Send), this handle Id is used for the APIs calls Com_TxConfirmation, Com_TriggerTransmit, Com_TriggerIPDUSend or Com_TriggerIPDUSendWithMetaData, Com_CopyTxData and Com_TpTxConfirmation to transmit respectively confirm transmissions of I-PDUs, as well as the PduId passed to the Tx-I-PDU-callout configured with ComIPduCallout and/or ComIPduTriggerTransmitCallout.
        enumeration ComIPduSignalProcessing: {DEFERRED, IMMEDIATE}, post-build-variant-value=true, set at link in variant link-time / post-build in variant post-build / pre-compile in variant pre-compile  # For the definition of the two modes Immediate and Deferred.
        function name ComIPduTriggerTransmitCallout [0..1]: multiplicity set at pre-compile, set at pre-compile  # If there is a trigger transmit callout defined for this I-PDU this parameter contains the name of the callout function.
        enumeration ComIPduType: {NORMAL, TP}, post-build-variant-value=true, set at link in variant link-time / post-build in variant post-build / pre-compile in variant pre-compile  # Defines if this I-PDU is a normal I-PDU that can be sent unfragmented or if this is a large I-PDU that shall be sent via the Transport Protocol of the underlying bus.
        reference ComIPduGroupRef [0..*]: multiplicity set at link in variant link-time / post-build in variant post-build / pre-compile in variant pre-compile, post-build-variant-multiplicity=true, post-build-variant-value=true, set at link in variant link-time / post-build in variant post-build / pre-compile in variant pre-compile, destination=ComIPduGroup  # Reference to the I-PDU groups this I-PDU belongs to.
        choice reference ComIPduMainFunctionRef [0..1]: multiplicity set at pre-compile, set at pre-compile, destination=[ComMainFunctionRx, ComMainFunctionTx]  # Reference to the Com_MainFunctionRx/Com_MainFunctionTx this I-PDU belongs to. | Mandatory, if multiple main functions of the relevant type are defined.
        reference ComIPduSignalGroupRef [0..*]: multiplicity set at link in variant link-time / post-build in variant post-build / pre-compile in variant pre-compile, post-build-variant-multiplicity=true, post-build-variant-value=true, set at link in variant link-time / post-build in variant post-build / pre-compile in variant pre-compile, destination=ComSignalGroup  # References to all signal groups contained in this I-Pdu
        reference ComIPduSignalRef [0..*]: multiplicity set at link in variant link-time / post-build in variant post-build / pre-compile in variant pre-compile, post-build-variant-multiplicity=true, post-build-variant-value=true, set at link in variant link-time / post-build in variant post-build / pre-compile in variant pre-compile, destination=ComSignal  # References to all signals contained in this I-PDU.
        reference ComMainFunctionRouteSignalsRef [0..1]: multiplicity set at pre-compile, set at pre-compile, destination=ComMainFunctionRouteSignals  # Reference to ComMainFunctionRouteSignals which performs signal gateway related activities.
        reference ComPduIdRef: set at link in variant link-time+post-build / pre-compile in variant pre-compile, destination=Pdu  # Reference to the "global" Pdu structure to allow harmonization of handle IDs in the COM-Stack.
        container ComTxIPdu [0..1]  # This container contains additional transmission related configuration parameters of the AUTOSAR COM module's I-PDUs.
          float ComMinimumDelayTime [0..1]: 0..3600, multiplicity set at link in variant link-time / post-build in variant post-build / pre-compile in variant pre-compile, post-build-variant-multiplicity=true, post-build-variant-value=true, set at link in variant link-time / post-build in variant post-build / pre-compile in variant pre-compile  # Defines the Minimum Delay Time (MDT) between successive transmissions of this I-PDU in seconds. The MDT is independent of the possible different transmission modes. There is only one minimum delay time parameter for one I-PDU. The minimum delay timer is not reset by changing the transmission mode. Hence, it is not allowed to violate the minimum delay time by transmission mode changes. It is not possible to monitor the minimum delay time for I-PDUs that are requested using the Com_TriggerTransmit API.
          enumeration ComTxIPduClearUpdateBit [0..1]: {Confirmation, Transmit, TriggerTransmit}, multiplicity set at link in variant link-time / post-build in variant post-build / pre-compile in variant pre-compile, post-build-variant-multiplicity=true, post-build-variant-value=true, set at link in variant link-time / post-build in variant post-build / pre-compile in variant pre-compile  # Defines when the update-bits of signals or signal groups, contained in this I-PDU, will be cleared.
          integer ComTxIPduUnusedAreasDefault: 0..255, set at link in variant link-time+post-build / pre-compile in variant pre-compile  # The AUTOSAR COM module fills not used areas of an I-PDU with this byte pattern. This attribute is mandatory to avoid undefined behaviour. This byte-pattern will be repeated throughout the I-PDU before any init-values or update-bits were set.
          container ComMetaDataDefaultItem [0..*]: multiplicity set at link in variant link-time / post-build in variant post-build / pre-compile in variant pre-compile, post-build-variant-multiplicity=true  # Defines a default value for a meta data item. Used for sending an I-PDU with meta data when it is triggered spontaneously (and not by Com_TriggerIPDUSendWithMetaData), and no meta data has been provided by the RTE. It represents a MetaDataItem of the referenced global PDU.
            integer ComMetaDataDefaultValue: 0..18446744073709551615, post-build-variant-value=true, set at link in variant link-time / post-build in variant post-build / pre-compile in variant pre-compile  # Default value for MetaDataItem of the global PDU.
            reference ComMetaDataItemRef: post-build-variant-value=true, set at link in variant link-time / post-build in variant post-build / pre-compile in variant pre-compile, destination=MetaDataItem  # Reference to a MetaDataItem of the global PDU.
          container ComTxModeFalse [0..1]  # This container contains the configuration parameters of the AUTOSAR COM module's transmission modes in the case the ComFilter evaluates to false.
            container ComTxMode  # This container contains the configuration parameters of the AUTOSAR COM module's transmission modes.
              enumeration ComTxModeMode: {DIRECT, MIXED, NONE, PERIODIC}, post-build-variant-value=true, set at link in variant link-time / post-build in variant post-build / pre-compile in variant pre-compile  # The available transmission modes described in [18] shall be extended by the additional mode None. | The transmission mode None shall not have any further sub-attributes in the ComTxMode object.
              integer ComTxModeNumberOfRepetitions [0..1]: 0..255, multiplicity set at link in variant link-time / post-build in variant post-build / pre-compile in variant pre-compile, post-build-variant-multiplicity=true, post-build-variant-value=true, set at link in variant link-time / post-build in variant post-build / pre-compile in variant pre-compile  # Defines the number of repetitions for the transmission mode DIRECT and the event driven part of transmission mode MIXED.
              float ComTxModeRepetitionPeriod [0..1]: 0..3600, multiplicity set at link in variant link-time / post-build in variant post-build / pre-compile in variant pre-compile, post-build-variant-multiplicity=true, post-build-variant-value=true, set at link in variant link-time / post-build in variant post-build / pre-compile in variant pre-compile  # Defines the repetition period in seconds of the multiple transmissions in case ComTxModeNumberOfRepetitions is configured greater than or equal to 1 and ComTxModeMode is configured to DIRECT or MIXED. In case of the mixed transmission mode only the event driven part is affected.
              float ComTxModeTimeOffset [0..1]: 0..3600, multiplicity set at link in variant link-time / post-build in variant post-build / pre-compile in variant pre-compile, post-build-variant-multiplicity=true, post-build-variant-value=true, set at link in variant link-time / post-build in variant post-build / pre-compile in variant pre-compile  # Defines the period in seconds between the start of the I-PDU by Com_IpduGroupStart and the first transmission request in case ComTxModeMode is configured to PERIODIC or MIXED. In case of the mixed transmission mode only the periodic part is affected. | In case ComTxModeTimeOffset is omitted or configured to 0, the first periodic transmission shall be transmitted within the next invocation of Com_MainFunctionTx.
              float ComTxModeTimePeriod [0..1]: 0..3600, multiplicity set at link in variant link-time / post-build in variant post-build / pre-compile in variant pre-compile, post-build-variant-multiplicity=true, post-build-variant-value=true, set at link in variant link-time / post-build in variant post-build / pre-compile in variant pre-compile  # Defines the repetition period in seconds of the periodic transmission requests in case ComTxModeMode is configured to PERIODIC or MIXED. In case of the mixed transmission mode only the periodic part is affected.
          container ComTxModeTrue [0..1]  # This container contains the configuration parameters of the AUTOSAR COM module's transmission modes in the case the ComFilter evaluates to true.
            container ComTxMode  # This container contains the configuration parameters of the AUTOSAR COM module's transmission modes.
              enumeration ComTxModeMode: {DIRECT, MIXED, NONE, PERIODIC}, post-build-variant-value=true, set at link in variant link-time / post-build in variant post-build / pre-compile in variant pre-compile  # The available transmission modes described in [18] shall be extended by the additional mode None. | The transmission mode None shall not have any further sub-attributes in the ComTxMode object.
              integer ComTxModeNumberOfRepetitions [0..1]: 0..255, multiplicity set at link in variant link-time / post-build in variant post-build / pre-compile in variant pre-compile, post-build-variant-multiplicity=true, post-build-variant-value=true, set at link in variant link-time / post-build in variant post-build / pre-compile in variant pre-compile  # Defines the number of repetitions for the transmission mode DIRECT and the event driven part of transmission mode MIXED.
              float ComTxModeRepetitionPeriod [0..1]: 0..3600, multiplicity set at link in variant link-time / post-build in variant post-build / pre-compile in variant pre-compile, post-build-variant-multiplicity=true, post-build-variant-value=true, set at link in variant link-time / post-build in variant post-build / pre-compile in variant pre-compile  # Defines the repetition period in seconds of the multiple transmissions in case ComTxModeNumberOfRepetitions is configured greater than or equal to 1 and ComTxModeMode is configured to DIRECT or MIXED. In case of the mixed transmission mode only the event driven part is affected.
              float ComTxModeTimeOffset [0..1]: 0..3600, multiplicity set at link in variant link-time / post-build in variant post-build / pre-compile in variant pre-compile, post-build-variant-multiplicity=true, post-build-variant-value=true, set at link in variant link-time / post-build in variant post-build / pre-compile in variant pre-compile  # Defines the period in seconds between the start of the I-PDU by Com_IpduGroupStart and the first transmission request in case ComTxModeMode is configured to PERIODIC or MIXED. In case of the mixed transmission mode only the periodic part is affected. | In case ComTxModeTimeOffset is omitted or configured to 0, the first periodic transmission shall be transmitted within the next invocation of Com_MainFunctionTx.
              float ComTxModeTimePeriod [0..1]: 0..3600, multiplicity set at link in variant link-time / post-build in variant post-build / pre-compile in variant pre-compile, post-build-variant-multiplicity=true, post-build-variant-value=true, set at link in variant link-time / post-build in variant post-build / pre-compile in variant pre-compile  # Defines the repetition period in seconds of the periodic transmission requests in case ComTxModeMode is configured to PERIODIC or MIXED. In case of the mixed transmission mode only the periodic part is affected.
      container ComIPduGroup [0..*]: multiplicity set at link in variant link-time / post-build in variant post-build / pre-compile in variant pre-compile, post-build-variant-multiplicity=true  # Contains the configuration parameters of the AUTOSAR COM module's I-PDU groups.
        integer ComIPduGroupHandleId: 0..65535, scope=ECU, set at pre-compile, symbolic-name-value=true, with-auto=true  # The numerical value used as the ID of this I-PDU Group . | The ComIPduGroupHandleId is required by the API calls to start and stop I-PDU Groups. Range: 0 .. (ComSupportedIPduGroups-1)
        reference ComIPduGroupGroupRef [0..*]: multiplicity set at link in variant link-time / post-build in variant post-build / pre-compile in variant pre-compile, post-build-variant-multiplicity=true, post-build-variant-value=true, set at link in variant link-time / post-build in variant post-build / pre-compile in variant pre-compile, destination=ComIPduGroup  # References to all I-PDU groups that includes this I-PDU group. If this reference is omitted this I-PDU group does not belong to another I-PDU group.
      container ComMainFunctionRouteSignals [0..*]: multiplicity set at pre-compile  # Each element of this container defines one instance of Com_MainFunctionRouteSignals.
        float ComMainRouteSignalsTimeBase: 0..INF, set at pre-compile  # The period between successive calls to according instance of Com_MainFunctionRouteSignals in seconds. This parameter may be used by the COM generator to transform the values of the reception related timing configuration parameters of the COM module to internal implementation specific counter or tick values. The COM module's internal timing handling is implementation specific. | The COM module (generator) may rely on the fact that Com_MainFunctionRouteSignals is scheduled according to the value configured here.
        reference ComMainRouteSignalsPartitionRef [0..1]: multiplicity set at pre-compile, set at pre-compile, destination=EcucPartition  # Reference to EcucPartition, where the according Com_MainFunction instance is assigned to.
      container ComMainFunctionRx [0..*]: multiplicity set at pre-compile  # Each element of this container defines one instance of Com_MainFunctionRx.
        float ComMainRxTimeBase: 0..INF, set at pre-compile  # The period between successive calls to according instance of Com_MainFunctionRx in seconds. This parameter may be used by the COM generator to transform the values of the reception related timing configuration parameters of the COM module to internal implementation specific counter or tick values. The COM module's internal timing handling is implementation specific. | The COM module (generator) may rely on the fact that Com_MainFunctionRx is scheduled according to the value configured here.
        reference ComMainRxPartitionRef [0..1]: multiplicity set at pre-compile, set at pre-compile, destination=EcucPartition  # Reference to EcucPartition, where the according Com_MainFunction instance is assigned to.
      container ComMainFunctionTx [0..*]: multiplicity set at pre-compile  # Each element of this container defines one instance of Com_MainFunctionTx.
        float ComMainTxTimeBase: 0..INF, set at pre-compile  # The period between successive calls to according instance of Com_MainFunctionTx in seconds. This parameter may be used by the COM generator to transform the values of the reception related timing configuration parameters of the COM module to internal implementation specific counter or tick values. The COM module's internal timing handling is implementation specific. | The COM module (generator) may rely on the fact that Com_MainFunctionTx is scheduled according to the value configured here.
        function name ComPreparationNotification [0..1]: multiplicity set at pre-compile, set at pre-compile  # This callback function indicates that the signals/signal groups to be sent via a dedicated Com_MainFunctionTx instance will now be prepared for transmission. | If this parameter is omitted no notification shall take place.
        reference ComMainTxPartitionRef [0..1]: multiplicity set at pre-compile, set at pre-compile, destination=EcucPartition  # Reference to EcucPartition, where the according Com_MainFunction instance is assigned to.
      container ComSignal [0..*]: multiplicity set at link in variant link-time / post-build in variant post-build / pre-compile in variant pre-compile, post-build-variant-multiplicity=true  # Contains the configuration parameters of the AUTOSAR COM module's signals.
        integer ComBitPosition: 0..4294967295, post-build-variant-value=true, set at link in variant link-time / post-build in variant post-build / pre-compile in variant pre-compile  # Starting position within the I-PDU. This parameter refers to the position in the I-PDU and not in the shadow buffer. If the endianness conversion is configured to Opaque the parameter ComBitPosition shall define the bit0 of the first byte like in little endian byte order
        integer ComBitSize [0..1]: 0..64, multiplicity set at link in variant link-time / post-build in variant post-build / pre-compile in variant pre-compile, post-build-variant-multiplicity=true, post-build-variant-value=true, set at link in variant link-time / post-build in variant post-build / pre-compile in variant pre-compile  # Size in bits, for integer signal types. For ComSignalType UINT8_N and UINT8_DYN | the size shall be configured by ComSignalLength. For ComSignalTypes FLOAT32 and FLOAT64 the size is already defined by the signal type and therefore may be omitted.
        enumeration ComDataInvalidAction [0..1]: {NOTIFY, REPLACE}, multiplicity set at link in variant link-time+post-build / pre-compile in variant pre-compile, set at link in variant link-time+post-build / pre-compile in variant pre-compile  # This parameter defines the action performed upon reception of an invalid signal. | Relating to signal groups the action in case if one of the included signals is an invalid signal. If Replace is used the ComSignalInitValue will be used for the replacement.
        float ComFirstTimeout [0..1]: 0..3600, multiplicity set at link in variant link-time / post-build in variant post-build / pre-compile in variant pre-compile, post-build-variant-multiplicity=true, post-build-variant-value=true, set at link in variant link-time / post-build in variant post-build / pre-compile in variant pre-compile  # Defines the length of the first deadline monitoring timeout period in seconds. This timeout is used immediately after start (or restart) of the deadline monitoring service. The timeout period of the successive periods is configured by ECUC_Com_00263.
        integer ComHandleId [0..1]: 0..65535, scope=ECU, multiplicity set at pre-compile, set at pre-compile, symbolic-name-value=true, with-auto=true  # The numerical value used as the ID. | This ID identifies signals and signal groups in the COM APIs using Com_SignalIdType or Com_SignalGroupIdType parameter respectively.
        boolean ComInitialValueOnly [0..1]: multiplicity set at link in variant link-time+post-build / pre-compile in variant pre-compile, set at link in variant link-time+post-build / pre-compile in variant pre-compile, default-value=false  # This parameter defines that the respective signal's initial value shall be put into the respective PDU but there will not be any update of the value through the users (e.g. RTE, SwCluC). Thus the Com implementation does not need to expect any API calls for this signal (group).
        enumeration ComRxDataTimeoutAction [0..1]: {NONE, REPLACE, SUBSTITUTE}, multiplicity set at link in variant link-time+post-build / pre-compile in variant pre-compile, set at link in variant link-time+post-build / pre-compile in variant pre-compile  # This parameter defines the action performed upon expiration of the reception deadline monitoring timer.
        string ComSignalDataInvalidValue [0..1]: multiplicity set at link in variant link-time+post-build / pre-compile in variant pre-compile, set at link in variant link-time+post-build / pre-compile in variant pre-compile  # Defines the data invalid value of the signal. | In case the ComSignalType is UINT8, UINT16, UINT32, UINT64, SINT8, SINT16, SINT32, SINT64 the string shall be interpreted as defined in the chapter Integer Type in the AUTOSAR EcuC specification. In case the ComSignalType is FLOAT32, FLOAT64 the string shall be interpreted as defined in the chapter Float Type in the AUTOSAR EcuC specification. In case the ComSignalType is BOOLEAN the string shall be interpreted as defined in the chapter Boolean Type in the AUTOSAR EcuC specification. In case the ComSignal is a UINT8_N, UINT8_DYN the string shall be interpreted as a decimal representation of the characters separated by blanks, e.g. "97 98 100" means a string "abd", where the char "a" is in byte 0(lowest address), "b" is in byte 1, and "d" is in byte 2 and (highest address). For the ComSignalType UINT8_DYN the dynamic length shall be set to the number of configured characters. An empty string "" shall be interpreted as 0-sized dynamic signal.
        enumeration ComSignalEndianness: {BIG_ENDIAN, LITTLE_ENDIAN, OPAQUE}, post-build-variant-value=true, set at link in variant link-time / post-build in variant post-build / pre-compile in variant pre-compile  # Defines the endianness of the signal's network representation.
        string ComSignalInitValue [0..1]: multiplicity set at link in variant link-time / post-build in variant post-build / pre-compile in variant pre-compile, post-build-variant-multiplicity=true, post-build-variant-value=true, set at link in variant link-time / post-build in variant post-build / pre-compile in variant pre-compile, default-value=0  # Initial value for this signal. In case of UINT8_N the default value is a string of length ComSignalLength with all bytes set to 0x00. In case of UINT8_DYN the initial size shall be 0. | In case the ComSignalType is UINT8, UINT16, UINT32, UINT64, SINT8, SINT16, SINT32, SINT64 the string shall be interpreted as defined in the chapter Integer Type in the AUTOSAR EcuC specification. In case the ComSignalType is FLOAT32, FLOAT64 the string shall be interpreted as defined in the chapter Float Type in the AUTOSAR EcuC specification. In case the ComSignalType is BOOLEAN the string shall be interpreted as defined in the chapter Boolean Type in the AUTOSAR EcuC specification. In case the ComSignal is a UINT8_N, UINT8_DYN the string shall be interpreted as a decimal representation of the characters separated by blanks, e.g. "97 98 100" means a string "abd", where the char "a" is in byte 0(lowest address), "b" is in byte 1, and "d" is in byte 2 and (highest address). For the ComSignalType UINT8_DYN the dynamic length shall be set to the number of configured characters. An empty string "" shall be interpreted as 0-sized dynamic signal.
        integer ComSignalLength [0..1]: 0..4294967295, multiplicity set at link in variant link-time+post-build / pre-compile in variant pre-compile, set at link in variant link-time+post-build / pre-compile in variant pre-compile  # Description: | For ComSignalType UINT8_N this parameter specifies the length n in bytes. For ComSignalType UINT8_DYN it specifies the maximum length in bytes. For all other types this parameter shall be ignored. The supported maximum length is restricted by the used transportation system. For non TP-PDUs the maximum size of a PDU, and therefore also of any included signal, is limited by the concrete bus characteristic. For example, the limit is 8 bytes for CAN and LIN, 64 bytes for CAN FD and 254 for FlexRay.
        enumeration ComSignalType: {BOOLEAN, FLOAT32, FLOAT64, SINT16, SINT32, SINT64, SINT8, UINT16, UINT32, UINT64, UINT8, UINT8_DYN, UINT8_N}, set at link in variant link-time+post-build / pre-compile in variant pre-compile  # The AUTOSAR type of the signal. Whether or not the signal is signed or unsigned can be found by examining the value of this attribute. | This type could also be used to reserved appropriate storage in AUTOSAR COM.
        float ComTimeout [0..1]: 0..3600, multiplicity set at link in variant link-time / post-build in variant post-build / pre-compile in variant pre-compile, post-build-variant-multiplicity=true, post-build-variant-value=true, set at link in variant link-time / post-build in variant post-build / pre-compile in variant pre-compile  # Defines the length of the deadline monitoring timeout period in seconds. The period for the first timeout period can be configured separately by ECUC_Com_00183.
        string ComTimeoutSubstitutionValue [0..1]: multiplicity set at link in variant link-time / post-build in variant post-build / pre-compile in variant pre-compile, post-build-variant-multiplicity=true, post-build-variant-value=true, set at link in variant link-time / post-build in variant post-build / pre-compile in variant pre-compile  # The signal substitution value will be used in case of a timeout and ComRxDataTimeoutAction is set to SUBSTITUTE. | In case of UINT8_N the default value is a string of length ComSignalLength with all bytes set to 0x00. In case ofUINT8_DYN the initial size shall be 0. In case the ComSignalType is UINT8, UINT16, UINT32, UINT64, SINT8, SINT16, SINT32, SINT64 the string shall be interpreted as defined in the chapter Integer Type in the AUTOSAR EcuC specification. In case the ComSignalType is FLOAT32, FLOAT64 the string shall be interpreted as defined in the chapter Float Type in the AUTOSAR EcuC specification. In case the ComSignalType is BOOLEAN the string shall be interpreted as defined in the chapter Boolean Type in the AUTOSAR EcuC specification. In case the ComSignal is a UINT8_N, UINT8_DYN the string shall be interpreted as a decimal representation of the characters separated by blanks, e.g. "97 98 100" means a string "abd", where the char "a" is in byte 0(lowest address), "b" is in byte 1, and "d" is in byte 2 and (highest address). For the ComSignalType UINT8_DYN the dynamic length shall be set to the number of configured characters. An empty string "" shall be interpreted as 0-sized dynamic signal.
        enumeration ComTransferProperty [0..1]: {PENDING, TRIGGERED, TRIGGERED_ON_CHANGE, TRIGGERED_ON_CHANGE_WITHOUT_REPETITION, TRIGGERED_WITHOUT_REPETITION}, multiplicity set at link in variant link-time / post-build in variant post-build / pre-compile in variant pre-compile, post-build-variant-multiplicity=true, post-build-variant-value=true, set at link in variant link-time / post-build in variant post-build / pre-compile in variant pre-compile  # Defines if a write access to this signal can trigger the transmission of the corresponding I-PDU. If the I-PDU is triggered, depends also on the transmission mode of the corresponding I-PDU.
        integer ComUpdateBitPosition [0..1]: 0..4294967295, multiplicity set at link in variant link-time / post-build in variant post-build / pre-compile in variant pre-compile, post-build-variant-multiplicity=true, post-build-variant-value=true, set at link in variant link-time / post-build in variant post-build / pre-compile in variant pre-compile  # Bit position of update-bit inside I-PDU. | If this attribute is omitted then there is no update-bit. This setting must be consistently on sender and on receiver side. Range: 0..63 for CAN and LIN, 0..511 for CAN FD, 0..2031 for FlexRay, 0..4294967295 for TP.
        foreign reference ComSystemTemplateSystemSignalRef [0..1]: scope=ECU, multiplicity set at link in variant link-time / post-build in variant post-build / pre-compile in variant pre-compile, post-build-variant-multiplicity=true, post-build-variant-value=true, set at link in variant link-time / post-build in variant post-build / pre-compile in variant pre-compile, destination-type=I-SIGNAL-TO-I-PDU-MAPPING  # Reference to the ISignalToIPduMapping that contains a reference to the ISignal (System Template) which this ComSignal (or ComGroupSignal) represents.
        container ComFilter [0..1]  # This container contains the configuration parameters of the AUTOSAR COM module's Filters. | Note: On sender side the container is used to specify the transmission mode conditions.
          enumeration ComFilterAlgorithm: {ALWAYS, MASKED_NEW_DIFFERS_MASKED_OLD, MASKED_NEW_DIFFERS_X, MASKED_NEW_EQUALS_X, NEVER, NEW_IS_OUTSIDE, NEW_IS_WITHIN, ONE_EVERY_N}, set at link in variant link-time+post-build / pre-compile in variant pre-compile  # The range of values is specified in the [17] specification, chapter 2.2.2, Reception Filtering.
          integer ComFilterMask [0..1]: -2147483648..4294967295, multiplicity set at link in variant link-time+post-build / pre-compile in variant pre-compile, set at link in variant link-time+post-build / pre-compile in variant pre-compile  # The name of this attribute corresponds to the parameter name in the [17] specification of Reception Filtering.
          integer ComFilterMax [0..1]: -2147483648..4294967295, multiplicity set at link in variant link-time+post-build / pre-compile in variant pre-compile, set at link in variant link-time+post-build / pre-compile in variant pre-compile  # The name of this attribute corresponds to the parameter name in the [17] specification of Reception Filtering.
          integer ComFilterMin [0..1]: -2147483648..4294967295, multiplicity set at link in variant link-time+post-build / pre-compile in variant pre-compile, set at link in variant link-time+post-build / pre-compile in variant pre-compile  # The name of this attribute corresponds to the parameter name in the [17] specification of Reception Filtering.
          integer ComFilterOffset [0..1]: 0..4294967294, multiplicity set at link in variant link-time+post-build / pre-compile in variant pre-compile, set at link in variant link-time+post-build / pre-compile in variant pre-compile  # The name of this attribute corresponds to the parameter name in the [17] specification of Reception Filtering. | Range = 0..(ComFilterPeriod-1)
          integer ComFilterPeriod [0..1]: 2..4294967295, multiplicity set at link in variant link-time / post-build in variant post-build / pre-compile in variant pre-compile, post-build-variant-multiplicity=true, post-build-variant-value=true, set at link in variant link-time / post-build in variant post-build / pre-compile in variant pre-compile  # This parameter defines the period of the ComFilterAlgorithm ONE_EVERY_N.
          integer ComFilterX [0..1]: -2147483648..4294967295, multiplicity set at link in variant link-time+post-build / pre-compile in variant pre-compile, set at link in variant link-time+post-build / pre-compile in variant pre-compile  # The name of this attribute corresponds to the parameter name in the [17] specification of Reception Filtering.
      container ComSignalGroup [0..*]: multiplicity set at link in variant link-time / post-build in variant post-build / pre-compile in variant pre-compile, post-build-variant-multiplicity=true  # Contains the configuration parameters of the AUTOSAR COM module's signal groups.
        enumeration ComDataInvalidAction [0..1]: {NOTIFY, REPLACE}, multiplicity set at link in variant link-time+post-build / pre-compile in variant pre-compile, set at link in variant link-time+post-build / pre-compile in variant pre-compile  # This parameter defines the action performed upon reception of an invalid signal. | Relating to signal groups the action in case if one of the included signals is an invalid signal. If Replace is used the ComSignalInitValue will be used for the replacement.
        float ComFirstTimeout [0..1]: 0..3600, multiplicity set at link in variant link-time / post-build in variant post-build / pre-compile in variant pre-compile, post-build-variant-multiplicity=true, post-build-variant-value=true, set at link in variant link-time / post-build in variant post-build / pre-compile in variant pre-compile  # Defines the length of the first deadline monitoring timeout period in seconds. This timeout is used immediately after start (or restart) of the deadline monitoring service. The timeout period of the successive periods is configured by ECUC_Com_00263.
        integer ComHandleId [0..1]: 0..65535, scope=ECU, multiplicity set at pre-compile, set at pre-compile, symbolic-name-value=true, with-auto=true  # The numerical value used as the ID. | This ID identifies signals and signal groups in the COM APIs using Com_SignalIdType or Com_SignalGroupIdType parameter respectively.
        boolean ComInitialValueOnly [0..1]: multiplicity set at link in variant link-time+post-build / pre-compile in variant pre-compile, set at link in variant link-time+post-build / pre-compile in variant pre-compile, default-value=false  # This parameter defines that the respective signal's initial value shall be put into the respective PDU but there will not be any update of the value through the users (e.g. RTE, SwCluC). Thus the Com implementation does not need to expect any API calls for this signal (group).
        enumeration ComRxDataTimeoutAction [0..1]: {NONE, REPLACE, SUBSTITUTE}, multiplicity set at link in variant link-time+post-build / pre-compile in variant pre-compile, set at link in variant link-time+post-build / pre-compile in variant pre-compile  # This parameter defines the action performed upon expiration of the reception deadline monitoring timer.
        boolean ComSignalGroupArrayAccess [0..1]: multiplicity set at pre-compile, set at pre-compile  # Defines whether the uint8-array based access shall be used for this ComSignalGroup.
        float ComTimeout [0..1]: 0..3600, multiplicity set at link in variant link-time / post-build in variant post-build / pre-compile in variant pre-compile, post-build-variant-multiplicity=true, post-build-variant-value=true, set at link in variant link-time / post-build in variant post-build / pre-compile in variant pre-compile  # Defines the length of the deadline monitoring timeout period in seconds. The period for the first timeout period can be configured separately by ECUC_Com_00183.
        enumeration ComTransferProperty [0..1]: {PENDING, TRIGGERED, TRIGGERED_ON_CHANGE, TRIGGERED_ON_CHANGE_WITHOUT_REPETITION, TRIGGERED_WITHOUT_REPETITION}, multiplicity set at link in variant link-time / post-build in variant post-build / pre-compile in variant pre-compile, post-build-variant-multiplicity=true, post-build-variant-value=true, set at link in variant link-time / post-build in variant post-build / pre-compile in variant pre-compile  # Defines if a write access to this signal can trigger the transmission of the corresponding I-PDU. If the I-PDU is triggered, depends also on the transmission mode of the corresponding I-PDU.
        integer ComUpdateBitPosition [0..1]: 0..4294967295, multiplicity set at link in variant link-time / post-build in variant post-build / pre-compile in variant pre-compile, post-build-variant-multiplicity=true, post-build-variant-value=true, set at link in variant link-time / post-build in variant post-build / pre-compile in variant pre-compile  # Bit position of update-bit inside I-PDU. | If this attribute is omitted then there is no update-bit. This setting must be consistently on sender and on receiver side. Range: 0..63 for CAN and LIN, 0..511 for CAN FD, 0..2031 for FlexRay, 0..4294967295 for TP.
        foreign reference ComSystemTemplateSignalGroupRef [0..1]: scope=ECU, multiplicity set at link in variant link-time / post-build in variant post-build / pre-compile in variant pre-compile, post-build-variant-multiplicity=true, post-build-variant-value=true, set at link in variant link-time / post-build in variant post-build / pre-compile in variant pre-compile, destination-type=I-SIGNAL-TO-I-PDU-MAPPING  # Reference to the ISignalToIPduMapping that contains a reference to the ISignalGroup (SystemTemplate) which this ComSignalGroup represents.
        container ComGroupSignal [0..*]: multiplicity set at link in variant link-time / post-build in variant post-build / pre-compile in variant pre-compile, post-build-variant-multiplicity=true  # This container contains the configuration parameters of group signals. I.e. signals that are included within a signal group.
          integer ComBitPosition: 0..4294967295, post-build-variant-value=true, set at link in variant link-time / post-build in variant post-build / pre-compile in variant pre-compile  # Starting position within the I-PDU. This parameter refers to the position in the I-PDU and not in the shadow buffer. If the endianness conversion is configured to Opaque the parameter ComBitPosition shall define the bit0 of the first byte like in little endian byte order
          integer ComBitSize [0..1]: 0..64, multiplicity set at link in variant link-time / post-build in variant post-build / pre-compile in variant pre-compile, post-build-variant-multiplicity=true, post-build-variant-value=true, set at link in variant link-time / post-build in variant post-build / pre-compile in variant pre-compile  # Size in bits, for integer signal types. For ComSignalType UINT8_N and UINT8_DYN | the size shall be configured by ComSignalLength. For ComSignalTypes FLOAT32 and FLOAT64 the size is already defined by the signal type and therefore may be omitted.
          integer ComHandleId [0..1]: 0..65535, scope=ECU, multiplicity set at pre-compile, set at pre-compile, symbolic-name-value=true, with-auto=true  # The numerical value used as the ID. | This ID identifies signals and signal groups in the COM APIs using Com_SignalIdType or Com_SignalGroupIdType parameter respectively.
          string ComSignalDataInvalidValue [0..1]: multiplicity set at link in variant link-time+post-build / pre-compile in variant pre-compile, set at link in variant link-time+post-build / pre-compile in variant pre-compile  # Defines the data invalid value of the signal. | In case the ComSignalType is UINT8, UINT16, UINT32, UINT64, SINT8, SINT16, SINT32, SINT64 the string shall be interpreted as defined in the chapter Integer Type in the AUTOSAR EcuC specification. In case the ComSignalType is FLOAT32, FLOAT64 the string shall be interpreted as defined in the chapter Float Type in the AUTOSAR EcuC specification. In case the ComSignalType is BOOLEAN the string shall be interpreted as defined in the chapter Boolean Type in the AUTOSAR EcuC specification. In case the ComSignal is a UINT8_N, UINT8_DYN the string shall be interpreted as a decimal representation of the characters separated by blanks, e.g. "97 98 100" means a string "abd", where the char "a" is in byte 0(lowest address), "b" is in byte 1, and "d" is in byte 2 and (highest address). For the ComSignalType UINT8_DYN the dynamic length shall be set to the number of configured characters. An empty string "" shall be interpreted as 0-sized dynamic signal.
          enumeration ComSignalEndianness: {BIG_ENDIAN, LITTLE_ENDIAN, OPAQUE}, post-build-variant-value=true, set at link in variant link-time / post-build in variant post-build / pre-compile in variant pre-compile  # Defines the endianness of the signal's network representation.
          string ComSignalInitValue [0..1]: multiplicity set at link in variant link-time / post-build in variant post-build / pre-compile in variant pre-compile, post-build-variant-multiplicity=true, post-build-variant-value=true, set at link in variant link-time / post-build in variant post-build / pre-compile in variant pre-compile, default-value=0  # Initial value for this signal. In case of UINT8_N the default value is a string of length ComSignalLength with all bytes set to 0x00. In case of UINT8_DYN the initial size shall be 0. | In case the ComSignalType is UINT8, UINT16, UINT32, UINT64, SINT8, SINT16, SINT32, SINT64 the string shall be interpreted as defined in the chapter Integer Type in the AUTOSAR EcuC specification. In case the ComSignalType is FLOAT32, FLOAT64 the string shall be interpreted as defined in the chapter Float Type in the AUTOSAR EcuC specification. In case the ComSignalType is BOOLEAN the string shall be interpreted as defined in the chapter Boolean Type in the AUTOSAR EcuC specification. In case the ComSignal is a UINT8_N, UINT8_DYN the string shall be interpreted as a decimal representation of the characters separated by blanks, e.g. "97 98 100" means a string "abd", where the char "a" is in byte 0(lowest address), "b" is in byte 1, and "d" is in byte 2 and (highest address). For the ComSignalType UINT8_DYN the dynamic length shall be set to the number of configured characters. An empty string "" shall be interpreted as 0-sized dynamic signal.
          integer ComSignalLength [0..1]: 0..4294967295, multiplicity set at link in variant link-time+post-build / pre-compile in variant pre-compile, set at link in variant link-time+post-build / pre-compile in variant pre-compile  # Description: | For ComSignalType UINT8_N this parameter specifies the length n in bytes. For ComSignalType UINT8_DYN it specifies the maximum length in bytes. For all other types this parameter shall be ignored. The supported maximum length is restricted by the used transportation system. For non TP-PDUs the maximum size of a PDU, and therefore also of any included signal, is limited by the concrete bus characteristic. For example, the limit is 8 bytes for CAN and LIN, 64 bytes for CAN FD and 254 for FlexRay.
          enumeration ComSignalType: {BOOLEAN, FLOAT32, FLOAT64, SINT16, SINT32, SINT64, SINT8, UINT16, UINT32, UINT64, UINT8, UINT8_DYN, UINT8_N}, set at link in variant link-time+post-build / pre-compile in variant pre-compile  # The AUTOSAR type of the signal. Whether or not the signal is signed or unsigned can be found by examining the value of this attribute. | This type could also be used to reserved appropriate storage in AUTOSAR COM.
          string ComTimeoutSubstitutionValue [0..1]: multiplicity set at link in variant link-time / post-build in variant post-build / pre-compile in variant pre-compile, post-build-variant-multiplicity=true, post-build-variant-value=true, set at link in variant link-time / post-build in variant post-build / pre-compile in variant pre-compile  # The signal substitution value will be used in case of a timeout and ComRxDataTimeoutAction is set to SUBSTITUTE. | In case of UINT8_N the default value is a string of length ComSignalLength with all bytes set to 0x00. In case ofUINT8_DYN the initial size shall be 0. In case the ComSignalType is UINT8, UINT16, UINT32, UINT64, SINT8, SINT16, SINT32, SINT64 the string shall be interpreted as defined in the chapter Integer Type in the AUTOSAR EcuC specification. In case the ComSignalType is FLOAT32, FLOAT64 the string shall be interpreted as defined in the chapter Float Type in the AUTOSAR EcuC specification. In case the ComSignalType is BOOLEAN the string shall be interpreted as defined in the chapter Boolean Type in the AUTOSAR EcuC specification. In case the ComSignal is a UINT8_N, UINT8_DYN the string shall be interpreted as a decimal representation of the characters separated by blanks, e.g. "97 98 100" means a string "abd", where the char "a" is in byte 0(lowest address), "b" is in byte 1, and "d" is in byte 2 and (highest address). For the ComSignalType UINT8_DYN the dynamic length shall be set to the number of configured characters. An empty string "" shall be interpreted as 0-sized dynamic signal.
          enumeration ComTransferProperty [0..1]: {PENDING, TRIGGERED_ON_CHANGE}, multiplicity set at link in variant link-time / post-build in variant post-build / pre-compile in variant pre-compile, post-build-variant-multiplicity=true, post-build-variant-value=true, set at link in variant link-time / post-build in variant post-build / pre-compile in variant pre-compile  # Optionally defines whether this group signal shall contribute to the TRIGGERED_ON_CHANGE transfer property of the signal group. If at least one group signal of a signal group has the "ComTransferProperty" configured all other group signals of that signal group shall have the attribute configured as well.
          foreign reference ComSystemTemplateSystemSignalRef [0..1]: scope=ECU, multiplicity set at link in variant link-time / post-build in variant post-build / pre-compile in variant pre-compile, post-build-variant-multiplicity=true, post-build-variant-value=true, set at link in variant link-time / post-build in variant post-build / pre-compile in variant pre-compile, destination-type=I-SIGNAL-TO-I-PDU-MAPPING  # Reference to the ISignalToIPduMapping that contains a reference to the ISignal (System Template) which this ComSignal (or ComGroupSignal) represents.
          container ComFilter [0..1]  # This container contains the configuration parameters of the AUTOSAR COM module's Filters. | Note: On sender side the container is used to specify the transmission mode conditions.
            enumeration ComFilterAlgorithm: {ALWAYS, MASKED_NEW_DIFFERS_MASKED_OLD, MASKED_NEW_DIFFERS_X, MASKED_NEW_EQUALS_X, NEVER, NEW_IS_OUTSIDE, NEW_IS_WITHIN, ONE_EVERY_N}, set at link in variant link-time+post-build / pre-compile in variant pre-compile  # The range of values is specified in the [17] specification, chapter 2.2.2, Reception Filtering.
            integer ComFilterMask [0..1]: -2147483648..4294967295, multiplicity set at link in variant link-time+post-build / pre-compile in variant pre-compile, set at link in variant link-time+post-build / pre-compile in variant pre-compile  # The name of this attribute corresponds to the parameter name in the [17] specification of Reception Filtering.
            integer ComFilterMax [0..1]: -2147483648..4294967295, multiplicity set at link in variant link-time+post-build / pre-compile in variant pre-compile, set at link in variant link-time+post-build / pre-compile in variant pre-compile  # The name of this attribute corresponds to the parameter name in the [17] specification of Reception Filtering.
            integer ComFilterMin [0..1]: -2147483648..4294967295, multiplicity set at link in variant link-time+post-build / pre-compile in variant pre-compile, set at link in variant link-time+post-build / pre-compile in variant pre-compile  # The name of this attribute corresponds to the parameter name in the [17] specification of Reception Filtering.
            integer ComFilterOffset [0..1]: 0..4294967294, multiplicity set at link in variant link-time+post-build / pre-compile in variant pre-compile, set at link in variant link-time+post-build / pre-compile in variant pre-compile  # The name of this attribute corresponds to the parameter name in the [17] specification of Reception Filtering. | Range = 0..(ComFilterPeriod-1)
            integer ComFilterPeriod [0..1]: 2..4294967295, multiplicity set at link in variant link-time / post-build in variant post-build / pre-compile in variant pre-compile, post-build-variant-multiplicity=true, post-build-variant-value=true, set at link in variant link-time / post-build in variant post-build / pre-compile in variant pre-compile  # This parameter defines the period of the ComFilterAlgorithm ONE_EVERY_N.
            integer ComFilterX [0..1]: -2147483648..4294967295, multiplicity set at link in variant link-time+post-build / pre-compile in variant pre-compile, set at link in variant link-time+post-build / pre-compile in variant pre-compile  # The name of this attribute corresponds to the parameter name in the [17] specification of Reception Filtering.
      container ComUserModule [0..*]: multiplicity set at pre-compile  # Contains the configuration parameters of the Com user modules. Tags: atp.Status=draft
        uri reference ComUserModuleCnfRef: scope=ECU, set at pre-compile, destination-uri=ComUser  # Reference to the Com user module configuration.
    container ComGeneral  # Contains the general configuration parameters of the module.
      boolean ComCancellationSupport [0..1]: multiplicity set at pre-compile, set at pre-compile, default-value=true  # This parameter enables/disables the cancellation feature: | true: enabled false: disabled
      boolean ComConfigurationUseDet [0..1]: multiplicity set at pre-compile, set at pre-compile  # The error hook shall contain code to call the Det. | If this parameter is configured COM_DEV_ERROR_DETECT shall be set to ON as output of the configuration tool. (as input for the source code).
      boolean ComEnableMDTForCyclicTransmission [0..1]: multiplicity set at pre-compile, set at pre-compile, default-value=true  # Enables globally for the whole Com module the minimum delay time monitoring for cyclic and repeated transmissions (ComTxModeMode=PERIODIC or ComTxModeMode=MIXED for the cyclic transmissions, ComTxModeNumberOfRepetitions > 0 for repeated transmissions).
      boolean ComEnableSecurityEventReporting: scope=ECU, set at pre-compile, default-value=false  # Switches the reporting of security events to the IdsM. | * true: reporting is enabled. * false: reporting is disabled.
      boolean ComEnableSignalGroupArrayApi: set at pre-compile, default-value=false  # Activate/Deactivate the signal group array access APIs (Com_SendSignalGroupArray, Com_ReceiveSignalGroupArray). | true: signal group array access APIs activated false: signal group array access APIs deactivated
      boolean ComMetaDataSupport [0..1]: multiplicity set at pre-compile, set at pre-compile, default-value=false  # This parameter enables/disables the support of meta-data feature including the API Com_TriggerIPDUSendWithMetaData. | true: enabled false: disabled
      boolean ComRetryFailedTransmitRequests [0..1]: multiplicity set at pre-compile, set at pre-compile, default-value=false  # If this Parameter is set to true, retry of failed transmission requests is enabled. If this Parameter is not present, the default value is assumed.
      integer ComSupportedIPduGroups: 0..65535, set at pre-compile  # Defines the maximum number of supported I-PDU groups.
      string ComUserCbkHeaderFile [0..*]: multiplicity set at pre-compile, set at pre-compile, max-length=32, min-length=1  # Defines the header files for callback functions which shall be included by the COM module.
      boolean ComVersionInfoApi: set at pre-compile, default-value=false  # Activate/Deactivate the version information API (Com_GetVersionInfo). | True: version information API activated False: version information API deactivated
      container ComSecurityEventRefs [0..1]: multiplicity set at pre-compile  # Container for the references to IdsMEvent elements representing the security events that the COM module shall report to the IdsM in case the corresponding security related event occurs (and if ComEnableSecurityEventReporting is set to "true"). The standardized security events in this container can be extended by vendor-specific security events.
        reference SEV_COM_RX_SIGNAL_VALUE_UNEXPECTED [0..1]: multiplicity set at pre-compile, set at pre-compile, requires-symbolic-name-value=true, destination=IdsMEvent  # Signal or group signal is received with out of range value.
  module definition ComM [0..1]: post-build-variant-support=true, variants post-build/pre-compile  # Configuration of the ComM (Communications Manager) module.
    container ComMConfigSet  # This container contains the configuration parameters and sub containers of the AUTOSAR ComM module.
      boolean ComMPncEnabled [0..1]: scope=ECU, multiplicity set at post-build in variant post-build / pre-compile in variant pre-compile, post-build-variant-multiplicity=true, post-build-variant-value=true, set at post-build in variant post-build / pre-compile in variant pre-compile, default-value=false  # Defines whether in this configuration set the partial networking is enabled. | true: Enabled false: Disabled
      container ComMChannel [1..256]  # This container contains the configuration (parameters) of the bus channel(s). The channel parameters shall be harmonized within the whole communication stack.
        enumeration ComMBusType: {COMM_BUS_TYPE_CAN, COMM_BUS_TYPE_CDD, COMM_BUS_TYPE_ETH, COMM_BUS_TYPE_FR, COMM_BUS_TYPE_INTERNAL, COMM_BUS_TYPE_LIN}, scope=ECU, set at pre-compile  # Identifies the bus type of the channel.
        string ComMCDDBusPrefix [0..1]: multiplicity set at pre-compile, set at pre-compile  # Prefix to be used for API calls to CDD.
        integer ComMChannelId: 0..255, scope=ECU, set at pre-compile, symbolic-name-value=true, with-auto=true  # Channel identification number of the corresponding channel.
        boolean ComMDynamicPncToChannelMappingEnabled [0..1]: multiplicity set at link in variant post-build / pre-compile in variant pre-compile, set at link in variant post-build / pre-compile in variant pre-compile, default-value=false  # Channel-specific parameter to enable the dynamic PNC-to-channel-mapping feature. | False: Dynamic PNC-to-channel-mapping is disabled True: Dynamic PNC-to-channel-mapping is enabled
        boolean ComMFullCommRequestNotificationEnabled: set at pre-compile, default-value=false  # Defines if the optional SenderReceiver Port of Interface ComM_CurrentChannelRequest will be provided for this channel. | True means enabled. False means disabled
        float ComMMainFunctionPeriod: 0..INF, scope=ECU, set at pre-compile, default-value=0.02  # Specifies the period in seconds that the MainFunction has to be triggered with. | Comment: ComM scheduling shall be at least as fast as the communication stack and a schedule longer than 100ms makes no sense for communication.
        boolean ComMNoCom: set at pre-compile, default-value=false  # Not allowed to change state of ComM channel to COMM_SILENT_COMMUNICATION or COMM_FULL_COMMUNICATION. | true: Enabled - Not allowed to switch to Communication Modes above. false: Disabled - Allowed to switch Communication Modes above. Shall be possible to change parameter during runtime with ComM API's. ECU/All channels: ComM_LimitECUToNoComMode(). Separate channels: ComM_LimitChannelToNoComMode().
        boolean ComMNoWakeup: set at pre-compile, default-value=false  # Defines if an ECU is not allowed to wake-up the channel. | true: Enabled (not allowed to wake-up)) false: Disabled This is the default/init value of a runtime variable that can be changed during runtime using ComM_PreventWakeUp().
        boolean ComMNoWakeUpInhibitionNvmStorage: set at pre-compile  # If this parameter is set to "true", the NoWakeUp inhibition state of the channel shall be stored (in some implementation specific way) in the block pointed to by ComMGlobalNvmBlockDescriptor.
        enumeration ComMPncGatewayType [0..1]: {COMM_GATEWAY_TYPE_ACTIVE, COMM_GATEWAY_TYPE_PASSIVE}, scope=ECU, multiplicity set at pre-compile, set at pre-compile, default-value=COMM_GATEWAY_TYPE_ACTIVE  # Identifies the Partial Network Gateway behaviour of a ComMChannel.
        boolean ComMWakeupSleepRequestEnabled [0..1]: multiplicity set at pre-compile, set at pre-compile, default-value=false  # Used for communication channels where the corresponding hardware support wake-up and/or sleep request capability on the network, e.g. OA TC10 compatible PHYs for Ethernet.
        reference ComMChannelPartitionRef [0..1]: multiplicity set at pre-compile, set at pre-compile, destination=EcucPartition  # Reference to EcucPartition, where the according ComMChannel is assigned to.
        reference ComMManageReference [0..*]: multiplicity set at pre-compile, set at pre-compile, destination=ComMChannel  # Represents the reference between a ComMChannel with role managing channel and a ComMChannel with role managed channel.
        container ComMNetworkManagement  # This container contains the configuration parameters of the networkmanagement.
          float ComMNmLightTimeout [0..1]: 0..255, multiplicity set at pre-compile, set at pre-compile, default-value=10  # Defines the timeout (in seconds) after COMM_FULL_COMMUNICATION sub-state COMM_FULL_COM_READY_SLEEP is left. | The range shall be greater than 0.0 and less or equal to 255.0.
          enumeration ComMNmVariant: {FULL, LIGHT, NONE, PASSIVE, SLAVE_ACTIVE, SLAVE_PASSIVE}, set at pre-compile, default-value=FULL  # Defines the functionality of the networkmanagement. | Shall be harmonized with NM configuration.
          boolean ComMPncNmRequest: set at pre-compile, default-value=false  # If this parameter equals true, then Nm shall be requested again by calling Nm_NetworkRequest under either the following conditions: | - every time a FULL Communication is requested due to a change in the PNC state machine to COMM_PNC_REQUESTED - if a shutdown for a PNC coincides with a PNC request of the same PNC
        container ComMUserPerChannel [0..255]  # This container contains a list of identifiers that are needed to refer to a user in the system which is linked to a channel.
          reference ComMUserChannel: set at pre-compile, destination=ComMUser  # Reference to the ComMUser that corresponds to this channel user. | ImplementationType: COMM_UserHandleType
      container ComMPnc [0..504]  # This container contains the configuration of the partial network cluster (PNC).
        integer ComMPncId: 8..511, scope=ECU, set at pre-compile, symbolic-name-value=true, with-auto=true  # Partial network cluster identification number.
        boolean ComMPncWakeupSleepRequestEnabled [0..1]: multiplicity set at pre-compile, set at pre-compile, default-value=false  # Used for PNCs where a requested PNC shall report an active communication request towards the BswM. The BswM forward the active communication request to the lower layer communication channels where the used hardware support wake-up and/or sleep request capability on the network, e.g. OA TC10 compatible PHYs for Ethernet. This is used e.g. for Ethernet Switch port group switching.
        reference ComMChannelPerPnc [0..255]: multiplicity set at post-build in variant post-build / pre-compile in variant pre-compile, post-build-variant-multiplicity=true, post-build-variant-value=true, set at post-build in variant post-build / pre-compile in variant pre-compile, destination=ComMChannel  # Reference to the ComMChannel that is required for this PNC. | ImplementationType: NetworkHandleType
        reference ComMChannelPerTxOnlyPnc [0..255]: multiplicity set at post-build in variant post-build / pre-compile in variant pre-compile, post-build-variant-multiplicity=true, post-build-variant-value=true, set at post-build in variant post-build / pre-compile in variant pre-compile, destination=ComMChannel  # Reference to the ComMChannel that is required for this PNC. This PNC is considered to be only transmitted on this channel as internal PNC request. | ImplementationType: NetworkHandleType
        reference ComMPncEthIfSwitchPortGroupRef [0..1]: scope=ECU, multiplicity set at link in variant post-build / pre-compile in variant pre-compile, post-build-variant-multiplicity=true, post-build-variant-value=true, set at link in variant post-build / pre-compile in variant pre-compile, requires-symbolic-name-value=true, destination=EthIfSwitchPortGroup  # Reference to the PortGroups that correspond to this PNC. Note: This is only for documentation.
        reference ComMUserPerPnc [0..255]: multiplicity set at post-build in variant post-build / pre-compile in variant pre-compile, post-build-variant-multiplicity=true, post-build-variant-value=true, set at post-build in variant post-build / pre-compile in variant pre-compile, destination=ComMUser  # Reference to the ComMUsers that correspond to this PNC. | ImplementationType: COMM_UserHandleType
      container ComMUser [0..65535]  # This container contains a list of identifiers that are needed to refer to a user in the system which is designated to request Communication modes.
        integer ComMUserIdentifier: 0..65534, set at pre-compile, symbolic-name-value=true, with-auto=true  # An identifier that is needed to refer to a user in the system which is designated to request Communication Modes. | ImplementationType: ComM_UserHandleType
        reference ComMUserEcucPartitionRef [0..1]: scope=ECU, multiplicity set at pre-compile, set at pre-compile, destination=EcucPartition  # Denotes in which "EcucPartition" the requester is executed. When the partition is stopped, the communication request shall be cancelled in the ComM | to avoid a stay-awake situation of the bus due to a stopped partition.
    container ComMGeneral  # General configuration parameters of the Communication Manager.
      boolean ComM0PncVectorAvoidance [0..1]: set at pre-compile, default-value=false  # This parameter avoids sending of 0-PNC-Vectors in case ComMPncGatewayEnabled is enabled.
      boolean ComMDevErrorDetect: set at pre-compile, default-value=false  # Switches the development error detection and notification on or off. | * true: detection and notification is enabled. * false: detection and notification is disabled.
      boolean ComMDirectUserMapping [0..1]: multiplicity set at pre-compile, set at pre-compile, default-value=false  # If this parameter is set to true the configuration tool shall automatically create a ComMUser per ComMPnc and a ComMUser per ComMChannel. | The shortName of the generated ComMUsers shall follow the following naming convention: PNCUser_ComMPncId, e.g. PNCUser_13 ChannelUser_ComMChannelId, e.g. ChannelUser_25 Restriction: ComMUser, which are created due to this configuration parameter, shall not be used by SWCs (only available for BswM).
      boolean ComMDynamicPncToChannelMappingSupport: scope=ECU, set at pre-compile, default-value=false  # Precompile time switch to enable the dynamic PNC-to-channel-mapping handling. | False: Dynamic PNC-to-channel-mapping is disabled True: Dynamic PNC-to-channel-mapping is enabled
      integer ComMEcuGroupClassification: 0..255, set at pre-compile, default-value=3  # Defines whether a mode inhibition affects the ECU or not. | Examples: 000: No mode inhibition can be activated 001: Wake up inhibition can be enabled
      boolean ComMModeLimitationEnabled: set at pre-compile, default-value=false  # true if mode limitation functionality shall be enabled. | true: Enabled false: Disabled
      boolean ComMPncGatewayEnabled [0..1]: multiplicity set at pre-compile, set at pre-compile, default-value=false  # Enables or disables support of Partial Network Gateway. | False: Partial Networking Gateway is disabled True: Partial Networking Gateway is enabled
      float ComMPncPrepareSleepTimer [0..1]: 0..63, multiplicity set at pre-compile, set at pre-compile  # Time in seconds the PNC state machine shall wait in COMM_PNC_PREPARE_SLEEP.
      boolean ComMPncSupport: set at pre-compile, default-value=false  # Enables or disables support of partial networking. | False: Partial Networking is disabled True: Partial Networking is enabled
      boolean ComMResetAfterForcingNoComm: set at pre-compile, default-value=false  # ComM shall perform a reset after entering "No Communication" mode because of an active mode limitation to "No Communication" mode. | true: Enabled false: Disabled
      boolean ComMSynchronizedPncShutdownEnabled [0..1]: multiplicity set at pre-compile, set at pre-compile, default-value=false  # Enables or disables support of synchronized PNC shutdown. | FALSE: synchronized PNC shutdown is disabled TRUE: synchronized PNC shutdown is enabled NOTE: This is only possible for ECU that has the role of an top-level PNC coordinator or intermediate PNC within the PNC network
      boolean ComMSynchronousWakeUp: set at pre-compile, default-value=true  # Wake up of one channel shall lead to a wake up of all channels if true. | true: Enabled false: Disabled
      float ComMTMinFullComModeDuration: 0.001..65, set at pre-compile, default-value=5  # Minimum time duration in seconds, spent in the COMM_FULL_COMMUNICATION sub-state COMM_FULL_COM_NETWORK_REQUESTED.
      boolean ComMVersionInfoApi: set at pre-compile, default-value=false  # Switches the possibility to read the version information with the service ComM_GetVersionInfo(). | true: Enabled false: Disabled
      boolean ComMWakeupInhibitionEnabled: set at pre-compile, default-value=false  # true if wake up inhibition functionality enabled. | true: Enabled false: Disabled
      reference ComMGlobalNvMBlockDescriptor [0..1]: scope=ECU, multiplicity set at pre-compile, set at pre-compile, requires-symbolic-name-value=true, destination=NvMBlockDescriptor  # Reference to NVRAM block containing the none volatile data. If this parameter is not configured it means that no NVRam is used at all.
  module definition CorTst [0..1]: variants link-time/pre-compile  # Configuration of the CorTst module.
    container CorTstBackgroundConfigSet [0..*]  # Multiple Configuration Set Container, defines background mode.
      reference CorTstBackgroundEcucPartitionRef [0..1]: scope=ECU, set at pre-compile, destination=EcucPartition  # Maps the background test configuration to zero or one ECUC partitions. The ECUC partition referenced is a subset of the ECUC partitions where the CorTst driver is mapped to.
      container CorTstSelect  # This container specifies configuration parameters to select individual tests for foreground mode and background mode. The availability is hardware and implementation specific.
        boolean CorTstAddress: set at link in variant link-time / pre-compile in variant pre-compile, default-value=false  # Enable/Disables core address test.
        boolean CorTstAlu: set at link in variant link-time / pre-compile in variant pre-compile, default-value=false  # Enable/Disables core ALU test.
        boolean CorTstCache: set at link in variant link-time / pre-compile in variant pre-compile, default-value=false  # Enable/Disables core cache test.
        boolean CorTstInterrupt: set at link in variant link-time / pre-compile in variant pre-compile, default-value=false  # Enable/Disables core interrupt test
        boolean CorTstMemoryIf: set at link in variant link-time / pre-compile in variant pre-compile, default-value=false  # Enable/Disables core memory interface test
        boolean CorTstMpu: set at link in variant link-time / pre-compile in variant pre-compile, default-value=false  # Enable/Disables core MPU test
        boolean CorTstRegister: set at link in variant link-time / pre-compile in variant pre-compile, default-value=false  # Enable/Disables core register test
    container CorTstConfigApiServices
      boolean CorTstAbortApi: set at pre-compile, default-value=false  # Adds / removes the service CorTst_Abort() from the code.
      boolean CorTstGetCurrentStatus: set at pre-compile, default-value=false  # Adds / removes the service CorTst_GetCurrentStatus() from the code.
      boolean CorTstGetFgndSignature: set at pre-compile, default-value=false  # Adds / removes the service CorTst_GetFgndSignature() from the code.
      boolean CorTstGetSignature: set at pre-compile, default-value=false  # Adds / removes the service CorTst_GetSignature() from the code.
      boolean CorTstGetStateApi: set at pre-compile, default-value=false  # Adds / removes the service CorTst_GetState() from the code.
      boolean CorTstStartApi: set at pre-compile, default-value=false  # Adds / removes the service CorTst_Start() from the code.
      boolean CorTstVersionInfoApi: set at pre-compile, default-value=false  # Adds / removes the service CorTst_GetVersionInfo() from the code.
    container CorTstDemEventParameterRefs [0..1]  # Container for the references to DemEventParameter elements which shall be invoked using the API Dem_SetEventStatus in case the corresponding error occurs. The EventId is taken from the referenced DemEventParameter's DemEventId symbolic value. The standardized errors are provided in this container and can be extended by vendor-specific error references.
      reference CORTST_E_CORE_FAILURE [0..1]: multiplicity set at pre-compile, set at pre-compile, requires-symbolic-name-value=true, destination=DemEventParameter  # Reference to the DemEventParameter which shall be issued when the error "CORE failure" has occured.
    container CorTstForegroundConfigSet [1..*]  # Multiple Configuration Set Container , defines foreground mode.
      integer CorTstTestIdFgnd: 0..4294967295, set at pre-compile  # This is the Id of this specific foreground test configuration. The value shall be used in the call to the API CorTst_Start(CorTst_TestIdFgndType TestId).
      reference CorTstForegroundEcucPartitionRef [0..1]: scope=ECU, set at pre-compile, destination=EcucPartition  # Maps the foreground test configuration to zero or one ECUC partitions. The ECUC partition referenced is a subset of the ECUC partitions where the CorTst driver is mapped to.
      container CorTstSelect  # This container specifies configuration parameters to select individual tests for foreground mode and background mode. The availability is hardware and implementation specific.
        boolean CorTstAddress: set at link in variant link-time / pre-compile in variant pre-compile, default-value=false  # Enable/Disables core address test.
        boolean CorTstAlu: set at link in variant link-time / pre-compile in variant pre-compile, default-value=false  # Enable/Disables core ALU test.
        boolean CorTstCache: set at link in variant link-time / pre-compile in variant pre-compile, default-value=false  # Enable/Disables core cache test.
        boolean CorTstInterrupt: set at link in variant link-time / pre-compile in variant pre-compile, default-value=false  # Enable/Disables core interrupt test
        boolean CorTstMemoryIf: set at link in variant link-time / pre-compile in variant pre-compile, default-value=false  # Enable/Disables core memory interface test
        boolean CorTstMpu: set at link in variant link-time / pre-compile in variant pre-compile, default-value=false  # Enable/Disables core MPU test
        boolean CorTstRegister: set at link in variant link-time / pre-compile in variant pre-compile, default-value=false  # Enable/Disables core register test
    container CorTstGeneral
      boolean CorTstDevErrorDetect: set at pre-compile, default-value=false  # Switches the development error detection and notification on or off. | * true: detection and notification is enabled. * false: detection and notification is disabled.
      integer CorTstFgndTestNumber: 1..4294967295, set at pre-compile  # This parameter holds the number of test configurations available for the foreground tests as defined in this configuration.
      boolean CorTstNotificationSupported: set at pre-compile, default-value=true  # Switch to indicate that the notification is supported.
      integer CorTstTestIntervalIdEndValue [0..1]: 0..4294967295, multiplicity set at pre-compile, set at pre-compile  # Defines the end value of the Test Interval Id.
      boolean CorTstTestResultMode: set at pre-compile, default-value=false  # Switch for enabling test result comparison within the Core test driver. In this mode a core test result OK or NOTOK shall not be calculated from the core test driver. Within core test driver no comparison against the reference value is processed.
      reference CorTstEcucPartitionRef [0..*]: scope=ECU, multiplicity set at pre-compile, set at pre-compile, destination=EcucPartition  # Maps the core test to zero or multiple ECUC partitions to make the modules API available in this partition.
  module definition Crc [0..1]: variants pre-compile  # Configuration of the Crc (Crc routines) module.
    container CrcGeneral  # General configuration of CRC module
      enumeration Crc16ARCMode [0..1]: {CRC_16_ARC_HARDWARE, CRC_16_ARC_RUNTIME, CRC_16_ARC_TABLE}, multiplicity set at pre-compile, set at pre-compile  # Switch to select one of the available CRC-16/ARC (polynomial 8005) calculation methods
      enumeration Crc16Mode [0..1]: {CRC_16_HARDWARE, CRC_16_RUNTIME, CRC_16_TABLE}, multiplicity set at pre-compile, set at pre-compile  # Switch to select one of the available CRC 16-bit (CCITT) calculation methods
      enumeration Crc32Mode [0..1]: {CRC_32_HARDWARE, CRC_32_RUNTIME, CRC_32_TABLE}, multiplicity set at pre-compile, set at pre-compile  # Switch to select one of the available CRC 32-bit (IEEE-802.3 CRC32 Ethernet Standard) calculation methods
      enumeration Crc32P4Mode [0..1]: {CRC_32P4_HARDWARE, CRC_32P4_RUNTIME, CRC_32P4_TABLE}, multiplicity set at pre-compile, set at pre-compile  # Switch to select one of the available CRC 32-bit E2E Profile 4 calculation methods.
      enumeration Crc32P76Mode [0..1]: multiplicity set at pre-compile, set at pre-compile, default-value=CRC_32P76_TABLE  # Switch to select one of the available CRC 32-bit SAE J1939-76 calculation methods. Tags: atp.Status=draft
        CRC_32P76_HARDWARE  # Tags: atp.Status=draft
        CRC_32P76_RUNTIME  # Tags: atp.Status=draft
        CRC_32P76_TABLE  # Tags: atp.Status=draft
      enumeration Crc64Mode [0..1]: {CRC_64_HARDWARE, CRC_64_RUNTIME, CRC_64_TABLE}, multiplicity set at pre-compile, set at pre-compile  # Switch to select one of the available CRC 64-bit calculation methods.
      enumeration Crc8H2FMode [0..1]: {CRC_8H2F_HARDWARE, CRC_8H2F_RUNTIME, CRC_8H2F_TABLE}, multiplicity set at pre-compile, set at pre-compile  # Switch to select one of the available CRC 8-bit (2Fh polynomial) calculation methods
      enumeration Crc8Mode [0..1]: {CRC_8_HARDWARE, CRC_8_RUNTIME, CRC_8_TABLE}, multiplicity set at pre-compile, set at pre-compile  # Switch to select one of the available CRC 8-bit (SAE J1850) calculation methods
  module definition CryIf [0..1]  # Configuration of the Crypto Interface.
    container CryIfChannel [0..*]  # Container for incorporation of CryIfChannel.
      integer CryIfChannelId: 0..4294967295, symbolic-name-value=true  # Identifier of the crypto channel. | Specifies to which crypto channel the CSM queue is connected to.
      reference CryIfDriverObjectRef: requires-symbolic-name-value=true, destination=CryptoDriverObject  # This parameter refers to a Crypto Driver Object. | Specifies to which Crypto Driver Object the crypto channel is connected to
    container CryIfGeneral  # Container for incorporation of CryIfGeneral.
      boolean CryIfDevErrorDetect: default-value=false  # Switches the development error detection and notification on or off. | true: detection and notification is enabled. false: detection and notification is disabled.
      boolean CryIfVersionInfoApi: default-value=false  # Pre-processor switch to enable and disable availability of the API CryIf_GetVersionInfo(). | True: API CryIf_GetVersionInfo() is available False: API CryIf_GetVersionInfo() is not available.
    container CryIfKey [0..*]  # Container for incorporation of CryIfKey.
      integer CryIfKeyId: 0..4294967295, symbolic-name-value=true  # Identifier of the CryIf key. | Specifies to which CryIf key the CSM key is mapped to.
      reference CryIfKeyRef: requires-symbolic-name-value=true, destination=CryptoKey  # This parameter refers to the crypto driver key. | Specifies to which crypto driver key the CryIf key is mapped to.
  module definition Crypto [0..*]: variants pre-compile  # Configuration of the Crypto (CryptoDriver) module
    container CryptoDriverObjects: multiplicity set at pre-compile  # Container for CRYPTO Objects
      container CryptoDriverObject [0..*]  # Configuration of a CryptoDriverObject
        integer CryptoDriverObjectId: 0..4294967295, multiplicity set at pre-compile, set at pre-compile, symbolic-name-value=true  # Identifier of the Crypto Driver Object. The Crypto Driver Object offers different crypto primitives.
        integer CryptoQueueSize: 0..4294967295, multiplicity set at pre-compile, set at pre-compile  # Size of the queue in the Crypto Driver. Defines the maximum number of jobs in the Crypto Driver Object queue. If it is set to 0, queueing is disabled in the Crypto Driver Object.
        reference CryptoDefaultRandomKeyRef [0..1]: multiplicity set at pre-compile, set at pre-compile, destination=CryptoKey  # This is a reference to the CryptoKey that is used by the CryptoDefaultRandomPrimitiveRef. The key contains key elements that are necessary to seed the random number generator. | This element shall only be set if the primitive referenced by CryptoDefaultRandomPrimitiveRef requires a seed value.
        reference CryptoDefaultRandomPrimitiveRef [0..1]: multiplicity set at pre-compile, set at pre-compile, destination=CryptoPrimitive  # This is a reference to a primitive that configures a default random number generator. If a crypto driver object needs to perform a crypto primitive that requires a random number generator, but the configuration of this primitive does not provide parameter for a random number generator, then this default random number generator shall be used (i.e. the elements of algorithm family, secondary algorithm family and algorithm mode do not provide this information). | Example: The crypto driver shall generate a signature based on elliptic curve but the primitive for signature generation lacks information about a random number generator.
        reference CryptoDriverObjectEcucPartitionRef [0..1]: scope=ECU, multiplicity set at pre-compile, set at pre-compile, destination=EcucPartition  # Maps a crypto driver object to zero or one ECUC partition. The ECUC partition referenced is a subset of the ECUC partitions where the Crypto driver is mapped to.
        reference CryptoPrimitiveRef [1..*]: multiplicity set at pre-compile, set at pre-compile, destination=CryptoPrimitive  # Refers to primitive in the CRYPTO. | The CryptoPrimitive is a pre-configured container of the crypto service that shall be used.
    container CryptoGeneral: multiplicity set at pre-compile  # Container for common configuration options
      boolean CryptoDevErrorDetect: multiplicity set at pre-compile, set at pre-compile, default-value=false  # Switches the development error detection and notification on or off. | true: detection and notification is enabled. false: detection and notification is disabled
      integer CryptoInstanceId: 0..255, set at pre-compile  # Instance ID of the crypto driver. This ID is used to discern several crypto drivers in case more than one driver is used in the same ECU.
      float CryptoMainFunctionPeriod [0..1]: 0..INF, multiplicity set at pre-compile, set at pre-compile  # Specifies the period of main function Crypto_MainFunction in seconds.
      boolean CryptoVersionInfoApi: multiplicity set at pre-compile, set at pre-compile, default-value=false  # Pre-processor switch to enable and disable availability of the API Crypto_GetVersionInfo(). | True: API Crypto_GetVersionInfo() is available False: API Crypto_GetVersionInfo() is not available.
      reference CryptoEcucPartitionRef [0..*]: scope=ECU, multiplicity set at pre-compile, set at pre-compile, destination=EcucPartition  # Maps the Crypto driver to zero or multiple ECUC partitions to make the modules API available in this partition.
    container CryptoKeyElements [0..1]  # Container for Crypto key elements
      container CryptoKeyElement [1..*]  # Configuration of a CryptoKeyElement
        boolean CryptoKeyElementAllowPartialAccess: multiplicity set at pre-compile, set at pre-compile, default-value=false  # Enable or disable writing and reading the key element with data smaller than the size of the element. | True: enable partial access of the key element False: disable partial access of the key element
        enumeration CryptoKeyElementFormat: {CRYPTO_KE_FORMAT_BIN_IDENT_PRIVATEKEY_PKCS8, CRYPTO_KE_FORMAT_BIN_IDENT_PUBLICKEY, CRYPTO_KE_FORMAT_BIN_OCTET, CRYPTO_KE_FORMAT_BIN_RSA_PRIVATEKEY, CRYPTO_KE_FORMAT_BIN_RSA_PUBLICKEY, CRYPTO_KE_FORMAT_BIN_SHEKEYS}, multiplicity set at pre-compile, set at pre-compile  # Defines the format for the key element. This is the format used to provide or extract the key data from the driver.
        integer CryptoKeyElementId: 0..4294967295, multiplicity set at pre-compile, set at pre-compile, symbolic-name-value=true  # Identifier of the CRYPTO key element
        string CryptoKeyElementInitValue [0..1]: multiplicity set at pre-compile, set at pre-compile, default-value=0  # Value which will be used to fill the key element during startup | (i) for all non-persistent key elements, and (ii) for those persistent key elements that have never been written.
        boolean CryptoKeyElementPersist: multiplicity set at pre-compile, set at pre-compile, default-value=false  # Enable or disable persisting of the key element in non-volatile storage. | True: enable persisting of the key element. False: disable persisting of the key element.
        enumeration CryptoKeyElementReadAccess: {CRYPTO_RA_ALLOWED, CRYPTO_RA_DENIED, CRYPTO_RA_ENCRYPTED, CRYPTO_RA_INTERNAL_COPY}, multiplicity set at pre-compile, set at pre-compile  # Define the reading access rights of the key element through external API. | CRYPTO_RA_DENIED = key element cannot be read from outside the Crypto Driver CRYPTO_RA INTERNAL_COPY = key element can be copied to another key element in the same crypto driver. CRYPTO_RA_ALLOWED = key element can be read as plaintext CRYPTO_RA_ENCRYPTED = key element can be read encrypted. E.g. SHE Ram-Key export.
        integer CryptoKeyElementSize: 1..4294967295, multiplicity set at pre-compile, set at pre-compile  # Maximum Size size of a CRYPTO key element in bytes
        enumeration CryptoKeyElementWriteAccess: {CRYPTO_WA_ALLOWED, CRYPTO_WA_DENIED, CRYPTO_WA_ENCRYPTED, CRYPTO_WA_INTERNAL_COPY}, multiplicity set at pre-compile, set at pre-compile  # Define the writing access rights of the key element through external API. | CRYPTO_WA_DENIED = key element can not be written from outside the Crypto Driver CRYPTO_WA INTERNAL_COPY = key element can be filled with another key element in the same crypto driver. CRYPTO_WA_ALLOWED = key element can be rwritten as plaintext CRYPTO_WA_ENCRYPTED = key element can be written encrypted. E.g. SHE load key.
    container CryptoKeyTypes [0..1]: multiplicity set at pre-compile  # Container for CRYPTO key types
      container CryptoKeyType [1..*]  # Configuration of a CryptoKeyType
        reference CryptoKeyElementRef [1..*]: multiplicity set at pre-compile, set at pre-compile, destination=CryptoKeyElement  # Refers to a pointer in the CRYPTOCrypto Key Element, which holds the data of the crypto key element.
    container CryptoKeys [0..1]  # Container for CRYPTO keys
      container CryptoKey [1..*]: multiplicity set at pre-compile  # Configuration of a CryptoKey
        integer CryptoKeyId: 0..4294967295, multiplicity set at pre-compile, set at pre-compile, symbolic-name-value=true  # Identifier of the CRYPTO Key
        reference CryptoKeyNvBlockRef [0..1]: multiplicity set at pre-compile, set at pre-compile, destination=CryptoNvBlock  # Reference to the NV block where the persistent key elements of this key shall be stored to.
        reference CryptoKeyTypeRef: multiplicity set at pre-compile, set at pre-compile, destination=CryptoKeyType  # Refers to a pointer in the CRYPTOto a CryptoKeyType. The CryptoKeyType provides the information which key elements are contained in a CryptoKey.
    container CryptoNvStorage [0..1]  # Container of NV block storage. Contains a collection of all NV storage blocks used for key storage.
      container CryptoNvBlock [1..*]  # Container to configure key storage in NVM
        integer CryptoNvBlockFailedRetries [0..1]: 1..65535, multiplicity set at pre-compile, set at pre-compile  # Number of retries to request an NVM service operation.
        enumeration CryptoNvBlockProcessing: {CRYPTO_NV_BLOCK_DEFERRED, CRYPTO_NV_BLOCK_IMMEDIATE}, multiplicity set at pre-compile, set at pre-compile  # Selects the operation mode when an NV block shall be updated.
        reference CryptoNvBlockDescriptorRef: multiplicity set at pre-compile, set at pre-compile, requires-symbolic-name-value=true, destination=NvMBlockDescriptor  # Reference to an NvM block descriptor
    container CryptoPrimitives [0..*]: multiplicity set at pre-compile  # Container for CRYPTO primitives
      container CryptoPrimitive [0..*]: multiplicity set at pre-compile  # Configuration of a CryptoPrimitive
        enumeration CryptoPrimitiveAlgorithmFamily [1..*]: {CRYPTO_ALGOFAM_3DES, CRYPTO_ALGOFAM_AES, CRYPTO_ALGOFAM_BLAKE_1_256, CRYPTO_ALGOFAM_BLAKE_1_512, CRYPTO_ALGOFAM_BLAKE_2s_256, CRYPTO_ALGOFAM_BLAKE_2s_512, CRYPTO_ALGOFAM_BRAINPOOL, CRYPTO_ALGOFAM_CHACHA, CRYPTO_ALGOFAM_CUSTOM, CRYPTO_ALGOFAM_DH, CRYPTO_ALGOFAM_DRBG, CRYPTO_ALGOFAM_ECCANSI, CRYPTO_ALGOFAM_ECCNIST, CRYPTO_ALGOFAM_ECCSEC, CRYPTO_ALGOFAM_ECDH, CRYPTO_ALGOFAM_ECDSA, CRYPTO_ALGOFAM_ED25519, CRYPTO_ALGOFAM_EEA3, CRYPTO_ALGOFAM_EIA3, CRYPTO_ALGOFAM_FIPS186, CRYPTO_ALGOFAM_HKDF, CRYPTO_ALGOFAM_KDFX963, CRYPTO_ALGOFAM_NOT_SET, CRYPTO_ALGOFAM_PADDING_ONEWITHZEROS, CRYPTO_ALGOFAM_PADDING_PKCS7, CRYPTO_ALGOFAM_PBKDF2, CRYPTO_ALGOFAM_POLY1305, CRYPTO_ALGOFAM_RIPEMD160, CRYPTO_ALGOFAM_RNG, CRYPTO_ALGOFAM_RSA, CRYPTO_ALGOFAM_SHA1, CRYPTO_ALGOFAM_SHA2_224, CRYPTO_ALGOFAM_SHA2_256, CRYPTO_ALGOFAM_SHA2_384, CRYPTO_ALGOFAM_SHA2_512, CRYPTO_ALGOFAM_SHA2_512_224, CRYPTO_ALGOFAM_SHA2_512_256, CRYPTO_ALGOFAM_SHA3_224, CRYPTO_ALGOFAM_SHA3_256, CRYPTO_ALGOFAM_SHA3_384, CRYPTO_ALGOFAM_SHA3_512, CRYPTO_ALGOFAM_SHAKE128, CRYPTO_ALGOFAM_SHAKE256, CRYPTO_ALGOFAM_SIPHASH, CRYPTO_ALGOFAM_SM2, CRYPTO_ALGOFAM_SM3, CRYPTO_ALGOFAM_X25519}, multiplicity set at pre-compile, set at pre-compile  # Determines the algorithm family used for the crypto service
        enumeration CryptoPrimitiveAlgorithmMode [1..*]: {CRYPTO_ALGOMODE_12ROUNDS, CRYPTO_ALGOMODE_20ROUNDS, CRYPTO_ALGOMODE_8ROUNDS, CRYPTO_ALGOMODE_AESKEYWRAP, CRYPTO_ALGOMODE_CBC, CRYPTO_ALGOMODE_CFB, CRYPTO_ALGOMODE_CMAC, CRYPTO_ALGOMODE_CTR, CRYPTO_ALGOMODE_CTRDRBG, CRYPTO_ALGOMODE_CUSTOM, CRYPTO_ALGOMODE_ECB, CRYPTO_ALGOMODE_GCM, CRYPTO_ALGOMODE_GMAC, CRYPTO_ALGOMODE_HMAC, CRYPTO_ALGOMODE_NOT_SET, CRYPTO_ALGOMODE_OFB, CRYPTO_ALGOMODE_PXXXR, CRYPTO_ALGOMODE_RSAES_OAEP, CRYPTO_ALGOMODE_RSAES_PKCS1_v1_5, CRYPTO_ALGOMODE_RSASSA_PKCS1_v1_5, CRYPTO_ALGOMODE_RSASSA_PSS, CRYPTO_ALGOMODE_SIPHASH_2_4, CRYPTO_ALGOMODE_SIPHASH_4_8, CRYPTO_ALGOMODE_XTS}, multiplicity set at pre-compile, set at pre-compile  # Determines the algorithm mode used for the crypto service
        enumeration CryptoPrimitiveAlgorithmSecondaryFamily [1..*]: {CRYPTO_ALGOFAM_3DES, CRYPTO_ALGOFAM_AES, CRYPTO_ALGOFAM_BLAKE_1_256, CRYPTO_ALGOFAM_BLAKE_1_512, CRYPTO_ALGOFAM_BLAKE_2s_256, CRYPTO_ALGOFAM_BLAKE_2s_512, CRYPTO_ALGOFAM_BRAINPOOL, CRYPTO_ALGOFAM_CHACHA, CRYPTO_ALGOFAM_CUSTOM, CRYPTO_ALGOFAM_DRBG, CRYPTO_ALGOFAM_ECCANSI, CRYPTO_ALGOFAM_ECCNIST, CRYPTO_ALGOFAM_ECCSEC, CRYPTO_ALGOFAM_ED25519, CRYPTO_ALGOFAM_FIPS186, CRYPTO_ALGOFAM_NOT_SET, CRYPTO_ALGOFAM_PADDING_ONEWITHZEROS, CRYPTO_ALGOFAM_PADDING_PKCS7, CRYPTO_ALGOFAM_POLY1305, CRYPTO_ALGOFAM_RIPEMD160, CRYPTO_ALGOFAM_RNG, CRYPTO_ALGOFAM_RSA, CRYPTO_ALGOFAM_SHA1, CRYPTO_ALGOFAM_SHA2_224, CRYPTO_ALGOFAM_SHA2_256, CRYPTO_ALGOFAM_SHA2_384, CRYPTO_ALGOFAM_SHA2_512, CRYPTO_ALGOFAM_SHA2_512_224, CRYPTO_ALGOFAM_SHA2_512_256, CRYPTO_ALGOFAM_SHA3_224, CRYPTO_ALGOFAM_SHA3_256, CRYPTO_ALGOFAM_SHA3_384, CRYPTO_ALGOFAM_SHA3_512, CRYPTO_ALGOFAM_SHAKE128, CRYPTO_ALGOFAM_SHAKE256, CRYPTO_ALGOFAM_SIPHASH, CRYPTO_ALGOFAM_X25519}, multiplicity set at pre-compile, set at pre-compile  # Determines the algorithm secondary family used for the crypto service
        enumeration CryptoPrimitiveService: {CRYPTO_AEADDECRYPT, CRYPTO_AEADENCRYPT, CRYPTO_DECRYPT, CRYPTO_ENCRYPT, CRYPTO_HASH, CRYPTO_KEYDERIVE, CRYPTO_KEYEXCHANGECALCPUBVAL, CRYPTO_KEYEXCHANGECALCSECRET, CRYPTO_KEYGENERATE, CRYPTO_KEYSETINVALID, CRYPTO_KEYSETVALID, CRYPTO_KEYUNWRAP, CRYPTO_KEYWRAP, CRYPTO_MACGENERATE, CRYPTO_MACVERIFY, CRYPTO_RANDOMGENERATE, CRYPTO_RANDOMSEED, CRYPTO_SIGNATUREGENERATE, CRYPTO_SIGNATUREVERIFY, CUSTOM_SERVICE}, multiplicity set at pre-compile, set at pre-compile  # Determines the crypto service used for defining the capabilities
        boolean CryptoPrimitiveSupportContext [0..1]: multiplicity set at pre-compile, set at pre-compile, default-value=false  # Configures if the crypto primitive supports to store or restore context data of the workspace. Since this option is vulnerable to security, it shall only set to TRUE if absolutely needed.
        reference CryptoPrimitiveAlgorithmFamilyCustomRef [0..*]: multiplicity set at pre-compile, set at pre-compile, destination=CryptoPrimitiveAlgorithmFamilyCustom  # Reference to a customer specific algorithm family custom container
        reference CryptoPrimitiveAlgorithmModeCustomRef [0..*]: multiplicity set at pre-compile, set at pre-compile, destination=CryptoPrimitiveAlgorithmModeCustom  # Reference to a customer specific algorithm mode custom container
        reference CryptoPrimitiveAlgorithmSecondaryFamilyCustomRef [0..*]: multiplicity set at pre-compile, set at pre-compile, destination=CryptoPrimitiveAlgorithmFamilyCustom  # Reference to a customer specific algorithm family custom container
      container CryptoPrimitiveAlgorithmFamilyCustom [0..*]  # Container of custom algorithm family values. | The container name serves as a symbolic name for the identifier of the custom algorithm family type.
        integer CryptoPrimitiveAlgorithmFamilyCustomId: 128..254, multiplicity set at pre-compile, set at pre-compile, symbolic-name-value=true  # The custom value of this algorithm family
      container CryptoPrimitiveAlgorithmModeCustom [0..*]  # Container of custom algorithm family values. | The container name serves as a symbolic name for the identifier of the custom algorithm family type.
        integer CryptoPrimitiveAlgorithmModeCustomId: 128..254, multiplicity set at pre-compile, set at pre-compile, symbolic-name-value=true  # The custom value of this algorithm mode
  module definition Csm [0..1]: variants pre-compile  # Configuration of the Csm (CryptoServiceManager) module.
    container CsmCallbacks [0..1]  # Container for callback function configurations
      container CsmCallback [0..*]: multiplicity set at pre-compile  # Container for configuration of a callback function
        function name CsmCallbackFunc: multiplicity set at pre-compile, set at pre-compile  # Callback function to be called if an asynchronous operation has finished. The corresponding job has to be configured to be processed asynchronously.
    container CsmGeneral: multiplicity set at pre-compile  # Container for common configuration options.
      boolean CsmDevErrorDetect: multiplicity set at pre-compile, set at pre-compile, default-value=false  # Switches the development error detection and notification on or off. | * true: detection and notification is enabled. * false: detection and notification is disabled.
      boolean CsmVersionInfoApi: multiplicity set at pre-compile, set at pre-compile, default-value=false  # Pre-processor switch to enable and disable availability of the API Csm_GetVersionInfo(). | True: API Csm_GetVersionInfo() is available. False: API Csm_GetVersionInfo() is not available.
    container CsmInOutRedirections [0..1]  # Configuration for CSM redirection configurations
      container CsmInOutRedirection [1..*]  # Container for configuration of a CSM redirection. | A redirection let a CSM job use a specific key element as input or/and output.
        integer CsmInputKeyElementId [0..1]: 0..4294967295, multiplicity set at pre-compile, set at pre-compile  # Identifier of the key element used as input
        integer CsmOutputKeyElementId [0..1]: 0..4294967295, multiplicity set at pre-compile, set at pre-compile  # Identifier of the key element used as output.
        integer CsmSecondaryInputKeyElementId [0..1]: 0..4294967295, multiplicity set at pre-compile, set at pre-compile  # Identifier of the key element used as secondary input.
        integer CsmSecondaryOutputKeyElementId [0..1]: 0..4294967295, multiplicity set at pre-compile, set at pre-compile  # Identifier of the key element used as secondary output.
        integer CsmTertiaryInputKeyElementId [0..1]: 0..4294967295, multiplicity set at pre-compile, set at pre-compile  # Identifier of the key element used as tertiary input.
        reference CsmInputKeyRef [0..1]: multiplicity set at pre-compile, set at pre-compile, destination=CsmKey  # This parameter refers to the key used as input.
        reference CsmOutputKeyRef [0..1]: multiplicity set at pre-compile, set at pre-compile, destination=CsmKey  # This parameter refers to the key used as output.
        reference CsmSecondaryInputKeyRef [0..1]: multiplicity set at pre-compile, set at pre-compile, destination=CsmKey  # This parameter refers to the key used as secondary input.
        reference CsmSecondaryOutputKeyRef [0..1]: multiplicity set at pre-compile, set at pre-compile, destination=CsmKey  # This parameter refers to the key used as secondary output.
        reference CsmTertiaryInputKeyRef [0..1]: multiplicity set at pre-compile, set at pre-compile, destination=CsmKey  # This parameter refers to the key used as tertiary input.
    container CsmJobs [0..1]: multiplicity set at pre-compile  # Container for configuration of CSM jobs.
      container CsmJob [1..*]: multiplicity set at pre-compile  # Container for configuration of CSM job. The container name serves as a symbolic name for the identifier of a job configuration.
        integer CsmJobId: 0..4294967295, multiplicity set at pre-compile, set at pre-compile, symbolic-name-value=true  # Identifier of the CSM job. The set of actually configured identifiers shall be consecutive and gapless.
        enumeration CsmJobInterfaceUsePort: {CRYPTO_USE_FNC, CRYPTO_USE_PORT, CRYPTO_USE_PORT_OPTIMIZED}, set at pre-compile  # Does the job need RTE interfaces?
        integer CsmJobPriority: 0..4294967295, multiplicity set at pre-compile, set at pre-compile  # Priority of the job. | The higher the value, the higher the job's priority.
        enumeration CsmJobServiceInterfaceContextUsePort [0..1]: {CRYPTO_USE_FNC, CRYPTO_USE_PORT}, multiplicity set at pre-compile, set at pre-compile, default-value=CRYPTO_USE_FNC  # Does the job need RTE interfaces for context operations
        enumeration CsmProcessingMode: {CRYPTO_PROCESSING_ASYNC, CRYPTO_PROCESSING_SYNC}, set at pre-compile  # Determines how the interface shall be used for that job. Synchronous processing returns with the result while asynchronous processing returns without processing the job. The caller will be notified by the corresponding callback.
        reference CsmInOutRedirectionRef [0..1]: multiplicity set at pre-compile, set at pre-compile, destination=CsmInOutRedirection  # This parameter refers to the used redirection.
        reference CsmJobKeyRef: multiplicity set at pre-compile, set at pre-compile, destination=CsmKey  # This parameter refers to the key which shall be used for the CsmPrimitive. It's possible to use a CsmKey for different jobs
        reference CsmJobPrimitiveCallbackRef [0..1]: multiplicity set at pre-compile, set at pre-compile, destination=CsmCallback  # This parameter refers to the used CsmCallback. | The referred CsmCallback is called when the crypto job has been finished.
        reference CsmJobPrimitiveRef: multiplicity set at pre-compile, set at pre-compile, destination=CsmPrimitives  # This parameter refers to the used CsmPrimitive. | Different jobs may refer to one CsmPrimitive. The referred CsmPrimitive provides detailed information on the actual cryptographic routine.
        reference CsmJobQueueRef: multiplicity set at pre-compile, set at pre-compile, destination=CsmQueue  # This parameter refers to the queue. | The queue is used if the underlying crypto driver object is busy. The queue refers also to the channel which is used.
    container CsmKeys [0..1]  # Container for CSM key configurations.
      container CsmKey [0..*]  # Container for configuration of a CSM key. The container name serves as a symbolic name for the identifier of a key configuration.
        integer CsmKeyId: 0..4294967295, multiplicity set at pre-compile, set at pre-compile, symbolic-name-value=true  # Identifier of the CsmKey. The set of actually configured identifiers shall be consecutive and gapless.
        boolean CsmKeyUsePort: multiplicity set at pre-compile, set at pre-compile  # Does the key need RTE interfaces? | True: RTE interfaces used for this key False: No RTE interfaces used for this key
        reference CsmKeyRef: multiplicity set at pre-compile, set at pre-compile, requires-symbolic-name-value=true, destination=CryIfKey  # This parameter refers to the used CryIfKey. The underlying CryIfKey refers to a specific CryptoKey in the Crypto Driver.
    container CsmMainFunction [0..*]  # Each element of this container defines one instance of Csm_MainFunction. | For each partition, where the Csm module shall be instantiated, at least one MainFunction instance needs to be configured.
      float CsmMainFunctionPeriod [0..1]: 0..INF, multiplicity set at pre-compile, set at pre-compile  # Specifies the period of main function Csm_MainFunction in seconds.
      reference CsmMainFunctionPartitionRef: set at pre-compile, destination=EcucPartition  # Reference to EcucPartition, where the according CsmMainFunction instance is assigned to.
    container CsmPrimitives [0..*]  # Container for configuration of CsmPrimitives
      container CsmAEADDecrypt [0..1]  # Configuration of AEAD decryption primitives
        container CsmAEADDecryptConfig  # Container for configuration of a CSM decryption interface. The container name serves as a symbolic name for the identifier of an decryption interface.
          enumeration CsmAEADDecryptAlgorithmFamily: {CRYPTO_ALGOFAM_3DES, CRYPTO_ALGOFAM_AES, CRYPTO_ALGOFAM_CHACHA, CRYPTO_ALGOFAM_CUSTOM, CRYPTO_ALGOFAM_EEA3}, multiplicity set at pre-compile, set at pre-compile  # Determines the algorithm family used for the crypto service. This parameter defines the most significant part of the algorithm.
          integer CsmAEADDecryptAlgorithmKeyLength: 1..4294967295, multiplicity set at pre-compile, set at pre-compile  # Size of the AEAD decryption key in bytes
          enumeration CsmAEADDecryptAlgorithmMode: {CRYPTO_ALGOMODE_12ROUNDS, CRYPTO_ALGOMODE_20ROUNDS, CRYPTO_ALGOMODE_8ROUNDS, CRYPTO_ALGOMODE_CUSTOM, CRYPTO_ALGOMODE_GCM}, multiplicity set at pre-compile, set at pre-compile  # Determines the algorithm mode used for the crypto service
          enumeration CsmAEADDecryptAlgorithmSecondaryFamily: {CRYPTO_ALGOFAM_CUSTOM, CRYPTO_ALGOFAM_NOT_SET, CRYPTO_ALGOFAM_POLY1305}, set at pre-compile  # Defines the secondary family used for the crypto service
          integer CsmAEADDecryptAssociatedDataMaxLength [0..1]: 1..4294967295, multiplicity set at pre-compile, set at pre-compile  # Size of the input associated data buffer for the synchronous RTE service interface if this primitive is referenced by a Csm job. It may also be possible that other BSW modules use the length parameter for buffer size calculation.
          integer CsmAEADDecryptCiphertextMaxLength [0..1]: 1..4294967295, multiplicity set at pre-compile, set at pre-compile  # Size of the input ciphertext buffer for the synchronous RTE service interface if this primitive is referenced by a Csm job. It may also be possible that other BSW modules use the length parameter for buffer size calculation.
          integer CsmAEADDecryptPlaintextMaxLength [0..1]: 1..4294967295, multiplicity set at pre-compile, set at pre-compile  # Size of the output plaintext buffer for the synchronous RTE service interface if this primitive is referenced by a Csm job. It may also be possible that other BSW modules use the length parameter for buffer size calculation.
          integer CsmAEADDecryptTagLength [0..1]: 1..4294967295, multiplicity set at pre-compile, set at pre-compile  # Size of the input tag buffer in BITS for the synchronous RTE service interface if this primitive is referenced by a Csm job. It may also be possible that other BSW modules use the length parameter for buffer size calculation."
          reference CsmAEADDecryptAlgorithmFamilyCustomRef [0..1]: multiplicity set at pre-compile, set at pre-compile, requires-symbolic-name-value=true, destination=CryptoPrimitiveAlgorithmFamilyCustom  # Reference to a customer specific algorithm family custom container
          reference CsmAEADDecryptAlgorithmModeCustomRef [0..1]: multiplicity set at pre-compile, set at pre-compile, requires-symbolic-name-value=true, destination=CryptoPrimitiveAlgorithmModeCustom  # Reference to a customer specific algorithm mode custom container
          reference CsmAEADDecryptAlgorithmSecondaryFamilyCustomRef [0..1]: multiplicity set at pre-compile, set at pre-compile, requires-symbolic-name-value=true, destination=CryptoPrimitiveAlgorithmFamilyCustom  # Reference to a customer specific algorithm family container in the Crypto Driver
          reference CsmAEADDecryptKeyRef: multiplicity set at pre-compile, set at pre-compile, destination=CsmKey  # This parameter refers to the key used for that decryption primitive.
          reference CsmAEADDecryptQueueRef: multiplicity set at pre-compile, set at pre-compile, destination=CsmQueue  # This parameter refers to the queue used for that decryption primitive.
      container CsmAEADEncrypt [0..1]  # Configuration of AEAD encryption primitives
        container CsmAEADEncryptConfig  # Container for configuration of a CSM encryption interface. The container name serves as a symbolic name for the identifier of an encryption interface.
          enumeration CsmAEADEncryptAlgorithmFamily: {CRYPTO_ALGOFAM_3DES, CRYPTO_ALGOFAM_AES, CRYPTO_ALGOFAM_CHACHA, CRYPTO_ALGOFAM_CUSTOM, CRYPTO_ALGOFAM_EEA3}, multiplicity set at pre-compile, set at pre-compile  # Determines the algorithm family used for the crypto service. This parameter defines the most significant part of the algorithm.
          integer CsmAEADEncryptAlgorithmKeyLength: 1..4294967295, multiplicity set at pre-compile, set at pre-compile  # Size of the AEAD encryption key in bytes
          enumeration CsmAEADEncryptAlgorithmMode: {CRYPTO_ALGOMODE_12ROUNDS, CRYPTO_ALGOMODE_20ROUNDS, CRYPTO_ALGOMODE_8ROUNDS, CRYPTO_ALGOMODE_CUSTOM, CRYPTO_ALGOMODE_GCM}, multiplicity set at pre-compile, set at pre-compile  # Determines the algorithm mode used for the crypto service
          enumeration CsmAEADEncryptAlgorithmSecondaryFamily: {CRYPTO_ALGOFAM_CUSTOM, CRYPTO_ALGOFAM_NOT_SET, CRYPTO_ALGOFAM_POLY1305}, multiplicity set at pre-compile, set at pre-compile  # Defines the secondary family used for the crypto service
          integer CsmAEADEncryptAssociatedDataMaxLength [0..1]: 1..4294967295, multiplicity set at pre-compile, set at pre-compile  # Size of the input associated data buffer for the synchronous RTE service interface if this primitive is referenced by a Csm job. It may also be possible that other BSW modules use the length parameter for buffer size calculation.
          integer CsmAEADEncryptCiphertextMaxLength [0..1]: 1..4294967295, multiplicity set at pre-compile, set at pre-compile  # Size of the output ciphertext buffer for the synchronous RTE service interface if this primitive is referenced by a Csm job. It may also be possible that other BSW modules use the length parameter for buffer size calculation.
          integer CsmAEADEncryptPlaintextMaxLength [0..1]: 1..4294967295, multiplicity set at pre-compile, set at pre-compile  # Size of the input plaintext buffer for the synchronous RTE service interface if this primitive is referenced by a Csm job. It may also be possible that other BSW modules use the length parameter for buffer size calculation
          integer CsmAEADEncryptTagLength [0..1]: 1..4294967295, multiplicity set at pre-compile, set at pre-compile  # Size of the output tag length buffer for the synchronous RTE service interface if this primitive is referenced by a Csm job. It may also be possible that other BSW modules use the length parameter for buffer size calculation.
          reference CsmAEADEncryptAlgorithmFamilyCustomRef [0..1]: multiplicity set at pre-compile, set at pre-compile, requires-symbolic-name-value=true, destination=CryptoPrimitiveAlgorithmFamilyCustom  # Reference to a customer specific algorithm family custom container
          reference CsmAEADEncryptAlgorithmModeCustomRef [0..1]: multiplicity set at pre-compile, set at pre-compile, requires-symbolic-name-value=true, destination=CryptoPrimitiveAlgorithmModeCustom  # Reference to a customer specific algorithm mode custom container
          reference CsmAEADEncryptAlgorithmSecondaryFamilyCustomRef [0..1]: multiplicity set at pre-compile, set at pre-compile, requires-symbolic-name-value=true, destination=CryptoPrimitiveAlgorithmFamilyCustom  # Reference to a customer specific algorithm family container in the Crypto Driver
          reference CsmAEADEncryptKeyRef: multiplicity set at pre-compile, set at pre-compile, destination=CsmKey  # This parameter refers to the key used for that encryption primitive.
          reference CsmAEADEncryptQueueRef: multiplicity set at pre-compile, set at pre-compile, destination=CsmQueue  # This parameter refers to the queue used for that encryption primitive.
      container CsmCustom [0..1]  # Container for configuration of a CSM custom crypto primitive.
        container CsmCustomConfig  # Container for custom primitive configuration configuration parameters
          enumeration CsmCustomAlgorithmFamily: {CRYPTO_ALGOFAM_CUSTOM, CRYPTO_ALGOFAM_NOT_SET}, multiplicity set at pre-compile, set at pre-compile  # Determines the algorithm family used for the crypto service. This parameter defines the most significant part of the algorithm.
          enumeration CsmCustomAlgorithmMode: {CRYPTO_ALGOMODE_CUSTOM, CRYPTO_ALGOMODE_NOT_SET}, multiplicity set at pre-compile, set at pre-compile  # Determines the algorithm mode used for the crypto service
          enumeration CsmCustomAlgorithmSecondaryFamily: {CRYPTO_ALGOFAM_CUSTOM, CRYPTO_ALGOFAM_NOT_SET}, multiplicity set at pre-compile, set at pre-compile  # Determines the algorithm mode used for the crypto service
          integer CsmCustomInputMaxLength: 1..4294967295, multiplicity set at pre-compile, set at pre-compile  # Size of the input data buffer for the synchronous RTE service interface if this primitive is referenced by a Csm job. It may also be possible that other BSW modules use the length parameter for buffer size calculation.
          integer CsmCustomOutputMaxLength: 1..4294967295, multiplicity set at pre-compile, set at pre-compile  # Size of the result data buffer for the synchronous RTE service interface if this primitive is referenced by a Csm job. It may also be possible that other BSW modules use the length parameter for buffer size calculation.
          integer CsmCustomSecondaryInputMaxLength: 1..4294967295, multiplicity set at pre-compile, set at pre-compile  # Size of the input data buffer for the synchronous RTE service interface if this primitive is referenced by a Csm job. It may also be possible that other BSW modules use the length parameter for buffer size calculation.
          integer CsmCustomSecondaryOutputMaxLength: 1..4294967295, multiplicity set at pre-compile, set at pre-compile  # Size of the result data buffer for the synchronous RTE service interface if this primitive is referenced by a Csm job. It may also be possible that other BSW modules use the length parameter for buffer size calculation.
          integer CsmCustomTargetKeyMaxLength: 1..4294967295, multiplicity set at pre-compile, set at pre-compile  # Size of the Key in bytes
          integer CsmCustomTertiaryInputMaxLength: 1..4294967295, multiplicity set at pre-compile, set at pre-compile  # Size of the input data buffer for the synchronous RTE service interface if this primitive is referenced by a Csm job. It may also be possible that other BSW modules use the length parameter for buffer size calculation.
          reference CsmCustomAlgorithmFamilyCustomRef: multiplicity set at pre-compile, set at pre-compile, destination=CryptoPrimitiveAlgorithmFamilyCustom  # Reference to a customer specific algorithm family custom container
          reference CsmCustomAlgorithmModeCustomRef: multiplicity set at pre-compile, set at pre-compile, destination=CryptoPrimitiveAlgorithmModeCustom  # Reference to a customer specific algorithm mode custom container
          reference CsmCustomAlgorithmSecondaryFamilyCustomRef: multiplicity set at pre-compile, set at pre-compile, destination=CryptoPrimitiveAlgorithmFamilyCustom  # Reference to a customer specific algorithm family container in the Crypto Driver
      container CsmDecrypt [0..1]  # Configurations of Decryption primitives
        container CsmDecryptConfig  # Container for configuration of a CSM decryption interface. The container name serves as a symbolic name for the identifier of an decryption interface.
          enumeration CsmDecryptAlgorithmFamily: {CRYPTO_ALGOFAM_3DES, CRYPTO_ALGOFAM_AES, CRYPTO_ALGOFAM_CHACHA, CRYPTO_ALGOFAM_CUSTOM, CRYPTO_ALGOFAM_EEA3, CRYPTO_ALGOFAM_RSA}, multiplicity set at pre-compile, set at pre-compile  # Determines the algorithm family used for the crypto service. This parameter defines the most significant part of the algorithm.
          integer CsmDecryptAlgorithmKeyLength: 1..4294967295, multiplicity set at pre-compile, set at pre-compile  # Size of the encryption key in bytes
          enumeration CsmDecryptAlgorithmMode: {CRYPTO_ALGOMODE_12ROUNDS, CRYPTO_ALGOMODE_20ROUNDS, CRYPTO_ALGOMODE_8ROUNDS, CRYPTO_ALGOMODE_CBC, CRYPTO_ALGOMODE_CFB, CRYPTO_ALGOMODE_CTR, CRYPTO_ALGOMODE_CUSTOM, CRYPTO_ALGOMODE_ECB, CRYPTO_ALGOMODE_OFB, CRYPTO_ALGOMODE_RSAES_OAEP, CRYPTO_ALGOMODE_RSAES_PKCS1_v1_5, CRYPTO_ALGOMODE_XTS}, multiplicity set at pre-compile, set at pre-compile  # Determines the algorithm mode used for the crypto service
          enumeration CsmDecryptAlgorithmSecondaryFamily: {CRYPTO_ALGOFAM_BLAKE_1_256, CRYPTO_ALGOFAM_BLAKE_1_512, CRYPTO_ALGOFAM_BLAKE_2s_256, CRYPTO_ALGOFAM_BLAKE_2s_512, CRYPTO_ALGOFAM_CUSTOM, CRYPTO_ALGOFAM_NOT_SET, CRYPTO_ALGOFAM_RIPEMD160, CRYPTO_ALGOFAM_SHA1, CRYPTO_ALGOFAM_SHA2_224, CRYPTO_ALGOFAM_SHA2_256, CRYPTO_ALGOFAM_SHA2_384, CRYPTO_ALGOFAM_SHA2_512, CRYPTO_ALGOFAM_SHA2_512_224, CRYPTO_ALGOFAM_SHA2_512_256, CRYPTO_ALGOFAM_SHA3_224, CRYPTO_ALGOFAM_SHA3_256, CRYPTO_ALGOFAM_SHA3_384, CRYPTO_ALGOFAM_SHA3_512, CRYPTO_ALGOFAM_SHAKE128, CRYPTO_ALGOFAM_SHAKE256}, multiplicity set at pre-compile, set at pre-compile, default-value=CRYPTO_ALGOFAM_NOT_SET  # Determines the secondary algorithm family used for the crypto service
          integer CsmDecryptDataMaxLength [0..1]: 1..4294967295, multiplicity set at pre-compile, set at pre-compile  # Size of the input ciphertext buffer for the synchronous RTE service interface if this primitive is referenced by a Csm job. It may also be possible that other BSW modules use the length parameter for buffer size calculation.
          integer CsmDecryptResultMaxLength [0..1]: 1..4294967295, multiplicity set at pre-compile, set at pre-compile  # Size of the result data buffer for the synchronous RTE service interface if this primitive is referenced by a Csm job. It may also be possible that other BSW modules use the length parameter for buffer size calculation.
          reference CsmDecryptAlgorithmFamilyCustomRef [0..1]: multiplicity set at pre-compile, set at pre-compile, requires-symbolic-name-value=true, destination=CryptoPrimitiveAlgorithmFamilyCustom  # Reference to a customer specific algorithm family custom container
          reference CsmDecryptAlgorithmModeCustomRef [0..1]: multiplicity set at pre-compile, set at pre-compile, requires-symbolic-name-value=true, destination=CryptoPrimitiveAlgorithmModeCustom  # Reference to a customer specific algorithm mode custom container
          reference CsmDecryptAlgorithmSecondaryFamilyCustomRef [0..1]: multiplicity set at pre-compile, set at pre-compile, requires-symbolic-name-value=true, destination=CryptoPrimitiveAlgorithmFamilyCustom  # Reference to a customer specific algorithm family container in the Crypto Driver
      container CsmEncrypt [0..1]  # Configurations of Encryption primitives
        container CsmEncryptConfig  # Container for configuration of a CSM encryption interface. The container name serves as a symbolic name for the identifier of an encryption interface.
          enumeration CsmEncryptAlgorithmFamily: {CRYPTO_ALGOFAM_3DES, CRYPTO_ALGOFAM_AES, CRYPTO_ALGOFAM_CHACHA, CRYPTO_ALGOFAM_CUSTOM, CRYPTO_ALGOFAM_EEA3, CRYPTO_ALGOFAM_RSA}, multiplicity set at pre-compile, set at pre-compile  # Determines the algorithm family used for the crypto service. This parameter defines the most significant part of the algorithm.
          integer CsmEncryptAlgorithmKeyLength: 1..4294967295, multiplicity set at pre-compile, set at pre-compile  # Size of the encryption key in bytes
          enumeration CsmEncryptAlgorithmMode: {CRYPTO_ALGOMODE_12ROUNDS, CRYPTO_ALGOMODE_20ROUNDS, CRYPTO_ALGOMODE_8ROUNDS, CRYPTO_ALGOMODE_CBC, CRYPTO_ALGOMODE_CFB, CRYPTO_ALGOMODE_CTR, CRYPTO_ALGOMODE_CUSTOM, CRYPTO_ALGOMODE_ECB, CRYPTO_ALGOMODE_NOT_SET, CRYPTO_ALGOMODE_OFB, CRYPTO_ALGOMODE_RSAES_OAEP, CRYPTO_ALGOMODE_RSAES_PKCS1_v1_5, CRYPTO_ALGOMODE_XTS}, multiplicity set at pre-compile, set at pre-compile  # Determines the algorithm mode used for the crypto service
          enumeration CsmEncryptAlgorithmSecondaryFamily: {CRYPTO_ALGOFAM_BLAKE_1_256, CRYPTO_ALGOFAM_BLAKE_1_512, CRYPTO_ALGOFAM_BLAKE_2s_256, CRYPTO_ALGOFAM_BLAKE_2s_512, CRYPTO_ALGOFAM_CUSTOM, CRYPTO_ALGOFAM_NOT_SET, CRYPTO_ALGOFAM_RIPEMD160, CRYPTO_ALGOFAM_SHA1, CRYPTO_ALGOFAM_SHA2_224, CRYPTO_ALGOFAM_SHA2_256, CRYPTO_ALGOFAM_SHA2_384, CRYPTO_ALGOFAM_SHA2_512, CRYPTO_ALGOFAM_SHA2_512_224, CRYPTO_ALGOFAM_SHA2_512_256, CRYPTO_ALGOFAM_SHA3_224, CRYPTO_ALGOFAM_SHA3_256, CRYPTO_ALGOFAM_SHA3_384, CRYPTO_ALGOFAM_SHA3_512, CRYPTO_ALGOFAM_SHAKE128, CRYPTO_ALGOFAM_SHAKE256}, multiplicity set at pre-compile, set at pre-compile, default-value=CRYPTO_ALGOFAM_NOT_SET  # Determines the algorithm family used for the crypto service
          integer CsmEncryptDataMaxLength [0..1]: 1..4294967295, multiplicity set at pre-compile, set at pre-compile  # Size of the input plaintext buffer for the synchronous RTE service interface if this primitive is referenced by a Csm job. It may also be possible that other BSW modules use the length parameter for buffer size calculation.
          integer CsmEncryptResultMaxLength [0..1]: 1..4294967295, multiplicity set at pre-compile, set at pre-compile  # Size of the result data buffer for the synchronous RTE service interface if this primitive is referenced by a Csm job. It may also be possible that other BSW modules use the length parameter for buffer size calculation.
          reference CsmEncryptAlgorithmFamilyCustomRef [0..1]: multiplicity set at pre-compile, set at pre-compile, requires-symbolic-name-value=true, destination=CryptoPrimitiveAlgorithmFamilyCustom  # Reference to a customer specific algorithm family custom container
          reference CsmEncryptAlgorithmModeCustomRef [0..1]: multiplicity set at pre-compile, set at pre-compile, requires-symbolic-name-value=true, destination=CryptoPrimitiveAlgorithmModeCustom  # Reference to a customer specific algorithm mode custom container
          reference CsmEncryptAlgorithmSecondaryFamilyCustomRef [0..1]: multiplicity set at pre-compile, set at pre-compile, requires-symbolic-name-value=true, destination=CryptoPrimitiveAlgorithmFamilyCustom  # Reference to a customer specific algorithm family container in the Crypto Driver
      container CsmHash [0..1]  # Container for Hash Configurations
        container CsmHashConfig  # Container for configuration of a CSM hash. The container name serves as a symbolic name for the identifier of a key configuration.
          enumeration CsmHashAlgorithmFamily: {CRYPTO_ALGOFAM_BLAKE_1_256, CRYPTO_ALGOFAM_BLAKE_1_512, CRYPTO_ALGOFAM_BLAKE_2s_256, CRYPTO_ALGOFAM_BLAKE_2s_512, CRYPTO_ALGOFAM_CUSTOM, CRYPTO_ALGOFAM_RIPEMD160, CRYPTO_ALGOFAM_SHA1, CRYPTO_ALGOFAM_SHA2_224, CRYPTO_ALGOFAM_SHA2_256, CRYPTO_ALGOFAM_SHA2_384, CRYPTO_ALGOFAM_SHA2_512, CRYPTO_ALGOFAM_SHA2_512_224, CRYPTO_ALGOFAM_SHA2_512_256, CRYPTO_ALGOFAM_SHA3_224, CRYPTO_ALGOFAM_SHA3_256, CRYPTO_ALGOFAM_SHA3_384, CRYPTO_ALGOFAM_SHA3_512, CRYPTO_ALGOFAM_SHAKE128, CRYPTO_ALGOFAM_SHAKE256, CRYPTO_ALGOFAM_SM3}, multiplicity set at pre-compile, set at pre-compile  # Determines the algorithm family used for the crypto service. This parameter defines the most significant part of the algorithm.
          enumeration CsmHashAlgorithmMode: {CRYPTO_ALGOMODE_CUSTOM, CRYPTO_ALGOMODE_NOT_SET}, multiplicity set at pre-compile, set at pre-compile, default-value=CRYPTO_ALGOMODE_NOT_SET  # Determines the algorithm mode used for the crypto service
          enumeration CsmHashAlgorithmSecondaryFamily: {CRYPTO_ALGOFAM_CUSTOM, CRYPTO_ALGOFAM_NOT_SET}, multiplicity set at pre-compile, set at pre-compile, default-value=CRYPTO_ALGOFAM_NOT_SET  # Determines the algorithm family used for the crypto service
          integer CsmHashDataMaxLength [0..1]: 1..4294967295, multiplicity set at pre-compile, set at pre-compile  # Size of the input data buffer for the synchronous RTE service interface if this primitive is referenced by a Csm job. It may also be possible that other BSW modules use the length parameter for buffer size calculation.
          integer CsmHashResultLength [0..1]: 1..4294967295, multiplicity set at pre-compile, set at pre-compile  # Size of the result data buffer for the synchronous RTE service interface if this primitive is referenced by a Csm job. It may also be possible that other BSW modules use the length parameter for buffer size calculation.
          reference CsmHashAlgorithmFamilyCustomRef [0..1]: multiplicity set at pre-compile, set at pre-compile, requires-symbolic-name-value=true, destination=CryptoPrimitiveAlgorithmFamilyCustom  # Reference to a customer specific algorithm family custom container
          reference CsmHashAlgorithmModeCustomRef [0..1]: multiplicity set at pre-compile, set at pre-compile, requires-symbolic-name-value=true, destination=CryptoPrimitiveAlgorithmModeCustom  # Reference to a customer specific algorithm mode custom container
          reference CsmHashAlgorithmSecondaryFamilyCustomRef [0..1]: multiplicity set at pre-compile, set at pre-compile, requires-symbolic-name-value=true, destination=CryptoPrimitiveAlgorithmFamilyCustom  # Reference to a customer specific algorithm family container in the Crypto Driver
      container CsmJobKeyDerive [0..1]  # Configurations of KeyDerive primitives
        container CsmJobKeyDeriveConfig  # Container for configuration of a CSM key derive operation. The container name serves as a symbolic name for the identifier of a key derive configuration.
          enumeration CsmJobKeyDeriveAlgorithmFamily: {CRYPTO_ALGOFAM_CUSTOM, CRYPTO_ALGOFAM_HKDF, CRYPTO_ALGOFAM_KDFX963, CRYPTO_ALGOFAM_PBKDF2}, set at pre-compile  # Determines the algorithm family used for the crypto service. This parameter defines the most significant part of the algorithm.
          enumeration CsmJobKeyDeriveAlgorithmMode: {CRYPTO_ALGOMODE_CMAC, CRYPTO_ALGOMODE_CTRDRBG, CRYPTO_ALGOMODE_CUSTOM, CRYPTO_ALGOMODE_GMAC, CRYPTO_ALGOMODE_HMAC, CRYPTO_ALGOMODE_NOT_SET, CRYPTO_ALGOMODE_SIPHASH_2_4, CRYPTO_ALGOMODE_SIPHASH_4_8}, set at pre-compile  # Determines the algorithm mode used for the crypto service
          enumeration CsmJobKeyDeriveAlgorithmSecondaryFamily: {CRYPTO_ALGOFAM_BLAKE_1_256, CRYPTO_ALGOFAM_BLAKE_1_512, CRYPTO_ALGOFAM_BLAKE_2s_256, CRYPTO_ALGOFAM_BLAKE_2s_512, CRYPTO_ALGOFAM_CUSTOM, CRYPTO_ALGOFAM_NOT_SET, CRYPTO_ALGOFAM_RIPEMD160, CRYPTO_ALGOFAM_SHA1, CRYPTO_ALGOFAM_SHA2_224, CRYPTO_ALGOFAM_SHA2_256, CRYPTO_ALGOFAM_SHA2_384, CRYPTO_ALGOFAM_SHA2_512, CRYPTO_ALGOFAM_SHA2_512_224, CRYPTO_ALGOFAM_SHA2_512_256, CRYPTO_ALGOFAM_SHA3_224, CRYPTO_ALGOFAM_SHA3_256, CRYPTO_ALGOFAM_SHA3_384, CRYPTO_ALGOFAM_SHA3_512, CRYPTO_ALGOFAM_SHAKE128, CRYPTO_ALGOFAM_SHAKE256}, set at pre-compile, default-value=CRYPTO_ALGOFAM_NOT_SET  # Determines the algorithm family used for the crypto service.
          reference CsmJobKeyDeriveAlgorithmFamilyCustomRef [0..1]: multiplicity set at pre-compile, set at pre-compile, requires-symbolic-name-value=true, destination=CryptoPrimitiveAlgorithmFamilyCustom  # Reference to a customer specific algorithm family custom container
          reference CsmJobKeyDeriveAlgorithmModeCustomRef [0..1]: multiplicity set at pre-compile, set at pre-compile, requires-symbolic-name-value=true, destination=CryptoPrimitiveAlgorithmModeCustom  # Reference to a customer specific algorithm mode custom container
          reference CsmJobKeyDeriveAlgorithmSecondaryFamilyCustomRef [0..1]: multiplicity set at pre-compile, set at pre-compile, requires-symbolic-name-value=true, destination=CryptoPrimitiveAlgorithmFamilyCustom  # Reference to a customer specific algorithm family container in the Crypto Driver
      container CsmJobKeyExchangeCalcPubVal [0..1]  # Configurations of KeyExchangeCalcPubVal primitives
        container CsmJobKeyExchangeCalcPubValConfig  # Container for configuration of a CSM JobKeyExchangeCalcPubVal. The container name serves as a symbolic name for the identifier of a key configuration.
          enumeration CsmJobKeyExchangeCalcPubValAlgorithmFamily: {CRYPTO_ALGOFAM_CUSTOM, CRYPTO_ALGOFAM_DH, CRYPTO_ALGOFAM_ECDH, CRYPTO_ALGOFAM_RSA}, set at pre-compile  # Determines the algorithm family used for the crypto service. This parameter defines the most significant part of the algorithm.
          enumeration CsmJobKeyExchangeCalcPubValAlgorithmMode: {CRYPTO_ALGOMODE_CUSTOM, CRYPTO_ALGOMODE_NOT_SET}, set at pre-compile  # Determines the algorithm mode used for the crypto service
          enumeration CsmJobKeyExchangeCalcPubValAlgorithmSecondaryFamily: {CRYPTO_ALGOFAM_CUSTOM, CRYPTO_ALGOFAM_ECCANSI, CRYPTO_ALGOFAM_ECCNIST, CRYPTO_ALGOFAM_ECCSEC, CRYPTO_ALGOFAM_NOT_SET, CRYPTO_ALGOFAM_X25519}, set at pre-compile  # Determines the algorithm family used for the crypto service.
          reference CsmJobKeyExchangeCalcPubValAlgorithmFamilyCustomRef [0..1]: multiplicity set at pre-compile, set at pre-compile, requires-symbolic-name-value=true, destination=CryptoPrimitiveAlgorithmFamilyCustom  # Reference to a customer specific algorithm family custom container
          reference CsmJobKeyExchangeCalcPubValAlgorithmModeCustomRef [0..1]: multiplicity set at pre-compile, set at pre-compile, requires-symbolic-name-value=true, destination=CryptoPrimitiveAlgorithmModeCustom  # Reference to a customer specific algorithm mode custom container
          reference CsmJobKeyExchangeCalcPubValAlgorithmSecondaryFamilyCustomRef [0..1]: multiplicity set at pre-compile, set at pre-compile, requires-symbolic-name-value=true, destination=CryptoPrimitiveAlgorithmFamilyCustom  # Reference to a customer specific algorithm family container in the Crypto Driver
      container CsmJobKeyExchangeCalcSecret [0..1]  # Configurations of KeyExchangeCalcSecret primitives
        container CsmJobKeyExchangeCalcSecretConfig  # Container for configuration of a CSM JobKeyExchangeCalcSecret. The container name serves as a symbolic name for the identifier of a JobKeyExchangeCalcSecret configuration.
          enumeration CsmJobKeyExchangeCalcSecretAlgorithmFamily: {CRYPTO_ALGOFAM_CUSTOM, CRYPTO_ALGOFAM_DH, CRYPTO_ALGOFAM_ECDH, CRYPTO_ALGOFAM_RSA}, set at pre-compile  # Determines the algorithm family used for the crypto service. This parameter defines the most significant part of the algorithm.
          enumeration CsmJobKeyExchangeCalcSecretAlgorithmMode: {CRYPTO_ALGOMODE_CUSTOM, CRYPTO_ALGOMODE_NOT_SET}, set at pre-compile  # Determines the algorithm mode used for the crypto service
          enumeration CsmJobKeyExchangeCalcSecretAlgorithmSecondaryFamily: {CRYPTO_ALGOFAM_CUSTOM, CRYPTO_ALGOFAM_ECCANSI, CRYPTO_ALGOFAM_ECCNIST, CRYPTO_ALGOFAM_ECCSEC, CRYPTO_ALGOFAM_NOT_SET, CRYPTO_ALGOFAM_X25519}, set at pre-compile  # Determines the algorithm family used for the crypto service.
          reference CsmJobKeyExchangeCalcSecretAlgorithmFamilyCustomRef [0..1]: multiplicity set at pre-compile, set at pre-compile, requires-symbolic-name-value=true, destination=CryptoPrimitiveAlgorithmFamilyCustom  # Reference to a customer specific algorithm family custom container
          reference CsmJobKeyExchangeCalcSecretAlgorithmModeCustomRef [0..1]: multiplicity set at pre-compile, set at pre-compile, requires-symbolic-name-value=true, destination=CryptoPrimitiveAlgorithmModeCustom  # Reference to a customer specific algorithm mode custom container
          reference CsmJobKeyExchangeCalcSecretAlgorithmSecondaryFamilyCustomRef [0..1]: multiplicity set at pre-compile, set at pre-compile, requires-symbolic-name-value=true, destination=CryptoPrimitiveAlgorithmFamilyCustom  # Reference to a customer specific algorithm family container in the Crypto Driver
      container CsmJobKeyGenerate [0..1]  # Configurations of KeyGenerate primitives
        container CsmJobKeyGenerateConfig  # Container for configuration of a CSM key generate operation. The container name serves as a symbolic name for the identifier of a key generate configuration.
          enumeration CsmJobKeyGenerateAlgorithmFamily: {CRYPTO_ALGOFAM_CUSTOM, CRYPTO_ALGOFAM_ECCANSI, CRYPTO_ALGOFAM_ECCNIST, CRYPTO_ALGOFAM_ECCSEC, CRYPTO_ALGOFAM_ECDH, CRYPTO_ALGOFAM_ED25519, CRYPTO_ALGOFAM_X25519}, set at pre-compile  # Determines the algorithm family used for the crypto service. This parameter defines the most significant part of the algorithm.
          enumeration CsmJobKeyGenerateAlgorithmMode: {CRYPTO_ALGOMODE_CUSTOM, CRYPTO_ALGOMODE_NOT_SET}, set at pre-compile, default-value=CRYPTO_ALGOMODE_NOT_SET  # Determines the algorithm mode used for the crypto service
          enumeration CsmJobKeyGenerateAlgorithmSecondaryFamily: {CRYPTO_ALGOFAM_CUSTOM, CRYPTO_ALGOFAM_NOT_SET}, set at pre-compile, default-value=CRYPTO_ALGOFAM_NOT_SET  # Determines the algorithm family used for the crypto service.
          reference CsmJobKeyGenerateAlgorithmFamilyCustomRef [0..1]: multiplicity set at pre-compile, set at pre-compile, requires-symbolic-name-value=true, destination=CryptoPrimitiveAlgorithmFamilyCustom  # Reference to a customer specific algorithm family custom container
          reference CsmJobKeyGenerateAlgorithmModeCustomRef [0..1]: multiplicity set at pre-compile, set at pre-compile, requires-symbolic-name-value=true, destination=CryptoPrimitiveAlgorithmModeCustom  # Reference to a customer specific algorithm mode custom container
          reference CsmJobKeyGenerateAlgorithmSecondaryFamilyCustomRef [0..1]: multiplicity set at pre-compile, set at pre-compile, requires-symbolic-name-value=true, destination=CryptoPrimitiveAlgorithmFamilyCustom  # Reference to a customer specific algorithm family container in the Crypto Driver
      container CsmJobKeySetInvalid [0..1]  # Configurations of KeySetInvalid primitives
        container CsmJobKeySetInvalidConfig  # Container for configuration of a CSM key set invalid operation.
          enumeration CsmJobKeySetInvalidAlgorithmFamily: {CRYPTO_ALGOFAM_CUSTOM, CRYPTO_ALGOFAM_NOT_SET}, multiplicity set at pre-compile, set at pre-compile  # Determines the algorithm family used for the crypto service. This parameter defines the most significant part of the algorithm.
          enumeration CsmJobKeySetInvalidAlgorithmMode: {CRYPTO_ALGOMODE_CUSTOM, CRYPTO_ALGOMODE_NOT_SET}, multiplicity set at pre-compile, set at pre-compile  # Determines the algorithm mode used for the crypto service.
          enumeration CsmJobKeySetInvalidAlgorithmSecondaryFamily: {CRYPTO_ALGOFAM_CUSTOM, CRYPTO_ALGOFAM_NOT_SET}, multiplicity set at pre-compile, set at pre-compile  # Determines the secondary algorithm family used for the crypto service.
          reference CsmJobKeySetInvalidAlgorithmFamilyCustomRef [0..1]: multiplicity set at pre-compile, set at pre-compile, requires-symbolic-name-value=true, destination=CryptoPrimitiveAlgorithmFamilyCustom  # Reference to a customer specific algorithm family custom container
          reference CsmJobKeySetInvalidAlgorithmModeCustomRef [0..1]: multiplicity set at pre-compile, set at pre-compile, requires-symbolic-name-value=true, destination=CryptoPrimitiveAlgorithmModeCustom  # Reference to a customer specific algorithm mode custom container
          reference CsmJobKeySetInvalidAlgorithmSecondaryFamilyCustomRef [0..1]: multiplicity set at pre-compile, set at pre-compile, requires-symbolic-name-value=true, destination=CryptoPrimitiveAlgorithmFamilyCustom  # Reference to a customer specific algorithm family container in the Crypto Driver
      container CsmJobKeySetValid [0..1]  # Configurations of KeySetValid primitives
        container CsmJobKeySetValidConfig  # Container for configuration of a CSM key set valid operation. The container name serves as a symbolic name for the identifier of a key configuration.
          enumeration CsmJobKeySetValidAlgorithmFamily: {CRYPTO_ALGOFAM_CUSTOM, CRYPTO_ALGOFAM_NOT_SET}, multiplicity set at pre-compile, set at pre-compile  # Determines the algorithm family used for the crypto service. This parameter defines the most significant part of the algorithm.
          enumeration CsmJobKeySetValidAlgorithmMode: {CRYPTO_ALGOMODE_CUSTOM, CRYPTO_ALGOMODE_NOT_SET}, multiplicity set at pre-compile, set at pre-compile  # Determines the algorithm mode used for the crypto service.
          enumeration CsmJobKeySetValidAlgorithmSecondaryFamily: {CRYPTO_ALGOFAM_CUSTOM, CRYPTO_ALGOFAM_NOT_SET}, multiplicity set at pre-compile, set at pre-compile  # Determines the secondary algorithm family used for the crypto service.
          reference CsmJobKeySetValidAlgorithmFamilyCustomRef [0..1]: multiplicity set at pre-compile, set at pre-compile, requires-symbolic-name-value=true, destination=CryptoPrimitiveAlgorithmFamilyCustom  # Reference to a customer specific algorithm family custom container
          reference CsmJobKeySetValidAlgorithmModeCustomRef [0..1]: multiplicity set at pre-compile, set at pre-compile, requires-symbolic-name-value=true, destination=CryptoPrimitiveAlgorithmModeCustom  # Reference to a customer specific algorithm mode custom container
          reference CsmJobKeySetValidAlgorithmSecondaryFamilyCustomRef [0..1]: multiplicity set at pre-compile, set at pre-compile, requires-symbolic-name-value=true, destination=CryptoPrimitiveAlgorithmFamilyCustom  # Reference to a customer specific algorithm family container in the Crypto Driver
      container CsmJobKeyUnwrap [0..1]  # Configurations of KeyUnWrap primitives
        container CsmJobKeyUnwrapConfig  # Container for configuration of a CSM key unwrap operation. The container name serves as a symbolic name for the identifier of a key unwrap configuration.
          enumeration CsmJobKeyUnwrapAlgorithmFamily: {CRYPTO_ALGOFAM_AES, CRYPTO_ALGOFAM_CUSTOM}, set at pre-compile  # Determines the algorithm family used for the crypto service. This parameter defines the most significant part of the algorithm.
          integer CsmJobKeyUnwrapAlgorithmKeyLength: 1..4294967295, multiplicity set at pre-compile, set at pre-compile  # Size of the key encryption key in bytes
          enumeration CsmJobKeyUnwrapAlgorithmMode: {CRYPTO_ALGOMODE_AESKEYWRAP, CRYPTO_ALGOMODE_CUSTOM}, set at pre-compile  # Determines the algorithm mode used for the crypto service.
          enumeration CsmJobKeyUnwrapAlgorithmSecondaryFamily: {CRYPTO_ALGOFAM_CUSTOM, CRYPTO_ALGOFAM_NOT_SET}, set at pre-compile  # Determines the algorithm family used for the crypto service.
          reference CsmJobKeyUnwrapAlgorithmFamilyCustomRef [0..1]: multiplicity set at pre-compile, set at pre-compile, requires-symbolic-name-value=true, destination=CryptoPrimitiveAlgorithmFamilyCustom  # Reference to a customer specific algorithm family custom container
          reference CsmJobKeyUnwrapAlgorithmModeCustomRef [0..1]: multiplicity set at pre-compile, set at pre-compile, requires-symbolic-name-value=true, destination=CryptoPrimitiveAlgorithmModeCustom  # Reference to a customer specific algorithm mode custom container
          reference CsmJobKeyUnwrapAlgorithmSecondaryFamilyCustomRef [0..1]: multiplicity set at pre-compile, set at pre-compile, requires-symbolic-name-value=true, destination=CryptoPrimitiveAlgorithmFamilyCustom  # Reference to a customer specific algorithm family container in the Crypto Driver
      container CsmJobKeyWrap [0..1]  # Configurations of KeyWrap primitives
        container CsmJobKeyWrapConfig  # Container for configuration of a CSM key wrap operation. The container name serves as a symbolic name for the identifier of a key wrap configuration.
          enumeration CsmJobKeyWrapAlgorithmFamily: {CRYPTO_ALGOFAM_AES, CRYPTO_ALGOFAM_CUSTOM}, set at pre-compile  # Determines the algorithm family used for the crypto service. This parameter defines the most significant part of the algorithm.
          integer CsmJobKeyWrapAlgorithmKeyLength: 1..4294967295, multiplicity set at pre-compile, set at pre-compile  # Size of the key encryption key in bytes
          enumeration CsmJobKeyWrapAlgorithmMode: {CRYPTO_ALGOMODE_AESKEYWRAP, CRYPTO_ALGOMODE_CUSTOM}, set at pre-compile  # Determines the algorithm mode used for the crypto service.
          enumeration CsmJobKeyWrapAlgorithmSecondaryFamily: {CRYPTO_ALGOFAM_CUSTOM, CRYPTO_ALGOFAM_NOT_SET}, set at pre-compile  # Determines the algorithm family used for the crypto service.
          reference CsmJobKeyWrapAlgorithmFamilyCustomRef [0..1]: multiplicity set at pre-compile, set at pre-compile, requires-symbolic-name-value=true, destination=CryptoPrimitiveAlgorithmFamilyCustom  # Reference to a customer specific algorithm family custom container
          reference CsmJobKeyWrapAlgorithmModeCustomRef [0..1]: multiplicity set at pre-compile, set at pre-compile, requires-symbolic-name-value=true, destination=CryptoPrimitiveAlgorithmModeCustom  # Reference to a customer specific algorithm mode custom container
          reference CsmJobKeyWrapAlgorithmSecondaryFamilyCustomRef [0..1]: multiplicity set at pre-compile, set at pre-compile, requires-symbolic-name-value=true, destination=CryptoPrimitiveAlgorithmFamilyCustom  # Reference to a customer specific algorithm family container in the Crypto Driver
      container CsmJobRandomSeed [0..1]  # Configurations of RandomSeed primitives
        container CsmJobRandomSeedConfig  # Container for configuration of a CSM random seed operation. The container name serves as a symbolic name for the identifier of a random seed configuration.
          enumeration CsmJobRandomSeedAlgorithmFamily: {CRYPTO_ALGOFAM_3DES, CRYPTO_ALGOFAM_AES, CRYPTO_ALGOFAM_BLAKE_1_256, CRYPTO_ALGOFAM_BLAKE_1_512, CRYPTO_ALGOFAM_BLAKE_2s_256, CRYPTO_ALGOFAM_BLAKE_2s_512, CRYPTO_ALGOFAM_CHACHA, CRYPTO_ALGOFAM_CUSTOM, CRYPTO_ALGOFAM_DRBG, CRYPTO_ALGOFAM_EEA3, CRYPTO_ALGOFAM_FIPS186, CRYPTO_ALGOFAM_RIPEMD160, CRYPTO_ALGOFAM_RNG, CRYPTO_ALGOFAM_SHA1, CRYPTO_ALGOFAM_SHA2_224, CRYPTO_ALGOFAM_SHA2_256, CRYPTO_ALGOFAM_SHA2_384, CRYPTO_ALGOFAM_SHA2_512, CRYPTO_ALGOFAM_SHA2_512_224, CRYPTO_ALGOFAM_SHA2_512_256, CRYPTO_ALGOFAM_SHA3_224, CRYPTO_ALGOFAM_SHA3_256, CRYPTO_ALGOFAM_SHA3_384, CRYPTO_ALGOFAM_SHA3_512, CRYPTO_ALGOFAM_SHAKE128, CRYPTO_ALGOFAM_SHAKE256, CRYPTO_ALGOFAM_SM3}, multiplicity set at pre-compile, set at pre-compile  # Determines the algorithm family used for the crypto service.
          enumeration CsmJobRandomSeedAlgorithmMode: {CRYPTO_ALGOMODE_CMAC, CRYPTO_ALGOMODE_CTRDRBG, CRYPTO_ALGOMODE_CUSTOM, CRYPTO_ALGOMODE_GMAC, CRYPTO_ALGOMODE_HMAC, CRYPTO_ALGOMODE_NOT_SET, CRYPTO_ALGOMODE_SIPHASH_2_4, CRYPTO_ALGOMODE_SIPHASH_4_8}, set at pre-compile  # Determines the algorithm mode used for the crypto service
          enumeration CsmJobRandomSeedAlgorithmSecondaryFamily: {CRYPTO_ALGOFAM_3DES, CRYPTO_ALGOFAM_AES, CRYPTO_ALGOFAM_BLAKE_1_256, CRYPTO_ALGOFAM_BLAKE_1_512, CRYPTO_ALGOFAM_BLAKE_2s_256, CRYPTO_ALGOFAM_BLAKE_2s_512, CRYPTO_ALGOFAM_CHACHA, CRYPTO_ALGOFAM_CUSTOM, CRYPTO_ALGOFAM_NOT_SET, CRYPTO_ALGOFAM_RIPEMD160, CRYPTO_ALGOFAM_SHA1, CRYPTO_ALGOFAM_SHA2_224, CRYPTO_ALGOFAM_SHA2_256, CRYPTO_ALGOFAM_SHA2_384, CRYPTO_ALGOFAM_SHA2_512, CRYPTO_ALGOFAM_SHA2_512_224, CRYPTO_ALGOFAM_SHA2_512_256, CRYPTO_ALGOFAM_SHA3_224, CRYPTO_ALGOFAM_SHA3_256, CRYPTO_ALGOFAM_SHA3_384, CRYPTO_ALGOFAM_SHA3_512, CRYPTO_ALGOFAM_SHAKE128, CRYPTO_ALGOFAM_SHAKE256}, set at pre-compile  # Determines the algorithm family used for the crypto service.
          reference CsmJobRandomSeedAlgorithmFamilyCustomRef [0..1]: multiplicity set at pre-compile, set at pre-compile, requires-symbolic-name-value=true, destination=CryptoPrimitiveAlgorithmFamilyCustom  # Reference to a customer specific algorithm family custom container
          reference CsmJobRandomSeedAlgorithmModeCustomRef [0..1]: multiplicity set at pre-compile, set at pre-compile, requires-symbolic-name-value=true, destination=CryptoPrimitiveAlgorithmModeCustom  # Reference to a customer specific algorithm mode custom container
          reference CsmJobRandomSeedAlgorithmSecondaryFamilyCustomRef [0..1]: multiplicity set at pre-compile, set at pre-compile, requires-symbolic-name-value=true, destination=CryptoPrimitiveAlgorithmFamilyCustom  # Reference to a customer specific algorithm family container in the Crypto Driver
      container CsmMacGenerate [0..1]  # Configurations of MacGenerate primitives
        container CsmMacGenerateConfig  # Container for configuration of a CSM mac generation interface. The container name serves as a symbolic name for the identifier of a MAC generation interface.
          enumeration CsmMacGenerateAlgorithmFamily: {CRYPTO_ALGOFAM_3DES, CRYPTO_ALGOFAM_AES, CRYPTO_ALGOFAM_BLAKE_1_256, CRYPTO_ALGOFAM_BLAKE_1_512, CRYPTO_ALGOFAM_BLAKE_2s_256, CRYPTO_ALGOFAM_BLAKE_2s_512, CRYPTO_ALGOFAM_CHACHA, CRYPTO_ALGOFAM_CUSTOM, CRYPTO_ALGOFAM_EEA3, CRYPTO_ALGOFAM_EIA3, CRYPTO_ALGOFAM_POLY1305, CRYPTO_ALGOFAM_RIPEMD160, CRYPTO_ALGOFAM_RNG, CRYPTO_ALGOFAM_SHA1, CRYPTO_ALGOFAM_SHA2_224, CRYPTO_ALGOFAM_SHA2_256, CRYPTO_ALGOFAM_SHA2_384, CRYPTO_ALGOFAM_SHA2_512, CRYPTO_ALGOFAM_SHA2_512_224, CRYPTO_ALGOFAM_SHA2_512_256, CRYPTO_ALGOFAM_SHA3_224, CRYPTO_ALGOFAM_SHA3_256, CRYPTO_ALGOFAM_SHA3_384, CRYPTO_ALGOFAM_SHA3_512, CRYPTO_ALGOFAM_SHAKE128, CRYPTO_ALGOFAM_SHAKE256, CRYPTO_ALGOFAM_SIPHASH, CRYPTO_ALGOFAM_SM3}, multiplicity set at pre-compile, set at pre-compile  # Determines the algorithm family used for the crypto service. This parameter defines the most significant part of the algorithm.
          integer CsmMacGenerateAlgorithmKeyLength: 1..4294967295, multiplicity set at pre-compile, set at pre-compile  # Size of the MAC key in bytes
          enumeration CsmMacGenerateAlgorithmMode: {CRYPTO_ALGOMODE_CMAC, CRYPTO_ALGOMODE_CTRDRBG, CRYPTO_ALGOMODE_CUSTOM, CRYPTO_ALGOMODE_GMAC, CRYPTO_ALGOMODE_HMAC, CRYPTO_ALGOMODE_NOT_SET, CRYPTO_ALGOMODE_SIPHASH_2_4, CRYPTO_ALGOMODE_SIPHASH_4_8}, multiplicity set at pre-compile, set at pre-compile  # Determines the algorithm mode used for the crypto service
          enumeration CsmMacGenerateAlgorithmSecondaryFamily: {CRYPTO_ALGOFAM_CUSTOM, CRYPTO_ALGOFAM_NOT_SET}, multiplicity set at pre-compile, set at pre-compile, default-value=CRYPTO_ALGOFAM_NOT_SET  # Determines the secondary algorithm family used for the crypto service
          integer CsmMacGenerateDataMaxLength [0..1]: 1..4294967295, multiplicity set at pre-compile, set at pre-compile  # Size of the input data buffer for the synchronous RTE service interface if this primitive is referenced by a Csm job. It may also be possible that other BSW modules use the length parameter for buffer size calculation.
          integer CsmMacGenerateResultLength [0..1]: 1..4294967295, multiplicity set at pre-compile, set at pre-compile  # Size of the result data buffer for the synchronous RTE service interface if this primitive is referenced by a Csm job. It may also be possible that other BSW modules use the length parameter for buffer size calculation.
          reference CsmMacGenerateAlgorithmFamilyCustomRef [0..1]: multiplicity set at pre-compile, set at pre-compile, requires-symbolic-name-value=true, destination=CryptoPrimitiveAlgorithmFamilyCustom  # Reference to a customer specific algorithm family custom container
          reference CsmMacGenerateAlgorithmModeCustomRef [0..1]: multiplicity set at pre-compile, set at pre-compile, requires-symbolic-name-value=true, destination=CryptoPrimitiveAlgorithmModeCustom  # Reference to a customer specific algorithm mode custom container
          reference CsmMacGenerateAlgorithmSecondaryFamilyCustomRef [0..1]: multiplicity set at pre-compile, set at pre-compile, requires-symbolic-name-value=true, destination=CryptoPrimitiveAlgorithmFamilyCustom  # Reference to a customer specific algorithm family container in the Crypto Driver
      container CsmMacVerify [0..1]  # Configurations of MacVerify primitives
        container CsmMacVerifyConfig  # Container for configuration of a CSM MAC verification interface. The container name serves as a symbolic name for the identifier of a MAC generation interface
          enumeration CsmMacVerifyAlgorithmFamily: {CRYPTO_ALGOFAM_3DES, CRYPTO_ALGOFAM_AES, CRYPTO_ALGOFAM_BLAKE_1_256, CRYPTO_ALGOFAM_BLAKE_1_512, CRYPTO_ALGOFAM_BLAKE_2s_256, CRYPTO_ALGOFAM_BLAKE_2s_512, CRYPTO_ALGOFAM_CHACHA, CRYPTO_ALGOFAM_EEA3, CRYPTO_ALGOFAM_EIA3, CRYPTO_ALGOFAM_POLY1305, CRYPTO_ALGOFAM_RIPEMD160, CRYPTO_ALGOFAM_RNG, CRYPTO_ALGOFAM_SHA1, CRYPTO_ALGOFAM_SHA2_224, CRYPTO_ALGOFAM_SHA2_256, CRYPTO_ALGOFAM_SHA2_384, CRYPTO_ALGOFAM_SHA2_512, CRYPTO_ALGOFAM_SHA2_512_224, CRYPTO_ALGOFAM_SHA2_512_256, CRYPTO_ALGOFAM_SHA3_224, CRYPTO_ALGOFAM_SHA3_256, CRYPTO_ALGOFAM_SHA3_384, CRYPTO_ALGOFAM_SHA3_512, CRYPTO_ALGOFAM_SHAKE128, CRYPTO_ALGOFAM_SHAKE256, CRYPTO_ALGOFAM_SIPHASH, CRYPTO_ALGOFAM_SM3, CRYPTO_ALGOMODE_CUSTOM}, multiplicity set at pre-compile, set at pre-compile  # Determines the algorithm family used for the crypto service. This parameter defines the most significant part of the algorithm.
          integer CsmMacVerifyAlgorithmKeyLength: 1..4294967295, multiplicity set at pre-compile, set at pre-compile  # Size of the MAC key in bytes
          enumeration CsmMacVerifyAlgorithmMode: {CRYPTO_ALGOMODE_CMAC, CRYPTO_ALGOMODE_CTRDRBG, CRYPTO_ALGOMODE_CUSTOM, CRYPTO_ALGOMODE_GMAC, CRYPTO_ALGOMODE_HMAC, CRYPTO_ALGOMODE_NOT_SET, CRYPTO_ALGOMODE_SIPHASH_2_4, CRYPTO_ALGOMODE_SIPHASH_4_8}, multiplicity set at pre-compile, set at pre-compile  # Determines the algorithm mode used for the crypto service
          enumeration CsmMacVerifyAlgorithmSecondaryFamily: {CRYPTO_ALGOFAM_CUSTOM, CRYPTO_ALGOFAM_NOT_SET}, multiplicity set at pre-compile, set at pre-compile, default-value=CRYPTO_ALGOFAM_NOT_SET  # Determines the secondary algorithm family used for the crypto service
          integer CsmMacVerifyCompareLength [0..1]: 1..4294967295, multiplicity set at pre-compile, set at pre-compile  # Size of the input MAC buffer in BITS for the synchronous RTE service interface if this primitive is referenced by a Csm job. It may also be possible that other BSW modules use the length parameter for buffer size calculation.
          integer CsmMacVerifyDataMaxLength [0..1]: 1..4294967295, multiplicity set at pre-compile, set at pre-compile  # Size of the input data buffer for the synchronous RTE service interface if this primitive is referenced by a Csm job. It may also be possible that other BSW modules use the length parameter for buffer size calculation.
          reference CsmMacVerifyAlgorithmFamilyCustomRef [0..1]: multiplicity set at pre-compile, set at pre-compile, requires-symbolic-name-value=true, destination=CryptoPrimitiveAlgorithmFamilyCustom  # Reference to a customer specific algorithm family custom container
          reference CsmMacVerifyAlgorithmModeCustomRef [0..1]: multiplicity set at pre-compile, set at pre-compile, requires-symbolic-name-value=true, destination=CryptoPrimitiveAlgorithmModeCustom  # Reference to a customer specific algorithm mode custom container
          reference CsmMacVerifyAlgorithmSecondaryFamilyCustomRef [0..1]: multiplicity set at pre-compile, set at pre-compile, requires-symbolic-name-value=true, destination=CryptoPrimitiveAlgorithmFamilyCustom  # Reference to a customer specific algorithm family container in the Crypto Driver
      container CsmRandomGenerate [0..1]  # Configurations of RandomGenerate primitives
        container CsmRandomGenerateConfig  # Container for configuration of a CSM random generator. The container name serves as a symbolic name for the identifier of a random generator configuration.
          enumeration CsmRandomGenerateAlgorithmFamily: {CRYPTO_ALGOFAM_3DES, CRYPTO_ALGOFAM_AES, CRYPTO_ALGOFAM_BLAKE_1_256, CRYPTO_ALGOFAM_BLAKE_1_512, CRYPTO_ALGOFAM_BLAKE_2s_256, CRYPTO_ALGOFAM_BLAKE_2s_512, CRYPTO_ALGOFAM_CHACHA, CRYPTO_ALGOFAM_CUSTOM, CRYPTO_ALGOFAM_EEA3, CRYPTO_ALGOFAM_RIPEMD160, CRYPTO_ALGOFAM_RNG, CRYPTO_ALGOFAM_SHA1, CRYPTO_ALGOFAM_SHA2_224, CRYPTO_ALGOFAM_SHA2_256, CRYPTO_ALGOFAM_SHA2_384, CRYPTO_ALGOFAM_SHA2_512, CRYPTO_ALGOFAM_SHA2_512_224, CRYPTO_ALGOFAM_SHA2_512_256, CRYPTO_ALGOFAM_SHA3_224, CRYPTO_ALGOFAM_SHA3_256, CRYPTO_ALGOFAM_SHA3_384, CRYPTO_ALGOFAM_SHA3_512, CRYPTO_ALGOFAM_SHAKE128, CRYPTO_ALGOFAM_SHAKE256, CRYPTO_ALGOFAM_SM3}, multiplicity set at pre-compile, set at pre-compile  # Determines the algorithm family used for the crypto service. This parameter defines the most significant part of the algorithm.
          enumeration CsmRandomGenerateAlgorithmMode: {CRYPTO_ALGOMODE_CTRDRBG, CRYPTO_ALGOMODE_CUSTOM, CRYPTO_ALGOMODE_GMAC, CRYPTO_ALGOMODE_HMAC, CRYPTO_ALGOMODE_NOT_SET, CRYPTO_ALGOMODE_SIPHASH_2_4, CRYPTO_ALGOMODE_SIPHASH_4_8}, multiplicity set at pre-compile, set at pre-compile  # Determines the algorithm mode used for the crypto service
          enumeration CsmRandomGenerateAlgorithmSecondaryFamily: {CRYPTO_ALGOFAM_CUSTOM, CRYPTO_ALGOFAM_NOT_SET}, multiplicity set at pre-compile, set at pre-compile  # Determines the algorithm family used for the crypto service
          integer CsmRandomGenerateResultLength [0..1]: 1..4294967295, multiplicity set at pre-compile, set at pre-compile  # Size of the result data buffer for the synchronous RTE service interface if this primitive is referenced by a Csm job. It may also be possible that other BSW modules use the length parameter for buffer size calculation
          reference CsmRandomGenerateAlgorithmFamilyCustomRef [0..1]: multiplicity set at pre-compile, set at pre-compile, requires-symbolic-name-value=true, destination=CryptoPrimitiveAlgorithmFamilyCustom  # Reference to a customer specific algorithm family custom container
          reference CsmRandomGenerateAlgorithmModeCustomRef [0..1]: multiplicity set at pre-compile, set at pre-compile, requires-symbolic-name-value=true, destination=CryptoPrimitiveAlgorithmModeCustom  # Reference to a customer specific algorithm mode custom container
          reference CsmRandomGenerateAlgorithmSecondaryFamilyCustomRef [0..1]: multiplicity set at pre-compile, set at pre-compile, requires-symbolic-name-value=true, destination=CryptoPrimitiveAlgorithmFamilyCustom  # Reference to a customer specific algorithm family container in the Crypto Driver
      container CsmSignatureGenerate [0..1]  # Configurations of SignatureGenerate primitives
        container CsmSignatureGenerateConfig  # Container for configuration of a CSM signature generation interface. The container name serves as a symbolic name for the identifier of signature generation interface.
          enumeration CsmSignatureGenerateAlgorithmFamily: {CRYPTO_ALGOFAM_BRAINPOOL, CRYPTO_ALGOFAM_CUSTOM, CRYPTO_ALGOFAM_ECCNIST, CRYPTO_ALGOFAM_ECDSA, CRYPTO_ALGOFAM_ED25519, CRYPTO_ALGOFAM_RSA, CRYPTO_ALGOFAM_SM2}, multiplicity set at pre-compile, set at pre-compile  # Determines the algorithm family used for the crypto service. This parameter defines the most significant part of the algorithm.
          enumeration CsmSignatureGenerateAlgorithmMode: {CRYPTO_ALGOMODE_CUSTOM, CRYPTO_ALGOMODE_NOT_SET, CRYPTO_ALGOMODE_RSASSA_PKCS1_v1_5, CRYPTO_ALGOMODE_RSASSA_PSS}, multiplicity set at pre-compile, set at pre-compile  # Determines the algorithm mode used for the crypto service
          enumeration CsmSignatureGenerateAlgorithmSecondaryFamily: {CRYPTO_ALGOFAM_BLAKE_1_256, CRYPTO_ALGOFAM_BLAKE_1_512, CRYPTO_ALGOFAM_BLAKE_2s_256, CRYPTO_ALGOFAM_BLAKE_2s_512, CRYPTO_ALGOFAM_CUSTOM, CRYPTO_ALGOFAM_NOT_SET, CRYPTO_ALGOFAM_RIPEMD160, CRYPTO_ALGOFAM_SHA1, CRYPTO_ALGOFAM_SHA2_224, CRYPTO_ALGOFAM_SHA2_256, CRYPTO_ALGOFAM_SHA2_384, CRYPTO_ALGOFAM_SHA2_512, CRYPTO_ALGOFAM_SHA2_512_224, CRYPTO_ALGOFAM_SHA2_512_256, CRYPTO_ALGOFAM_SHA3_224, CRYPTO_ALGOFAM_SHA3_256, CRYPTO_ALGOFAM_SHA3_384, CRYPTO_ALGOFAM_SHA3_512, CRYPTO_ALGOFAM_SHAKE128, CRYPTO_ALGOFAM_SHAKE256}, multiplicity set at pre-compile, set at pre-compile, default-value=CRYPTO_ALGOFAM_NOT_SET  # Determines the algorithm mode used for the crypto service
          integer CsmSignatureGenerateDataMaxLength [0..1]: 1..4294967295, multiplicity set at pre-compile, set at pre-compile  # Size of the input data buffer for the synchronous RTE service interface if this primitive is referenced by a Csm job. It may also be possible that other BSW modules use the length parameter for buffer size calculation.
          integer CsmSignatureGenerateKeyLength: 1..4294967295, multiplicity set at pre-compile, set at pre-compile  # Size of the signature generate key in bytes
          integer CsmSignatureGenerateResultLength [0..1]: 1..4294967295, multiplicity set at pre-compile, set at pre-compile  # Size of the result data buffer for the synchronous RTE service interface if this primitive is referenced by a Csm job. It may also be possible that other BSW modules use the length parameter for buffer size calculation.
          reference CsmSignatureGenerateAlgorithmFamilyCustomRef [0..1]: multiplicity set at pre-compile, set at pre-compile, requires-symbolic-name-value=true, destination=CryptoPrimitiveAlgorithmFamilyCustom  # Reference to a customer specific algorithm family custom container
          reference CsmSignatureGenerateAlgorithmModeCustomRef [0..1]: multiplicity set at pre-compile, set at pre-compile, requires-symbolic-name-value=true, destination=CryptoPrimitiveAlgorithmModeCustom  # Reference to a customer specific algorithm mode custom container
          reference CsmSignatureGenerateAlgorithmSecondaryFamilyCustomRef [0..1]: multiplicity set at pre-compile, set at pre-compile, requires-symbolic-name-value=true, destination=CryptoPrimitiveAlgorithmFamilyCustom  # Reference to a customer specific algorithm family container in the Crypto Driver
      container CsmSignatureVerify [0..1]  # Configurations of SignatureVerify primitives
        container CsmSignatureVerifyConfig  # Container for configuration of a CSM signature verification interface. The container name serves as a symbolic name for the identifier of signature verification interface.
          enumeration CsmSignatureVerifyAlgorithmFamily: {CRYPTO_ALGOFAM_BRAINPOOL, CRYPTO_ALGOFAM_CUSTOM, CRYPTO_ALGOFAM_ECCNIST, CRYPTO_ALGOFAM_ECDSA, CRYPTO_ALGOFAM_ED25519, CRYPTO_ALGOFAM_RSA, CRYPTO_ALGOFAM_SM2}, multiplicity set at pre-compile, set at pre-compile  # Determines the algorithm family used for the crypto service. This parameter defines the most significant part of the algorithm.
          enumeration CsmSignatureVerifyAlgorithmMode: {CRYPTO_ALGOMODE_CUSTOM, CRYPTO_ALGOMODE_NOT_SET, CRYPTO_ALGOMODE_RSASSA_PKCS1_v1_5, CRYPTO_ALGOMODE_RSASSA_PSS}, multiplicity set at pre-compile, set at pre-compile  # Determines the algorithm mode used for the crypto service
          enumeration CsmSignatureVerifyAlgorithmSecondaryFamily: {CRYPTO_ALGOFAM_BLAKE_1_256, CRYPTO_ALGOFAM_BLAKE_1_512, CRYPTO_ALGOFAM_BLAKE_2s_256, CRYPTO_ALGOFAM_BLAKE_2s_512, CRYPTO_ALGOFAM_CUSTOM, CRYPTO_ALGOFAM_NOT_SET, CRYPTO_ALGOFAM_RIPEMD160, CRYPTO_ALGOFAM_SHA1, CRYPTO_ALGOFAM_SHA2_224, CRYPTO_ALGOFAM_SHA2_256, CRYPTO_ALGOFAM_SHA2_384, CRYPTO_ALGOFAM_SHA2_512, CRYPTO_ALGOFAM_SHA2_512_224, CRYPTO_ALGOFAM_SHA2_512_256, CRYPTO_ALGOFAM_SHA3_224, CRYPTO_ALGOFAM_SHA3_256, CRYPTO_ALGOFAM_SHA3_384, CRYPTO_ALGOFAM_SHA3_512, CRYPTO_ALGOFAM_SHAKE128, CRYPTO_ALGOFAM_SHAKE256}, multiplicity set at pre-compile, set at pre-compile  # Determines the algorithm family used for the crypto service. This parameter defines the most significant part of the algorithm.
          integer CsmSignatureVerifyCompareLength [0..1]: 1..4294967295, multiplicity set at pre-compile, set at pre-compile  # Size of the input signature buffer for the synchronous RTE service interface if this primitive is referenced by a Csm job. It may also be possible that other BSW modules use the length parameter for buffer size calculation.
          integer CsmSignatureVerifyDataMaxLength [0..1]: 1..4294967295, multiplicity set at pre-compile, set at pre-compile  # Size of the input data buffer for the synchronous RTE service interface if this primitive is referenced by a Csm job. It may also be possible that other BSW modules use the length parameter for buffer size calculation.
          integer CsmSignatureVerifyKeyLength: 1..4294967295, multiplicity set at pre-compile, set at pre-compile  # Size of the signature verify key in bytes
          reference CsmSignatureVerifyAlgorithmFamilyCustomRef [0..1]: multiplicity set at pre-compile, set at pre-compile, requires-symbolic-name-value=true, destination=CryptoPrimitiveAlgorithmFamilyCustom  # Reference to a customer specific algorithm family custom container
          reference CsmSignatureVerifyAlgorithmModeCustomRef [0..1]: multiplicity set at pre-compile, set at pre-compile, requires-symbolic-name-value=true, destination=CryptoPrimitiveAlgorithmModeCustom  # Reference to a customer specific algorithm mode custom container
          reference CsmSignatureVerifyAlgorithmSecondaryFamilyCustomRef [0..1]: multiplicity set at pre-compile, set at pre-compile, requires-symbolic-name-value=true, destination=CryptoPrimitiveAlgorithmFamilyCustom  # Reference to a customer specific algorithm family container in the Crypto Driver
    container CsmQueues [0..1]  # Container for CSM queue configurations
      container CsmQueue [1..*]  # Container for configuration of a CSM queue. | A queue has two tasks: 1. queue jobs which cannot be processed since the underlying hardware is busy and 2. refer to channel which shall be used
        integer CsmQueueSize: 1..4294967295, multiplicity set at pre-compile, set at pre-compile  # Size of the CsmQueue. If jobs cannot be processed by the underlying hardware since the hardware is busy, the jobs stay in the prioritized queue. If the queue is full, the next job will be rejected.
        reference CsmChannelRef: multiplicity set at pre-compile, set at pre-compile, requires-symbolic-name-value=true, destination=CryIfChannel  # Refers to the underlying Crypto Interface channel.
        reference CsmQueueMainFunctionRef: set at pre-compile, destination=CsmMainFunction  # Reference to CsmMainFunction, where the according CsmQueue is assigned to.
