[part 2 of 14: package /AUTOSAR/EcucDefs]
AUTOSAR XML (schema 00053)
package /AUTOSAR/EcucDefs  (continued)
  module definition Can [0..*]: post-build-variant-support=true, variants post-build/pre-compile  # This container holds the configuration of a single CAN Driver.
    container CanConfigSet  # This container contains the configuration parameters and sub containers of the AUTOSAR Can module.
      container CanController [1..*]: multiplicity set at pre-compile  # This container contains the configuration parameters of the CAN controller(s).
        enumeration CanBusoffProcessing: {INTERRUPT, POLLING}, set at pre-compile  # Enables / disables API Can_MainFunction_BusOff() for handling busoff events in polling mode.
        boolean CanControllerActivation: set at pre-compile  # Defines if a CAN controller is used in the configuration.
        integer CanControllerBaseAddress: 0..4294967295, set at pre-compile  # Specifies the CAN controller base address.
        integer CanControllerId: 0..255, scope=ECU, set at pre-compile, symbolic-name-value=true, with-auto=true  # This parameter provides the controller ID which is unique in a given CAN Driver. The value for this parameter starts with 0 and continue without any gaps.
        boolean CanHwPnSupport: set at pre-compile, default-value=false  # Indicates whether the HW supports the selective wakeup function. | TRUE = Selective wakeup feature is supported by the CAN controller. FALSE = Selective wakeup functionality is not available in the CAN controller.
        enumeration CanRxProcessing: {INTERRUPT, MIXED, POLLING}, set at pre-compile  # Enables / disables API Can_MainFunction_Read() for handling PDU reception events in polling mode.
        enumeration CanTxProcessing: {INTERRUPT, MIXED, POLLING}, set at pre-compile  # Enables / disables API Can_MainFunction_Write() for handling PDU transmission events in polling mode.
        enumeration CanWakeupProcessing: {INTERRUPT, POLLING}, set at pre-compile  # Enables / disables API Can_MainFunction_Wakeup() for handling wakeup events in polling mode.
        boolean CanWakeupSupport: set at pre-compile  # CAN driver support for wakeup over CAN Bus.
        reference CanControllerDefaultBaudrate: post-build-variant-value=true, set at post-build in variant post-build / pre-compile in variant pre-compile, destination=CanControllerBaudrateConfig  # Reference to baudrate configuration container configured for the Can Controller.
        reference CanControllerEcucPartitionRef [0..1]: scope=ECU, multiplicity set at pre-compile, post-build-variant-multiplicity=true, post-build-variant-value=true, set at pre-compile, destination=EcucPartition  # Maps the CAN controller to zero or one ECUC partitions. The ECUC partition referenced is a subset of the ECUC partitions where the CAN driver is mapped to.
        reference CanCpuClockRef: set at pre-compile, destination=McuClockReferencePoint  # Reference to the CPU clock configuration, which is set in the MCU driver configuration
        reference CanWakeupSourceRef [0..1]: multiplicity set at pre-compile, set at pre-compile, requires-symbolic-name-value=true, destination=EcuMWakeupSource  # This parameter contains a reference to the Wakeup Source for this controller as defined in the ECU State Manager. | Implementation Type: reference to EcuM_WakeupSourceType
        container CanControllerBaudrateConfig [1..*]: multiplicity set at post-build in variant post-build / pre-compile in variant pre-compile, post-build-variant-multiplicity=true  # This container contains bit timing related configuration parameters of the CAN controller(s).
          float CanControllerBaudRate: 0..2000, post-build-variant-value=true, set at post-build in variant post-build / pre-compile in variant pre-compile  # Specifies the baudrate of the controller in kbps.
          integer CanControllerBaudRateConfigID: 0..65535, scope=ECU, post-build-variant-value=true, set at post-build in variant post-build / pre-compile in variant pre-compile, default-value=0  # This ID is used by SetBaudrate API and uniquely identifies a specific baud rate configuration within a controller configuration.
          integer CanControllerPropSeg: 0..384, post-build-variant-value=true, set at post-build in variant post-build / pre-compile in variant pre-compile  # Specifies propagation delay in time quantas.
          integer CanControllerSeg1: 0..255, post-build-variant-value=true, set at post-build in variant post-build / pre-compile in variant pre-compile  # Specifies phase segment 1 in time quantas.
          integer CanControllerSeg2: 0..255, post-build-variant-value=true, set at post-build in variant post-build / pre-compile in variant pre-compile  # Specifies phase segment 2 in time quantas.
          integer CanControllerSyncJumpWidth: 0..255, post-build-variant-value=true, set at post-build in variant post-build / pre-compile in variant pre-compile  # Specifies the synchronization jump width for the controller in time quantas.
          container CanControllerFdBaudrateConfig [0..1]  # This optional container contains bit timing related configuration parameters of the CAN controller(s) for payload and CRC of a CAN FD frame. If this container exists the controller supports CAN FD frames.
            float CanControllerFdBaudRate: 0..16000, post-build-variant-value=true, set at post-build in variant post-build / pre-compile in variant pre-compile  # Specifies the data segment baud rate of the controller in kbps.
            integer CanControllerPropSeg: 0..255, post-build-variant-value=true, set at post-build in variant post-build / pre-compile in variant pre-compile  # Specifies propagation delay in time quantas.
            integer CanControllerSeg1: 0..255, post-build-variant-value=true, set at post-build in variant post-build / pre-compile in variant pre-compile  # Specifies phase segment 1 in time quantas.
            integer CanControllerSeg2: 0..255, post-build-variant-value=true, set at post-build in variant post-build / pre-compile in variant pre-compile  # Specifies phase segment 2 in time quantas.
            integer CanControllerSspOffset [0..1]: 0..255, multiplicity set at post-build in variant post-build / pre-compile in variant pre-compile, post-build-variant-multiplicity=true, post-build-variant-value=true, set at post-build in variant post-build / pre-compile in variant pre-compile  # Specifies the Transmitter Delay Compensation Offset in minimum time quanta (see [17]). Transmitter Delay Compensation Offset is used to adjust the position of the Secondary Sample Point (SSP), relative to the beginning of the received bit. If this parameter is configured, the Transmitter Delay Compensation is done by measurement of the CAN controller. If not specified, Transmitter Delay Compensation is disabled. | Note: MTQ == Minimum Time Quanta in seconds == 1/(frequency of the CAN controller clock) Secondary Sample Point Offset in seconds = CanControllerSspOffset * MTQ Example: CAN controller clock frequency = 20MHz => MTQ = 1/20 * 10^(-6) s = 0,05 us = 50ns Baud rate = 1MBit/s => BitTime = 1/(1 * 10^6) s/Bit = 1 * 10^(-6) = 1us/Bit SSP = 75% => SSP in seconds = 0,75 * 1us = 750 ns CanControllerSspOffset in MTQ = 750ns / 50ns = 15 Note: Please consider the minimum range (0..63) stated in [17] and the range definition (0..127) used as per [19].
            integer CanControllerSyncJumpWidth: 0..255, post-build-variant-value=true, set at post-build in variant post-build / pre-compile in variant pre-compile  # Specifies the synchronization jump width for the controller in time quantas.
            boolean CanControllerTxBitRateSwitch: post-build-variant-value=true, set at post-build in variant post-build / pre-compile in variant pre-compile, default-value=true  # Specifies if the bit rate switching shall be used for transmissions. | If FALSE: CAN FD frames shall be sent without bit rate switching.
          container CanXLBaudrateConfig [0..1]: multiplicity set at post-build in variant post-build / pre-compile in variant pre-compile, post-build-variant-multiplicity=true  # This container is specified in the SWS CAN XL Driver and contains bit timing related configuration parameters of the CAN controller(s) for payload and CRC of a CAN XL frame.
            float CanXLBaudRate: 0..20000, post-build-variant-value=true, set at post-build in variant post-build / pre-compile in variant pre-compile  # Specifies the data segment baud rate of the controller in kbps. | Note: The CAN XL baudrate should be at least twice the nominal bitrate so that an error flag can safely destroy a CAN XL frame.
            boolean CanXLErrorSignaling: post-build-variant-value=true, set at post-build in variant post-build / pre-compile in variant pre-compile  # Specifies if error signaling shall be enabled.
            integer CanXLPropSeg: 0..255, post-build-variant-value=true, set at post-build in variant post-build / pre-compile in variant pre-compile  # Specifies propagation delay in time quantas.
            integer CanXLPwmL: 0..255, post-build-variant-value=true, set at post-build in variant post-build / pre-compile in variant pre-compile  # Specifies the PWM long phase length.
            integer CanXLPwmO: 0..255, post-build-variant-value=true, set at post-build in variant post-build / pre-compile in variant pre-compile  # Specifies the PWM time offset.
            integer CanXLPwmS: 0..255, post-build-variant-value=true, set at post-build in variant post-build / pre-compile in variant pre-compile  # Specifies the PWM short phase length.
            integer CanXLSeg1: 0..255, post-build-variant-value=true, set at post-build in variant post-build / pre-compile in variant pre-compile  # Specifies phase segment 1 in time quantas.
            integer CanXLSeg2: 0..255, post-build-variant-value=true, set at post-build in variant post-build / pre-compile in variant pre-compile  # Specifies phase segment 2 in time quantas.
            integer CanXLSspOffset [0..1]: 0..255, multiplicity set at post-build in variant post-build / pre-compile in variant pre-compile, post-build-variant-multiplicity=true, post-build-variant-value=true, set at post-build in variant post-build / pre-compile in variant pre-compile  # Specifies the Transmitter Delay Compensation Offset in minimum time quanta. If this parameter is configured, the Transmitter Delay Compensation is done by measurement of the CAN controller. If not specified, Transmitter Delay Compensation is disabled. | See ECUC_Can_00494 for details.
            integer CanXLSyncJumpWidth: 0..255, post-build-variant-value=true, set at post-build in variant post-build / pre-compile in variant pre-compile  # Specifies the synchronization jump width for the controller in time quantas.
            boolean CanXLTrcvPwmMode: post-build-variant-value=true, set at post-build in variant post-build / pre-compile in variant pre-compile  # Specifies if the transceiver shall be set to the PWM mode.
        container CanPartialNetwork [0..1]: multiplicity set at pre-compile  # Container gives CAN Controller driver information about the configuration of Partial Networking functionality.
          boolean CanPnEnabled: post-build-variant-value=true, set at post-build in variant post-build / pre-compile in variant pre-compile, default-value=false  # Indicates whether the selective wake-up function is enabled or disabled in HW. | TRUE = Selective wakeup feature is enabled in the controller hardware FALSE = Selective wakeup feature is disabled in the controller hardware
          integer CanPnFrameCanId: 0..4294967295, post-build-variant-value=true, set at post-build in variant post-build / pre-compile in variant pre-compile  # CAN ID of the Wake-up Frame (WUF).
          integer CanPnFrameCanIdMask: 0..4294967295, post-build-variant-value=true, set at post-build in variant post-build / pre-compile in variant pre-compile  # ID Mask for the selective activation of the CAN controller. It is used to enableFrame Wake-up (WUF) on a group of IDs.
          integer CanPnFrameDlc: 0..8, post-build-variant-value=true, set at post-build in variant post-build / pre-compile in variant pre-compile  # Data Length of the Wake-up Frame (WUF).
          container CanPnFrameDataMaskSpec [0..8]: multiplicity set at pre-compile  # Defines data payload mask to be used on the received payload in order to determine if the controller must be woken up by the received Wake-up Frame (WUF).
            integer CanPnFrameDataMask: 0..255, post-build-variant-value=true, set at post-build in variant post-build / pre-compile in variant pre-compile  # Defines the n byte (Byte0 = LSB) of the data payload mask to be used on the received payload in order to determine if the controller must be woken up by the received Wake-up Frame (WUF).
            integer CanPnFrameDataMaskIndex: 0..7, post-build-variant-value=true, set at post-build in variant post-build / pre-compile in variant pre-compile  # Holds the position n in frame of the mask-part
        container CanTTController [0..1]  # CanTTController is specified in the SWS TTCAN and contains the configuration parameters of the TTCAN controller(s) (which are needed in addition to the configuration parameters of the CAN controller(s)). | This container is only included and valid if TTCAN is supported by the controller, enabled (see CanSupportTTCANRef, ECUC_Can_00430), and used.
          integer CanTTControllerApplWatchdogLimit: 0..255, scope=ECU, post-build-variant-value=true, set at post-build in variant post-build / pre-compile in variant pre-compile  # Defines the maximum time period (unit is 256 times NTU) after which the application has to serve the watchdog.
          integer CanTTControllerCycleCountMax: 0..63, scope=ECU, post-build-variant-value=true, set at post-build in variant post-build / pre-compile in variant pre-compile  # Defines the value for cycle_count_max. | Allowed values: 0x00: 1 basic cycle 0x01: 2 basic cycles 0x03: 4 basic cycles 0x07: 8 basic cycles 0x0F: 16 basic cycles 0x1F: 32 basic cycles 0x3F: 64 basic cycles
          integer CanTTControllerExpectedTxTrigger: 0..255, post-build-variant-value=true, set at post-build in variant post-build / pre-compile in variant pre-compile  # Number of expected_tx_trigger.
          boolean CanTTControllerExternalClockSynchronisation: scope=ECU, post-build-variant-value=true, set at post-build in variant post-build / pre-compile in variant pre-compile  # Enables/disables the external clock synchronization. | TRUE: External clock synchronization enabled. FALSE: External clock synchronization disabled. This parameter shall only be configurable if parameter CanTTControllerLevel2 equals TRUE.
          boolean CanTTControllerGlobalTimeFiltering: post-build-variant-value=true, set at post-build in variant post-build / pre-compile in variant pre-compile  # Enables/disables the global time filtering. | TRUE: Global time filtering enabled. FALSE: Global time filtering disabled. This parameter shall only be configurable if parameter CanTTControllerLevel2 equals TRUE.
          integer CanTTControllerInitialRefOffset: 0..127, scope=ECU, post-build-variant-value=true, set at post-build in variant post-build / pre-compile in variant pre-compile  # Defines the initial value for ref trigger offset.
          integer CanTTControllerInterruptEnable: 0..1023, post-build-variant-value=true, set at post-build in variant post-build / pre-compile in variant pre-compile  # Enables/disables the respective interrupts. | Bit Position set to 1: Enable respective interrupt. Bit Position set to 0: Disable respective interrupt. Bit Position / Interrupt Source: 10: Application Watchdog. 9: Watch Trigger reached. 8: Initialization Watch Trigger reached. 7: Change of Error Level. 6: Tx Overflow. 5: Tx Underflow. 4: Global Time Error. 3: Gap. 2: Start of Cycle. 1: Time Discontinuity. 0: Master State Change. Bit position "1: Time Discontinuity" and "4: Global Time Error" shall only be configurable if parameter CanTTControllerLevel2 equals TRUE.
          boolean CanTTControllerLevel2: post-build-variant-value=true, set at post-build in variant post-build / pre-compile in variant pre-compile  # Defines whether Level 2 or Level 1 is used. | TRUE: Level 2. FALSE: Level 1. If this parameter is set to FALSE then all parameters with dependency to CanTTControllerLevel2 need not be configured.
          float CanTTControllerNTUConfig: 0..100, scope=ECU, post-build-variant-value=true, set at post-build in variant post-build / pre-compile in variant pre-compile  # Defines the config value for NTU (network time unit). | Value given in microseconds. The value configured shall be greater than 0. Together with the local oscillator period, the TUR (time unit ratio) can be derived from the NTU. This parameter shall only be configurable if parameter CanTTControllerLevel2 equals TRUE.
          enumeration CanTTControllerOperationMode: {CAN_TT_EVENT_SYNC_TIME_TRIGGERED, CAN_TT_EVENT_TRIGGERED, CAN_TT_TIME_TRIGGERED}, scope=ECU, post-build-variant-value=true, set at post-build in variant post-build / pre-compile in variant pre-compile  # Defines the operation mode.
          float CanTTControllerSyncDeviation: 0..100, post-build-variant-value=true, set at post-build in variant post-build / pre-compile in variant pre-compile  # Defines the maximum synchronization deviation: | Given as a percentage value of the NTU (network time unit). The value configured shall be greater than 0. This parameter shall only be configurable if parameter CanTTControllerLevel2 equals TRUE.
          boolean CanTTControllerTimeMaster: scope=ECU, post-build-variant-value=true, set at post-build in variant post-build / pre-compile in variant pre-compile  # Defines whether the controller acts as a potential time master. | TRUE: Potential time master. FALSE: Time slave.
          integer CanTTControllerTimeMasterPriority: 0..7, scope=ECU, post-build-variant-value=true, set at post-build in variant post-build / pre-compile in variant pre-compile  # Defines the time master priority.
          boolean CanTTControllerTURRestore: post-build-variant-value=true, set at post-build in variant post-build / pre-compile in variant pre-compile  # Enables/disables the TUR restore. | Note that the value configured for TUR can be derived from the value configured for NTU and the local oscillator preriod. TRUE: TUR restore enabled. FALSE: TUR restore disabled. This parameter shall only be configurable if parameter CanTTControllerLevel2 equals TRUE.
          integer CanTTControllerTxEnableWindowLength: 1..16, scope=ECU, post-build-variant-value=true, set at post-build in variant post-build / pre-compile in variant pre-compile  # Length of the tx enable window given in CAN bit times. | Definition parameter "CanTTControllerTxEnableWindowlength" is used such that: Length of enable window = CanTTControllerTxEnableWindowLength + 1
          integer CanTTControllerWatchTriggerGapTimeMark: 0..65535, post-build-variant-value=true, set at post-build in variant post-build / pre-compile in variant pre-compile  # watch trigger time mark after a gap
          integer CanTTControllerWatchTriggerTimeMark: 0..65535, post-build-variant-value=true, set at post-build in variant post-build / pre-compile in variant pre-compile  # watch trigger time mark
          enumeration CanTTIRQProcessing: {INTERRUPT, POLLING}, scope=ECU, post-build-variant-value=true, set at post-build in variant post-build / pre-compile in variant pre-compile  # Enables / disables API Can_MainFunction_BusOff() for handling busoff events in polling mode.
          reference CanTTControllerEcucPartitionRef [0..1]: scope=ECU, multiplicity set at pre-compile, post-build-variant-value=true, set at pre-compile, destination=EcucPartition  # Maps the Time triggered CAN controller to zero or one ECUC partitions. The ECUC partition referenced is a subset of the ECUC partitions where the CAN driver is mapped to.
        container CanXLController [0..1]: multiplicity set at pre-compile  # This container is specified in the SWS CAN XL Driver and represents a CAN XL channel. If this container is present, the CAN driver will provide the extended CanXL API.
          integer CanXLCtrlEthDefaultPriority [0..1]: 0..65535, multiplicity set at pre-compile, post-build-variant-value=true, set at post-build in variant post-build / pre-compile in variant pre-compile  # Defines the default CAN XL Priority ID to be used for outgoing tunneled Ethernet frames.
          integer CanXLEthDefaultQueue [0..1]: 0..255, multiplicity set at pre-compile, post-build-variant-value=true, set at post-build in variant post-build / pre-compile in variant pre-compile  # Defines the default CAN XL Queue to be used for outgoing tunneled Ethernet frames.
          string CanXLEthPhysAddress [0..1]: multiplicity set at pre-compile, post-build-variant-value=true, set at post-build in variant post-build / pre-compile in variant pre-compile, max-length=17, min-length=17, regular-expression=([0-9a-fA-F]\{2}:)\{5}[0-9a-fA-F]\{2}  # Specifies the unique 48-bit physical address (MAC address) of the controller in network byte order.
          reference CanXLEthEcucPartitionRef [0..1]: multiplicity set at pre-compile, set at pre-compile, destination=EcucPartition  # Maps the Ethernet Interface access to the CAN XL controller to zero or one ECUC partitions.
          container CanXLEthEgressFifo [0..*]: multiplicity set at post-build in variant post-build / pre-compile in variant pre-compile, post-build-variant-multiplicity=true  # Represents a Fifo at the egress side.
            integer CanXLEthEgressFifoCanXLPriority: 0..65535, post-build-variant-value=true, set at post-build in variant post-build / pre-compile in variant pre-compile  # Defines the CAN XL Priority ID to be used for outgoing tunneled Ethernet frames using this FIFO.
            integer CanXLEthEgressFifoCanXLQueue: 0..255, post-build-variant-value=true, set at post-build in variant post-build / pre-compile in variant pre-compile  # Defines the CAN XL Queue to be used for outgoing tunneled Ethernet frames using this FIFO.
            integer CanXLEthEgressFifoIdx: 0..255, post-build-variant-value=true, set at post-build in variant post-build / pre-compile in variant pre-compile, symbolic-name-value=true, with-auto=true  # Egress Fifo index.
          container CanXLEthIngressFifo [0..*]: multiplicity set at post-build in variant post-build / pre-compile in variant pre-compile, post-build-variant-multiplicity=true  # Represents a Fifo at the ingress side.
            integer CanXLEthIngressFifoCanXLQueue: 0..255, post-build-variant-value=true, set at post-build in variant post-build / pre-compile in variant pre-compile  # Defines the CAN XL Queue to be used for incoming tunneled Ethernet frames using this FIFO.
            integer CanXLEthIngressFifoIdx: 0..255, post-build-variant-value=true, set at post-build in variant post-build / pre-compile in variant pre-compile, symbolic-name-value=true, with-auto=true  # Ingress Fifo index.
            integer CanXLEthIngressFifoVcid [0..*]: 0..255, multiplicity set at post-build in variant post-build / pre-compile in variant pre-compile, post-build-variant-multiplicity=true, post-build-variant-value=true, set at post-build in variant post-build / pre-compile in variant pre-compile  # Configures a VCID to be accepted by this FIFO. If not present, all VCIDs shall be accepted.
      container CanHardwareObject [0..*]: multiplicity set at post-build in variant post-build / pre-compile in variant pre-compile, post-build-variant-multiplicity=true  # This container contains the configuration (parameters) of CAN Hardware Objects.
        integer CanFdPaddingValue [0..1]: 0..255, scope=ECU, multiplicity set at post-build in variant post-build / pre-compile in variant pre-compile, post-build-variant-multiplicity=true, post-build-variant-value=true, set at post-build in variant post-build / pre-compile in variant pre-compile, default-value=0  # Specifies the value which is used to pad unspecified data in CAN FD frames > 8 bytes for transmission. This is necessary due to the discrete possible values of the DLC if > 8 bytes. | If the length of a PDU which was requested to be sent does not match the allowed DLC values, the remaining bytes up to the next possible value shall be padded with this value.
        enumeration CanHandleType: {BASIC, FULL}, scope=ECU, post-build-variant-value=true, set at post-build in variant post-build / pre-compile in variant pre-compile  # Specifies the type (Full-CAN or Basic-CAN) of a hardware object.
        boolean CanHardwareObjectUsesPolling [0..1]: default-value=false  # Enables polling of this hardware object.
        integer CanHwObjectCount: 1..65535, scope=ECU, multiplicity set at post-build in variant post-build / pre-compile in variant pre-compile, post-build-variant-multiplicity=true, post-build-variant-value=true, set at post-build in variant post-build / pre-compile in variant pre-compile, default-value=1  # Number of hardware objects used to implement one HOH. In case of a HRH this parameter defines the number of elements in the hardware FIFO or the number of shadow buffers, in case of a HTH it defines the number of hardware objects used for multiplexed transmission or for a hardware FIFO used by a FullCAN HTH.
        enumeration CanIdType: {EXTENDED, MIXED, STANDARD}, scope=ECU, post-build-variant-value=true, set at post-build in variant post-build / pre-compile in variant pre-compile  # Specifies whether the IdValue is of type standard identifier, extended identifier or mixed mode. | ImplementationType: Can_IdType
        integer CanObjectId: 0..65535, scope=ECU, set at pre-compile, symbolic-name-value=true, with-auto=true  # Holds the handle ID of HRH or HTH. The value of this parameter is unique in a given CAN Driver, and it should start with 0 and continue without any gaps. | The HRH and HTH Ids share a common ID range. Example: HRH0-0, HRH1-1, HTH0-2, HTH1-3
        enumeration CanObjectPayloadLength [0..1]: {CAN_OBJECT_PL_12, CAN_OBJECT_PL_16, CAN_OBJECT_PL_20, CAN_OBJECT_PL_24, CAN_OBJECT_PL_32, CAN_OBJECT_PL_48, CAN_OBJECT_PL_64, CAN_OBJECT_PL_8}, scope=ECU, post-build-variant-value=true, set at post-build in variant post-build / pre-compile in variant pre-compile  # Specifies the maximum L-PDU payload length in bytes the hardware object can store. | If the parameter is not provided, Can driver configuration generators have to assume the maximum length of the underlying CAN derivate, e.g. 8 bytes for CAN, 64 bytes for CAN-FD.
        enumeration CanObjectType: {RECEIVE, TRANSMIT}, post-build-variant-value=true, set at post-build in variant post-build / pre-compile in variant pre-compile  # Specifies if the HardwareObject is used as Transmit or as Receive object
        boolean CanTriggerTransmitEnable [0..1]: scope=ECU, set at pre-compile, default-value=false  # This parameter defines if or if not Can supports the trigger-transmit API for this handle.
        reference CanControllerRef: post-build-variant-value=true, set at post-build in variant post-build / pre-compile in variant pre-compile, destination=CanController  # Reference to CAN Controller to which the HOH is associated to.
        reference CanMainFunctionRWPeriodRef [0..1]: multiplicity set at post-build in variant post-build / pre-compile in variant pre-compile, post-build-variant-multiplicity=true, post-build-variant-value=true, set at post-build in variant post-build / pre-compile in variant pre-compile, destination=CanMainFunctionRWPeriods  # Reference to CanMainFunctionPeriod. If configured, this hardware object will be polled.
        container CanHwFilter [0..*]  # This container is only valid for HRHs and contains the configuration (parameters) of one hardware filter.
          integer CanHwFilterCode: 0..4294967295, post-build-variant-value=true, set at post-build in variant post-build / pre-compile in variant pre-compile  # Specifies (together with the filter mask) the identifiers range that passes the hardware filter.
          integer CanHwFilterMask: 0..4294967295, post-build-variant-value=true, set at post-build in variant post-build / pre-compile in variant pre-compile  # Describes a mask for hardware-based filtering of CAN identifiers. The CAN identifiers of incoming messages are masked with the appropriate CanFilterMaskValue. Bits holding a 0 mean don't care, i.e. do not compare the message's identifier in the respective bit position. | The mask shall be build by filling with leading 0. In case of CanIdType EXTENDED or MIXED a 29 bit mask shall be build. In case of CanIdType STANDARD a 11 bit mask shall be build
        container CanTTHardwareObjectTrigger [0..*]  # CanTTHardwareObjectTrigger is specified in the SWS TTCAN and contains the configuration (parameters) of TTCAN triggers for Hardware Objects, which are additional to the configuration (parameters) of CAN Hardware Objects. | This container is only included and valid if TTCAN is supported by the controller and, enabled (see CanSupportTTCANRef, ECUC_Can_00430), and used.
          integer CanTTHardwareObjectBaseCycle: 0..63, scope=ECU, post-build-variant-value=true, set at post-build in variant post-build / pre-compile in variant pre-compile  # Defines the cycle_offset. | CanTTHardwareObjectBaseCycle must be not greater than cycle_count_max.
          integer CanTTHardwareObjectCycleRepetition: 1..64, scope=ECU, post-build-variant-value=true, set at post-build in variant post-build / pre-compile in variant pre-compile  # Defines the repeat_factor. | CanTTHardwareObjectCycleRepetition shall be a power of two (2), greater than cycle_offset but not greater than cycle_count_max + 1.
          integer CanTTHardwareObjectTimeMark: 0..65535, post-build-variant-value=true, set at post-build in variant post-build / pre-compile in variant pre-compile  # Defines the point in time, when the trigger will be activated. | Value is given in cycle time.
          integer CanTTHardwareObjectTriggerId: 0..63, set at pre-compile, symbolic-name-value=true, with-auto=true  # Sequential number which allows separation of different TTCAN triggers configured for one and the same hardware object.
          enumeration CanTTHardwareObjectTriggerType: {CAN_TT_RX_TRIGGER, CAN_TT_TX_REF_TRIGGER, CAN_TT_TX_REF_TRIGGER_GAP, CAN_TT_TX_TRIGGER_EXCLUSIVE, CAN_TT_TX_TRIGGER_MERGED, CAN_TT_TX_TRIGGER_SINGLE}, post-build-variant-value=true, set at post-build in variant post-build / pre-compile in variant pre-compile  # Defines the type of the trigger associated with the hardware object. This parameter depends on plain CAN parameter CAN_OBJECT_TYPE. | If CAN_OBJECT_TYPE equals RECEIVE than this parameter is fixed to CAN_TT_RX_TRIGGER. If CAN_OBJECT_TYPE equals TRANSMIT than one of the following literals is configurable: CAN_TT_TX_REF_TRIGGER, CAN_TT_TX_REF_TRIGGER_GAP, CAN_TT_TX_TRIGGER_MERGED, CAN_TT_TX_TRIGGER_SINGLE, CAN_TT_TX_TRIGGER_EXCLUSIVE.
      container CanXLHardwareObject [0..*]: multiplicity set at post-build in variant post-build / pre-compile in variant pre-compile, post-build-variant-multiplicity=true  # This container is specified in the SWS CAN XL Driver and contains the configuration (parameters) of CAN XL Hardware Objects.
        enumeration CanObjectType: {RECEIVE, TRANSMIT}, post-build-variant-value=true, set at post-build in variant post-build / pre-compile in variant pre-compile  # Specifies if the HardwareObject is used as Transmit or as Receive object
        integer CanXLObjectId: 0..65535, set at pre-compile, symbolic-name-value=true  # Holds the handle ID of CAN XL HRH or HTH.
        reference CanControllerRef: post-build-variant-value=true, set at post-build in variant post-build / pre-compile in variant pre-compile, destination=CanController  # Reference to CAN Controller to which the HOH is associated to.
        reference CanMainFunctionRWPeriodRef [0..1]: multiplicity set at post-build in variant post-build / pre-compile in variant pre-compile, post-build-variant-multiplicity=true, post-build-variant-value=true, set at post-build in variant post-build / pre-compile in variant pre-compile, destination=CanMainFunctionRWPeriods  # Reference to CanMainFunctionPeriod. If configured, this hardware object will be polled.
        container CanXLHwFilter [0..*]: multiplicity set at post-build in variant post-build / pre-compile in variant pre-compile, post-build-variant-multiplicity=true  # This container is only valid for CAN XL HRHs and contains the configuration (parameters) of one hardware filter. | This container is intentionally left empty, because the parameters are very hardware specific and shall be filled in by the VSMD.
    container CanGeneral  # This container contains the parameters related each CAN Driver Unit.
      boolean CanDevErrorDetect: set at pre-compile, default-value=false  # Switches the development error detection and notification on or off. | * true: detection and notification is enabled. * false: detection and notification is disabled.
      boolean CanEnableSecurityEventReporting: scope=ECU, set at pre-compile, default-value=false  # Switches the reporting of security events to the IdsM: Tags: atp.Status=draft | - true: reporting is enabled. - false: reporting is disabled.
      boolean CanGlobalTimeSupport: set at pre-compile  # Enables/Disables the Global Time APIs used when hardware timestamping is supported by CAN controller. Tags: atp.Status=draft
      integer CanIndex: 0..255, scope=ECU, set at pre-compile  # Specifies the InstanceId of this module instance. If only one instance is present it shall have the Id 0.
      function name CanLPduReceiveCalloutFunction [0..1]: multiplicity set at pre-compile, set at pre-compile  # This parameter defines the existence and the name of a callout function that is called after a successful reception of a received CAN Rx L-PDU. If this parameter is omitted no callout shall take place.
      float CanMainFunctionBusoffPeriod [0..1]: 0..INF, multiplicity set at pre-compile, set at pre-compile  # This parameter describes the period for cyclic call to Can_MainFunction_Busoff. Unit is seconds.
      float CanMainFunctionModePeriod: 0..INF, set at pre-compile  # This parameter describes the period for cyclic call to Can_MainFunction_Mode. Unit is seconds.
      float CanMainFunctionWakeupPeriod [0..1]: 0..INF, multiplicity set at pre-compile, set at pre-compile  # This parameter describes the period for cyclic call to Can_MainFunction_Wakeup. Unit is seconds.
      boolean CanMultiplexedTransmission: scope=ECU, set at pre-compile  # Specifies if multiplexed transmission shall be supported.ON or OFF
      boolean CanSetBaudrateApi [0..1]: scope=ECU, multiplicity set at pre-compile, set at pre-compile, default-value=false  # The support of the Can_SetBaudrate API is optional. | If this parameter is set to true the Can_SetBaudrate API shall be supported. Otherwise the API is not supported.
      float CanTimeoutDuration: 1E-6..65.535, set at pre-compile  # Specifies the maximum time for blocking function until a timeout is detected. Unit is seconds.
      boolean CanVersionInfoApi: set at pre-compile, default-value=false  # Switches the Can_GetVersionInfo() API ON or OFF.
      reference CanEcucPartitionRef [0..*]: scope=ECU, multiplicity set at pre-compile, post-build-variant-multiplicity=true, post-build-variant-value=true, set at pre-compile, destination=EcucPartition  # Maps the CAN driver to zero or multiple ECUC partitions to make the modules API available in this partition.
      reference CanOsCounterRef [0..1]: multiplicity set at pre-compile, set at pre-compile, destination=OsCounter  # This parameter contains a reference to the OsCounter, which is used by the CAN driver.
      reference CanSupportTTCANRef: scope=ECU, set at pre-compile, destination=CanIfPrivateCfg  # The parameter refers to CanIfSupportTTCAN parameter in the CAN Interface Module configuration. | The CanIfSupportTTCAN parameter defines whether TTCAN is supported.
      container CanMainFunctionRWPeriods [0..*]: multiplicity set at pre-compile  # This container contains the parameter for configuring the period for cyclic call to Can_MainFunction_Read or Can_MainFunction_Write depending on the referring item.
        float CanMainFunctionPeriod: 0..INF, set at pre-compile  # This parameter describes the period for cyclic call to Can_MainFunction_Read or Can_MainFunction_Write depending on the referring item. Unit is seconds. Different poll-cycles will be configurable if more than one CanMainFunctionPeriod is configured. In this case multiple Can_MainFunction_Read() or Can_MainFunction_Write() will be provided by the CAN Driver module.
      container CanXLGeneral [0..1]: multiplicity set at pre-compile  # This container is specified in the SWS CAN XL Driver and contains global parameters of the CAN XL Driver.
        boolean CanXLEthGlobalTimeSupport: set at pre-compile  # Enables/Disables the Global Time APIs for the Ethernet Interface used when hardware timestamping is supported by CAN controller.
  module definition CanIf [0..1]: post-build-variant-support=true, variants link-time/post-build/pre-compile  # This container includes all necessary configuration sub-containers according the CAN Interface configuration structure.
    container CanIfCtrlDrvCfg [1..*]: multiplicity set at pre-compile  # Configuration parameters for all the underlying CAN Driver modules are aggregated under this container. For each CAN Driver module a seperate instance of this container has to be provided.
      reference CanIfCtrlDrvInitHohConfigRef: set at link in variant link-time+post-build / pre-compile in variant pre-compile, destination=CanIfInitHohCfg  # Reference to the Init Hoh Configuration
      reference CanIfCtrlDrvNameRef: set at pre-compile, destination=CanGeneral  # CAN Interface Driver Reference. | This reference can be used to get any information (Ex. Driver Name, Vendor ID) from the CAN driver. The CAN Driver name can be derived from the ShortName of the CAN driver module.
      container CanIfCtrlCfg [1..*]: multiplicity set at pre-compile  # This container contains the configuration (parameters) of an adressed CAN controller by an underlying CAN Driver module. This container is configurable per CAN controller.
        integer CanIfCtrlId: 0..255, scope=ECU, set at pre-compile, symbolic-name-value=true, with-auto=true  # This parameter abstracts from the CAN Driver specific parameter Controller. Each controller of all connected CAN Driver modules shall be assigned to one specific ControllerId of the CanIf. | Range: 0..number of configured controllers of all CAN Driver modules
        boolean CanIfCtrlWakeupSupport: scope=ECU, set at link in variant link-time+post-build / pre-compile in variant pre-compile, default-value=false  # This parameter defines if a respective controller of the referenced CAN Driver modules is queriable for wake up events. | True: Enabled False: Disabled
        reference CanIfCtrlCanCtrlRef: scope=ECU, set at link in variant link-time+post-build / pre-compile in variant pre-compile, requires-symbolic-name-value=true, destination=CanController  # This parameter references to the logical handle of the underlying CAN controller from the CAN Driver module to be served by the CAN Interface module. The following parameters of CanController config container shall be referenced by this link: CanControllerId, CanWakeupSourceRef | Range: 0..max. number of underlying supported CAN controllers
    container CanIfDispatchCfg  # Callback functions provided by upper layer modules of the CanIf. The callback functions defined in this container are common to all configured CAN Driver / CAN Transceiver Driver modules.
      function name CanIfDispatchUserCheckTrcvWakeFlagIndicationName [0..1]: scope=ECU, multiplicity set at link in variant link-time+post-build / pre-compile in variant pre-compile, set at link in variant link-time+post-build / pre-compile in variant pre-compile  # This parameter defines the name of <User_CheckTrcvWakeFlagIndication>. | If CanIfDispatchUserCheckTrcvWakeFlagIndicationUL equals CAN_SM the name of <User_CheckTrcvWakeFlagIndication> is fixed. If it equals CDD, the name is selectable. If CanIfPublicPnSupport equals True and CanIfPublicTrcvPnEnable equals True, this parameter shall be configurable.
      enumeration CanIfDispatchUserCheckTrcvWakeFlagIndicationUL [0..1]: {CAN_SM, CDD}, scope=ECU, multiplicity set at link in variant link-time+post-build / pre-compile in variant pre-compile, set at link in variant link-time+post-build / pre-compile in variant pre-compile  # This parameter defines the upper layer module to which the CheckTrcvWakeFlagIndication from the Driver modules have to be routed. | If CanIfPublicPnSupport equals True and CanIfPublicTrcvPnEnable equals True, this parameter shall be configurable.
      function name CanIfDispatchUserClearTrcvWufFlagIndicationName [0..1]: scope=ECU, multiplicity set at link in variant link-time+post-build / pre-compile in variant pre-compile, set at link in variant link-time+post-build / pre-compile in variant pre-compile  # This parameter defines the name of <User_ClearTrcvWufFlagIndication>. | If CanIfDispatchUserClearTrcvWufFlagIndicationUL equals CAN_SM the name of <User_ClearTrcvWufFlagIndication> is fixed. If it equals CDD, the name is selectable. If CanIfPublicPnSupport equals True and CanIfPublicTrcvPnEnable equals True, this parameter shall be configurable.
      enumeration CanIfDispatchUserClearTrcvWufFlagIndicationUL [0..1]: {CAN_SM, CDD}, scope=ECU, multiplicity set at link in variant link-time+post-build / pre-compile in variant pre-compile, set at link in variant link-time+post-build / pre-compile in variant pre-compile  # This parameter defines the upper layer module to which the ClearTrcvWufFlagIndication from the Driver modules have to be routed. | If CanIfPublicPnSupport equals True and CanIfPublicTrcvPnEnable equals True, this parameter shall be configurable.
      function name CanIfDispatchUserConfirmCtrlPnAvailabilityName [0..1]: scope=ECU, multiplicity set at link in variant link-time+post-build / pre-compile in variant pre-compile, set at link in variant link-time+post-build / pre-compile in variant pre-compile  # This parameter defines the name of <User_ConfirmCtrlPnAvailability>. If CanIfDispatchUserConfirmCtrlPnAvailabilityUL equals CAN_SM the name of <User_ConfirmCtrlPnAvailability> is fixed. If it equals CDD, the name is selectable. If CanIfPublicPnSupport equals True and CanIfPublicCtrlPnEnable equals True, this parameter shall be configurable.
      enumeration CanIfDispatchUserConfirmCtrlPnAvailabilityUL [0..1]: {CAN_SM, CDD}, scope=ECU, multiplicity set at link in variant link-time+post-build / pre-compile in variant pre-compile, set at link in variant link-time+post-build / pre-compile in variant pre-compile  # This parameter defines the upper layer module to which the ConfirmCtrlPnAvailability notification from the Driver modules have to be routed. If CanIfPublicPnSupport equals True and CanIfPublicCtrlPnEnable equals True, this parameter shall be configurable.
      function name CanIfDispatchUserConfirmPnAvailabilityName [0..1]: scope=ECU, multiplicity set at link in variant link-time+post-build / pre-compile in variant pre-compile, set at link in variant link-time+post-build / pre-compile in variant pre-compile  # This parameter defines the name of <User_ConfirmPnAvailability>. If CanIfDispatchUserConfirmPnAvailabilityUL equals CAN_SM the name of <User_ConfirmPnAvailability> is fixed. If it equals CDD, the name is selectable. | If CanIfPublicPnSupport equals True and CanIfPublicTrcvPnEnable equals True, this parameter shall be configurable.
      enumeration CanIfDispatchUserConfirmPnAvailabilityUL [0..1]: {CAN_SM, CDD}, scope=ECU, multiplicity set at link in variant link-time+post-build / pre-compile in variant pre-compile, set at link in variant link-time+post-build / pre-compile in variant pre-compile  # This parameter defines the upper layer module to which the ConfirmPnAvailability notification from the Driver modules have to be routed. | If CanIfPublicPnSupport equals True and CanIfPublicTrcvPnEnable equals True, this parameter shall be configurable.
      function name CanIfDispatchUserCtrlBusOffName [0..1]: scope=ECU, multiplicity set at link in variant link-time+post-build / pre-compile in variant pre-compile, set at link in variant link-time+post-build / pre-compile in variant pre-compile, max-length=32, min-length=1  # This parameter defines the name of <User_ControllerBusOff>. | This parameter depends on the parameter CanIfDispatchUserCtrlBusOffUL. If CanIfDispatchUserCtrlBusOffUL equals CAN_SM the name of <User_ControllerBusOff> is fixed. If CanIfDispatchUserCtrlBusOffUL equals CDD, the name of <User_ControllerBusOff> is selectable.
      enumeration CanIfDispatchUserCtrlBusOffUL: {CAN_SM, CDD}, scope=ECU, set at link in variant link-time+post-build / pre-compile in variant pre-compile  # This parameter defines the upper layer (UL) module to which the notifications of all ControllerBusOff events from the CAN Driver modules have to be routed via <User_ControllerBusOff>. | There is no possibility to configure no upper layer (UL) module as the provider of <User_ControllerBusOff>.
      function name CanIfDispatchUserCtrlModeIndicationName [0..1]: scope=ECU, multiplicity set at link in variant link-time+post-build / pre-compile in variant pre-compile, set at link in variant link-time+post-build / pre-compile in variant pre-compile, max-length=32, min-length=1  # This parameter defines the name of <User_ControllerModeIndication>. | This parameter depends on the parameter CanIfDispatchUserCtrlModeIndicationUL. If CanIfDispatchUserCtrlModeIndicationUL equals CAN_SM the name of <User_ControllerModeIndication> is fixed. If CanIfDispatchUserCtrlModeIndicationUL equals CDD, the name of <User_ControllerModeIndication> is selectable.
      enumeration CanIfDispatchUserCtrlModeIndicationUL: {CAN_SM, CDD}, scope=ECU, set at link in variant link-time+post-build / pre-compile in variant pre-compile  # This parameter defines the upper layer (UL) module to which the notifications of all ControllerTransition events from the CAN Driver modules have to be routed | via <User_ControllerModeIndication>.
      function name CanIfDispatchUserTrcvModeIndicationName [0..1]: scope=ECU, multiplicity set at link in variant link-time+post-build / pre-compile in variant pre-compile, set at link in variant link-time+post-build / pre-compile in variant pre-compile, max-length=32, min-length=1  # This parameter defines the name of <User_TrcvModeIndication>. | This parameter depends on the parameter CanIfDispatchUserTrcvModeIndicationUL. If CanIfDispatchUserTrcvModeIndicationUL equals CAN_SM the name of <User_TrcvModeIndication> is fixed. If CanIfDispatchUserTrcvModeIndicationUL equals CDD, the name of <User_TrcvModeIndication> is selectable.
      enumeration CanIfDispatchUserTrcvModeIndicationUL [0..1]: {CAN_SM, CDD}, scope=ECU, multiplicity set at link in variant link-time+post-build / pre-compile in variant pre-compile, set at link in variant link-time+post-build / pre-compile in variant pre-compile  # This parameter defines the upper layer (UL) module to which the notifications of all TransceiverTransition events from the CAN Transceiver Driver modules have to be routed via <User_TrcvModeIndication>. If no UL module is configured, no upper layer callback function will be called.
      function name CanIfDispatchUserValidateWakeupEventName [0..1]: scope=ECU, multiplicity set at link in variant link-time+post-build / pre-compile in variant pre-compile, set at link in variant link-time+post-build / pre-compile in variant pre-compile, max-length=32, min-length=1  # This parameter defines the name of <User_ValidateWakeupEvent>. This | parameter depends on the parameter CanIfDispatchUserValidateWakeupEventUL. If CanIfDispatchUserValidateWakeupEventUL equals ECUM, the name of <User_ValidateWakeupEvent> is fixed. If CanIfDispatchUserValidateWakeupEventUL equals CDD, the name of <User_ValidateWakeupEvent> is selectable.
      enumeration CanIfDispatchUserValidateWakeupEventUL [0..1]: {CDD, ECUM}, scope=ECU, multiplicity set at link in variant link-time+post-build / pre-compile in variant pre-compile, set at link in variant link-time+post-build / pre-compile in variant pre-compile  # This parameter defines the upper layer (UL) module to which the notifications about positive former requested wake up sources have to be routed via <User_ValidateWakeupEvent>.
    container CanIfInitCfg  # This container contains the init parameters of the CAN Interface.
      string CanIfInitCfgSet: post-build-variant-value=true, set at link in variant link-time / post-build in variant post-build / pre-compile in variant pre-compile, max-length=32, min-length=1  # Selects the CAN Interface specific configuration setup. This type of the external data structure shall contain the post build initialization data for the CAN Interface for all underlying CAN Dirvers. | constant to CanIf_ConfigType
      integer CanIfMaxBufferSize [0..1]: 0..18446744073709551615, multiplicity set at link in variant link-time+post-build / pre-compile in variant pre-compile, set at link in variant link-time+post-build / pre-compile in variant pre-compile  # Maximum total size of all Tx buffers. This parameter is needed only in case of post-build loadable implementation using static memory | allocation.
      integer CanIfMaxRxPduCfg [0..1]: 0..18446744073709551615, multiplicity set at link in variant link-time+post-build / pre-compile in variant pre-compile, set at link in variant link-time+post-build / pre-compile in variant pre-compile  # Maximum number of Pdus. This parameter is needed only in case of post-build loadable implementation using static memory allocation.
      integer CanIfMaxTxPduCfg [0..1]: 0..18446744073709551615, multiplicity set at link in variant link-time+post-build / pre-compile in variant pre-compile, set at link in variant link-time+post-build / pre-compile in variant pre-compile  # Maximum number of Pdus. This parameter is needed only in case of post-build loadable implementation using static memory allocation.
      container CanIfBufferCfg [0..*]: multiplicity set at link in variant link-time / post-build in variant post-build / pre-compile in variant pre-compile, post-build-variant-multiplicity=true  # This container contains the Txbuffer configuration. Multiple buffers with different sizes could be configured. If CanIfBufferSize (ECUC_CanIf_00834) equals 0, the CanIf Tx L-PDU only refers via this CanIfBufferCfg the corresponding CanIfHthCfg.
        integer CanIfBufferSize: 0..255, post-build-variant-value=true, set at link in variant link-time / post-build in variant post-build / pre-compile in variant pre-compile, default-value=0  # This parameter defines the number of CanIf Tx L-PDUs which can be buffered in one Txbuffer. If this value equals 0, the CanIf does not perform Txbuffering for the CanIf Tx L-PDUs which are assigned to this Txbuffer. If CanIfPublicTxBuffering equals False, this parameter equals 0 for all TxBuffer. If the CanHandleType of the referred HTH equals FULL, this parameter equals 0 for this TxBuffer.
        reference CanIfBufferHthRef: post-build-variant-value=true, set at link in variant link-time / post-build in variant post-build / pre-compile in variant pre-compile, destination=CanIfHthCfg  # Reference to HTH, that defines the hardware object or the pool of hardware objects configured for transmission. All the CanIf Tx L-PDUs refer via the CanIfBufferCfg and this parameter to the HTHs if TxBuffering is enabled, or not. | Each HTH shall not be assigned to more than one buffer.
      container CanIfInitHohCfg [0..*]: multiplicity set at pre-compile  # This container contains the references to the configuration setup of each underlying CAN Driver.
        container CanIfHrhCfg [0..*]: multiplicity set at link in variant link-time / post-build in variant post-build / pre-compile in variant pre-compile, post-build-variant-multiplicity=true  # This container contains configuration parameters for each hardware receive object (HRH).
          boolean CanIfHrhSoftwareFilter: set at link in variant link-time+post-build / pre-compile in variant pre-compile, default-value=true  # Selects the hardware receive objects by using the HRH range/list from CAN Driver configuration to define, for which HRH a software filtering has to be performed at during receive processing. | True: Software filtering is enabled False: Software filtering is enabled
          reference CanIfHrhCanCtrlIdRef: scope=ECU, post-build-variant-value=true, set at link in variant link-time / post-build in variant post-build / pre-compile in variant pre-compile, destination=CanIfCtrlCfg  # Reference to controller Id to which the HRH belongs to. A controller can contain one or more HRHs.
          choice reference CanIfHrhIdSymRef: scope=ECU, post-build-variant-value=true, set at link in variant link-time / post-build in variant post-build / pre-compile in variant pre-compile, requires-symbolic-name-value=true, destination=[CanHardwareObject, CanXLHardwareObject]  # The parameter refers to a particular HRH object in the CanDrv configuration (see CanHardwareObject or CanXLHardwareObject). | CanIf receives the following information of the CanDrv module by this reference: * CanHandleType (only CAN 2.0 and CAN FD) * CanObjectId
          container CanIfHrhRangeCfg [0..*]: multiplicity set at link in variant link-time / post-build in variant post-build / pre-compile in variant pre-compile, post-build-variant-multiplicity=true  # Defines the parameters required for configurating multiple CANID ranges for a given same HRH.
            integer CanIfHrhRangeBaseId [0..1]: 0..536870911, multiplicity set at link in variant link-time / post-build in variant post-build / pre-compile in variant pre-compile, post-build-variant-multiplicity=true, post-build-variant-value=true, set at link in variant link-time / post-build in variant post-build / pre-compile in variant pre-compile  # CAN Identifier used as base value in combination with CanIfHrhRangeMask for a masked ID range in which all CAN Ids shall pass the software filtering. The size of this parameter is limited by CanIfHrhRangeRxPduRangeCanIdType.
            integer CanIfHrhRangeMask [0..1]: 0..536870911, multiplicity set at link in variant link-time / post-build in variant post-build / pre-compile in variant pre-compile, post-build-variant-multiplicity=true, post-build-variant-value=true, set at link in variant link-time / post-build in variant post-build / pre-compile in variant pre-compile  # Used as mask value in combination with CanIfHrhRangeBaseId for a masked ID range in which all CAN Ids shall pass the software filtering. The size of this parameter is limited by CanIfHrhRangeRxPduRangeCanIdType.
            integer CanIfHrhRangeRxPduLowerCanId [0..1]: 0..536870911, multiplicity set at link in variant link-time / post-build in variant post-build / pre-compile in variant pre-compile, post-build-variant-multiplicity=true, post-build-variant-value=true, set at link in variant link-time / post-build in variant post-build / pre-compile in variant pre-compile  # Lower CAN Identifier of a receive CAN L-PDU for identifier range definition, in which all CAN Ids shall pass the software filtering.
            enumeration CanIfHrhRangeRxPduRangeCanIdType: {EXTENDED, STANDARD}, post-build-variant-value=true, set at link in variant link-time / post-build in variant post-build / pre-compile in variant pre-compile  # Specifies whether a configured Range of CAN Ids shall only consider standard CAN Ids or extended CAN Ids.
            integer CanIfHrhRangeRxPduUpperCanId [0..1]: 0..536870911, multiplicity set at link in variant link-time / post-build in variant post-build / pre-compile in variant pre-compile, post-build-variant-multiplicity=true, post-build-variant-value=true, set at link in variant link-time / post-build in variant post-build / pre-compile in variant pre-compile  # Upper CAN Identifier of a receive CAN L-PDU for identifier range definition, in which all CAN Ids shall pass the software filtering.
        container CanIfHthCfg [0..*]: multiplicity set at link in variant link-time / post-build in variant post-build / pre-compile in variant pre-compile, post-build-variant-multiplicity=true  # This container contains parameters related to each HTH.
          reference CanIfHthCanCtrlIdRef: scope=ECU, post-build-variant-value=true, set at link in variant link-time / post-build in variant post-build / pre-compile in variant pre-compile, destination=CanIfCtrlCfg  # Reference to controller Id to which the HTH belongs to. A controller can contain one or more HTHs.
          choice reference CanIfHthIdSymRef: scope=ECU, post-build-variant-value=true, set at link in variant link-time / post-build in variant post-build / pre-compile in variant pre-compile, requires-symbolic-name-value=true, destination=[CanHardwareObject, CanXLHardwareObject]  # The parameter refers to a particular HTH object in the CanDrv configuration (see CanHardwareObject or CanXLHardwareObject). | CanIf receives the following information of the CanDrv module by this reference: * CanHandleType (only for CAN 2.0 and CAN FD) * CanObjectId
      container CanIfRxPduCfg [0..*]: multiplicity set at link in variant link-time / post-build in variant post-build / pre-compile in variant pre-compile, post-build-variant-multiplicity=true  # This container contains the configuration (parameters) of each receive CAN L-PDU. | The SHORT-NAME of "CanIfRxPduConfig" container itself represents the symolic name of Receive L-PDU. This L-SDU produces a meta data item of type CAN_ID_32 and TIMETUPLE_TYPE_PTR, and, depending on CanIfRxPduXLParams, meta data items of type PRIORITYID_16, VLAN_16, SDUTYPE_8, and ACCEPTANCEFIELD_32.
        integer CanIfRxPduCanId [0..1]: 0..536870911, scope=ECU, multiplicity set at link in variant link-time / post-build in variant post-build / pre-compile in variant pre-compile, post-build-variant-multiplicity=true, post-build-variant-value=true, set at link in variant link-time / post-build in variant post-build / pre-compile in variant pre-compile  # CAN Identifier of Receive CAN L-PDUs used by the CAN Interface. Exa: Software Filtering. This parameter is used if exactly one Can Identifier is assigned to the Pdu. If a range is assigned then the CanIfRxPduCanIdRange parameter shall be used. | Range: 11 Bit For Standard CAN Identifier ... 29 Bit For Extended CAN identifier
        integer CanIfRxPduCanIdMask [0..1]: 0..536870911, scope=ECU, multiplicity set at link in variant link-time / post-build in variant post-build / pre-compile in variant pre-compile, post-build-variant-multiplicity=true, post-build-variant-value=true, set at link in variant link-time / post-build in variant post-build / pre-compile in variant pre-compile, default-value=536870911  # Identifier mask which denotes relevant bits in the CAN Identifier. This parameter defines a CAN Identifier range in an alternative way to CanIfRxPduCanIdRange. It identifies the bits of the configured CAN Identifier that must match the received CAN Identifier. Range: 11 bits for Standard CAN Identifier, 29 bits for Extended CAN Identifier.
        enumeration CanIfRxPduCanIdType [0..1]: {EXTENDED_CAN, EXTENDED_FD_CAN, EXTENDED_NO_FD_CAN, STANDARD_CAN, STANDARD_FD_CAN, STANDARD_NO_FD_CAN}, multiplicity set at link in variant link-time / post-build in variant post-build / pre-compile in variant pre-compile, post-build-variant-multiplicity=true, post-build-variant-value=true, set at link in variant link-time / post-build in variant post-build / pre-compile in variant pre-compile  # CAN Identifier of receive CAN L-PDUs used by the CAN Driver for CAN L-PDU reception.
        integer CanIfRxPduDataLength: 0..2048, scope=ECU, post-build-variant-value=true, set at link in variant link-time / post-build in variant post-build / pre-compile in variant pre-compile  # Data length of the received CAN L-PDUs used by the CAN Interface. | This information is used for Data Length Check. Additionally it might specify the valid bits in case of the discrete DLC for CAN FD L-PDUs > 8 bytes. The data area size of a CAN L-PDU can have a range from 0 to 2048 bytes.
        boolean CanIfRxPduDataLengthCheck: post-build-variant-value=true, set at link in variant link-time / post-build in variant post-build / pre-compile in variant pre-compile, default-value=true  # This parameter switches the message specific data length check. | True: Data length check will be executed during the reception of this PDU. False: No data length check will be executed during the reception of this PDU.
        integer CanIfRxPduId: 0..4294967295, scope=ECU, set at pre-compile, symbolic-name-value=true, with-auto=true  # ECU wide unique, symbolic handle for receive CAN L-SDU. It shall fulfill ANSI/AUTOSAR definitions for constant defines. | Range: 0..max. number of defined CanRxPduIds
        boolean CanIfRxPduReadData: scope=ECU, post-build-variant-value=true, set at link in variant link-time / post-build in variant post-build / pre-compile in variant pre-compile, default-value=false  # Enables and disables the Rx buffering for reading of received L-SDU data. | True: Enabled False: Disabled
        boolean CanIfRxPduReadNotifyStatus: post-build-variant-value=true, set at link in variant link-time / post-build in variant post-build / pre-compile in variant pre-compile, default-value=false  # Enables and disables receive indication for each receive CAN L-SDU for reading its notification status. | True: Enabled False: Disabled
        reference CanIfRxPduHrhIdRef: post-build-variant-value=true, set at link in variant link-time / post-build in variant post-build / pre-compile in variant pre-compile, destination=CanIfHrhCfg  # The HRH to which Rx L-PDU belongs to, is referred through this parameter.
        reference CanIfRxPduRef: scope=ECU, post-build-variant-value=true, set at link in variant link-time / post-build in variant post-build / pre-compile in variant pre-compile, destination=Pdu  # Reference to the "global" Pdu structure to allow harmonization of handle IDs in the COM-Stack.
        container CanIfRxPduCanIdRange [0..1]  # Optional container that allows to map a range of CAN Ids to one PduId.
          integer CanIfRxPduCanIdRangeLowerCanId: 0..536870911, post-build-variant-value=true, set at link in variant link-time / post-build in variant post-build / pre-compile in variant pre-compile  # Lower CAN Identifier of a receive CAN L-PDU for identifier range definition, in which all CAN Ids are mapped to one PduId.
          integer CanIfRxPduCanIdRangeUpperCanId: 0..536870911, post-build-variant-value=true, set at link in variant link-time / post-build in variant post-build / pre-compile in variant pre-compile  # Upper CAN Identifier of a receive CAN L-PDU for identifier range definition, in which all CAN Ids are mapped to one PduId.
        container CanIfRxPduXLParams [0..1]: multiplicity set at link in variant link-time / post-build in variant post-build / pre-compile in variant pre-compile, post-build-variant-multiplicity=true  # CAN XL parameters. Identifies the CanIfRxPduCfg as CAN XL PDU.
          integer CanIfXLAcceptanceField [0..1]: 0..4294967295, multiplicity set at link in variant link-time / post-build in variant post-build / pre-compile in variant pre-compile, post-build-variant-multiplicity=true, post-build-variant-value=true, set at link in variant link-time / post-build in variant post-build / pre-compile in variant pre-compile  # Acceptance field of a CAN XL message.
          integer CanIfXLPriorityId [0..1]: 0..2047, multiplicity set at link in variant link-time / post-build in variant post-build / pre-compile in variant pre-compile, post-build-variant-multiplicity=true, post-build-variant-value=true, set at link in variant link-time / post-build in variant post-build / pre-compile in variant pre-compile  # Priority ID of a CAN XL message.
          integer CanIfXLSduType [0..1]: 0..255, multiplicity set at link in variant link-time / post-build in variant post-build / pre-compile in variant pre-compile, post-build-variant-multiplicity=true, post-build-variant-value=true, set at link in variant link-time / post-build in variant post-build / pre-compile in variant pre-compile  # SDU type of a CAN XL message.
          integer CanIfXLVcid [0..1]: 0..255, multiplicity set at link in variant link-time / post-build in variant post-build / pre-compile in variant pre-compile, post-build-variant-multiplicity=true, post-build-variant-value=true, set at link in variant link-time / post-build in variant post-build / pre-compile in variant pre-compile  # Virtual CAN network ID of a CAN XL message.
        container CanIfTTRxFrameTriggering [0..1]  # CanIfTTRxFrameTriggering is specified in the SWS TTCAN Interface and defines Frame trigger for TTCAN reception. | This container is only included and valid if TTCAN is supported by the controller, enabled (see CanIfSupportTTCAN, ECUC_CanIf_00675), and a joblist is used for reception.
          integer CanTTRxJoblistTimeMark [0..1]: 0..65535, multiplicity set at link in variant link-time / post-build in variant post-build / pre-compile in variant pre-compile, post-build-variant-multiplicity=true, post-build-variant-value=true, set at link in variant link-time / post-build in variant post-build / pre-compile in variant pre-compile  # Defines the point in time, when the joblist execution funciton (JLEF) shall be called for the referenced rx trigger. Value is given in cycle time. This parameter is only configurable if a joblist is enabled by parameter CanIfTTJobList.
          reference CanIfTTRxHwObjectTriggerIdRef: post-build-variant-value=true, set at link in variant link-time / post-build in variant post-build / pre-compile in variant pre-compile, destination=CanTTHardwareObjectTrigger  # This parameter refers to a particular TTCAN hardware receive object Trigger of a hardware object in the TTCAN Driver Module, which is referred via plain CAN parameter CANIF_HRH_HANDLETYPE_REF. This parameter is only configurable if a joblist is enabled by parameter CanIfTTJobList.
      container CanIfTxPduCfg [0..*]: multiplicity set at link in variant link-time / post-build in variant post-build / pre-compile in variant pre-compile, post-build-variant-multiplicity=true  # This container contains the configuration (parameters) of a transmit CAN L-PDU. It has to be configured as often as a transmit CAN L-PDU is needed. | The SHORT-NAME of "CanIfTxPduConfig" container represents the symolic name of Transmit L-PDU. This L-SDU consumes a meta data item of type CAN_ID_32, and, depending on CanIfTxPduXLParams, meta data items of type PRIORITYID_16, VLAN_16, SDUTYPE_8, and ACCEPTANCEFIELD_32.
        integer CanIfTxPduCanId [0..1]: 0..536870911, scope=ECU, multiplicity set at link in variant link-time / post-build in variant post-build / pre-compile in variant pre-compile, post-build-variant-multiplicity=true, post-build-variant-value=true, set at link in variant link-time / post-build in variant post-build / pre-compile in variant pre-compile  # CAN Identifier of transmit CAN L-PDUs used by the CAN Driver for CAN L-PDU transmission. | Range: 11 Bit For Standard CAN Identifier ... 29 Bit For Extended CAN identifier The CAN Identifier may be omitted for dynamic transmit L-PDUs and CAN XL PDUs.
        integer CanIfTxPduCanIdMask [0..1]: 0..3758096383, scope=ECU, multiplicity set at link in variant link-time / post-build in variant post-build / pre-compile in variant pre-compile, post-build-variant-multiplicity=true, post-build-variant-value=true, set at link in variant link-time / post-build in variant post-build / pre-compile in variant pre-compile, default-value=3758096383  # Identifier mask which denotes relevant bits in the CAN Identifier. This parameter may be used to keep parts of the CAN Identifier of dynamic transmit L-PDUs static. Range: 11 bits for Standard CAN Identifier, 29 bits for Extended CAN Identifier.
        enumeration CanIfTxPduCanIdType [0..1]: {EXTENDED_CAN, EXTENDED_FD_CAN, STANDARD_CAN, STANDARD_FD_CAN}, scope=ECU, multiplicity set at link in variant link-time / post-build in variant post-build / pre-compile in variant pre-compile, post-build-variant-multiplicity=true, post-build-variant-value=true, set at link in variant link-time / post-build in variant post-build / pre-compile in variant pre-compile  # Type of CAN Identifier of the transmit CAN L-PDU used by the CAN Driver module for CAN L-PDU transmission.
        integer CanIfTxPduId: 0..4294967295, scope=ECU, set at pre-compile, symbolic-name-value=true, with-auto=true  # ECU wide unique, symbolic handle for transmit CAN L-SDU. | Range: 0..max. number of CantTxPduIds
        boolean CanIfTxPduPnFilterPdu [0..1]: multiplicity set at link in variant link-time / post-build in variant post-build / pre-compile in variant pre-compile, post-build-variant-multiplicity=true, post-build-variant-value=true, set at link in variant link-time / post-build in variant post-build / pre-compile in variant pre-compile, default-value=false  # If CanIfPublicPnFilterSupport is enabled, by this parameter PDUs could be configured which will pass the CanIfPnFilter. | If there is no CanIfTxPduPnFilterPdu configured per controller, the corresponding controller applies no CanIfPnFilter.
        boolean CanIfTxPduReadNotifyStatus: post-build-variant-value=true, set at link in variant link-time / post-build in variant post-build / pre-compile in variant pre-compile, default-value=false  # Enables and disables transmit confirmation for each transmit CAN L-SDU for reading its notification status. | True: Enabled False: Disabled
        boolean CanIfTxPduTriggerTransmit [0..1]: scope=ECU, post-build-variant-value=true, set at link in variant link-time / post-build in variant post-build / pre-compile in variant pre-compile, default-value=false  # Determines if or if not CanIf shall use the trigger transmit API for this PDU.
        boolean CanIfTxPduTruncation: scope=ECU, post-build-variant-value=true, set at link in variant link-time / post-build in variant post-build / pre-compile in variant pre-compile, default-value=true  # Enables/disables truncation of PDUs that exceed the configured size.
        enumeration CanIfTxPduType: {DYNAMIC, STATIC}, scope=ECU, post-build-variant-value=true, set at link in variant link-time / post-build in variant post-build / pre-compile in variant pre-compile  # Defines the type of each transmit CAN L-PDU.
        reference CanIfTxPduBufferRef: scope=ECU, post-build-variant-value=true, set at link in variant link-time / post-build in variant post-build / pre-compile in variant pre-compile, destination=CanIfBufferCfg  # Configurable reference to a CanIf buffer configuration.
        reference CanIfTxPduRef: scope=ECU, post-build-variant-value=true, set at link in variant link-time / post-build in variant post-build / pre-compile in variant pre-compile, destination=Pdu  # Reference to the "global" Pdu structure to allow harmonization of handle IDs in the COM-Stack.
        container CanIfTTTxFrameTriggering [0..1]  # CanIfTTTxFrameTriggering is specified in the SWS TTCAN Interface and defines Frame trigger for TTCAN transmission. | This container is only included and valid if TTCAN is supported by the controller, enabled (see CanIfSupportTTCAN, ECUC_CanIf_00675), and a joblist is used.
          integer CanIfTTTxJoblistTimeMark [0..1]: 0..65535, multiplicity set at link in variant link-time / post-build in variant post-build / pre-compile in variant pre-compile, post-build-variant-multiplicity=true, post-build-variant-value=true, set at link in variant link-time / post-build in variant post-build / pre-compile in variant pre-compile  # Defines the point in time, when the joblist execution funciton (JLEF) shall be called for the referenced tx frame trigger. | Value is given in cycle time. This parameter is only configurable if a joblist is enabled by parameter CanIfTTJobList.
          reference CanIfTTTxHwObjectTriggerIdRef: post-build-variant-value=true, set at link in variant link-time / post-build in variant post-build / pre-compile in variant pre-compile, destination=CanTTHardwareObjectTrigger  # This parameter refers to a particular TTCAN hardware transmit object Trigger of a hardware object in the TTCAN Driver Module, | which is referred via plain CAN parameter CANIF_HTH_HANDLETYPE_REF. This parameter is only configurable if a joblist is enabled by parameter CanIfTTJobList.
        container CanIfTxPduXLParams [0..1]: multiplicity set at link in variant link-time / post-build in variant post-build / pre-compile in variant pre-compile, post-build-variant-multiplicity=true  # CAN XL parameters. Identifies the CanIfTxPduCfg as CAN XL PDU.
          integer CanIfXLAcceptanceField [0..1]: 0..4294967295, multiplicity set at link in variant link-time / post-build in variant post-build / pre-compile in variant pre-compile, post-build-variant-multiplicity=true, post-build-variant-value=true, set at link in variant link-time / post-build in variant post-build / pre-compile in variant pre-compile  # Acceptance field of a CAN XL message.
          integer CanIfXLPriorityId [0..1]: 0..2047, multiplicity set at link in variant link-time / post-build in variant post-build / pre-compile in variant pre-compile, post-build-variant-multiplicity=true, post-build-variant-value=true, set at link in variant link-time / post-build in variant post-build / pre-compile in variant pre-compile  # Priority ID of a CAN XL message.
          integer CanIfXLSduType [0..1]: 0..255, multiplicity set at link in variant link-time / post-build in variant post-build / pre-compile in variant pre-compile, post-build-variant-multiplicity=true, post-build-variant-value=true, set at link in variant link-time / post-build in variant post-build / pre-compile in variant pre-compile  # SDU type of a CAN XL message.
          integer CanIfXLVcid [0..1]: 0..255, multiplicity set at link in variant link-time / post-build in variant post-build / pre-compile in variant pre-compile, post-build-variant-multiplicity=true, post-build-variant-value=true, set at link in variant link-time / post-build in variant post-build / pre-compile in variant pre-compile  # Virtual CAN network ID of a CAN XL message.
    container CanIfPrivateCfg  # This container contains the private configuration (parameters) of the CAN Interface.
      boolean CanIfFixedBuffer: multiplicity set at pre-compile, set at pre-compile, default-value=false  # This parameter defines if the buffer element length shall be fixed to 8 Bytes for buffers to which only PDUs < 8 Bytes are assigned. | TRUE: Minimum buffer element length is fixed to 8 Bytes. FALSE: Buffer element length depends on the configured length of the referenced global PDUs (see ECUC_EcuC_00078).
      boolean CanIfPrivateDataLengthCheck: set at pre-compile, default-value=true  # Selects whether Data Length Check is supported. | True: Enabled False: Disabled
      enumeration CanIfPrivateSoftwareFilterType: {BINARY, INDEX, LINEAR, TABLE}, set at pre-compile  # Selects the desired software filter mechanism for reception only. | Each implemented software filtering method is identified by this enumeration number. Range: Types implemented software filtering methods
      boolean CanIfSupportTTCAN: scope=ECU, set at pre-compile, default-value=false  # Defines whether TTCAN is supported. | TRUE: TTCAN is supported. FALSE: TTCAN is not supported, only normal CAN communication is possible.
      container CanIfTTGeneral [0..1]  # CanIfTTGeneral is specified in the SWS TTCAN Interface and defines if and in which way TTCAN is supported. | This container is only included and valid if TTCAN is supported by the controller, enabled (see CanIfSupportTTCAN, ECUC_CanIf_00675), and used.
        boolean CanIfTTJoblist: set at pre-compile, default-value=false  # Defines whether TTCAN is processed via a joblist. | TRUE: Joblist is used. FALSE: No joblist is used. This parameter is only configurable if TTCAN is enabled by parameter CanIfSupportTTCAN.
        integer CanIfTTMaxIsrDelay: 0..65535, post-build-variant-value=true, set at link in variant link-time / post-build in variant post-build / pre-compile in variant pre-compile  # Defines the maximum delay for the execution of the joblist execution function JLEF. This parameter is only configurable if a joblist is enabled by parameter CanIfTTJobList.
        container CanIfTTDemEventParameterRefs [0..1]  # Container for the references to DemEventParameter elements which shall be invoked using the API Dem_SetEventStatus in case the corresponding error occurs. The EventId is taken from the referenced DemEventParameter's DemEventId symbolic value. The standardized errors are provided in this container and can be extended by vendor-specific error references.
          reference CANIF_TT_E_JLE_SYNC [0..1]: multiplicity set at link in variant link-time / post-build in variant post-build / pre-compile in variant pre-compile, post-build-variant-multiplicity=true, post-build-variant-value=true, set at link in variant link-time / post-build in variant post-build / pre-compile in variant pre-compile, requires-symbolic-name-value=true, destination=DemEventParameter  # Reference to configured DEM event to report that the JLEF lost synchronization to the local time of the TTCAN controller.
    container CanIfPublicCfg  # This container contains the public configuration (parameters) of the CAN Interface.
      boolean CanIfBusMirroringSupport: set at pre-compile, default-value=false  # Enable support for Bus Mirroring.
      boolean CanIfDevErrorDetect: set at pre-compile, default-value=false  # Switches the development error detection and notification on or off. | * true: detection and notification is enabled. * false: detection and notification is disabled.
      boolean CanIfEnableSecurityEventReporting: scope=ECU, set at pre-compile, default-value=false  # Switches the reporting of security events to the IdsM: Tags: atp.Status=draft | - true: reporting is enabled. - false: reporting is disabled.
      boolean CanIfGlobalTimeSupport: set at pre-compile  # Enables/Disables the Global Time APIs used when hardware timestamping is supported. Tags: atp.Status=draft
      boolean CanIfMetaDataSupport [0..1]: scope=ECU, multiplicity set at pre-compile, set at pre-compile, default-value=false  # Enable support for dynamic ID handling using L-SDU MetaData.
      string CanIfPublicCddHeaderFile [0..*]: scope=ECU, multiplicity set at pre-compile, set at pre-compile, max-length=32, min-length=1  # Defines header files for callback functions which shall be included in case of CDDs. Range of characters is 1.. 32.
      boolean CanIfPublicCtrlPnEnable: scope=ECU, set at pre-compile, default-value=false  # Indicates whether Partial Network function is enabled or disabled in CanDrv. | * True: Enabled * False: Disabled
      enumeration CanIfPublicHandleTypeEnum: {UINT16, UINT8}, scope=ECU, set at pre-compile  # This parameter is used to configure the Can_HwHandleType. The Can_HwHandleType represents the hardware object handles of a CAN hardware unit. For CAN hardware units with more than 255 HW objects the extended range shall be used (UINT16).
      boolean CanIfPublicMultipleDrvSupport: scope=ECU, set at pre-compile, default-value=true  # Selects support for multiple CAN Drivers. | True: Enabled False: Disabled
      boolean CanIfPublicPnSupport: scope=ECU, set at pre-compile, default-value=false  # Selects support of Partial Network features in CanIf. | True: Enabled False: Disabled
      boolean CanIfPublicReadRxPduDataApi: scope=ECU, set at pre-compile, default-value=false  # Enables / Disables the API CanIf_ReadRxPduData() for reading received L-SDU data. | True: Enabled False: Disabled
      boolean CanIfPublicReadRxPduNotifyStatusApi: scope=ECU, set at pre-compile, default-value=false  # Enables and disables the API for reading the notification status of receive L-PDUs. | True: Enabled False: Disabled
      boolean CanIfPublicReadTxPduNotifyStatusApi: scope=ECU, set at pre-compile, default-value=false  # Enables and disables the API for reading the notification status of transmit L-PDUs. | True: Enabled False: Disabled
      boolean CanIfPublicSetDynamicTxIdApi: scope=ECU, set at pre-compile, default-value=false  # Enables and disables the API for reconfiguration of the CAN Identifier for each Transmit L-PDU. | True: Enabled False: Disabled
      boolean CanIfPublicTrcvPnEnable: scope=ECU, set at pre-compile, default-value=false  # Indicates whether Partial Network function is enabled or disabled in CanTrcv. | True: Enabled False: Disabled
      boolean CanIfPublicTxBuffering: scope=ECU, set at pre-compile, default-value=false  # Enables and disables the buffering of transmit L-PDUs (rejected by the CanDrv) within the CAN Interface module. | True: Enabled False: Disabled
      boolean CanIfPublicTxConfirmPollingSupport: set at pre-compile  # Configuration parameter to enable/disable the API to poll for Tx Confirmation state.
      boolean CanIfPublicWakeupCheckValidByNM [0..1]: scope=ECU, multiplicity set at pre-compile, set at pre-compile, default-value=false  # If enabled, only NM messages shall validate a detected wake-up event in CanIf. | If disabled, all received messages corresponding to a configured Rx PDU shall validate such a wake-up event. This parameter depends on CanIfPublicWakeupCheckValidSupport and shall only be configurable, if it is enabled. True: Enabled False: Disabled
      boolean CanIfPublicWakeupCheckValidSupport: scope=ECU, set at pre-compile, default-value=false  # Selects support for wake up validation | True: Enabled False: Disabled
      boolean CanIfSetBaudrateApi [0..1]: scope=ECU, multiplicity set at pre-compile, set at pre-compile, default-value=false  # Configuration parameter to enable/disable the CanIf_SetBaudrate API to change the baud rate of a CAN Controller. If this parameter is set to true the CanIf_SetBaudrate API shall be supported. Otherwise the API is not supported.
      boolean CanIfTriggerTransmitSupport: scope=ECU, multiplicity set at pre-compile, default-value=true  # Enables the CanIf_TriggerTransmit API at Pre-Compile-Time. Therefore, this parameter defines if there shall be support for trigger transmit transmissions. | TRUE: Enabled FALSE: Disabled
      boolean CanIfTxOfflineActiveSupport: scope=ECU, set at pre-compile, default-value=false  # Determines wether TxOffLineActive feature (see SWS_CANIF_00072) is supported by CanIf. | True: Enabled False: Disabled
      boolean CanIfVersionInfoApi: set at pre-compile, default-value=false  # Enables and disables the API for reading the version information about the CAN Interface. | True: Enabled False: Disabled
      boolean CanIfWakeupSupport: scope=ECU, set at pre-compile, default-value=true  # Enables the CanIf_CheckWakeup API at Pre-Compile-Time. Therefore, this parameter defines if there shall be support for wake-up. | TRUE: Enabled FALSE: Disabled
      container CanIfSecurityEventRefs [0..1]: multiplicity set at pre-compile  # Container for the references to IdsMEvent elements representing the security events that the CanIf module shall report to the IdsM in case the coresponding security related event occurs (and if CanIfEnableSecurityEventReporting is set to "true"). The standardized security events in this container can be extended by vendor-specific security events. Tags: atp.Status=draft
        reference SEV_CAN_ERRORSTATE_BUSOFF [0..1]: multiplicity set at pre-compile, set at pre-compile, requires-symbolic-name-value=true, destination=IdsMEvent  # The CAN controller transitioned to state busoff. Tags: atp.Status=draft
        reference SEV_CAN_ERRORSTATE_PASSIVE [0..1]: multiplicity set at pre-compile, set at pre-compile, requires-symbolic-name-value=true, destination=IdsMEvent  # A reception related error was detected. Depending on the context data this could indicate suspicious CAN activity. Tags: atp.Status=draft
        reference SEV_CAN_RX_ERROR_DETECTED [0..1]: multiplicity set at pre-compile, set at pre-compile, requires-symbolic-name-value=true, destination=IdsMEvent  # A reception related error was detected. Depending on the context data this could indicate suspicious CAN activity. Tags: atp.Status=draft
        reference SEV_CAN_TX_ERROR_DETECTED [0..1]: multiplicity set at pre-compile, set at pre-compile, requires-symbolic-name-value=true, destination=IdsMEvent  # A transmission related error was detected. Depending on the context data this could indicate suspicious CAN activity. Tags: atp.Status=draft
    container CanIfTrcvDrvCfg [0..*]: multiplicity set at pre-compile  # This container contains the configuration (parameters) of all addressed CAN transceivers by each underlying CAN Transceiver Driver module. For each CAN transceiver Driver a seperate instance of this container shall be provided.
      container CanIfTrcvCfg [1..*]: multiplicity set at pre-compile  # This container contains the configuration (parameters) of one addressed CAN transceiver by the underlying CAN Transceiver Driver module. For each CAN transceiver a seperate instance of this container has to be provided.
        integer CanIfTrcvId: 0..255, scope=ECU, set at pre-compile, symbolic-name-value=true, with-auto=true  # This parameter abstracts from the CAN Transceiver Driver specific parameter Transceiver. Each transceiver of all connected CAN Transceiver Driver modules shall be assigned to one specific TransceiverId of the CanIf. | Range: 0..number of configured transceivers of all CAN Transceiver Driver modules
        boolean CanIfTrcvWakeupSupport: scope=ECU, set at link in variant link-time+post-build / pre-compile in variant pre-compile, default-value=false  # This parameter defines if a respective transceiver of the referenced CAN Transceiver Driver modules is queriable for wake up events. | True: Enabled False: Disabled
        reference CanIfTrcvCanTrcvRef: scope=ECU, set at link in variant link-time+post-build / pre-compile in variant pre-compile, requires-symbolic-name-value=true, destination=CanTrcvChannel  # This parameter references to the logical handle of the underlying CAN | transceiver from the CAN transceiver driver module to be served by the CAN Interface module. Range: 0..max. number of underlying supported CAN transceivers
  module definition CanNm [0..1]: post-build-variant-support=true, variants link-time/post-build/pre-compile  # Configuration Parameters for the Can Nm module.
    container CanNmGlobalConfig  # This container contains the global configuration parameter of the CanNm. The parameters and the parameters of the sub containers shall be mapped to the C data type CanNm_ConfigType (for parameters where it is possible) which is passed to the CanNm_Init function.
      boolean CanNmBusLoadReductionEnabled: set at pre-compile  # Pre-processor switch for enabling busload reduction support.
      boolean CanNmBusSynchronizationEnabled: scope=ECU, set at pre-compile  # Pre-processor switch for enabling bus synchronization support. This feature is required for gateway nodes only.
      boolean CanNmComControlEnabled: scope=ECU, set at pre-compile  # Pre-processor switch for enabling the Communication Control support.
      boolean CanNmComUserDataSupport: scope=ECU, set at pre-compile  # Preprocessor switch for enabling the Tx path of Com User Data. | Use case: Setting of NMUserData via SWC.
      boolean CanNmCoordinatorSyncSupport: scope=ECU, set at pre-compile  # Enables/disables the coordinator synchronization support.
      boolean CanNmDevErrorDetect: set at pre-compile, default-value=false  # Switches the development error detection and notification on or off. | * true: detection and notification is enabled. * false: detection and notification is disabled.
      boolean CanNmDynamicPncToChannelMappingSupport: scope=ECU, set at pre-compile  # Precompile time switch to enable the dynamic PNC-to-channel-mapping handling. | False: Dynamic PNC-to-channel-mapping is disabled True: Dynamic PNC-to-channel-mapping is enabled
      boolean CanNmGlobalPnSupport: set at pre-compile, default-value=false  # Pre-processor switch for enabling partial networking support globally.
      boolean CanNmImmediateRestartEnabled: set at pre-compile  # Pre-processor switch for enabling the immediate transmission of a NM PDU upon bus-communication request in Prepare-Bus-Sleep mode.
      boolean CanNmImmediateTxconfEnabled: scope=ECU, set at pre-compile  # Enable/disable the immediate tx confirmation.
      float CanNmMainFunctionPeriod: 0..INF, set at link in variant link-time+post-build / pre-compile in variant pre-compile  # Call cycle in seconds of CanNm_MainFunction.
      boolean CanNmPassiveModeEnabled: scope=ECU, set at pre-compile  # Pre-processor switch for enabling support of the Passive Mode.
      boolean CanNmPduRxIndicationEnabled: scope=ECU, set at pre-compile  # Pre-processor switch for enabling the PDU Rx Indication.
      boolean CanNmRemoteSleepIndEnabled: set at pre-compile  # Pre-processor switch for enabling remote sleep indication support. This feature is required for gateway nodes only.
      boolean CanNmStateChangeIndEnabled: scope=ECU, set at pre-compile  # Pre-processor switch for enabling the CAN NM state change notification.
      boolean CanNmUserDataEnabled: scope=ECU, set at pre-compile  # Pre-processor switch for enabling user data support.
      boolean CanNmVersionInfoApi: scope=ECU, set at pre-compile, default-value=false  # Pre-processor switch for enabling version info API support.
      container CanNmChannelConfig [1..*]: multiplicity set at pre-compile, post-build-variant-multiplicity=true  # This container contains the channel specific configuration parameter of the CanNm.
        boolean CanNmActiveWakeupBitEnabled [0..1]: multiplicity set at link in variant link-time+post-build / pre-compile in variant pre-compile, set at link in variant link-time+post-build / pre-compile in variant pre-compile, default-value=false  # Enables/Disables the handling of the Active Wakeup Bit in the CanNm module.
        boolean CanNmAllNmMessagesKeepAwake [0..1]: multiplicity set at link in variant link-time+post-build / pre-compile in variant pre-compile, set at link in variant link-time+post-build / pre-compile in variant pre-compile, default-value=false  # Specifies if CanNm drops irrelevant NM PDUs. | false: Only NM PDUs with a PNI bit = true and containing a PN request for this ECU triggers the standard RX indication handling true: Every NM PDU triggers the standard RX indication handling
        boolean CanNmBusLoadReductionActive: set at link in variant link-time+post-build / pre-compile in variant pre-compile  # This parameter defines if bus load reduction for the respective NM channel is active or not.
        integer CanNmCarWakeUpBitPosition [0..1]: 0..7, multiplicity set at link in variant link-time+post-build / pre-compile in variant pre-compile, set at link in variant link-time+post-build / pre-compile in variant pre-compile  # Specifies the Bit position of the CWU within the NM PDU.
        integer CanNmCarWakeUpBytePosition [0..1]: 0..7, multiplicity set at link in variant link-time+post-build / pre-compile in variant pre-compile, set at link in variant link-time+post-build / pre-compile in variant pre-compile  # Specifies the Byte position of the CWU within the NM PDU.
        boolean CanNmCarWakeUpFilterEnabled [0..1]: multiplicity set at link in variant link-time+post-build / pre-compile in variant pre-compile, set at link in variant link-time+post-build / pre-compile in variant pre-compile, default-value=false  # If CWU filtering is supported, only the CWU bit within the NM PDU with source node identifier CanNmCarWakeUpFilterNodeId is considered as CWU request. | FALSE - CWU filtering is not supported TRUE - CWU filtering is supported
        integer CanNmCarWakeUpFilterNodeId [0..1]: 0..255, multiplicity set at link in variant link-time+post-build / pre-compile in variant pre-compile, set at link in variant link-time+post-build / pre-compile in variant pre-compile  # Source node identifier for CWU filtering. If CWU filtering is supported, only the CWU bit within the NM PDU with source node identifier CanNmCarWakeUpFilterNodeId is considered as CWU request.
        boolean CanNmCarWakeUpRxEnabled: scope=ECU, set at link in variant link-time+post-build / pre-compile in variant pre-compile, default-value=false  # Enables or disables support of CarWakeUp bit evaluation in received NM PDUs. | FALSE - CarWakeUp not supported TRUE - CarWakeUp supported
        boolean CanNmDynamicPncToChannelMappingEnabled [0..1]: scope=ECU, set at link in variant link-time+post-build / pre-compile in variant pre-compile, default-value=false  # Channel-specific parameter to enable the dynamic PNC-to-channel-mapping feature. | False: Dynamic PNC-to-channel-mapping is disabled True: Dynamic PNC-to-channel-mapping is enabled
        float CanNmImmediateNmCycleTime [0..1]: 0.001..65.535, multiplicity set at link in variant link-time+post-build / pre-compile in variant pre-compile, set at link in variant link-time+post-build / pre-compile in variant pre-compile  # Defines the immediate NM PDU cycle time in seconds which is used for CanNmImmediateNmTransmissions NM PDU transmissions.
        integer CanNmImmediateNmTransmissions: 0..255, set at link in variant link-time+post-build / pre-compile in variant pre-compile  # Defines the number of immediate NM PDUs which shall be transmitted. If the value is zero no immediate NM PDUs are transmitted. The cycle time of immeditate NM PDUs is defined by CanNmImmediateNmCycleTime.
        float CanNmMsgCycleOffset: 0..65.535, post-build-variant-value=true, set at link in variant link-time+post-build / pre-compile in variant pre-compile  # Time offset in the periodic transmission node. It determines the start delay of the transmission. Specified in seconds.
        float CanNmMsgCycleTime: 0.001..65.535, scope=ECU, set at link in variant link-time+post-build / pre-compile in variant pre-compile  # Period of a NM PDU in seconds. It determines the periodic rate in the "periodic transmission mode with bus load reduction" and is the basis for transmit scheduling in the "periodic transmission mode without bus load reduction".
        float CanNmMsgReducedTime: 0.001..65.535, post-build-variant-value=true, set at link in variant link-time+post-build / pre-compile in variant pre-compile  # Node specific bus cycle time in the periodic transmission mode with bus load reduction. Specified in seconds.
        float CanNmMsgTimeoutTime [0..1]: 0.001..65.535, multiplicity set at link in variant link-time+post-build / pre-compile in variant pre-compile, post-build-variant-multiplicity=true, post-build-variant-value=true, set at link in variant link-time+post-build / pre-compile in variant pre-compile  # When using Partial Network and this timeout is defined then CanNm monitors that a NM-PDU is transmitted successfully within this Transmission Timeout Time and provides an error notification otherwise.
        boolean CanNmNodeDetectionEnabled: scope=ECU, set at link in variant link-time+post-build / pre-compile in variant pre-compile  # Precompile time switch to enable the node detection feature.
        integer CanNmNodeId: 0..255, post-build-variant-value=true, set at link in variant link-time / post-build in variant post-build / pre-compile in variant pre-compile  # Node identifier of local node.
        boolean CanNmNodeIdEnabled: scope=ECU, set at link in variant link-time+post-build / pre-compile in variant pre-compile  # Pre-processor switch for enabling the source node identifier.
        enumeration CanNmPduCbvPosition: {CANNM_PDU_BYTE_0, CANNM_PDU_BYTE_1, CANNM_PDU_OFF}, scope=ECU, set at link in variant link-time+post-build / pre-compile in variant pre-compile  # Defines the position of the control bit vector within the NM PDU. | The value of the parameter represents the location of the Control Bit Vector in the NM PDU (CanNmPduByte0 means byte 0, CanNmPduByte1 means byte 1, CanNmPduOff means source node identifier is not part of the NM PDU) ImplementationType: CanNm_PduPositionType
        enumeration CanNmPduNidPosition: {CANNM_PDU_BYTE_0, CANNM_PDU_BYTE_1, CANNM_PDU_OFF}, scope=ECU, set at link in variant link-time+post-build / pre-compile in variant pre-compile  # Defines the position of the source node identifier within the NM PDU. | The value of the parameter represents the location of the source node identifier in the NM PDU (CANNM_PDU_BYTE_0 means byte 0, CANNM_PDU_BYTE_1 means byte 1, CANNM_PDU_OFF means source node identifier is not part of the NM PDU) ImplementationType: CanNm_PduPositionType
        boolean CanNmPnEnabled [0..1]: scope=ECU, multiplicity set at link in variant link-time / post-build in variant post-build / pre-compile in variant pre-compile, post-build-variant-multiplicity=true, post-build-variant-value=true, set at link in variant link-time / post-build in variant post-build / pre-compile in variant pre-compile, default-value=false  # Enables or disables support of partial networking. | false: Partial networking Range not supported true: Partial networking supported
        boolean CanNmPnHandleMultipleNetworkRequests [0..1]: multiplicity set at link in variant link-time+post-build / pre-compile in variant pre-compile, set at link in variant link-time+post-build / pre-compile in variant pre-compile, default-value=false  # Specifies if CanNm performs an additional transition from Network Mode to Repeat Message State (true) or not (false).
        float CanNmRemoteSleepIndTime [0..1]: 0.001..65.535, set at link in variant link-time+post-build / pre-compile in variant pre-compile  # Timeout for Remote Sleep Indication. | It defines the time in seconds how long it shall take to recognize that all other nodes are ready to sleep.
        float CanNmRepeatMessageTime: 0..65.535, set at link in variant link-time+post-build / pre-compile in variant pre-compile  # Timeout for Repeat Message State. | It defines the time in seconds how long the NM shall stay in the Repeat Message State.
        boolean CanNmRepeatMsgIndEnabled: scope=ECU, set at link in variant link-time+post-build / pre-compile in variant pre-compile  # Enable/disable the notification that a RepeatMessageRequest bit has been received.
        boolean CanNmStayInPbsEnabled: set at link in variant link-time+post-build / pre-compile in variant pre-compile, default-value=false  # If this parameter is disabled Prepare Bus-Sleep Mode is left after CanNmWaitBusSleepTime. If this parameter is enabled Prepare Bus-Sleep Mode can only be left if ECU is powered off or any restart reason applies.
        boolean CanNmSynchronizedPncShutdownEnabled [0..1]: multiplicity set at link in variant link-time / pre-compile in variant pre-compile, set at link in variant link-time / pre-compile in variant pre-compile, default-value=false  # Specifies if CanNm handle PN shutdown messages to support a synchronized PNC shutdown across a PN topology. This is only used for ECUs in the role of a top-level PNC coordinator or intermediate PNC coordinator. Thus, the PNC gateway functionality is enabled and therefore ERA calculation is used. | FALSE: synchronized PNC shutdown is disabled TRUE: synchronized PNC shutdown is enabled
        float CanNmTimeoutTime: 0.002..65.535, scope=ECU, set at link in variant link-time+post-build / pre-compile in variant pre-compile  # If NM is in Ready Sleep State it denotes the time in seconds how long after the last NM PDU transmission or reception state transition into the Prepare Bus-Sleep Mode is initiated. | If NM is in Repeat Message or Normal Operation state and no NM PDU can be transmitted or received within this time, a run-time error is raised.
        float CanNmWaitBusSleepTime [0..1]: 0.001..65.535, set at link in variant link-time+post-build / pre-compile in variant pre-compile  # Timeout for bus calm down phase. | It denotes the time in seconds how long the NM shall stay in the Prepare Bus-Sleep Mode before transition into Bus-Sleep Mode shall take place.
        reference CanNmComMNetworkHandleRef: set at link in variant link-time+post-build / pre-compile in variant pre-compile, requires-symbolic-name-value=true, destination=ComMChannel  # This reference points to the unique channel defined by the ComMChannel and provides access to the unique channel index value in ComMChannelId.
        container CanNmRxPdu [1..*]  # This container is used to configure the Rx PDU properties that are used for the CanNm Channel.
          integer CanNmRxPduId: 0..65535, scope=ECU, set at pre-compile, symbolic-name-value=true, with-auto=true  # This parameter defines the Rx PDU ID of the CanIf L-PDU range that is associated with this CanNm channel.
          reference CanNmRxPduRef: post-build-variant-value=true, set at link in variant link-time / post-build in variant post-build / pre-compile in variant pre-compile, destination=Pdu  # Reference to the global PDU that is used by this CanNm channel.
        container CanNmTxPdu [0..1]  # This container contains the CanNmTxConfirmationPduId and the CanNmTxPduRef.
          integer CanNmTxConfirmationPduId: 0..65535, scope=ECU, set at pre-compile, symbolic-name-value=true, with-auto=true  # Handle Id to be used by the Lower Layer to confirm the transmission of the CanNmTxPdu to the LowerLayer.
          reference CanNmTxPduRef: post-build-variant-value=true, set at link in variant link-time / post-build in variant post-build / pre-compile in variant pre-compile, destination=Pdu  # The reference to the common PDU structure.
        container CanNmUserDataTxPdu [0..1]  # This optional container is used to configure the UserNm PDU. This container is only available if CanNmComUserDataSupport is enabled.
          integer CanNmTxUserDataPduId: 0..65535, scope=ECU, set at pre-compile, symbolic-name-value=true, with-auto=true  # This parameter defines the Handle ID of the NM User Data I-PDU.
          reference CanNmTxUserDataPduRef: post-build-variant-value=true, set at link in variant link-time / post-build in variant post-build / pre-compile in variant pre-compile, destination=Pdu  # Reference to the NM User Data I-PDU in the global PDU collection.
  module definition CanSM [0..1]: post-build-variant-support=true, variants link-time/post-build/pre-compile  # Configuration of the CanSM module
    container CanSMConfiguration  # This container contains the global parameters of the CanSM and sub containers, which are for the CAN network specific configuration.
      integer CanSMModeRequestRepetitionMax: 0..255, post-build-variant-value=true, set at link in variant link-time / post-build in variant post-build / pre-compile in variant pre-compile  # Specifies the maximal amount of mode request repetitions without a respective mode indication from the CanIf module until the CanSM module reports a Development Error to the Det and tries to go back to no communication.
      float CanSMModeRequestRepetitionTime: 0..65.535, post-build-variant-value=true, set at link in variant link-time / post-build in variant post-build / pre-compile in variant pre-compile  # Specifies in which time duration the CanSM module shall repeat mode change requests by using the API of the CanIf module.
      container CanSMManagerNetwork [1..*]  # This container contains the CAN network specific parameters of each CAN network
        integer CanSMBorCounterL1ToL2: 0..255, post-build-variant-value=true, set at link in variant link-time / post-build in variant post-build / pre-compile in variant pre-compile  # This threshold defines the count of bus-offs until the bus-off recovery switches from level 1 (short recovery time) to level 2 (long recovery time).
        float CanSMBorTimeL1: 0..65.535, post-build-variant-value=true, set at link in variant link-time / post-build in variant post-build / pre-compile in variant pre-compile  # This time parameter defines in seconds the duration of the bus-off recovery time in level 1 (short recovery time).
        float CanSMBorTimeL2: 0..65.535, post-build-variant-value=true, set at link in variant link-time / post-build in variant post-build / pre-compile in variant pre-compile  # This time parameter defines in seconds the duration of the bus-off recovery time in level 2 (long recovery time).
        float CanSMBorTimeTxEnsured: 0..65.535, post-build-variant-value=true, set at link in variant link-time / post-build in variant post-build / pre-compile in variant pre-compile  # This parameter defines in seconds the duration of the bus-off event check. This check assesses, if the recovery has been successful after the recovery reenables the transmit path. If a new bus-off occurs during this time period, the CanSM assesses this bus-off as sequential bus-off without successful recovery. Because a bus-off only can be detected, when PDUs are transmitted, the time has to be great enough to ensure that PDUs are transmitted again (e. g. time period of the fastest cyclic transmitted PDU of the COM module, ComTxModeTimePeriod).
        boolean CanSMBorTxConfirmationPolling: set at pre-compile  # This parameter shall configure, if the CanSM polls the CanIf_GetTxConfirmationState API to decide the bus-off state to be recovered instead of using the CanSMBorTimeTxEnsured parameter for this decision.
        boolean CanSMEnableBusOffDelay [0..1]: multiplicity set at pre-compile, set at pre-compile, default-value=false  # This parameter defines if the <User_GetBusOffDelay> shall be called for this network.
        reference CanSMComMNetworkHandleRef: post-build-variant-value=true, set at link in variant link-time / post-build in variant post-build / pre-compile in variant pre-compile, requires-symbolic-name-value=true, destination=ComMChannel  # Unique handle to identify one certain CAN network. Reference to one of the network handles configured for the ComM.
        reference CanSMTransceiverId [0..1]: multiplicity set at link in variant link-time / post-build in variant post-build / pre-compile in variant pre-compile, post-build-variant-multiplicity=true, post-build-variant-value=true, set at link in variant link-time / post-build in variant post-build / pre-compile in variant pre-compile, requires-symbolic-name-value=true, destination=CanIfTrcvCfg  # ID of the CAN transceiver assigned to the configured network handle. Reference to one of the transceivers managed by the CanIf module.
        container CanSMController [1..*]  # This container contains the controller IDs assigned to a CAN network.
          reference CanSMControllerId: post-build-variant-value=true, set at link in variant link-time / post-build in variant post-build / pre-compile in variant pre-compile, requires-symbolic-name-value=true, destination=CanIfCtrlCfg  # Unique handle to identify one certain CAN controller. Reference to one of the CAN controllers managed by the CanIf module.
        container CanSMDemEventParameterRefs [0..1]  # Container for the references to DemEventParameter elements which shall be invoked using the API Dem_SetEventStatus in case the corresponding error occurs. The EventId is taken from the referenced DemEventParameter's DemEventId symbolic value. The standardized errors are provided in this container and can be extended by vendor-specific error references.
          reference CANSM_E_BUS_OFF [0..1]: multiplicity set at link in variant link-time / post-build in variant post-build / pre-compile in variant pre-compile, post-build-variant-multiplicity=true, post-build-variant-value=true, set at link in variant link-time / post-build in variant post-build / pre-compile in variant pre-compile, requires-symbolic-name-value=true, destination=DemEventParameter  # Reference to configured DEM event to report bus off errors for this CAN network.
          reference CANSM_E_MODE_REQUEST_TIMEOUT [0..1]: multiplicity set at link in variant link-time / post-build in variant post-build / pre-compile in variant pre-compile, post-build-variant-multiplicity=true, post-build-variant-value=true, set at link in variant link-time / post-build in variant post-build / pre-compile in variant pre-compile, requires-symbolic-name-value=true, destination=DemEventParameter  # Reference to configured DEM event to report bus off errors for this CAN network.
    container CanSMGeneral  # Container for general pre-compile parameters of the CanSM module
      boolean CanSMDevErrorDetect: set at pre-compile, default-value=false  # Switches the development error detection and notification on or off. | * true: detection and notification is enabled. * false: detection and notification is disabled.
      function name CanSMGetBusOffDelayFunction [0..1]: multiplicity set at pre-compile, set at pre-compile  # This parameter configures the name of the <User_GetBusOffDelay> callout function, which is used by CanSM to acquire an additional L1/L2 delay time. This function is only called for channels where CanSMEnableBusOffDelay is enabled.
      string CanSMGetBusOffDelayHeader [0..1]: multiplicity set at pre-compile, set at pre-compile  # This parameter configures the header file containing the prototype of the <User_GetBusOffDelay> callout function.
      float CanSMMainFunctionTimePeriod: 0..INF, set at pre-compile  # This parameter defines the cycle time of the function CanSM_MainFunction in seconds
      boolean CanSMPncSupport [0..1]: multiplicity set at pre-compile, set at pre-compile, default-value=false  # Enables or disables support of partial networking. | False: Partial Networking is disabled True: Partial Networking is enabled
      boolean CanSMSetBaudrateApi [0..1]: scope=ECU, multiplicity set at pre-compile, set at pre-compile, default-value=false  # The support of the Can_SetBaudrate API is optional. If this parameter is set to true the Can_SetBaudrate API shall be supported. Otherwise the API is not supported.
      boolean CanSMTxOfflineActiveSupport [0..1]: multiplicity set at pre-compile, set at pre-compile  # Determines whether the ECU passive feature is supported by CanSM. | True: Enabled False: Disabled
      boolean CanSMVersionInfoApi: set at pre-compile, default-value=false  # Activate/Deactivate the version information API (CanSM_GetVersionInfo). | true: version information API activated false: version information API deactivated
  module definition CanTSyn [0..1]: post-build-variant-support=true, variants pre-compile  # Configuration of the Synchronized Time-base Manager (StbM) module with respect to global time handling on CAN.
    container CanTSynGeneral  # This container holds the general parameters of the CAN-specific Synchronized Time-base Manager
      boolean CanTSynDevErrorDetect: set at pre-compile, default-value=false  # Switches the development error detection and notification on or off. | * true: detection and notification is enabled. * false: detection and notification is disabled.
      boolean CanTSynEnableSecurityEventReporting: set at pre-compile, default-value=false  # Switches the reporting of security events to the IdsM: | - true: reporting is enabled. - false: reporting is disabled.
      boolean CanTSynHardwareTimestampSupport: set at pre-compile  # Activate/Deactivate the hardware time stamping functionality of the CAN hardware. Tags: atp.Status=draft | True: Timestamp is retrieved from the CAN hardware False: Timestamp is retrieved from the StbM
      float CanTSynMainFunctionPeriod: 0..INF, set at pre-compile  # Schedule period of the main function CanTSyn_MainFunction. Unit: [s].
      integer CanTSynSyncTransmissionsPerCycle [0..1]: 0..255, multiplicity set at pre-compile, set at pre-compile, default-value=0  # Maximum number of SYNC message transmissions within one CanTSyn_MainFunction Tags: atp.Status=draft
      boolean CanTSynTimeValidationSupport: set at pre-compile, default-value=false  # Switches support for Time Validation on or off. | * true: Time Validation is enabled. * false: Time Validation is disabled
      boolean CanTSynVersionInfoApi: set at pre-compile, default-value=false  # Activate/Deactivate the version information API (CanTSyn_GetVersionInfo). True: version information API activated False: version information API deactivated.
      container CanTSynSecurityEventRefs [0..1]: multiplicity set at pre-compile  # Container for the references to IdsMEvent elements representing the security events that the CanTSyn module shall report to the IdsM in case the coresponding security related event occurs (and if | CanTSynEnableSecurityEventReporting is set to "true"). The standardized security events in this container can be extended by vendor-specific security events.
        reference SEV_TSYN_CAN_FRESHNESS_NOT_AVAILABLE [0..1]: multiplicity set at pre-compile, set at pre-compile, requires-symbolic-name-value=true, destination=IdsMEvent  # FV not available from FVM. Context data provides the respective domain ID.
        reference SEV_TSYN_CAN_ICV_GENERATION_FAILED [0..1]: multiplicity set at pre-compile, set at pre-compile, requires-symbolic-name-value=true, destination=IdsMEvent  # ICV generation for Follow_Up message failed. Context data provides the respective domain ID
        reference SEV_TSYN_CAN_ICV_VERIFICATION_FAILED [0..1]: multiplicity set at pre-compile, set at pre-compile, requires-symbolic-name-value=true, destination=IdsMEvent  # ICV verification for Follow_Up message failed. Context data provides the respective domain ID.
        reference SEV_TSYN_CAN_MSG_SEQUENCE_ERROR [0..1]: multiplicity set at pre-compile, set at pre-compile, requires-symbolic-name-value=true, destination=IdsMEvent  # Failed to receive correct sequence of SYNC and FUP from the TimeMaster within (CanTSynGlobalTimeFollowUpTimeout).
    container CanTSynGlobalTimeDomain [1..*]  # This represents the existence of a global time domain on CAN. The CanTSyn module can administrate several global time domains at the same time that in itself form a hierarchy of domains and sub-domains. | If the CanTSyn exists it is assumed that at least one global time domain exists.
      boolean CanTSynEnableTimeValidation [0..1]: set at pre-compile  # Enables/disables time recording for Time Validation for a specific Time Domain.
      integer CanTSynGlobalTimeDomainId: 0..15, set at pre-compile  # The global time domain ID.
      integer CanTSynGlobalTimeNetworkSegmentId [0..1]: 0..255, multiplicity set at pre-compile, post-build-variant-value=true, set at pre-compile  # This represents the numerical identifier of the network on system level scope where this Global Time has been communicated on.
      boolean CanTSynUseExtendedMsgFormat: set at pre-compile, default-value=false  # Switches support for 16 Byte Timesync messages on or off (for CAN FD only) | * true: CAN FD support is active: use at least 16 byte for Timesync messages (depending on configuration) * false: Classic CAN support is active: use always 8 byte for Timesync messages
      reference CanTSynSynchronizedTimeBaseRef: set at pre-compile, requires-symbolic-name-value=true, destination=StbMSynchronizedTimeBase  # Mandatory reference to the required synchronized time-base.
      container CanTSynGlobalTimeFupDataIDList [0..1]: multiplicity set at pre-compile, post-build-variant-multiplicity=true  # The DataIDList for FUP messages ensures the identification of data elements due to CRC calculation and message authentication process.
        container CanTSynGlobalTimeFupDataIDListElement [16..16]  # Element of the DataIDList for FUP messages ensures the identification of data elements due to CRC calculation and message authentication process.
          integer CanTSynGlobalTimeFupDataIDListIndex: 0..15, post-build-variant-value=true, set at pre-compile  # Index of the DataIDList for FUP messages ensures the identification of data elements due to CRC calculation and message authentication process.
          integer CanTSynGlobalTimeFupDataIDListValue: 0..255, post-build-variant-value=true, set at pre-compile  # Value of the DataIDList for FUP messages ensures the identification of data elements due to CRC calculation and message authentication process.
      container CanTSynGlobalTimeMaster [0..1]: multiplicity set at pre-compile, post-build-variant-multiplicity=true  # Configuration of a Time Master for a Time Domain (refer to parent container). If CanTSynGlobalTimeMaster container exists, the local ECU acts as a Time Master for the Time Domain.
        float CanTSynCyclicMsgResumeTime: 0..INF, post-build-variant-value=true, set at pre-compile  # Defines the time where the 1st regular cycle time based message transmission takes place, after an immediate transmission before. Unit: seconds
        float CanTSynGlobalTimeDebounceTime: 0..4, post-build-variant-value=true, set at pre-compile  # This represents the configuration of a TX debounce time for SYNC and FUP messages compared to a message before with the same PDU. Unit: seconds
        enumeration CanTSynGlobalTimeTxCrcSecured: {CRC_NOT_SUPPORTED, CRC_SUPPORTED}, post-build-variant-value=true, set at pre-compile  # This represents the configuration of whether or not CRC is supported.
        enumeration CanTSynGlobalTimeTxIcvSecured: set at pre-compile, default-value=ICV_NOT_SUPPORTED  # This parameter controls whether or not ICV generation shall be supported. Tags: atp.Status=draft
          ICV_NOT_SUPPORTED  # Tags: atp.Status=draft
          ICV_SUPPORTED  # Tags: atp.Status=draft
        float CanTSynGlobalTimeTxPeriod: 0..INF, post-build-variant-value=true, set at pre-compile  # This represents configuration of the TX period. Unit: seconds
        boolean CanTSynImmediateTimeSync: post-build-variant-value=true, set at pre-compile  # Enables/Disables the cyclic polling of StbM_GetTimeBaseUpdateCounter() within CanTSyn_MainFunction().
        container CanTSynGlobalTimeMasterPdu  # This container encloses the configuration of the PDU that is supposed to contain the global time information.
          integer CanTSynGlobalTimeMasterConfirmationHandleId: 0..65535, set at pre-compile, symbolic-name-value=true, with-auto=true  # This represents the handle ID of the PDU that contains the global time information.
          reference CanTSynGlobalTimePduRef: post-build-variant-value=true, set at pre-compile, destination=Pdu  # This represents the reference to the Pdu taken to transmit the global time information. The global time master of a global time domain acts as the sender of the Pdu while all the time slaves are supposed to receive the Pdu.
        container CanTSynGlobalTimeTxIcvGeneration [0..1]: multiplicity set at pre-compile  # This container collects configuration that shall be used for ICV generation.
          enumeration CanTSynIcvGenerationBase: {ICV_MAC, ICV_SIGNATURE}, set at pre-compile  # Symmetric or asymmetric cryptography selection for the ICV generation
          float CanTSynIcvGenerationTimeout: 0..INF, set at pre-compile  # Timeout of ICV generation (respective CSM job completion in asynchronous behavior). A value of 0 disables the ICV timeout monitoring. Unit: Seconds
          integer CanTSynIcvTxLength: 0..54, set at pre-compile  # Length of ICV to be transmitted within Follow_Up Message on the bus (in bytes).
          integer CanTSynTxAuthenticationBuildAttempts: 0..65535, set at pre-compile, default-value=0  # This parameter specifies the number of authentication build attempts that are to be carried out when the generation of the ICV failed for a given FUP message. If zero is set, then only one ICV build attempt is done.
          reference CanTSynIcvGenerationFvIdRef [0..1]: multiplicity set at pre-compile, set at pre-compile, requires-symbolic-name-value=true, destination=StbMFreshnessValue  # This represents the reference to the FV taken to generate the ICV generation.
          reference CanTSynIcvGenerationJobRef: set at pre-compile, requires-symbolic-name-value=true, destination=CsmJob  # This represents the reference to the CSM job to fetch the CSM job ID.
      container CanTSynGlobalTimeSlave [0..1]: multiplicity set at pre-compile, post-build-variant-multiplicity=true  # Configuration of a Time Slave for a Time Domain (refer to parent container). If CanTSynGlobalTimeSlave container exists, the local ECU acts as a Time Slave for the Time Domain.
        float CanTSynGlobalTimeFollowUpTimeout: 0..INF, post-build-variant-value=true, set at pre-compile  # Rx timeout for the follow-up message. This is only relevant for selected bus systems Unit:seconds
        float CanTSynGlobalTimeRxDebounceTime: 0..4, post-build-variant-value=true, set at pre-compile  # This represents the configuration of a RX debounce time for the Sync and FUP. Unit: seconds
        integer CanTSynGlobalTimeSequenceCounterHysteresis: 0..15, post-build-variant-value=true, set at pre-compile, default-value=0  # CanTSynGlobalTimeSequenceCounterHysteresis specifies the number of consecutive valid message pairs that are required by the Time Slave while being in Timeout state until a Time Tuple is forwarded to the StbM.
        integer CanTSynGlobalTimeSequenceCounterJumpWidth: 0..15, post-build-variant-value=true, set at pre-compile, default-value=0  # The SequenceCounterJumpWidth specifies the maximum allowed gap of the Sequence Counter between two SYNC messages.
        enumeration CanTSynRxCrcValidated: {CRC_IGNORED, CRC_NOT_VALIDATED, CRC_OPTIONAL, CRC_VALIDATED}, post-build-variant-value=true, set at pre-compile  # Definition of whether or not validation of the CRC is supported.
        enumeration CanTSynRxIcvVerificationType: {ICV_IGNORED, ICV_NOT_VERIFIED, ICV_OPTIONAL, ICV_VERIFIED}, set at pre-compile  # This parameter controls whether or not ICV verification shall be supported.
        container CanTSynGlobalTimeRxIcvVerification [0..1]: multiplicity set at pre-compile  # This container collects configuration required for ICV verification.
          integer CanTSynIcvRxLength: 0..54, set at pre-compile  # Length of ICV to be used for verification of received ICV within FUP Message in Bytes.
          integer CanTSynIcvVerificationAttempts: 0..65535, set at pre-compile, default-value=0  # This parameter specifies the number of ICV verification attempts that are to be carried out when the verification of the ICV failed for a given FUP message. If zero is set, then only one ICV verification attempt is | done.
          enumeration CanTSynIcvVerificationBase: {ICV_MAC, ICV_SIGNATURE}, set at pre-compile  # Symmetric or asymmetric cryptography selection for the ICV generation
          float CanTSynIcvVerificationTimeout: 0..INF, set at pre-compile  # Timeout of ICV generation (respective CSM job completion in asynchronous behavior). A value of 0 disables the ICV timeout monitoring. Unit: Seconds
          integer CanTSynRxAuthenticationBuildAttempts: 0..65535, set at pre-compile, default-value=0  # This parameter specifies the number of authentication build attempts that are to be carried out when the verification of the ICV failed for a given FUP message. If zero is set, then only one ICV verification attempt is done.
          reference CanTSynIcvVerificationFvIdRef [0..1]: multiplicity set at pre-compile, set at pre-compile, requires-symbolic-name-value=true, destination=StbMFreshnessValue  # This represents the reference to the FV taken to generate the ICV generation.
          reference CanTSynIcvVerificationJobRef: set at pre-compile, requires-symbolic-name-value=true, destination=CsmJob  # This represents the reference to the CSM job to fetch the CSM job ID.
        container CanTSynGlobalTimeSlavePdu  # This container encloses the configuration of the PDU that is supposed to contain the global time information. | Supported MetaData entry: TIMETUPLE_TYPE_PTR
          float CanTSynGlobalTimePropagationDelay: 0..1, post-build-variant-value=true, set at pre-compile, default-value=0  # Physical Layer specific propagation delay of a SYNC message to be compensated upon SYNC reception. Unit: seconds.
          integer CanTSynGlobalTimeSlaveHandleId: 0..65535, set at pre-compile, symbolic-name-value=true, with-auto=true  # This represents the handle ID of the PDU that contains the global time information.
          reference CanTSynGlobalTimePduRef: post-build-variant-value=true, set at pre-compile, destination=Pdu  # This represents the reference to the Pdu taken to transmit the global time information. The global time master of a global time domain acts as the sender of the Pdu while all the time slaves are supposed to receive the Pdu.
      container CanTSynGlobalTimeSyncDataIDList [0..1]: multiplicity set at pre-compile, post-build-variant-multiplicity=true  # The DataIDList for SYNC messages ensures the identification of data elements due to CRC calculation and message authentication process.
        container CanTSynGlobalTimeSyncDataIDListElement [16..16]  # Element of the DataIDList for SYNC messages ensures the identification of data elements due to CRC calculation and message authentication process.
          integer CanTSynGlobalTimeSyncDataIDListIndex: 0..15, post-build-variant-value=true, set at pre-compile  # Index for the DataIDList for SYNC messages ensures the identification of data elements due to CRC calculation and message authentication process.
          integer CanTSynGlobalTimeSyncDataIDListValue: 0..255, post-build-variant-value=true, set at pre-compile  # Value of the DataIDList for SYNC messages ensures the identification of data elements due to CRC calculation and message authentication process.
  module definition CanTp [0..1]: post-build-variant-support=true, variants post-build/pre-compile  # Configuration of the CanTp (CAN Transport Protocol) module.
    container CanTpConfig  # This container contains the configuration parameters and sub containers of the AUTOSAR CanTp module.
      float CanTpMainFunctionPeriod: 0..INF, scope=ECU, set at pre-compile  # Allow to configure the time for the MainFunction (as float in seconds). The CanTpMainFunctionPeriod should be assigned a value which is optimal regarding all of the timers configured for CanTp in TX and RX data transfer i.e. the differences from the configured timing should be as small as possible. Please note: This period shall be the same as call cycle time of the periodic task were CanTp Main function is called.
      integer CanTpMaxChannelCnt [0..1]: 0..18446744073709551615, multiplicity set at pre-compile, set at pre-compile  # Maximum number of channels. This parameter is needed only in case of post-build loadable implementation using static memory allocation.
      container CanTpChannel [1..*]: multiplicity set at post-build in variant post-build / pre-compile in variant pre-compile, post-build-variant-multiplicity=true  # This container contains the configuration parameters of the CanTp channel.
        container CanTpRxNSdu [0..*]: multiplicity set at post-build in variant post-build / pre-compile in variant pre-compile, post-build-variant-multiplicity=true  # The following parameters needs to be configured for each CAN N-SDU that the CanTp module receives via the CanTpChannel. This N-SDU produces meta data items of type SOURCE_ADDRESS_16, TARGET_ADDRESS_16 and ADDRESS_EXTENSION_8.
          integer CanTpBs [0..1]: 0..255, multiplicity set at post-build in variant post-build / pre-compile in variant pre-compile, post-build-variant-multiplicity=true, post-build-variant-value=true, set at post-build in variant post-build / pre-compile in variant pre-compile  # Sets the number of N-PDUs the CanTp receiver allows the sender to send, before waiting for an authorization to continue transmission of the following N-PDUs.For further details on this parameter value see ISO 15765-2 specification.
          float CanTpNar [0..1]: 0..INF, multiplicity set at post-build in variant post-build / pre-compile in variant pre-compile, post-build-variant-multiplicity=true, post-build-variant-value=true, set at post-build in variant post-build / pre-compile in variant pre-compile  # Value in seconds of the N_Ar timeout. N_Ar is the time for transmission of a CAN frame (any N_PDU) on the receiver side.
          float CanTpNbr [0..1]: 0..INF, post-build-variant-value=true, set at post-build in variant post-build / pre-compile in variant pre-compile  # Value in seconds of the performance requirement for (N_Br + N_Ar). N_Br is the elapsed time between the receiving indication of a FF or CF or the transmit confirmation of a FC, until the transmit request of the next FC.
          float CanTpNcr [0..1]: 0..INF, multiplicity set at post-build in variant post-build / pre-compile in variant pre-compile, post-build-variant-multiplicity=true, post-build-variant-value=true, set at post-build in variant post-build / pre-compile in variant pre-compile  # Value in seconds of the N_Cr timeout. N_Cr is the time until reception of the next Consecutive Frame N_PDU.
          enumeration CanTpRxAddressingFormat: {CANTP_EXTENDED, CANTP_MIXED, CANTP_MIXED29BIT, CANTP_NORMALFIXED, CANTP_STANDARD}, set at pre-compile  # Declares which communication addressing mode is supported for this RxNSdu. Definition of Enumeration values: | CanTpStandard to use normal addressing format. CanTpExtended to use extended addressing format. CanTpMixed to use mixed 11 bit addressing format. CanTpNormalFixed to use normal fixed addressing format. CanTpMixed29Bit to use mixed 29 bit addressing format.
          integer CanTpRxNSduId: 0..65535, set at pre-compile, symbolic-name-value=true, with-auto=true  # Unique identifier user by the upper layer to call CanTp_CancelReceive, CanTp_ChangeParameter and CanTp_ReadParameter.
          enumeration CanTpRxPaddingActivation: {CANTP_OFF, CANTP_ON}, post-build-variant-value=true, set at post-build in variant post-build / pre-compile in variant pre-compile  # Defines if the received frame uses padding or not. This parameter is restricted to 8 bytes N-PDUs. | Definition of enumeration values: CanTpOn: The N-PDU received uses padding for SF, FC and the last CF. (N-PDU length is always >= 8 bytes in case of CAN 2.0) CanTpOff: The N-PDU received does not use padding for SF, FC and the last CF. (N-PDU length is dynamic - any valid DLC value). Note: The mandatory mapping to the next higher valid DLC value for N-PDUs with a length > 8 bytes is not affected by this parameter.
          enumeration CanTpRxTaType: {CANTP_FUNCTIONAL, CANTP_PHYSICAL}, set at pre-compile  # Declares the communication type of this Rx N-SDU.
          integer CanTpRxWftMax [0..1]: 0..65535, multiplicity set at post-build in variant post-build / pre-compile in variant pre-compile, post-build-variant-multiplicity=true, post-build-variant-value=true, set at post-build in variant post-build / pre-compile in variant pre-compile  # This parameter indicates how many Flow Control wait N-PDUs can be consecutively transmitted by the receiver. It is local to the node and is not transmitted inside the FC protocol data unit. | CanTpRxWftMax is used to avoid sender nodes being potentially hooked-up in case of a temporarily reception inability on the part of the receiver nodes, whereby the sender could be waiting continuously.
          float CanTpSTmin [0..1]: 0..INF, multiplicity set at post-build in variant post-build / pre-compile in variant pre-compile, post-build-variant-multiplicity=true, post-build-variant-value=true, set at post-build in variant post-build / pre-compile in variant pre-compile  # Sets the duration of the minimum time the CanTp sender shall wait between the transmissions of two CF N-PDUs. | For further details on this parameter value see ISO 15765-2 specification.
          reference CanTpRxNSduRef: post-build-variant-value=true, set at post-build in variant post-build / pre-compile in variant pre-compile, destination=Pdu  # Reference to a Pdu in the COM-Stack.
          container CanTpNAe [0..1]  # This container is required for each RxNSdu and TxNSdu with AddressingFormat CANTP_MIXED or CANTP_MIXED29BIT.
            integer CanTpNAe: 0..255, set at pre-compile  # This parameter contains the transport protocol address extension value.
          container CanTpNSa [0..1]  # This container is required for each RxNSdu and TxNSdu with RxTaType CANTP_PHYSICAL and CanTpAddressingFormat CANTP_EXTENDED. When DynIdSupport is enabled, this container is also required for each TxNSdu with AddressingFormat CANTP_NORMALFIXED or CANTP_MIXED29BIT. When DynIdSupport is enabled and GenericConnectionSupport is not enabled, this container is also required for each RxNSdu with AddressingFormat CANTP_NORMALFIXED or CANTP_MIXED29BIT.
            integer CanTpNSa: 0..255, set at pre-compile  # This parameter contains the transport protocol source address value.
          container CanTpNTa [0..1]  # This container is required for each RxNSdu and TxNSdu with AddressingFormat CANTP_EXTENDED. When DynIdSupport is enabled, this container is also required for each RxNSdu with AddressingFormat CANTP_NORMALFIXED or CANTP_MIXED29BIT. When DynIdSupport is enabled and GenericConnectionSupport is not enabled, this container is also required for each TxNSdu with AddressingFormat CANTP_NORMALFIXED or CANTP_MIXED29BIT.
            integer CanTpNTa: 0..255, set at pre-compile  # This parameter contains the transport protocol target address value.
          container CanTpRxNPdu  # Used for grouping of the ID of a PDU and the Reference to a PDU. This N-PDU consumes a meta data item of type CAN_ID_32.
            integer CanTpRxNPduId: 0..65535, set at pre-compile, symbolic-name-value=true, with-auto=true  # The N-PDU identifier attached to the RxNsdu is identified by CanTpRxNSduId. | Each RxNsdu identifier is linked to only one SF/FF/CF N-PDU identifier. Nevertheless, in the case of extended or mixed addressing format, the same N-PDU identifier can be used for several N-SDU identifiers. The distinction is made by the N_TA or N_AE value (first data byte of SF or FF frames).
            reference CanTpRxNPduRef: post-build-variant-value=true, set at post-build in variant post-build / pre-compile in variant pre-compile, destination=Pdu  # Reference to a Pdu in the COM-Stack.
          container CanTpTxFcNPdu [0..1]  # Used for grouping of the ID of a PDU and the Reference to a PDU. This N-PDU produces a meta data item of type CAN_ID_32.
            integer CanTpTxFcNPduConfirmationPduId: 0..65535, set at pre-compile, symbolic-name-value=true, with-auto=true  # Handle Id to be used by the LSduR to confirm the transmission of the CanTpTxFcNPdu to the LSduR module.
            reference CanTpTxFcNPduRef: post-build-variant-value=true, set at post-build in variant post-build / pre-compile in variant pre-compile, destination=Pdu  # Reference to a Pdu in the COM-Stack.
        container CanTpTxNSdu [0..*]: multiplicity set at post-build in variant post-build / pre-compile in variant pre-compile, post-build-variant-multiplicity=true  # The following parameters needs to be configured for each CAN N-SDU that the CanTp module transmits via the CanTpChannel. This N-SDU consumes meta data items of type SOURCE_ADDRESS_16, TARGET_ADDRESS_16 and ADDRESS_EXTENSION_8.
          float CanTpNas: 0..INF, post-build-variant-value=true, set at post-build in variant post-build / pre-compile in variant pre-compile  # Value in second of the N_As timeout. N_As is the time for transmission of a CAN frame (any N_PDU) on the part of the sender.
          float CanTpNbs [0..1]: 0..INF, multiplicity set at post-build in variant post-build / pre-compile in variant pre-compile, post-build-variant-multiplicity=true, post-build-variant-value=true, set at post-build in variant post-build / pre-compile in variant pre-compile  # Value in seconds of the N_Bs timeout. N_Bs is the time of transmission until reception of the next Flow Control N_PDU.
          float CanTpNcs [0..1]: 0..INF, multiplicity set at post-build in variant post-build / pre-compile in variant pre-compile, post-build-variant-multiplicity=true, post-build-variant-value=true, set at post-build in variant post-build / pre-compile in variant pre-compile  # Value in seconds of the performance requirements relating to N_Cs. CanTpNcs is the time in which CanTp is allowed to request from PduR the Tx data of a Consecutive Frame N_PDU.
          boolean CanTpTc: set at pre-compile  # Switch for enabling Transmit Cancellation.
          enumeration CanTpTxAddressingFormat: {CANTP_EXTENDED, CANTP_MIXED, CANTP_MIXED29BIT, CANTP_NORMALFIXED, CANTP_STANDARD}, set at pre-compile  # Declares which communication addressing format is supported for this TxNSdu. Definition of Enumeration values: | CanTpStandard to use normal addressing format. CanTpExtended to use extended addressing format. CanTpMixed to use mixed 11 bit addressing format. CanTpNormalFixed to use normal fixed addressing format. CanTpMixed29Bit to use mixed 29 bit addressing format.
          integer CanTpTxNSduId: 0..65535, set at pre-compile, symbolic-name-value=true, with-auto=true  # Unique identifier to a structure that contains all useful information to process the transmission of a TxNsdu.
          enumeration CanTpTxPaddingActivation: {CANTP_OFF, CANTP_ON}, post-build-variant-value=true, set at post-build in variant post-build / pre-compile in variant pre-compile  # Defines if the transmit frame use padding or not. This parameter is restricted to 8 byte N-PDUs. | Definition of Enumeration values: CanTpOn The transmit N-PDU uses padding for SF, FC and the last CF. (N-PDU length is always 8 bytes in case of CAN 2.0) CanTpOff The transmit N-PDU does not use padding for SF, CF and the last CF. (N-PDU length is dynamic - any valid DLC value). Note: The mandatory mapping to the next higher valid DLC value for N-PDUs with a length > 8 bytes is not affected by this parameter.
          enumeration CanTpTxTaType: {CANTP_FUNCTIONAL, CANTP_PHYSICAL}, set at pre-compile  # Declares the communication type of this TxNsdu. | Enumeration values: CanTpPhysical. Used for 1:1 communication. CanTpFunctional. Used for 1:n communication.
          reference CanTpTxNSduRef: post-build-variant-value=true, set at post-build in variant post-build / pre-compile in variant pre-compile, destination=Pdu  # Reference to a Pdu in the COM-Stack.
          container CanTpNAe [0..1]  # This container is required for each RxNSdu and TxNSdu with AddressingFormat CANTP_MIXED or CANTP_MIXED29BIT.
            integer CanTpNAe: 0..255, set at pre-compile  # This parameter contains the transport protocol address extension value.
          container CanTpNSa [0..1]  # This container is required for each RxNSdu and TxNSdu with RxTaType CANTP_PHYSICAL and CanTpAddressingFormat CANTP_EXTENDED. When DynIdSupport is enabled, this container is also required for each TxNSdu with AddressingFormat CANTP_NORMALFIXED or CANTP_MIXED29BIT. When DynIdSupport is enabled and GenericConnectionSupport is not enabled, this container is also required for each RxNSdu with AddressingFormat CANTP_NORMALFIXED or CANTP_MIXED29BIT.
            integer CanTpNSa: 0..255, set at pre-compile  # This parameter contains the transport protocol source address value.
          container CanTpNTa [0..1]  # This container is required for each RxNSdu and TxNSdu with AddressingFormat CANTP_EXTENDED. When DynIdSupport is enabled, this container is also required for each RxNSdu with AddressingFormat CANTP_NORMALFIXED or CANTP_MIXED29BIT. When DynIdSupport is enabled and GenericConnectionSupport is not enabled, this container is also required for each TxNSdu with AddressingFormat CANTP_NORMALFIXED or CANTP_MIXED29BIT.
            integer CanTpNTa: 0..255, set at pre-compile  # This parameter contains the transport protocol target address value.
          container CanTpRxFcNPdu [0..1]  # Used for grouping of the ID of a PDU and the Reference to a PDU. This N-PDU consumes a meta data item of type CAN_ID_32.
            integer CanTpRxFcNPduId: 0..65535, set at pre-compile, symbolic-name-value=true, with-auto=true  # N-PDU identifier attached to the FC N-PDU of this TxNsdu identified by CanTpTxNSduId. | Each TxNsdu identifier is linked to one Rx FC N-PDU identifier only. However, in the case of extended addressing format, the same FC N-PDU identifier can be used for several N-SDU identifiers. The distinction is made by means of the N_TA value (first data byte of FC frames).
            reference CanTpRxFcNPduRef: post-build-variant-value=true, set at post-build in variant post-build / pre-compile in variant pre-compile, destination=Pdu  # Reference to a Pdu in the COM-Stack.
          container CanTpTxNPdu  # Used for grouping of the ID of a PDU and the Reference to a PDU. This N-PDU produces a meta data item of type CAN_ID_32.
            integer CanTpTxNPduConfirmationPduId: 0..65535, set at pre-compile, symbolic-name-value=true, with-auto=true  # Handle Id to be used by the LSduR to confirm the transmission of the CanTpTxNPdu to the LSduR module.
            reference CanTpTxNPduRef: post-build-variant-value=true, set at post-build in variant post-build / pre-compile in variant pre-compile, destination=Pdu  # Reference to a Pdu in the COM-Stack.
    container CanTpDemEventParameterRefs [0..1]: multiplicity set at pre-compile  # Container for the references to DemEventParameter elements which shall be invoked using the API Dem_SetEventStatus in case the corresponding error occurs. The Event Id is taken from the referenced DemEventParameter's DemEventId symbolic value. | The standardized errors are provided in this container and can be extended by vendor-specific error references.
      reference CANTP_E_CANTPNAR_TIMEOUT_OCCURRED [0..1]: scope=ECU, multiplicity set at pre-compile, set at pre-compile, requires-symbolic-name-value=true, destination=DemEventParameter  # A Reference to DemEventParameter element which shall be invoked using the API Dem_SetEventStatus in case CANTP_E_CANTPNAR_TIMEOUT_OCCURRED error occurs. The EventId is taken from the referenced DemEventParameter's DemEventId symbolic value.
      reference CANTP_E_CANTPNAS_TIMEOUT_OCCURRED [0..1]: scope=ECU, multiplicity set at pre-compile, set at pre-compile, requires-symbolic-name-value=true, destination=DemEventParameter  # A Reference to DemEventParameter element which shall be invoked using the API Dem_SetEventStatus in case CANTP_E_CANTPNAS_TIMEOUT_OCCURRED error occurs. The EventId is taken from the referenced DemEventParameter's DemEventId symbolic value.
      reference CANTP_E_CANTPNBR_TIMEOUT_OCCURRED [0..1]: scope=ECU, multiplicity set at pre-compile, set at pre-compile, requires-symbolic-name-value=true, destination=DemEventParameter  # A Reference to DemEventParameter element which shall be invoked using the API Dem_SetEventStatus in case CANTP_E_CANTPNBR_TIMEOUT_OCCURRED error occurs. The EventId is taken from the referenced DemEventParameter's DemEventId symbolic value.
      reference CANTP_E_CANTPNBS_TIMEOUT_OCCURRED [0..1]: scope=ECU, multiplicity set at pre-compile, set at pre-compile, requires-symbolic-name-value=true, destination=DemEventParameter  # A Reference to DemEventParameter element which shall be invoked using the API Dem_SetEventStatus in case CANTP_E_CANTPNBS_TIMEOUT_OCCURRED error occurs. The EventId is taken from the referenced DemEventParameter's DemEventId symbolic value.
      reference CANTP_E_CANTPNCR_TIMEOUT_OCCURRED [0..1]: scope=ECU, multiplicity set at pre-compile, set at pre-compile, requires-symbolic-name-value=true, destination=DemEventParameter  # A Reference to DemEventParameter element which shall be invoked using the API Dem_SetEventStatus in case CANTP_E_CANTPNCR_TIMEOUT_OCCURRED error occurs. The EventId is taken from the referenced DemEventParameter's DemEventId symbolic value.
      reference CANTP_E_CANTPNCS_TIMEOUT_OCCURRED [0..1]: scope=ECU, multiplicity set at pre-compile, set at pre-compile, requires-symbolic-name-value=true, destination=DemEventParameter  # A Reference to DemEventParameter element which shall be invoked using the API Dem_SetEventStatus in case CANTP_E_CANTPNCS_TIMEOUT_OCCURRED error occurs. The EventId is taken from the referenced DemEventParameter's DemEventId symbolic value.
      reference CANTP_E_DROPPED_CONSECUTIVE_FRAMES_DETECTED [0..1]: scope=ECU, multiplicity set at pre-compile, set at pre-compile, requires-symbolic-name-value=true, destination=DemEventParameter  # A Reference to DemEventParameter element which shall be invoked using the API Dem_SetEventStatus in case CANTP_E_DROPPED_CONSECUTIVE_FRAMES_DETECTED error occurs. The EventId is taken from the referenced DemEventParameter's DemEventId symbolic value.
      reference CANTP_E_FC_OVERFLOW_RECEIVED [0..1]: scope=ECU, multiplicity set at pre-compile, set at pre-compile, requires-symbolic-name-value=true, destination=DemEventParameter  # A Reference to DemEventParameter element which shall be invoked using the API Dem_SetEventStatus in case CANTP_E_FC_OVERFLOW_RECEIVED error occurs. The EventId is taken from the referenced DemEventParameter's DemEventId symbolic value.
      reference CANTP_E_FC_OVERFLOW_TRANSMITTED [0..1]: scope=ECU, multiplicity set at pre-compile, set at pre-compile, requires-symbolic-name-value=true, destination=DemEventParameter  # A Reference to DemEventParameter element which shall be invoked using the API Dem_SetEventStatus in case CANTP_E_FC_OVERFLOW_TRANSMITTED error occurs. The EventId is taken from the referenced DemEventParameter's DemEventId symbolic value.
      reference CANTP_E_SWAPPED_CONSECUTIVE_FRAMES_RECEIVED [0..1]: scope=ECU, multiplicity set at pre-compile, set at pre-compile, requires-symbolic-name-value=true, destination=DemEventParameter  # A Reference to DemEventParameter element which shall be invoked using the API Dem_SetEventStatus in case CANTP_E_SWAPPED_CONSECUTIVE_FRAMES_RECEIVED error occurs. The EventId is taken from the referenced DemEventParameter's DemEventId symbolic value.
    container CanTpGeneral  # This container contains the general configuration parameters of the CanTp module.
      boolean CanTpChangeParameterApi: set at pre-compile  # This parameter, if set to true, enables the CanTp_ChangeParameterRequest Api for this Module.
      boolean CanTpDevErrorDetect: set at pre-compile, default-value=false  # Switches the development error detection and notification on or off. | * true: detection and notification is enabled. * false: detection and notification is disabled.
      boolean CanTpDynIdSupport [0..1]: multiplicity set at pre-compile, set at pre-compile, default-value=false  # Enable support for dynamic ID handling via N-PDU MetaData.
      boolean CanTpEnableSecurityEventReporting: scope=ECU, set at pre-compile, default-value=false  # Switches the reporting of security events to the IdsM: | * true: reporting is enabled. * false: reporting is disabled.
      boolean CanTpFlexibleDataRateSupport [0..1]: set at pre-compile, default-value=true  # Enable support for CAN FD frames.
      boolean CanTpGenericConnectionSupport [0..1]: multiplicity set at pre-compile, set at pre-compile, default-value=false  # Enable support for the handling of generic connections using N-SDUs with MetaData. Requires CanTpDynIdSupport.
      integer CanTpPaddingByte: 0..255, set at pre-compile  # Used for the initialization of unused bytes with a certain value
      boolean CanTpReadParameterApi: set at pre-compile  # This parameter, if set to true, enables the CanTp_ReadParameterApi for this module.
      boolean CanTpVersionInfoApi: set at pre-compile, default-value=false  # The function CanTp_GetVersionInfo is configurable (On/Off) by this configuration parameter.
      container CanTpEnableSecurityEventRefs [0..1]: multiplicity set at pre-compile  # Container for the references to IdsMEvent elements representing the security events that the CanTp module shall report to the IdsM in case the coresponding security related event occurs (and if CanTpEnableSecurityEventReporting is set to "true"). The standardized security events in this container can be extended by vendor-specific security events.
        reference SEV_CAN_ERROR_INVALID_FS [0..1]: scope=ECU, multiplicity set at pre-compile, set at pre-compile, requires-symbolic-name-value=true, destination=IdsMEvent  # Flow Control with invalid Flow Status received.
        reference SEV_CAN_ERROR_NO_BUFFER [0..1]: scope=ECU, multiplicity set at pre-compile, set at pre-compile, requires-symbolic-name-value=true, destination=IdsMEvent  # Flow Control with OVFLW Flow Status received.
        reference SEV_CAN_ERROR_PADDING [0..1]: scope=ECU, multiplicity set at pre-compile, set at pre-compile, requires-symbolic-name-value=true, destination=IdsMEvent  # PDU received with a length smaller than 8 bytes (i.e. PduInfoPtr.SduLength < 8).
        reference SEV_CAN_ERROR_TIMEOUT_A [0..1]: scope=ECU, multiplicity set at pre-compile, set at pre-compile, requires-symbolic-name-value=true, destination=IdsMEvent  # N_Ar timeout.
        reference SEV_CAN_ERROR_TIMEOUT_BS [0..1]: scope=ECU, multiplicity set at pre-compile, set at pre-compile, requires-symbolic-name-value=true, destination=IdsMEvent  # N_Bs timeout.
        reference SEV_CAN_ERROR_TIMEOUT_CR [0..1]: scope=ECU, multiplicity set at pre-compile, set at pre-compile, requires-symbolic-name-value=true, destination=IdsMEvent  # N_Cr timeout.
        reference SEV_CAN_ERROR_UNEXP_PDU [0..1]: scope=ECU, multiplicity set at pre-compile, set at pre-compile, requires-symbolic-name-value=true, destination=IdsMEvent  # Unexpected protocol data unit received (segmented reception in progress).
        reference SEV_CAN_ERROR_WFT_OVRN [0..1]: scope=ECU, multiplicity set at pre-compile, set at pre-compile, requires-symbolic-name-value=true, destination=IdsMEvent  # The Flow Control WAIT frame exceeded the maximum counter N_WFTmax received.
        reference SEV_CAN_ERROR_WRONG_SN [0..1]: scope=ECU, multiplicity set at pre-compile, set at pre-compile, requires-symbolic-name-value=true, destination=IdsMEvent  # Invalid sequence number value received.
        reference SEV_CAN_INVALID_TATYPE [0..1]: scope=ECU, multiplicity set at pre-compile, set at pre-compile, requires-symbolic-name-value=true, destination=IdsMEvent  # Multi-frame reception occurs with a handle whose communication type is functional.
  module definition CanTrcv [0..*]: post-build-variant-support=true, variants link-time/post-build/pre-compile  # Configuration of the CanTrcv (CAN Transceiver driver) module.
    container CanTrcvConfigSet  # This container contains the configuration parameters and sub containers of the AUTOSAR CanTrcv module.
      integer CanTrcvSPICommRetries [0..1]: 0..255, post-build-variant-value=true, set at link in variant link-time / post-build in variant post-build / pre-compile in variant pre-compile, default-value=0  # Indicates the maximum number of communication retries in case of a failed SPI communication (applies both to timed out communication and to errors/NACK in the response data). | If configured value is '0', no retry is allowed (communication is expected to succeed at first try).
      integer CanTrcvSPICommTimeout [0..1]: 0..100, post-build-variant-value=true, set at link in variant link-time / post-build in variant post-build / pre-compile in variant pre-compile, default-value=0  # Indicates the maximum time allowed to the CanTrcv for replying (either positively or negatively) to a SPI command. | Timeout is configured in milliseconds. Timeout value of '0' means that no specific timeout is to be used by CanTrcv and the communication is executed at the best of the SPI HW capacity.
      container CanTrcvChannel [1..*]: multiplicity set at pre-compile  # Container gives CAN transceiver driver information about a single CAN | transceiver (channel).
        integer CanTrcvChannelId: 0..255, scope=ECU, set at pre-compile, symbolic-name-value=true, with-auto=true  # Unique identifier of the CAN Transceiver Channel.
        boolean CanTrcvChannelUsed: set at pre-compile, default-value=true  # Shall the related CAN transceiver channel be used?
        boolean CanTrcvControlsPowerSupply: set at pre-compile, default-value=false  # Is ECU power supply controlled by this transceiver? | TRUE = Controlled by transceiver. FALSE = Not controlled by transceiver.
        boolean CanTrcvHwPnSupport: set at pre-compile, default-value=false  # Indicates whether the HW supports the selective wake-up function | TRUE = Selective wakeup feature is supported by the transceiver FALSE = Selective wakeup functionality is not available in transceiver
        enumeration CanTrcvInitState: {CANTRCV_OP_MODE_SLEEP, CANTRCV_OP_MODE_STANDBY}, set at pre-compile  # State of CAN transceiver after call to CanTrcv_Init.
        integer CanTrcvMaxBaudrate: 0..20000, set at pre-compile  # Indicates the data transfer rate in kbps. | Maximum data transfer rate in kbps for transceiver hardware type. Only used for validation purposes. This value can be used by configuration tools.
        boolean CanTrcvWakeupByBusUsed [0..1]: multiplicity set at pre-compile, set at pre-compile, default-value=false  # Is wake up by bus supported? If CAN transceiver hardware does not support wake up by bus value is always FALSE. If CAN transceiver hardware supports wake up by bus value is TRUE or FALSE depending whether it is used or not. | TRUE = Is used. FALSE = Is not used.
        reference CanTrcvChannelEcucPartitionRef [0..1]: scope=ECU, multiplicity set at pre-compile, post-build-variant-multiplicity=true, post-build-variant-value=true, set at pre-compile, destination=EcucPartition  # Maps the CAN transceiver channel to zero or one ECUC partitions. The ECUC partition referenced is a subset of the ECUC partitions where the CAN transceiver driver is mapped to.
        reference CanTrcvIcuChannelRef [0..1]: multiplicity set at pre-compile, set at pre-compile, requires-symbolic-name-value=true, destination=IcuChannel  # Reference to the IcuChannel to enable/disable the interrupts | for wakeups.
        reference CanTrcvPorWakeupSourceRef [0..1]: scope=ECU, multiplicity set at pre-compile, set at pre-compile, requires-symbolic-name-value=true, destination=EcuMWakeupSource  # Symbolic name reference to specify the wakeup sources that should be used in the calls to EcuM_SetWakeupEvent as specified in [SWS_CanTrcv_00183] and [SWS_CanTrcv_00184]. | This reference is mandatory if the HW supports POR or SYSERR flags
        reference CanTrcvSyserrWakeupSourceRef [0..1]: scope=ECU, multiplicity set at pre-compile, set at pre-compile, requires-symbolic-name-value=true, destination=EcuMWakeupSource  # Symbolic name reference to specify the wakeup sources that should be used in the calls to EcuM_SetWakeupEvent as specified in [SWS_CanTrcv_00183] and [SWS_CanTrcv_00184] | This reference is mandatory if the HW supports POR or SYSERR flags
        reference CanTrcvWakeupSourceRef [0..1]: scope=ECU, multiplicity set at pre-compile, set at pre-compile, requires-symbolic-name-value=true, destination=EcuMWakeupSource  # Reference to a wakeup source in the EcuM configuration. | This reference is only needed if CanTrcvWakeupByBusUsed is true.
        choice container CanTrcvAccess  # Container gives CanTrcv Driver information about access to a single CAN transceiver.
          container CanTrcvDioAccess [0..1]  # Container gives CAN transceiver driver information about accessing ports and port pins. In addition relation between CAN transceiver hardware pin names and Dio port access information is given. | If a CAN transceiver hardware has no Dio interface, there is no instance of this container.
            container CanTrcvDioChannelAccess [1..*]  # Container gives DIO channel access by single Can transceiver channel.
              string CanTrcvHardwareInterfaceName: set at pre-compile  # CAN transceiver hardware interface name. It is typically the name of a pin. From a Dio point of view it is either a port, a single channel or a channel group. Depending on this fact either | CANTRCV_DIO_PORT_SYMBOLIC_NAME or CANTRCV_DIO_CHANNEL_SYMBOLIC_NAME or CANTRCV_DIO_CHANNEL_GROUP_SYMBOLIC_NAME shall reference a Dio configuration. The CAN transceiver driver implementation description shall list up this name for the appropriate CAN transceiver hardware.
              choice reference CanTrcvDioSymNameRef: set at pre-compile, destination=[DioChannel, DioChannelGroup, DioPort]  # Choice Reference to a DIO Port, DIO Channel or DIO Channel Group. This reference replaces the CANTRCV_DIO_PORT_SYM_NAME, CANTRCV_DIO_CHANNEL_SYM_NAME and CANTRCV_DIO_GROUP_SYM_NAME references in the Can Trcv SWS.
          container CanTrcvSpiAccess [0..1]  # Container gives CAN transceiver driver information about accessing Spi. If a CAN transceiver hardware has no Spi interface, there is no instance of this container.
            container CanTrcvSpiSequence [1..*]  # Container gives CAN transceiver driver information about one SPI sequence. | One SPI sequence used by CAN transceiver driver is in exclusive use for it. No other driver is allowed to access this sequence. CAN transceiver driver may use one sequence to access n CAN transceiver hardwares chips of the same type or n sequences are used to access one single CAN transceiver hardware chip. If a CAN transceiver hardware has no SPI interface, there is no instance of this container.
              boolean CanTrcvSpiAccessSynchronous [0..1]: multiplicity set at pre-compile, set at pre-compile, default-value=false  # This parameter is used to define whether the access to the Spi sequence is synchronous or asynchronous. | true: SPI access is synchronous. false: SPI access is asynchronous.
              reference CanTrcvSpiSequenceName [0..*]: multiplicity set at pre-compile, set at pre-compile, requires-symbolic-name-value=true, destination=SpiSequence  # Reference to a Spi sequence configuration container.
        container CanTrcvDemEventParameterRefs [0..1]  # Container for the references to DemEventParameter elements which shall be invoked using the API Dem_SetEventStatus in case the corresponding error occurs. The EventId is taken from the referenced DemEventParameter's DemEventId symbolic value. The standardized errors are provided in this container and can be extended by vendor-specific error references.
          reference CANTRCV_E_BUS_ERROR [0..1]: scope=ECU, multiplicity set at pre-compile, set at pre-compile, requires-symbolic-name-value=true, destination=DemEventParameter  # Reference to the DemEventParameter which shall be issued when bus error has occurred.
        container CanTrcvPartialNetwork [0..1]  # Container gives CAN transceiver driver information about the configuration of Partial Networking functionality.
          integer CanTrcvBaudRate: 0..12000, post-build-variant-value=true, set at link in variant link-time / post-build in variant post-build / pre-compile in variant pre-compile  # Indicates the data transfer rate in kbps.
          boolean CanTrcvBusErrFlag: post-build-variant-value=true, set at link in variant link-time / post-build in variant post-build / pre-compile in variant pre-compile, default-value=false  # Indicates if the Bus Error (BUSERR) flag is managed by the BSW. This flag is set if a bus failure is detected by the transceiver. | TRUE = Supported by transceiver and managed by BSW. FALSE = Not managed by BSW.
          boolean CanTrcvPnCanIdIsExtended: post-build-variant-value=true, set at link in variant link-time / post-build in variant post-build / pre-compile in variant pre-compile, default-value=false  # Indicates whether extended or standard ID is used. | TRUE = Extended Can identifier is used. FALSE = Standard Can identifier is used
          boolean CanTrcvPnEnabled: post-build-variant-value=true, set at link in variant link-time / post-build in variant post-build / pre-compile in variant pre-compile, default-value=false  # Indicates whether the selective wake-up function is enabled or disabled in HW. | TRUE = Selective wakeup feature is enabled in the transceiver hardware FALSE = Selective wakeup feature is disabled in the transceiver hardware
          integer CanTrcvPnFrameCanId: 0..4294967295, post-build-variant-value=true, set at link in variant link-time / post-build in variant post-build / pre-compile in variant pre-compile  # CAN ID of the Wake-up Frame (WUF).
          integer CanTrcvPnFrameCanIdMask: 0..4294967295, post-build-variant-value=true, set at link in variant link-time / post-build in variant post-build / pre-compile in variant pre-compile  # ID Mask for the selective activation of the transceiver. It is used to enableFrame Wake-up (WUF) on a group of IDs.
          integer CanTrcvPnFrameDlc: 0..8, post-build-variant-value=true, set at link in variant link-time / post-build in variant post-build / pre-compile in variant pre-compile  # Data Length of the Wake-up Frame (WUF).
          boolean CanTrcvPowerOnFlag: post-build-variant-value=true, set at link in variant link-time / post-build in variant post-build / pre-compile in variant pre-compile, default-value=false  # Description: Indicates if the Power On Reset (POR) flag is available and is managed by the transceiver. | TRUE = Supported by Hardware. FALSE = Not supported by Hardware
          container CanTrcvPnFrameDataMaskSpec [0..8]  # Defines data payload mask to be used on the received payload in order to determine if the transceiver must be woken up by the received Wake-up Frame (WUF).
            integer CanTrcvPnFrameDataMask: 0..255, post-build-variant-value=true, set at link in variant link-time / post-build in variant post-build / pre-compile in variant pre-compile  # Defines the n byte (Byte0 = LSB) of the data payload mask to be used on the received payload in order to determine if the transceiver must be woken up by the received Wake-up Frame (WUF).
            integer CanTrcvPnFrameDataMaskIndex: 0..7, post-build-variant-value=true, set at link in variant link-time / post-build in variant post-build / pre-compile in variant pre-compile  # holds the position n in frame of the mask-part
        container CanXLTrcvChannel [0..1]: multiplicity set at pre-compile  # This container is specified in the SWS CAN XL Transceiver Driver and represents a CAN XL transceiver channel. If this container is present, the CAN transceiver will provide the extended CanXLTrcv API.
          reference CanXLTrcvEthEcucPartitionRef [0..1]: multiplicity set at pre-compile, set at pre-compile, destination=EcucPartition  # Maps the Ethernet Interface access to the CAN XL transceiver channel to zero or one ECUC partitions.
    container CanTrcvGeneral  # Container gives CAN transceiver driver basic information.
      boolean CanTrcvDevErrorDetect: set at pre-compile, default-value=false  # Switches the development error detection and notification on or off. | * true: detection and notification is enabled. * false: detection and notification is disabled.
      integer CanTrcvIndex: 0..255, set at pre-compile, with-auto=true  # Specifies the InstanceId of this module instance. If only one instance is present it shall have the Id 0.
      float CanTrcvMainFunctionDiagnosticsPeriod [0..1]: 0..INF, multiplicity set at pre-compile, set at pre-compile  # This parameter describes the period for cyclic call to CanTrcv_MainFunctionDiagnostics. Unit is seconds.
      float CanTrcvMainFunctionPeriod [0..1]: 0..INF, multiplicity set at pre-compile, set at pre-compile  # This parameter describes the period for cyclic call to CanTrcv_MainFunction. Unit is seconds.
      enumeration CanTrcvTimerType [0..1]: {None, Timer_1us16bit}, multiplicity set at pre-compile, set at pre-compile  # Type of the Time Service Predefined Timer.
      boolean CanTrcvVersionInfoApi: set at pre-compile, default-value=false  # Switches version information API on and off. If switched off, function need not be present in compiled code.
      float CanTrcvWaitTime [0..1]: 0..2.55E-4, multiplicity set at pre-compile, set at pre-compile  # Wait time for transceiver state changes in seconds.
      enumeration CanTrcvWakeUpSupport: {CANTRCV_WAKEUP_BY_POLLING, CANTRCV_WAKEUP_NOT_SUPPORTED}, set at pre-compile  # Informs whether wake up is supported by polling or not supported. In case no | wake up is supported by the hardware, setting has to be NOT_SUPPORTED. Only in the case of wake up supported by polling, function CanTrcv_MainFunction has to be present and to be invoked by the scheduler.
      reference CanTrcvEcucPartitionRef [0..*]: scope=ECU, multiplicity set at pre-compile, post-build-variant-multiplicity=true, post-build-variant-value=true, set at pre-compile, destination=EcucPartition  # Maps the CAN transceiver driver to zero or multiple ECUC partitions to make the modules API available in this partition.
  module definition Cdd [0..*]: post-build-variant-support=true, variants link-time/post-build/pre-compile  # The CDD module describes the minimal requirements that are necessary for the configuration of a CDD with respect to the surrounding standardized BSW modules.
    container CddComStackContribution [0..1]  # Contribution of COM Stack modules.
      container CddComIfUpperLayerContribution [0..1]  # Parameters that are necessary for the configuration of a Complex Driver that serves as the UpperLayer of the Com Interface module.
        container CddComIfUpperLayerRxPdu [0..*]  # This container specifies Rx PDUs that are exchanged between the CDD and the standardized BSW module.
          integer CddComIfHandleId [0..1]: 0..65535, symbolic-name-value=true, with-auto=true  # ECU wide unique, symbolic handle for the Pdu.
          reference CddComIfPduRef: destination=Pdu  # Reference to the "global" Pdu structure to allow harmonization of handle IDs in the COM-Stack.
        container CddComIfUpperLayerTxPdu [0..*]  # This container specifies Tx PDUs that are exchanged between the CDD and the standardized BSW module.
          integer CddComIfHandleId [0..1]: 0..65535, symbolic-name-value=true, with-auto=true  # ECU wide unique, symbolic handle for the Pdu.
          reference CddComIfPduRef: destination=Pdu  # Reference to the "global" Pdu structure to allow harmonization of handle IDs in the COM-Stack.
      container CddComMLowerLayerContribution [0..1]  # Parameters that are necessary for the configuration of a Complex Driver that serves as the LowerLayer of the Communication Manager module.
        container CddComMLowerLayerChannel [1..*]  # This container contains the network specific parameters.
          reference CddComMLowerLayerChannelRef: requires-symbolic-name-value=true, destination=ComMChannel  # Unique handle to identify one certain network. Reference to one of the network handles configured for the ComM.
      container CddGenericNmLowerLayerContribution [0..1]  # Parameters that are necessary for the configuration of a Complex Driver that serves as the LowerLayer of the Generic NM module.
        container CddGenericNmLowerLayerChannel [1..*]  # NM Channel specific configuration parameters.
          reference CddGenericNmComMNetworkHandleRef: requires-symbolic-name-value=true, destination=ComMChannel  # This reference points to the unique channel defined by the ComMChannel and provides access to the unique channel index value in ComMChannelId.
      container CddJ1939RmContribution [0..1]  # Contribution of J1939Rm module
        boolean CddJ1939RmAckIndication  # Defines whether the <User>_AckIndication callback function is implemented.
        boolean CddJ1939RmRequestIndication  # Defines whether the <User>_RequestIndication callback function is implemented.
        boolean CddJ1939RmRequestTimeoutIndication  # Defines whether the <User>_RequestTimeoutIndication callback function is implemented.
      container CddLSduRLowerLayerContribution [0..1]  # Parameters that are necessary for the configuration of a Complex Driver that serves as the LowerLayer of the L-Sdu Router module. Tags: atp.Status=draft
        container CddLSduRLowerLayerRxPdu [0..*]  # This container specifies Rx PDUs that are exchanged between a lower layer CDD and the L-Sdu Router. Tags: atp.Status=draft
          integer CddLSduRLowerLayerHandleId [0..1]: 0..65535, symbolic-name-value=true, with-auto=true  # ECU wide unique, symbolic handle for the Pdu. Tags: atp.Status=draft
          reference CddLSduRLowerLayerPduRef: destination=Pdu  # Reference to the "global" Pdu structure to allow harmonization of handle IDs in the COM-Stack. Tags: atp.Status=draft
        container CddLSduRLowerLayerTxPdu [0..*]  # This container specifies Tx PDUs that are exchanged between a lower layer CDD and the L-Sdu Router. Tags: atp.Status=draft
          integer CddLSduRLowerLayerHandleId [0..1]: 0..65535, symbolic-name-value=true, with-auto=true  # ECU wide unique, symbolic handle for the Pdu. Tags: atp.Status=draft
          reference CddLSduRLowerLayerPduRef: destination=Pdu  # Reference to the "global" Pdu structure to allow harmonization of handle IDs in the COM-Stack. Tags: atp.Status=draft
      container CddLSduRUpperLayerContribution [0..1]  # Parameters that are necessary for the configuration of a Complex Driver that serves as the UpperLayer of the L-Sdu Router module. Tags: atp.Status=draft
        container CddLSduRUpperLayerRxPdu [0..*]  # This container specifies Rx PDUs that are exchanged between an upper layer CDD and the L-Sdu Router. Tags: atp.Status=draft
          integer CddLSduRUpperLayerHandleId [0..1]: 0..65535, symbolic-name-value=true, with-auto=true  # ECU wide unique, symbolic handle for the Pdu. Tags: atp.Status=draft
          reference CddLSduRUpperLayerPduRef: destination=Pdu  # Reference to the "global" Pdu structure to allow harmonization of handle IDs in the COM-Stack. Tags: atp.Status=draft
        container CddLSduRUpperLayerTxPdu [0..*]  # This container specifies Tx PDUs that are exchanged between an upper layer CDD and the L-Sdu Router. Tags: atp.Status=draft
          integer CddLSduRUpperLayerHandleId [0..1]: 0..65535, scope=ECU, symbolic-name-value=true, with-auto=true  # ECU wide unique, symbolic handle for the Pdu. Tags: atp.Status=draft
          reference CddLSduRUpperLayerPduRef: destination=Pdu  # Reference to the "global" Pdu structure to allow harmonization of handle IDs in the COM-Stack. Tags: atp.Status=draft
      container CddPduRLowerLayerContribution [0..1]  # Parameters that are necessary for the configuration of a Complex Driver that serves as the LowerLayer of the Pdu Router module.
        container CddPduRLowerLayerRxPdu [0..*]  # This container specifies Rx PDUs that are exchanged between the CDD and the standardized BSW module.
          enumeration CddPduRApiType [0..1]: {IF, TP}  # This parameter configures the type of the CDD interface (IF/TP)
          integer CddPduRLowerLayerHandleId [0..1]: 0..65535, symbolic-name-value=true, with-auto=true  # ECU wide unique, symbolic handle for the Pdu.
          reference CddPduRLowerLayerPduRef: destination=Pdu  # Reference to the "global" Pdu structure to allow harmonization of handle IDs in the COM-Stack.
        container CddPduRLowerLayerTxPdu [0..*]  # This container specifies Tx PDUs that are exchanged between the CDD and the standardized BSW module.
          enumeration CddPduRApiType [0..1]: {IF, TP}  # This parameter configures the type of the CDD interface (IF/TP)
          integer CddPduRLowerLayerHandleId [0..1]: 0..65535, symbolic-name-value=true, with-auto=true  # ECU wide unique, symbolic handle for the Pdu.
          reference CddPduRLowerLayerPduRef: destination=Pdu  # Reference to the "global" Pdu structure to allow harmonization of handle IDs in the COM-Stack.
      container CddPduRUpperLayerContribution [0..1]  # Parameters that are necessary for the configuration of a Complex Driver that serves as the UpperLayer of the Pdu Router module.
        container CddPduRUpperLayerRxPdu [0..*]  # This container specifies Rx PDUs that are exchanged between the CDD and the standardized BSW module.
          enumeration CddPduRApiType [0..1]: {IF, TP}  # This parameter configures the type of the CDD interface (IF/TP)
          integer CddPduRUpperLayerHandleId [0..1]: 0..65535, symbolic-name-value=true, with-auto=true  # ECU wide unique, symbolic handle for the Pdu.
          reference CddPduRUpperLayerPduRef: destination=Pdu  # Reference to the "global" Pdu structure to allow harmonization of handle IDs in the COM-Stack.
        container CddPduRUpperLayerTxPdu [0..*]  # This container specifies Tx PDUs that are exchanged between the CDD and the standardized BSW module.
          enumeration CddPduRApiType [0..1]: {IF, TP}  # This parameter configures the type of the CDD interface (IF/TP)
          integer CddPduRUpperLayerHandleId [0..1]: 0..65535, symbolic-name-value=true, with-auto=true  # ECU wide unique, symbolic handle for the Pdu.
          reference CddPduRUpperLayerPduRef: destination=Pdu  # Reference to the "global" Pdu structure to allow harmonization of handle IDs in the COM-Stack.
      container CddSoAdUpperLayerContribution [0..1]  # Parameters that are necessary for the configuration of a Complex Driver that serves as the UpperLayer of the SoAd module.
        container CddSoAdUpperLayerRxPdu [0..*]  # This container specifies Rx PDUs that are exchanged between the CDD and the standardized BSW module.
          enumeration CddPduRApiType [0..1]: {IF, TP}  # This parameter configures the type of the CDD interface (IF/TP)
          integer CddSoAdUpperLayerHandleId: 0..65535, symbolic-name-value=true, with-auto=true  # ECU wide unique, symbolic handle for the Pdu.
          reference CddSoAdUpperLayerPduRef: destination=Pdu  # Reference to the "global" Pdu structure to allow harmonization of handle IDs in the COM-Stack.
        container CddSoAdUpperLayerTxPdu [0..*]  # This container specifies Tx PDUs that are exchanged between the CDD and the standardized BSW module.
          enumeration CddPduRApiType [0..1]: {IF, TP}  # This parameter configures the type of the CDD interface (IF/TP)
          integer CddSoAdUpperLayerHandleId [0..1]: 0..65535, symbolic-name-value=true, with-auto=true  # ECU wide unique, symbolic handle for the Pdu.
          reference CddSoAdUpperLayerPduRef: destination=Pdu  # Reference to the "global" Pdu structure to allow harmonization of handle IDs in the COM-Stack.
    container CddEcucPartitionInteraction [0..1]  # This optional container holds the partition interaction configuration.
      function name CddPartitionStoppedFunctionName  # Function name to be called when the partition which is triggering the Complex Driver is stopped.
      reference CddEcucPartitionRef: destination=EcucPartition  # Reference to the "EcucPartition" which executes the software which triggers the CDD.
    container CddGeneral [0..1]  # Contains the general configuration parameters of the module.
      integer CddInstanceId: 0..255, set at pre-compile  # Specifies the InstanceId of this module instance. If only one instance is present it shall have the Id 0.
      integer CddModuleId [0..1]: 255..4095, set at pre-compile, default-value=255  # Specifies the ModuleId of this module.
    container CddGlobalTimeContribution [0..1]  # Contribution of Global Time modules.
      container CddGlobalTimeDomain [1..*]  # This represents the existence of a CDD global time domain. The CddGlobalTimeContribution can administrate several global time domains at the same time that in itself form a hierarchy of domains and sub-domains.
        integer CddGlobalTimeDomainId: 0..31  # The global time domain ID.
        reference CddSynSynchronizedTimeBaseRef: requires-symbolic-name-value=true, destination=StbMSynchronizedTimeBase  # Mandatory reference to the required synchronized time-base.
        container CddGlobalTimeMaster [0..1]  # Configuration of the global time master. Each global time domain is required to have exactly one global time master. This master may or may not exist on the configured ECU.
          float CddGlobalTimeTxPeriod: 0..INF  # This represents configuration of the TX period. Unit: seconds
          container CddGlobalTimeMasterPdu [0..1]  # This container encloses the configuration of the PDU that is supposed to contain the global time information. | Please note that the configuration of CddGlobalTimeMasterPdu is optional and shall only be used for Complex Drivers that are using Pdus for carrying timeSync information.
            reference CddGlobalTimeMasterPduRef: destination=CddComIfUpperLayerTxPdu  # This represents the reference to the Pdu taken to transmit the global time information. The global time master of a global time domain is the sender of this Pdu.
        container CddGlobalTimeSlave [0..1]  # Configuration of a global time slave. Each global time domain is required to have at least one time slave. The configured ECU may or may not represent a time slave.
          container CddGlobalTimeSlavePdu [0..1]  # This container encloses the configuration of the PDU that is supposed to contain the global time information. | Please note that the configuration of CddGlobalTimeSlavePdu is optional and shall only be used for Complex Drivers that are using Pdus for carrying timeSync information.
            reference CddGlobalTimeSlavePduRef: destination=CddComIfUpperLayerRxPdu  # This represents the reference to the Pdu taken to transmit the global time information. All the time slaves are supposed to receive the Pdu.
  module definition CnV2xM [0..1]: variants pre-compile  # Configuration of the CnV2xM module. Tags: atp.Status=draft
    container CnV2xMGeneral  # This container contains the general configuration parameters of the BSW module CnV2xM. Tags: atp.Status=draft
      boolean CnV2xMDevErrorDetect: set at pre-compile, default-value=false  # Switches the Default Error Tracer (Det) detection and notification ON or OFF. Tags: atp.Status=draft | - true: enabled (ON) - false: disabled (OFF)
      float CnV2xMMainFunctionPeriod: 0..1, set at pre-compile, default-value=0.1  # This parameter defines the schedule period of CnV2xM_MainFunction.Unit:[s] Tags: atp.Status=draft
      boolean CnV2xMVersionInfoApi: set at pre-compile, default-value=false  # Enable/disables the API for reading the version information of the CnV2xM Module. Tags: atp.Status=draft | - true: enabled (ON) - false: disabled (OFF)
      reference CnV2xMEthIfCtrlRef: scope=ECU, set at pre-compile, requires-symbolic-name-value=true, destination=EthIfController  # This is represents the reference to the Ethernet interface taken to transmit the C-V2X packets to. Tags: atp.Status=draft
  module definition CnV2xMsg [0..1]: variants pre-compile  # Configuration of the CnV2xMsg module. Tags: atp.Status=draft
    container CnV2xMsgConfig  # This container contains the configuration parameters of the BSW module CnV2xMsg. Tags: atp.Status=draft
      boolean CnV2xMsgV2xDmServiceConfig: set at pre-compile, default-value=false  # Enable/disables the messages reception service via V2xDm. | - true: enabled (ON) - false: disabled (OFF)
      container CnV2xMsgDmMsgConfig [1..*]: multiplicity set at pre-compile  # This container contains the configuration of all messages that are passed on to the V2x Data Manager. Tags: atp.Status=draft
        enumeration CnV2xMsgDmAid [0..*]: multiplicity set at pre-compile, set at pre-compile  # When message is processed by the V2X Data Manager Tags: atp.Status=draft | (CnV2xMsgV2xDmServiceConfig is enabled), this configuration is used to indicate the type of message.
          CNV2XMSG_AID_DYNAMIC_RSI  # Tags: atp.Status=draft
          CNV2XMSG_AID_EMERGENCY_EVENTTRIGGERED_BSM  # Tags: atp.Status=draft
          CNV2XMSG_AID_EMERGENCY_REGULAR_BSM  # Tags: atp.Status=draft
          CNV2XMSG_AID_MAP  # Tags: atp.Status=draft
          CNV2XMSG_AID_NONEMERGENCY_EVENTTRIGGERED_BSM  # Tags: atp.Status=draft
          CNV2XMSG_AID_NONEMERGENCY_REGULAR_BSM  # Tags: atp.Status=draft
          CNV2XMSG_AID_RSM  # Tags: atp.Status=draft
          CNV2XMSG_AID_SEMIDYNAMIC_RSI  # Tags: atp.Status=draft
          CNV2XMSG_AID_SPAT  # Tags: atp.Status=draft
          CNV2XMSG_AID_STATIC_RSI  # Tags: atp.Status=draft
          CNV2XMSG_AID_V2X_TERMINAL_AFTERMARKET  # Tags: atp.Status=draft
    container CnV2xMsgGeneral  # This container contains the general configuration parameters of the AUTOSAR CnV2xMsg module. Tags: atp.Status=draft
      float CnV2xMsgBsmBsMainFunction: 0..1, set at pre-compile, default-value=0.1  # This parameter defines the schedule period of CnV2xMsg_BsmBs_MainFunction.Unit:[s] Tags: atp.Status=draft
      float Cnv2xMsgCRsiSMainFunction: 0..INF, set at pre-compile, default-value=0.1  # This parameter defines the schedule period of CnV2xMsg_RsiS_MainFunction.Unit:[s] Tags: atp.Status=draft
      boolean CnV2xMsgDevErrorDetect: set at pre-compile, default-value=false  # Switches the Default Error Tracer (Det) detection and notification ON or OFF. Tags: atp.Status=draft | - true: enabled (ON) - false: disabled (OFF)
      float CnV2xMsgMapSMainFunction: 0..INF, set at pre-compile, default-value=0.1  # This parameter defines the schedule period of CnV2xMsg_MapS_MainFunction.Unit:[s] Tags: atp.Status=draft
      float CnV2xMsgMgtMainFunction: 0..1, set at pre-compile, default-value=0.1  # This parameter defines the schedule period of CnV2xMsg_Mgt_MainFunction.Unit:[s] Tags: atp.Status=draft
      float CnV2xMsgRsmSMainFunction: 0..INF, set at pre-compile, default-value=0.1  # This parameter defines the schedule period of CnV2xMsg_RsmS_MainFunction.Unit:[s] Tags: atp.Status=draft
      float CnV2xMsgSpatSMainFunction: 0..INF, set at pre-compile, default-value=0.1  # This parameter defines the schedule period of CnV2xMsg_SpatS_MainFunction.Unit:[s] Tags: atp.Status=draft
      enumeration CnV2xMsgVehicleClass: set at pre-compile, default-value=CNV2XMSG_VC_UNKNOWN  # This configuration value defines the Vehicle Class information, Road Side Unit not supported by AUTOSAR. Tags: atp.Status=draft
        CNV2XMSG_VC_BUS  # Tags: atp.Status=draft
        CNV2XMSG_VC_EM_AMBULANCE  # Tags: atp.Status=draft
        CNV2XMSG_VC_EM_ENGINEERING  # Tags: atp.Status=draft
        CNV2XMSG_VC_EM_FIRETRUCK_HEAVY  # Tags: atp.Status=draft
        CNV2XMSG_VC_EM_FIRETRUCK_LIGHT  # Tags: atp.Status=draft
        CNV2XMSG_VC_EM_NURSING  # Tags: atp.Status=draft
        CNV2XMSG_VC_EM_POLICE_HEAVY  # Tags: atp.Status=draft
        CNV2XMSG_VC_EM_POLICE_LIGHT  # Tags: atp.Status=draft
        CNV2XMSG_VC_GOODS_LIGHT  # Tags: atp.Status=draft
        CNV2XMSG_VC_GOODS_SEMITRAILER  # Tags: atp.Status=draft
        CNV2XMSG_VC_PASSENGER  # Tags: atp.Status=draft
        CNV2XMSG_VC_SPECIAL  # Tags: atp.Status=draft
        CNV2XMSG_VC_UNKNOWN  # Tags: atp.Status=draft
      boolean CnV2xMsgVersionInfoApi: set at pre-compile, default-value=false  # Enable/disables the API for reading the version information of the CnV2xMsg Module. Tags: atp.Status=draft | - true: enabled (ON) - false: disabled (OFF)
      integer CnV2xMsgvMaxCurveRadius: 0..18446744073709551615, set at pre-compile, default-value=2500  # The maximum Curve Radius Tags: atp.Status=draft
      integer CnV2xMsgvMaxPHistDistance: 0..18446744073709551615, set at pre-compile, default-value=300  # The Maximum distance between the first and last path history point along the vehicle path), Unit:[m] Tags: atp.Status=draft
      integer CnV2xMsgvMaxPHistPoints: 0..18446744073709551615, set at pre-compile, default-value=15  # Maximum number of path history points in a BSM packet Tags: atp.Status=draft
      integer CnV2xMsgvMinCurveRadius: 0..18446744073709551615, set at pre-compile, default-value=100  # The minimum Curve Radius Tags: atp.Status=draft
      integer CnV2xMsgvMinPHistDistance: 0..18446744073709551615, set at pre-compile, default-value=200  # The Minimum distance between the first and last path history point along the vehicle path), Unit:[m] Tags: atp.Status=draft
      integer CnV2xMsgvPathPerpendicularDist: 0..18446744073709551615, set at pre-compile, default-value=200  # The perpendicular distance between any point on the vehicle path and the straight line connecting two adjacent path history points, unit:[m] Tags: atp.Status=draft
      integer CnV2xMsgvPPredRadiusError: 0..100, set at pre-compile, default-value=2  # The error from the actual radius, Unit:[%] Tags: atp.Status=draft
      float CnV2xMsgvPPredTransitionTime: set at pre-compile, default-value=4  # The transition time from a constant radius of curvature (R1) to a new constant radius of curvature (R2), unit: [s] Tags: atp.Status=draft
      integer CnV2xMsgvStationarySpeedThresh: 0..18446744073709551615, set at pre-compile, default-value=1  # The threshold of vehicle speed, unit:[m/s] Tags: atp.Status=draft
  module definition CnV2xNet [0..1]: variants pre-compile  # Configuration of the CnV2xNet module. Tags: atp.Status=draft
    container CnV2xNetConfig  # This container contains the configuration parameters and sub containers of the CnV2xNet module. Tags: atp.Status=draft
      integer CnV2xNetDSMPprotocolVersion: 0..7, set at pre-compile, default-value=0  # DSMP protocol version as defined in chapter 4.3.3.1 [13] Tags: atp.Status=draft
      integer CnV2xNetDSMPSduSize: 0..65535, set at pre-compile, default-value=65535  # Maximum size of DSMP-SDU in [Byte] Tags: atp.Status=draft
      reference CnV2xNetEthIfRef: set at pre-compile, requires-symbolic-name-value=true, destination=EthIfController  # This is represents the reference to the Ethernet interface taken to transmit the C-V2X packets to. Tags: atp.Status=draft
      container CnV2xNetRxPdu  # Represents the received PDU. This PDU is usually linked to the EthIf via LSduR. It consumes meta data items of the types BROADCAST_8 and ETHERNET_MAC_64. Tags: atp.Status=draft
        integer CnV2xNetRxPduId: 0..65535, scope=ECU, set at pre-compile, symbolic-name-value=true, with-auto=true, default-value=0  # PDU identifier used for RxIndication from LSduR. Tags: atp.Status=draft
        reference CnV2xNetRxPduRef: scope=ECU, set at pre-compile, destination=Pdu  # Reference to the global PDU. Tags: atp.Status=draft
      container CnV2xNetTxPdu  # Represents the transmitted PDU. This PDU is usually linked to the EthIf via LSduR. It produces meta data items of the type ETHERNET_MAC_64. Tags: atp.Status=draft
        integer CnV2xNetTxPduId: 0..65535, scope=ECU, set at pre-compile, symbolic-name-value=true, with-auto=true, default-value=0  # PDU identifier used for TxConfirmation from LSduR. Tags: atp.Status=draft
        reference CnV2xNetTxPduRef: scope=ECU, set at pre-compile, destination=Pdu  # Reference to the global PDU. Tags: atp.Status=draft
    container CnV2xNetGeneral  # This container contains the configuration parameters of the BSW module CnV2xNet. Tags: atp.Status=draft
      boolean CnV2xNetDevErrorDetect: set at pre-compile, default-value=false  # Switches the Default Error Tracer (Det) detection and notification ON or OFF. Tags: atp.Status=draft | - true: enabled (ON) - false: disabled (OFF)
      float CnV2xNetMainFunctionPeriod: 0..1, set at pre-compile, default-value=0.1  # This parameter defines the schedule period of CnV2xNet_BsmBs_MainFunction.Unit:[s] Tags: atp.Status=draft
      boolean CnV2xNetTxConfirmation: set at pre-compile, default-value=false  # When enabled, transmission status information will be forwarded to the upper layer. Tags: atp.Status=draft | - true: enabled (ON) - false: disabled (OFF)
      boolean CnV2xNetVersionInfoApi: set at pre-compile, default-value=false  # Enable/disables the API for reading the version information of the CnV2xNet Module. Tags: atp.Status=draft | - true: enabled (ON) - false: disabled (OFF)
