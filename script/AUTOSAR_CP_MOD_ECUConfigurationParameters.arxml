[part 12 of 14: package /AUTOSAR/EcucDefs]
AUTOSAR XML (schema 00053)
package /AUTOSAR/EcucDefs  (continued)
  module definition Sd [0..1]: post-build-variant-support=true, variants link-time/post-build/pre-compile  # Configuration of the Service Discovery module.
    container SdConfig  # This container contains the configuration parameters and sub containers of the AUTOSAR Service Discovery module.
      reference SdAclCheckBlockDescriptorRef [0..1]: scope=ECU, multiplicity set at pre-compile, set at pre-compile, requires-symbolic-name-value=true, destination=NvMBlockDescriptor  # Reference to the Nvm block description in the Nvm module configuration in which the Acl will be stored. Tags: atp.Status=draft
      container SdCapabilityRecordMatchCallout [0..*]  # Callout that is invoked by the Sd implementation to determine whether the configuration options contained in the entries of a received SD message match the capability record elements configured in SdServerCapabilityRecord or SdClientCapabilityRecord.
        function name SdCapabilityRecordMatchCalloutName: multiplicity set at link in variant link-time+post-build / pre-compile in variant pre-compile, set at link in variant link-time+post-build / pre-compile in variant pre-compile  # Function name (i.e., C-identifier) of the SdCapabilityRecordMatchCallout.
      container SdInstance [0..*]  # This container represents an instance of the SD; i.e. the SD configuration for a certain link.
        string SdInstanceHostname [0..1]: multiplicity set at link in variant link-time / post-build in variant post-build / pre-compile in variant pre-compile, post-build-variant-multiplicity=true, post-build-variant-value=true, set at link in variant link-time / post-build in variant post-build / pre-compile in variant pre-compile  # Configuration parameter to specify the Hostname.
        integer SdInstanceLocalAdressCheckLength [0..1]: 0..128, scope=ECU, multiplicity set at link in variant link-time / post-build in variant post-build / pre-compile in variant pre-compile, post-build-variant-multiplicity=true, post-build-variant-value=true, set at link in variant link-time / post-build in variant post-build / pre-compile in variant pre-compile  # This item describes on how many bits of the addresses shall be compared to determine, if a remote address is acceptable to be used. | This shall support IPv4 (0..32) and IPv6 (0..128). If this item is not present, the security checks use the configured netmask instead. "0" meaning not to check at all. For example "8" means that the first 8 bits of a remote address must be equal to the local address to be considered acceptable.
        container SdClientService [0..*]  # This container specifies all parameters used by Client services.
          boolean SdClientServiceAutoRequire: post-build-variant-value=true, set at link in variant link-time / post-build in variant post-build / pre-compile in variant pre-compile, default-value=false  # If existing and set to true, this Service will be set to "required" on start.
          integer SdClientServiceHandleId: 0..65535, set at pre-compile, symbolic-name-value=true, with-auto=true  # The HandleId by which the BswM can identify this Client Service Instance.
          integer SdClientServiceId: 0..65534, post-build-variant-value=true, set at link in variant link-time / post-build in variant post-build / pre-compile in variant pre-compile  # Id to identify the service. This is unique for the service interface.
          integer SdClientServiceInstanceId: 0..65534, post-build-variant-value=true, set at link in variant link-time / post-build in variant post-build / pre-compile in variant pre-compile  # Configuration parameter to specify Instance Id of the service as used in SD entries.
          integer SdClientServiceMajorVersion: 0..254, post-build-variant-value=true, set at link in variant link-time / post-build in variant post-build / pre-compile in variant pre-compile  # Major version number of the Service as used in the SD entries.
          integer SdClientServiceMinorVersion: 0..4294967295, post-build-variant-value=true, set at link in variant link-time / post-build in variant post-build / pre-compile in variant pre-compile  # Minor version number of the Service as used in the SD Service Entries. If configured to 0xffffffff (any), SD will accept all Minor Versions.
          integer SdMaxNumOfIpAddressesInAcl [0..1]: 1..255, multiplicity set at pre-compile, set at pre-compile  # The maximum number of IP addresses to be saved in the ACL.
          enumeration SdVersionDrivenFindBehavior [0..1]: {EXACT_OR_ANY_MINOR_VERSION, MINIMUM_MINOR_VERSION}, multiplicity set at link in variant link-time+post-build / pre-compile in variant pre-compile, post-build-variant-value=true, set at link in variant link-time / post-build in variant post-build / pre-compile in variant pre-compile, default-value=EXACT_OR_ANY_MINOR_VERSION  # Defined the possible acceptance kinds for required service instances. Tags: atp.Status=draft
          reference SdClientCapabilityRecordMatchCalloutRef [0..1]: multiplicity set at link in variant link-time / post-build in variant post-build / pre-compile in variant pre-compile, post-build-variant-multiplicity=true, post-build-variant-value=true, set at link in variant link-time / post-build in variant post-build / pre-compile in variant pre-compile, destination=SdCapabilityRecordMatchCallout  # Reference to a SdCapabilityRecordMatchCallout, The referenced SdCapabilityRecordMatchCallout is invoked to determine whether the configuration options contained in the entries of a received SD message match the client's configured SdClientCapabilityRecord elements.
          reference SdClientServiceMulticastRef [0..1]: multiplicity set at link in variant link-time / post-build in variant post-build / pre-compile in variant pre-compile, post-build-variant-multiplicity=true, post-build-variant-value=true, set at link in variant link-time / post-build in variant post-build / pre-compile in variant pre-compile, destination=SoAdSocketConnectionGroup  # Reference to the SoAdSocketConnection representing the data path (UDP) for communication with the server. This element is also used to set the remote address of the server. | This is used, if a ClientService subscribes with a Consumed Eventgroup multicast endpoint. This is an alternative to subscribe with a Consumed Eventgroup unicast endpoint (see SdClientServiceUdpRef). Please note: usage of this reference is mutually exclusive to SdClientServiceUdpRef.
          reference SdClientServiceTcpRef [0..1]: multiplicity set at link in variant link-time / post-build in variant post-build / pre-compile in variant pre-compile, post-build-variant-multiplicity=true, post-build-variant-value=true, set at link in variant link-time / post-build in variant post-build / pre-compile in variant pre-compile, destination=SoAdSocketConnectionGroup  # Reference to the SoAdSocketConnection representing the data path (TCP) for communication with methods. | This element is also used to set the remote address of the server and to open the TCP connection.
          reference SdClientServiceTimerRef: scope=ECU, post-build-variant-value=true, set at link in variant link-time / post-build in variant post-build / pre-compile in variant pre-compile, destination=SdClientTimer  # The reference of the SdClientTimer container for this service.
          reference SdClientServiceUdpRef [0..1]: multiplicity set at link in variant link-time / post-build in variant post-build / pre-compile in variant pre-compile, post-build-variant-multiplicity=true, post-build-variant-value=true, set at link in variant link-time / post-build in variant post-build / pre-compile in variant pre-compile, destination=SoAdSocketConnectionGroup  # Reference to the SoAdSocketConnection representing the data path (UDP) for communication with methods. | This element is also used to set the remote address of the server. This is used, if a ClientService subscribes with a Consumed Eventgroup unicast endpoint. This is an alternative to subscribe with a Consumed Eventgroup multicast endpoint. (see SdClientServiceMulticastRef). Please note: usage of this reference is mutually exclusive to SdClientServiceMulticastRef.
          reference SdServiceGroupRef [0..*]: multiplicity set at link in variant link-time / post-build in variant post-build / pre-compile in variant pre-compile, post-build-variant-multiplicity=true, post-build-variant-value=true, set at link in variant link-time / post-build in variant post-build / pre-compile in variant pre-compile, destination=SdServiceGroup  # Reference to the SdServiceGroupS this SdClientService belongs to.
          container SdBlocklistedVersions [0..1]: multiplicity set at link in variant link-time / post-build in variant post-build / pre-compile in variant pre-compile, post-build-variant-multiplicity=true  # Collection of blocklisted versions. Tags: atp.Status=draft
            integer SdBlocklistedMinorVersions [0..*]: 0..4294967295, multiplicity set at link in variant link-time / post-build in variant post-build / pre-compile in variant pre-compile, post-build-variant-multiplicity=true, post-build-variant-value=true, set at link in variant link-time / post-build in variant post-build / pre-compile in variant pre-compile  # Blocklisted MinorVersions. Tags: atp.Status=draft
          container SdClientCapabilityRecord [0..*]  # Sd uses capability records to store arbitrary name/value pairs conveying additional information about the named service. | The following use cases are supported: 1) Key present, with no value (e.g. "passreq" -- password required for this service) 2) Key present, with empty value (e.g. "PlugIns=" server supports plugins, but none are presently installed) 3) Key present, with non-empty value (e.g. "PlugIns=JPEG,MPEG2,MPEG4")
            string SdClientServiceCapabilityRecordKey: set at pre-compile  # Defines a CapabilityRecord key.
            string SdClientServiceCapabilityRecordValue [0..1]: multiplicity set at pre-compile, set at pre-compile  # Defines the corresponding CapabilityRecord value.
          container SdClientServiceAllowedProvider [0..*]: multiplicity set at link in variant link-time / post-build in variant post-build / pre-compile in variant pre-compile, post-build-variant-multiplicity=true  # The container defines the allowed providers for this ClientService. Tags: atp.Status=draft
            string SdIpAddress: scope=ECU, set at pre-compile  # This parameter defines the IP Address of the remote communication partner. Tags: atp.Status=draft
            enumeration SdIpAddressType: scope=ECU, set at pre-compile  # This parameter defines the IP version that is used for communication with the remote communication partner. Tags: atp.Status=draft
              SD_AF_INET  # Tags: atp.Status=draft
              SD_AF_INET6  # Tags: atp.Status=draft
          container SdConsumedEventGroup [0..*]  # A Service may have event groups which can be consumed. A service consumer has to subscribe to the corresponding event-group. After the subscription the event consumer takes the role of a server and the event provider that of a client.
            boolean SdConsumedEventGroupAutoRequire: post-build-variant-value=true, set at link in variant link-time / post-build in variant post-build / pre-compile in variant pre-compile, default-value=false  # If existing and set to true, this EventGroup will be set to "required" on start.
            integer SdConsumedEventGroupHandleId: 0..65535, set at pre-compile, symbolic-name-value=true, with-auto=true  # The HandleId by which the BswM can identify this EventGroup.
            integer SdConsumedEventGroupId: 0..65534, set at pre-compile  # The Eventgroup Id of this eventGroup as a unique identifier of the eventgroup in this service. This identifier is used for EventGroup entries as well. | Please note, that the Eventgroup ID 0x0000 is reserved.
            reference SdConsumedEventGroupMulticastActivationRef [0..1]: multiplicity set at link in variant link-time / post-build in variant post-build / pre-compile in variant pre-compile, post-build-variant-multiplicity=true, post-build-variant-value=true, set at link in variant link-time / post-build in variant post-build / pre-compile in variant pre-compile, requires-symbolic-name-value=true, destination=SoAdRoutingGroup  # The reference of a Routing Group in order to activate and setup the Socket Connection for Multicast Events of this EventGroup. The Multicast address from the received Multicast Option is setup by SoAd_RequestIpAddrAssignment. | The local address is the same as for the unicast events; thus, it was sent in the UDP Endpoint option of the Subscribe EventGroup entry. This is usually equal to the SdConsumedEventGroupUdpActivationRef.
            reference SdConsumedEventGroupMulticastGroupRef [0..*]: multiplicity set at link in variant link-time / post-build in variant post-build / pre-compile in variant pre-compile, post-build-variant-multiplicity=true, post-build-variant-value=true, set at link in variant link-time / post-build in variant post-build / pre-compile in variant pre-compile, destination=SoAdSocketConnectionGroup  # Reference to the SoAdSocketConnectionGroup representing the multicast data path (UDP).
            reference SdConsumedEventGroupTcpActivationRef [0..1]: multiplicity set at link in variant link-time / post-build in variant post-build / pre-compile in variant pre-compile, post-build-variant-multiplicity=true, post-build-variant-value=true, set at link in variant link-time / post-build in variant post-build / pre-compile in variant pre-compile, requires-symbolic-name-value=true, destination=SoAdRoutingGroup  # The reference of the Routing Group for activation of the data path for receiving TCP events. | This element is also being used for getting the IP address and port number for building the TCP endpoint option for the Subscribe EventGroup entry. If no TCP methods are used in the service, this element is also being used for setting the remote address (TCP Endpoint option referenced by the Offer Service entry) and opening the TCP connection to the server before sending the Subscribe EventGroup entry. If multiple EventGroups of the same Service Instance are subscribed the TCP connection will be shared and must be opened only once.
            reference SdConsumedEventGroupTimerRef: post-build-variant-value=true, set at link in variant link-time / post-build in variant post-build / pre-compile in variant pre-compile, destination=SdClientTimer  # The reference of the SdClientTimer container for this eventGroup.
            reference SdConsumedEventGroupUdpActivationRef [0..1]: multiplicity set at link in variant link-time / post-build in variant post-build / pre-compile in variant pre-compile, post-build-variant-multiplicity=true, post-build-variant-value=true, set at link in variant link-time / post-build in variant post-build / pre-compile in variant pre-compile, requires-symbolic-name-value=true, destination=SoAdRoutingGroup  # The reference of the Routing Group for activation of the data path for receiving UDP events. | This element is also being used for getting the IP address and port number for building the UDP Endpoint option or Consumed Multicast option for the Subscribe EventGroup entry. If no UDP methods are used in the service, this element is also being used for setting the remote address (UDP Endpoint option referenced by the Offer Service entry). If multiple EventGroups of the same Service Instance are subscribed the UDP Socket Connection will be shared and must be set only once.
          container SdConsumedMethods [0..1]  # Container element for representing the data path for accessing the server methods.
            reference SdClientServiceActivationRef: post-build-variant-value=true, set at link in variant link-time / post-build in variant post-build / pre-compile in variant pre-compile, requires-symbolic-name-value=true, destination=SoAdRoutingGroup  # Reference to a SoAdRoutingGroupRef to activate/deactivate the data path for the methods.
        container SdClientTimer [0..*]  # This container specifies all timers used by the Service Discovery module for Client Services.
          float SdClientTimerInitialFindDelayMax [0..1]: 0..INF, scope=ECU, multiplicity set at link in variant link-time / post-build in variant post-build / pre-compile in variant pre-compile, post-build-variant-multiplicity=true, post-build-variant-value=true, set at link in variant link-time / post-build in variant post-build / pre-compile in variant pre-compile  # Max value in [s] to delay randomly the transmission of a find message. This parameter is mandatory for ClientService.
          float SdClientTimerInitialFindDelayMin [0..1]: 0..INF, scope=ECU, multiplicity set at link in variant link-time / post-build in variant post-build / pre-compile in variant pre-compile, post-build-variant-multiplicity=true, post-build-variant-value=true, set at link in variant link-time / post-build in variant post-build / pre-compile in variant pre-compile  # Min value in [s] to delay randomly the transmission of a find message. This parameter is mandatory for ClientService.
          float SdClientTimerInitialFindRepetitionsBaseDelay [0..1]: 0..INF, scope=ECU, multiplicity set at link in variant link-time / post-build in variant post-build / pre-compile in variant pre-compile, post-build-variant-multiplicity=true, post-build-variant-value=true, set at link in variant link-time / post-build in variant post-build / pre-compile in variant pre-compile  # The base delay in [s] for find repetitions. Successive finds have an exponential back off delay (1x base delay, 2x base delay, 4x base delay, ...). This parameter is mandatory for ClientService.
          integer SdClientTimerInitialFindRepetitionsMax [0..1]: 0..10, scope=ECU, multiplicity set at link in variant link-time / post-build in variant post-build / pre-compile in variant pre-compile, post-build-variant-multiplicity=true, post-build-variant-value=true, set at link in variant link-time / post-build in variant post-build / pre-compile in variant pre-compile  # Configuration for the maximum number of find repetitions. This parameter is mandatory for ClientService.
          float SdClientTimerRequestResponseMaxDelay [0..1]: 0..INF, scope=ECU, multiplicity set at link in variant link-time / post-build in variant post-build / pre-compile in variant pre-compile, post-build-variant-multiplicity=true, post-build-variant-value=true, set at link in variant link-time / post-build in variant post-build / pre-compile in variant pre-compile  # Maximum allowable response delay to entries received by multicast in seconds. This parameter is mandatory for ConsumedEventGroups.
          float SdClientTimerRequestResponseMinDelay [0..1]: 0..INF, scope=ECU, multiplicity set at link in variant link-time / post-build in variant post-build / pre-compile in variant pre-compile, post-build-variant-multiplicity=true, post-build-variant-value=true, set at link in variant link-time / post-build in variant post-build / pre-compile in variant pre-compile  # Minimum allowable response delay to the find message in seconds. This parameter is mandatory for ConsumedEventGroups.
          integer SdClientTimerTTL: 1..16777215, scope=ECU, post-build-variant-value=true, set at link in variant link-time / post-build in variant post-build / pre-compile in variant pre-compile  # Time to live for find and subscribe messages. Note! The TTL value for find messages shall be ignored by the server service and the configuration is only kept for backward compatibility
          float SdSubscribeEventgroupRetryDelay [0..1]: 0.001..50, multiplicity set at link in variant link-time / post-build in variant post-build / pre-compile in variant pre-compile, post-build-variant-multiplicity=true, post-build-variant-value=true, set at link in variant link-time / post-build in variant post-build / pre-compile in variant pre-compile, default-value=0.01  # Time in seconds when a subscription to an event group shall be retriggered, if no SubscribeEventGroupAck or SubscribeEventGroupNack was received.
          integer SdSubscribeEventgroupRetryMax [0..1]: 0..255, multiplicity set at link in variant link-time / post-build in variant post-build / pre-compile in variant pre-compile, post-build-variant-multiplicity=true, post-build-variant-value=true, set at link in variant link-time / post-build in variant post-build / pre-compile in variant pre-compile, default-value=0  # Maximum count of retry a subscription, if a subscription to an event group is not acknowledged by SubscribeEventGroupAck or SubscribeEventGroupNack. 0x0=no retry, 0xFF=retry forever (as long as the event group is requested)
        container SdInstanceDemEventParameterRefs [0..1]  # Container for the references to DemEventParameter elements which shall be invoked using the API Dem_SetEventStatus in case the corresponding error occurs. The EventId is taken from the referenced DemEventParameter's DemEventId symbolic value. The standardized errors are provided in this container and can be extended by vendor-specific error references.
          reference SD_E_MALFORMED_MSG [0..1]: multiplicity set at pre-compile, post-build-variant-value=true, set at link in variant link-time / post-build in variant post-build / pre-compile in variant pre-compile, requires-symbolic-name-value=true, destination=DemEventParameter  # Reference to the DemEventParameter which shall be issued when the SD Instance received malformed messsage.
          reference SD_E_OUT_OF_RES [0..1]: multiplicity set at pre-compile, post-build-variant-value=true, set at link in variant link-time / post-build in variant post-build / pre-compile in variant pre-compile, requires-symbolic-name-value=true, destination=DemEventParameter  # Reference to the DemEventParameter which shall be issued when the SD Instance does not have enough resources to handle client.
          reference SD_E_SUBSCR_NACK_RECV [0..1]: multiplicity set at pre-compile, post-build-variant-value=true, set at link in variant link-time / post-build in variant post-build / pre-compile in variant pre-compile, requires-symbolic-name-value=true, destination=DemEventParameter  # Reference to the DemEventParameter which shall be issued when receiving SubscribeEventgroupNack entry.
        container SdInstanceMulticastRxPdu  # This container specifies the received PDU.
          integer SdRxPduId: 0..65535, scope=ECU, post-build-variant-value=true, set at link in variant link-time / post-build in variant post-build / pre-compile in variant pre-compile  # ID of the PDU that will be received via the API Sd_SoAdIfRxIndication().
          reference SdRxPduRef: post-build-variant-value=true, set at link in variant link-time / post-build in variant post-build / pre-compile in variant pre-compile, destination=Pdu  # Reference to the "global" Pdu structure to allow harmonization of handle IDs in the COM-Stack.
        container SdInstanceTxPdu  # This container specifies the transmitted PDU.
          reference SdTxPduRef: post-build-variant-value=true, set at link in variant link-time / post-build in variant post-build / pre-compile in variant pre-compile, destination=Pdu  # Reference to the "global" Pdu structure to allow harmonization of handle IDs in the COM-Stack.
        container SdInstanceUnicastRxPdu  # This container specifies the received PDU.
          integer SdRxPduId: 0..65535, scope=ECU, post-build-variant-value=true, set at link in variant link-time / post-build in variant post-build / pre-compile in variant pre-compile  # ID of the PDU that will be received via the API Sd_SoAdIfRxIndication().
          reference SdRxPduRef: post-build-variant-value=true, set at link in variant link-time / post-build in variant post-build / pre-compile in variant pre-compile, destination=Pdu  # Reference to the "global" Pdu structure to allow harmonization of handle IDs in the COM-Stack.
        container SdServerService [0..*]  # This container specifies all parameters used by Server services.
          integer SdMaxNumOfIpAddressesInAcl [0..1]: 1..255, multiplicity set at pre-compile, set at pre-compile  # The maximum number of IP addresses to be saved in the ACL.
          boolean SdServerServiceAutoAvailable: post-build-variant-value=true, set at link in variant link-time / post-build in variant post-build / pre-compile in variant pre-compile, default-value=false  # If existing and set to true, this Service will be set to "Available" on start.
          integer SdServerServiceHandleId: 0..65535, set at pre-compile, symbolic-name-value=true, with-auto=true  # The HandleId by which the BswM can identify this Server Service Instance.
          integer SdServerServiceId: 0..65534, post-build-variant-value=true, set at link in variant link-time / post-build in variant post-build / pre-compile in variant pre-compile  # Id to identify the service. This is unique for the service interface.
          integer SdServerServiceInstanceId: 0..65534, post-build-variant-value=true, set at link in variant link-time / post-build in variant post-build / pre-compile in variant pre-compile  # Configuration parameter to specify Instance Id of the Service implemented by the Server Service.
          integer SdServerServiceLoadBalancingPriority [0..1]: 0..65535, post-build-variant-value=true, set at link in variant link-time / post-build in variant post-build / pre-compile in variant pre-compile  # Defines the value to be used for load balancing priority in the service offer. Lower value means higher priority.
          integer SdServerServiceLoadBalancingWeight [0..1]: 0..65535, post-build-variant-value=true, set at link in variant link-time / post-build in variant post-build / pre-compile in variant pre-compile  # Defines the value to be used for load balancing weight in the service offer. Higher value means higher probability to be chosen.
          integer SdServerServiceMajorVersion: 0..254, post-build-variant-value=true, set at link in variant link-time / post-build in variant post-build / pre-compile in variant pre-compile  # Major version number of the Service as used in SD Entries.
          integer SdServerServiceMinorVersion: 0..4294967294, post-build-variant-value=true, set at link in variant link-time / post-build in variant post-build / pre-compile in variant pre-compile  # Minor version number of the Service as used e.g. in Offer Service entries.
          reference SdServerCapabilityRecordMatchCalloutRef [0..1]: multiplicity set at link in variant link-time / post-build in variant post-build / pre-compile in variant pre-compile, post-build-variant-multiplicity=true, post-build-variant-value=true, set at link in variant link-time / post-build in variant post-build / pre-compile in variant pre-compile, destination=SdCapabilityRecordMatchCallout  # Reference to a SdCapabilityRecordMatchCallout, The referenced SdCapabilityRecordMatchCallout is invoked to determine whether the configuration options contained in the entries of a received SD message match the server's configured SdServerCapabilityRecord elements.
          reference SdServerServiceTcpRef [0..1]: scope=ECU, multiplicity set at link in variant link-time / post-build in variant post-build / pre-compile in variant pre-compile, post-build-variant-multiplicity=true, post-build-variant-value=true, set at link in variant link-time / post-build in variant post-build / pre-compile in variant pre-compile, destination=SoAdSocketConnectionGroup  # Reference to SoAdSocketConnectionGroup used for methods. | This is used to access the local IP address and port for building the endpoint option for offers of this service.
          reference SdServerServiceTimerRef: scope=ECU, post-build-variant-value=true, set at link in variant link-time / post-build in variant post-build / pre-compile in variant pre-compile, destination=SdServerTimer  # The reference of the SdServerTimer container for this service.
          reference SdServerServiceUdpRef [0..1]: scope=ECU, multiplicity set at link in variant link-time / post-build in variant post-build / pre-compile in variant pre-compile, post-build-variant-multiplicity=true, post-build-variant-value=true, set at link in variant link-time / post-build in variant post-build / pre-compile in variant pre-compile, destination=SoAdSocketConnectionGroup  # Reference to SoAdSocketConnectionGroup used for methods. | This is used to access the local IP address and port for building the endpoint option for offers of this service.
          reference SdServiceGroupRef [0..*]: multiplicity set at link in variant link-time / post-build in variant post-build / pre-compile in variant pre-compile, post-build-variant-multiplicity=true, post-build-variant-value=true, set at link in variant link-time / post-build in variant post-build / pre-compile in variant pre-compile, destination=SdServiceGroup  # Reference to the SdServiceGroupS this SdServerService belongs to.
          container SdEventHandler [0..*]  # Container Element for representing an EventGroup as part of the Service Instance.
            integer SdEventHandlerEventGroupId: 0..65534, set at pre-compile  # The EventGroup Id of this EventGroup as a unique identifier of the EventGroup in this service. This identifier is used for EventGroup entries as well. | Please note, that the Eventgroup ID 0x0000 is reserved.
            integer SdEventHandlerHandleId: 0..65535, scope=ECU, set at pre-compile, symbolic-name-value=true, with-auto=true  # The HandleId by which the BswM can identify this EventGroup.
            integer SdEventHandlerMulticastThreshold: 0..65535, post-build-variant-value=true, set at link in variant link-time / post-build in variant post-build / pre-compile in variant pre-compile  # Specifies the number of subscribed clients with different endpoint information (see SWS_SD_00754) that triggers the Server to change the transmission of events via the Eventhandler Multicast connection. | If configured to 0 only Consumed Evengroup unicast connections and Consumed Eventgroup multicast connections will be used. If configured to 1 the first client and all further subscribed clients will be served via the Eventhandler Multicast connection as configured in SdMulticastEventSoConRef. If configured to n up to n-1 clients with different endpoint information will be served via Consumed Evengroup unicast connections and Consumed Eventgroup multicast connections. As soon as the number of subscribed clients with different endpoint information reaches n, then all subscribed clients are served via the Eventhandler Multicast connection as configured in SdMulticastEventSoConRef. This does not influence the handling of initial events.
            reference SdEventHandlerTimerRef [0..1]: multiplicity set at link in variant link-time / post-build in variant post-build / pre-compile in variant pre-compile, post-build-variant-multiplicity=true, post-build-variant-value=true, set at link in variant link-time / post-build in variant post-build / pre-compile in variant pre-compile, destination=SdServerTimer  # The reference of the SdServerTimer container for this EventGroup.
            container SdEventHandlerMulticast [0..1]  # The subcontainer including the Routing Group for Activation of Events sent over Multicast. | The activation ref is also being used for identification of the related Socket Connection in order to find the Multicast Address used in the Multicast Option referenced by the Subscribe EventGroup Ack entry.
              reference SdEventActivationRef [0..1]: multiplicity set at link in variant link-time / post-build in variant post-build / pre-compile in variant pre-compile, post-build-variant-multiplicity=true, post-build-variant-value=true, set at link in variant link-time / post-build in variant post-build / pre-compile in variant pre-compile, requires-symbolic-name-value=true, destination=SoAdRoutingGroup  # Reference to a SoAdRoutingGroup for activation of the data path for a subscribed client (start sending events after subscribe). This is usually equal to the SdEventActivationRef referenced by SdEventHandlerUdp
              reference SdMulticastEventSoConRef: multiplicity set at link in variant link-time / post-build in variant post-build / pre-compile in variant pre-compile, post-build-variant-multiplicity=true, post-build-variant-value=true, set at link in variant link-time / post-build in variant post-build / pre-compile in variant pre-compile, requires-symbolic-name-value=true, destination=SoAdSocketConnection  # Reference to the SoAdSocketConnection representing the Eventhandler Multicast data path (UDP).
            container SdEventHandlerTcp [0..1]  # The subcontainer including the Routing Groups for Activation and Trigger Transmit for Events sent over TCP. | The activation ref (or triggering ref if no activation ref exists) is also being used for identification of the related socket connections in order to find the related client by iterating the SdEventHandlerTcp elements (remote address statically configured or automatically set by opening TCP connection before subscription).
              reference SdEventActivationRef [0..1]: multiplicity set at link in variant link-time / post-build in variant post-build / pre-compile in variant pre-compile, post-build-variant-multiplicity=true, post-build-variant-value=true, set at link in variant link-time / post-build in variant post-build / pre-compile in variant pre-compile, requires-symbolic-name-value=true, destination=SoAdRoutingGroup  # Reference to a SoAdRoutingGroup for activation of the data path for a subscribed client (start sending events after subscribe). This is usually equal to the SdEventActivationRef referenced by SdEventHandlerUdp
              reference SdEventTriggeringRef [0..1]: multiplicity set at link in variant link-time / post-build in variant post-build / pre-compile in variant pre-compile, post-build-variant-multiplicity=true, post-build-variant-value=true, set at link in variant link-time / post-build in variant post-build / pre-compile in variant pre-compile, requires-symbolic-name-value=true, destination=SoAdRoutingGroup  # Reference to a SoAdRoutingGroup that is used for triggered transmit. Triggering is needed to sent out initial events on the server side after a client got subscribed.
            container SdEventHandlerUdp [0..1]  # The subcontainer including the Routing Groups for Activation and Trigger Transmit for Events sent over UDP. | The activation ref (or triggering ref if no activation ref exists) is also being used for identification of the related socket connections in order to set the remote address (either unicast address or multicast address) of the client or find the related client by iterating the SdEventHandlerUdp elements (remote address statically configured or automatically set by method call before subscription).
              reference SdEventActivationRef [0..1]: multiplicity set at link in variant link-time / post-build in variant post-build / pre-compile in variant pre-compile, post-build-variant-multiplicity=true, post-build-variant-value=true, set at link in variant link-time / post-build in variant post-build / pre-compile in variant pre-compile, requires-symbolic-name-value=true, destination=SoAdRoutingGroup  # Reference to a SoAdRoutingGroup for activation of the data path for a subscribed client (start sending events after subscribe). This is usually equal to the SdEventActivationRef referenced by SdEventHandlerUdp
              reference SdEventTriggeringRef [0..1]: multiplicity set at link in variant link-time / post-build in variant post-build / pre-compile in variant pre-compile, post-build-variant-multiplicity=true, post-build-variant-value=true, set at link in variant link-time / post-build in variant post-build / pre-compile in variant pre-compile, requires-symbolic-name-value=true, destination=SoAdRoutingGroup  # Reference to a SoAdRoutingGroup that is used for triggered transmit. Triggering is needed to sent out initial events on the server side after a client got subscribed.
          container SdProvidedMethods [0..1]  # Container element for representing the needed elements of the data path for the methods provided by the service.
            reference SdServerServiceActivationRef: scope=ECU, post-build-variant-value=true, set at link in variant link-time / post-build in variant post-build / pre-compile in variant pre-compile, requires-symbolic-name-value=true, destination=SoAdRoutingGroup  # Reference to a SoAdRoutingGroup to activated and deactivate the data path for methods of the service.
          container SdServerCapabilityRecord [0..*]  # Sd uses capability records to store arbitrary name/value pairs conveying additional information about the named service. | The following use cases are supported: 1) Key present, with no value (e.g. "passreq" -- password required for this service) 2) Key present, with empty value (e.g. "PlugIns=" server supports plugins, but none are presently installed) 3) Key present, with non-empty value (e.g. "PlugIns=JPEG,MPEG2,MPEG4")
            string SdServerCapabilityRecordKey: set at pre-compile  # Defines a CapabilityRecord key.
            string SdServerCapabilityRecordValue [0..1]: multiplicity set at pre-compile, set at pre-compile  # Defines the corresponding CapabilityRecord value.
          container SdServerServiceAllowedConsumers [0..*]: multiplicity set at link in variant link-time / post-build in variant post-build / pre-compile in variant pre-compile, post-build-variant-multiplicity=true  # This container defines a list of consumers that are allowed to access this SdServerService. Tags: atp.Status=draft
            string SdIpAddress: scope=ECU, set at pre-compile  # This parameter defines the IP Address of the remote communication partner. Tags: atp.Status=draft
            enumeration SdIpAddressType: scope=ECU, set at pre-compile  # This parameter defines the IP version that is used for communication with the remote communication partner. Tags: atp.Status=draft
              SD_AF_INET  # Tags: atp.Status=draft
              SD_AF_INET6  # Tags: atp.Status=draft
        container SdServerTimer [0..*]  # This container specifies all timers used by the Service Discovery module for Server Services.
          float SdServerTimerInitialOfferDelayMax [0..1]: 0..INF, scope=ECU, multiplicity set at link in variant link-time / post-build in variant post-build / pre-compile in variant pre-compile, post-build-variant-multiplicity=true, post-build-variant-value=true, set at link in variant link-time / post-build in variant post-build / pre-compile in variant pre-compile  # Max value in [s] to delay randomly the first offer. This parameter is mandatory for ServerService.
          float SdServerTimerInitialOfferDelayMin [0..1]: 0..INF, scope=ECU, multiplicity set at link in variant link-time / post-build in variant post-build / pre-compile in variant pre-compile, post-build-variant-multiplicity=true, post-build-variant-value=true, set at link in variant link-time / post-build in variant post-build / pre-compile in variant pre-compile  # Min value in [s] to delay randomly the first offer. This parameter is mandatory for ServerService.
          float SdServerTimerInitialOfferRepetitionBaseDelay [0..1]: 0..INF, scope=ECU, multiplicity set at link in variant link-time / post-build in variant post-build / pre-compile in variant pre-compile, post-build-variant-multiplicity=true, post-build-variant-value=true, set at link in variant link-time / post-build in variant post-build / pre-compile in variant pre-compile  # The base delay in [s] for offer repetitions. Successive offers have an exponential back off delay (1x base delay, 2x base delay, 4x base delay, ...). This parameter is mandatory for ServerService.
          integer SdServerTimerInitialOfferRepetitionsMax [0..1]: 0..10, scope=ECU, multiplicity set at link in variant link-time / post-build in variant post-build / pre-compile in variant pre-compile, post-build-variant-multiplicity=true, post-build-variant-value=true, set at link in variant link-time / post-build in variant post-build / pre-compile in variant pre-compile  # Configure the maximum amount of offer repetition. This parameter is mandatory for ServerService.
          float SdServerTimerOfferCyclicDelay [0..1]: 0..INF, multiplicity set at link in variant link-time / post-build in variant post-build / pre-compile in variant pre-compile, post-build-variant-multiplicity=true, post-build-variant-value=true, set at link in variant link-time / post-build in variant post-build / pre-compile in variant pre-compile  # Interval between cyclic offers in the main phase. This parameter is mandatory for ServerService.
          float SdServerTimerRequestResponseMaxDelay: 0..INF, scope=ECU, post-build-variant-value=true, set at link in variant link-time / post-build in variant post-build / pre-compile in variant pre-compile  # Maximum allowable response delay to entries received by multicast in seconds.
          float SdServerTimerRequestResponseMinDelay: 0..INF, scope=ECU, post-build-variant-value=true, set at link in variant link-time / post-build in variant post-build / pre-compile in variant pre-compile  # Minimum allowable response delay to entries received by multicast in seconds.
          integer SdServerTimerTTL: 1..16777215, scope=ECU, post-build-variant-value=true, set at link in variant link-time / post-build in variant post-build / pre-compile in variant pre-compile  # Time to live for offer service.
      container SdServiceGroup [0..*]: multiplicity set at link in variant link-time / post-build in variant post-build / pre-compile in variant pre-compile, post-build-variant-multiplicity=true  # Contains the configuration parameters of the AUTOSAR SD module's SdServiceGroupS.
        integer SdServiceGroupHandleId: 0..65535, scope=ECU, set at pre-compile, symbolic-name-value=true  # The numerical value used as the ID of this SdServiceGroup. The SdServiceHandleId is required by the API calls to start and stop SdServiceGroupS.
    container SdGeneral  # This container lists the general configuration parameters for the Service Discovery module.
      boolean SdDevErrorDetect: set at pre-compile, default-value=false  # Switches the development error detection and notification on or off. | * true: detection and notification is enabled. * false: detection and notification is disabled.
      boolean SdEnableAclPolicyCheck: scope=ECU, set at pre-compile, default-value=false  # Switches the Sd AclPolicy check: Tags: atp.Status=draft | * true: feature is enabled. * false: feature is disabled.
      boolean SdEnableSecurityEventReporting: scope=ECU, set at pre-compile, default-value=false  # Switches the reporting of security events to the IdsM: | * true: reporting is enabled. * false: reporting is disabled.
      float SdMainFunctionCycleTime: 0..INF, set at pre-compile  # This parameter defines the cycle time in seconds of the periodic calling of Sd main function.
      boolean SdSetRemAddrOfClientRxMulticastSoCon: scope=ECU, set at pre-compile, default-value=true  # If SdSetRemAddrOfClientRxMulticastSoCon is set to TRUE, the Service Discovery module shall choose an multicast socket connection which match to the received Endpoint option of the corresponding OfferService. If no particular socket connection exist, then an unused socket connection with its remote address set to wildcard shall be used and the remote address shall be updated accordingly. If SdSetRemAddrOfClientRxMulticastSoCon is set to FALSE, the Service Discovery shall choose an unused socket connection with its remote address set to wildcard and skip to update the remote address, i.e. the wildcard for the remote address is kept. | Note: setting SdSetRemAddrOfClientRxMulticastSoCon to FALSE supports the re-use of a multicast socket connection for multiple ClientServices which are located on the same ECU and subscribed to ServerServices which are located on different ECUs. The configuration of the ECU where the ClientServices are located, could be simplified by only configuring one socket connection within the multicast socket connection group.
      boolean SdSubscribeEventgroupRetryEnable: set at pre-compile, default-value=false  # Switch to enable or disable the retry functionality to subscribe to Eventgroups of ServerServices with TTL set to 0xFFFFFF.
      boolean SdVersionInfoApi: set at pre-compile, default-value=false  # Enables and disables the version info API.
      container SdSecurityEventRefs  # Container for the references to IdsMEvent elements representing the security events that the SD module shall report to the IdsM in case the coresponding security related event occurs (and if SdEnableSecurityEventReporting is set to "true"). The standardized security events in this container can be extended by vendor-specific security events.
        reference SEV_SOME_IP_ACL_CHECK_FAILED_EVENT_SUBSCRIPTION [0..1]: multiplicity set at pre-compile, set at pre-compile, requires-symbolic-name-value=true, destination=IdsMEvent  # ACL check for a subscribe event group request failed. Tags: atp.Status=draft
        reference SEV_SOME_IP_ACL_CHECK_FAILED_METHOD_REQUEST [0..1]: multiplicity set at pre-compile, set at pre-compile, requires-symbolic-name-value=true, destination=IdsMEvent  # ACL check for a method request failed. Tags: atp.Status=draft
        reference SEV_SOME_IP_ACL_CHECK_FAILED_OFFER [0..1]: multiplicity set at pre-compile, set at pre-compile, requires-symbolic-name-value=true, destination=IdsMEvent  # ACL check for a service offer failed. Tags: atp.Status=draft
        reference SEV_SOME_IP_SD_DUPLICATE_OFFER [0..1]: multiplicity set at pre-compile, set at pre-compile, requires-symbolic-name-value=true, destination=IdsMEvent  # SD rejected Offer for a ServiceInstance which is already offered by a different endpoint and TTL still valid. Tags: atp.Status=draft
  module definition SecOC [0..1]: post-build-variant-support=true, variants link-time/post-build/pre-compile  # Configuration of the SecOC (SecureOnboardCommunication) module.
    container SecOCGeneral  # Contains the general configuration parameters of the SecOC module.
      integer SecOCDefaultAuthenticationInformationPattern [0..1]: 0..255, multiplicity set at pre-compile, set at pre-compile  # The parameter describes the behaviour of SecOC when authentication build counter has reached the configuration value SecOCAuthenticationBuildAttempts, or the query of the freshness function returns E_NOT_OK or the calculation of the authenticator has returned a non-recoverable error such as returning E_NOT_OK or KEY_FAILURE. | If the configuration parameter is not present, SecOC module shall remove the Authentic I-PDU from its internal buffer and cancel the transmission request If the configuration parameter is present, SecOC will use this value for each byte of Freshness Value and Authenticator when building the Authentication Information, and will not cancel the transmission request.
      boolean SecOCDevErrorDetect: set at pre-compile, default-value=false  # Switches the development error detection and notification on or off. | * true: detection and notification is enabled. * false: detection and notification is disabled.
      boolean SecOCEnableForcedPassOverride: set at pre-compile, default-value=false  # When this configuration option is set to TRUE then the functionality inside the function SecOC_VerifyStatusOverride to send I-PDUs to upper layer independent of the verification result is enabled.
      boolean SecOCEnableSecurityEventReporting: scope=ECU, set at pre-compile, default-value=false  # Switches the reporting of security events to the IdsM: Tags: atp.Status=draft | - true: reporting is enabled. - false: reporting is disabled.
      boolean SecOCIgnoreVerificationResult: set at pre-compile, default-value=false  # The result of the authentication process (e.g. MAC Verify) is ignored after the first try and the SecOC proceeds like the result was a success. The calculation of the authenticator is still done, only its result will be ignored. | * true: enabled (verification result is ignored). * false: disabled (verification result is NOT ignored).
      string SecOCMaxAlignScalarType: set at pre-compile  # The scalar type which has the maximum alignment restrictions on the given platform. This type can be e.g. uint8, uint16 or uint32.
      integer SecOCMaxTransmitRetries: 0..255, set at pre-compile, default-value=10  # Maximum number of retries to send a secured I-PDU in case PduR_SecOCTransmit returns E_NOT_OK.
      boolean SecOCOverrideStatusWithDataId [0..1]: set at pre-compile, default-value=false  # This option defines if the parameter "ValueId" of the function SecOC_VerifyStatusOverride() accepts the freshness value (as a collection of one or more Secured I-PDUs to freshness) or the dataID for individual Secured I-PDUs. | * true: Function SecOC_VerifyStatusOverride accepts SecOCDataId as parameter. * false: Function SecOC_VerifyStatusOverride accepts SecOCFreshnessValueId as parameter.
      boolean SecOCPropagateOnlyFinalVerificationStatus: set at pre-compile, default-value=false  # This parameter Is used to specify if the verification status shall be reported only after the final determination of the verification status (TRUE) or on every verification attempt (FALSE).
      enumeration SecOCQueryFreshnessValue: {CFUNC, RTE}, set at pre-compile, default-value=CFUNC  # This parameter specifies if the freshness value shall be determined through a C-function (CD) or a software component (SW-C).
      function name SecOCVerificationStatusCallout [0..*]: multiplicity set at pre-compile, set at pre-compile  # Entry address of the customer specific call out routine which shall be invoked in case of a verification attempt.
      boolean SecOCVersionInfoApi: set at pre-compile, default-value=false  # If true the SecOC_GetVersionInfo API is available.
      container SecOCSecurityEventRefs [0..1]: multiplicity set at pre-compile  # Container for the references to IdsMEvent elements representing the security events that the SecOC module shall report to the IdsM in case the coresponding security related event occurs (and if SecOCEnableSecurityEventReporting is set to "true"). The standardized security events in this container can be extended by vendor-specific security events. Tags: atp.Status=draft
        reference SEV_SECOC_FRESHNESS_NOT_AVAILABLE [0..1]: multiplicity set at pre-compile, set at pre-compile, requires-symbolic-name-value=true, destination=IdsMEvent  # Failed to get freshness value from FvM. Tags: atp.Status=draft
        reference SEV_SECOC_MAC_VERIFICATION_FAILED [0..1]: multiplicity set at pre-compile, set at pre-compile, requires-symbolic-name-value=true, destination=IdsMEvent  # MAC verification of a received PDU failed. Tags: atp.Status=draft
    container SecOCMainFunctionRx [0..*]  # Each element of this container defines one instance of SecOC_MainFunctionRx.
      float SecOCMainFunctionPeriodRx: 0..INF, set at pre-compile  # Allows to configure the time for the respective MainFunction instance of the Rx path (as float in seconds).
      reference SecOCMainFunctionRxPartitionRef: set at pre-compile, destination=EcucPartition  # Reference to EcucPartition, where the according SecOC_MainFunction instance is assigned to.
    container SecOCMainFunctionTx [0..*]  # Each element of this container defines one instance of SecOC_MainFunctionTx.
      float SecOCMainFunctionPeriodTx: 0..INF, set at pre-compile  # Allows to configure the time for the respective MainFunction instance of the Tx path (as float in seconds).
      reference SecOCMainFunctionTxPartitionRef: set at pre-compile, destination=EcucPartition  # Reference to EcucPartition, where the according SecOC_MainFunction instance is assigned to.
    container SecOCRxPduProcessing [0..*]  # Contains the parameters to configure the RxPdus to be verified by the SecOC module.
      integer SecOCAuthDataFreshnessLen [0..1]: 0..65535, scope=ECU, set at pre-compile  # The length of the external authentic PDU data in bits (uint16).
      integer SecOCAuthDataFreshnessStartPosition [0..1]: 0..65535, scope=ECU, set at pre-compile  # This value determines the start position in bits (uint16) of the Authentic PDU that shall be passed on to the Freshness SWC. The bit counting is done according to TPS_SYST_01068 and the bit ordering is done according to TPS_SYST_01069.
      integer SecOCAuthenticationBuildAttempts [0..1]: 0..65535, set at pre-compile  # This parameter specifies the number of authentication build attempts.
      integer SecOCAuthenticationVerifyAttempts [0..1]: 0..65535, set at pre-compile, default-value=0  # This parameter specifies the number of authentication verify attempts that are to be carried out when the verification of the authentication information failed for a given Secured I-PDU. If zero is set, then only one authentication verification attempt is done.
      integer SecOCAuthInfoTruncLength: 1..65535, post-build-variant-value=true, set at link in variant link-time / post-build in variant post-build / pre-compile in variant pre-compile  # This parameter defines the length in bits of the authentication code to be included in the payload of the Secured I-PDU.
      enumeration SecOCClientServerVerificationStatusPropagationMode: {BOTH, FAILURE_ONLY, NONE}, post-build-variant-value=true, set at link in variant link-time / post-build in variant post-build / pre-compile in variant pre-compile  # This parameter is used to determine the propagation of the verification status through the client/server interface to an SW-C.
      integer SecOCDataId: 0..65535, post-build-variant-value=true, set at link in variant link-time / post-build in variant post-build / pre-compile in variant pre-compile  # This parameter defines a unique numerical identifier for the Secured I-PDU.
      boolean SecOCDynamicRuntimeLengthHandling [0..1]: multiplicity set at pre-compile, set at pre-compile  # Defines whether the length information for handling this received Pdu is taken from the configuration or from the actually provided length information during runtime. | true: SecuredIPdu length information is taken from the actually provided length information during runtime. false: SecuredIPdu length information is taken from parameter PduLength of the Pdu.
      integer SecOCFreshnessValueId: 0..65535, post-build-variant-value=true, set at link in variant link-time / post-build in variant post-build / pre-compile in variant pre-compile  # This parameter defines the Id of the Freshness Value. | The Freshness Value might be a normal counter or a time value.
      integer SecOCFreshnessValueLength: 0..64, post-build-variant-value=true, set at link in variant link-time / post-build in variant post-build / pre-compile in variant pre-compile  # This parameter defines the complete length in bits of the Freshness Value. As long as the key doesn't change the counter shall not overflow. The length of the counter shall be determined based on the expected life time of the corresponding key and frequency of usage of the counter.
      integer SecOCFreshnessValueTruncLength: 0..64, post-build-variant-value=true, set at link in variant link-time / post-build in variant post-build / pre-compile in variant pre-compile  # This parameter defines the length in bits of the Freshness Value to be included in the payload of the Secured I-PDU. This length is specific to the least significant bits of the complete Freshness Counter. If the parameter is 0 no Freshness Value is included in the Secured I-PDU.
      enumeration SecOCReceptionOverflowStrategy: {QUEUE, REJECT, REPLACE}, set at pre-compile  # This parameter defines the overflow strategy for receiving PDUs
      integer SecOCReceptionQueueSize [0..1]: 1..65535, set at pre-compile  # This parameter defines the queue size in case the overflow strategy for receiving PDUs is set to QUEUE.
      boolean SecOCUseAuthDataFreshness: scope=ECU, set at pre-compile, default-value=false  # A Boolean value that indicates if a part of the Authentic-PDU shall be passed on to the SWC that verifies and generates the Freshness. If it is set to TRUE, the values SecOCAuthDataFreshnessStartPosition and SecOCAuthDataFreshnessLen must be set to specify the bit position and length within the Authentic-PDU.
      enumeration SecOCVerificationStatusPropagationMode: {BOTH, FAILURE_ONLY, NONE}, post-build-variant-value=true, set at link in variant link-time / post-build in variant post-build / pre-compile in variant pre-compile  # This parameter is used to describe the propagation of the status of each verification attempt from the SecOC module to SWCs.
      reference SecOCRxAuthServiceConfigRef: requires-symbolic-name-value=true, destination=CsmJob  # This reference is used to define which crypto service function is called for authentication. | If PDUs with a dynamic length are used (e.g. CanTP or Dynamic Length PDUs) a MAC algorithm has to be chosen, that is not vulnerable to length extension attack (e.g. CMAC/HMAC).
      reference SecOCRxPduMainFunctionRef [0..1]: multiplicity set at pre-compile, set at pre-compile, destination=SecOCMainFunctionRx  # Reference to the SecOC_MainFunctionRx this PDU belongs to. | Mandatory, if multiple main functions are defined.
      reference SecOCSameBufferPduRef [0..1]: multiplicity set at pre-compile, set at pre-compile, destination=SecOCSameBufferPduCollection  # This reference is used to collect Pdus that are using the same SecOC buffer.
      container SecOCRxAuthenticPduLayer  # This container specifies the Pdu that is transmitted by the SecOC module to the PduR after the Mac was verified.
        enumeration SecOCPduType: {SECOC_IFPDU, SECOC_TPPDU}, set at pre-compile  # This parameter defines API Type to use for communication with PduR.
        integer SecOCRxAuthenticLayerPduId: 0..65535, set at pre-compile, with-auto=true  # PDU identifier assigned by SecOC module. Used by PduR for SecOC_TpCancelReceive.
        reference SecOCRxAuthenticLayerPduRef: post-build-variant-value=true, set at link in variant link-time / post-build in variant post-build / pre-compile in variant pre-compile, destination=Pdu  # Reference to the global Pdu.
      container SecOCRxPduSecuredArea [0..1]  # This container specifies an area in the Authentic I-Pdu that will be the input to the Authenticator verification algorithm. If this container does not exist in the configuration the complete Authentic I-Pdu will be the input to the Authenticator verification algorithm.
        integer SecOCSecuredRxPduLength: 1..4294967295, post-build-variant-value=true, set at link in variant link-time / post-build in variant post-build / pre-compile in variant pre-compile  # This parameter defines the length (in bytes) of the area within the Pdu which is secured
        integer SecOCSecuredRxPduOffset: 0..4294967295, post-build-variant-value=true, set at link in variant link-time / post-build in variant post-build / pre-compile in variant pre-compile, default-value=0  # This parameter defines the start position (offset in bytes) of the area within the Pdu which is secured
      choice container SecOCRxSecuredPduLayer  # This container specifies the Pdu that is received by the SecOC module from the PduR. For this Pdu the Mac verification is provided.
        container SecOCRxSecuredPdu [0..1]  # This container specifies the Pdu that is received by the SecOC module from the PduR. For this Pdu the Mac verification is provided.
          integer SecOCAuthPduHeaderLength [0..1]: 0..4, set at pre-compile, default-value=0  # This parameter indicates the length (in bytes) of the Secured I-PDU Header in the Secured I-PDU. The length of zero means there's no header in the PDU.
          integer SecOCRxSecuredLayerPduId: 0..65535, set at pre-compile, symbolic-name-value=true, with-auto=true  # PDU identifier assigned by SecOC module. Used by PduR for <nowiki>SecOC_[If|Tp]RxIndication</nowiki>.
          boolean SecOCSecuredRxPduVerification: post-build-variant-value=true, set at pre-compile, default-value=false  # This parameter defines whether the signature authentication or MAC verification shall be performed on this Secured I-PDU. If set to false, the SecOC module extracts the Authentic I-PDU from the Secured I-PDU without verification.
          reference SecOCRxSecuredLayerPduRef: post-build-variant-value=true, set at link in variant link-time / post-build in variant post-build / pre-compile in variant pre-compile, destination=Pdu  # Reference to the global Pdu.
        container SecOCRxSecuredPduCollection [0..1]  # This container specifies two Pdus that are received by the SecOC module from the PduR and a message linking between them. | SecOCRxAuthenticPdu contains the original Authentic I-PDU, i.e. the secured data, and the SecOCRxCryptographicPdu contains the Authenticator, i.e. the actual Authentication Information.
          boolean SecOCSecuredRxPduVerification: post-build-variant-value=true, set at pre-compile, default-value=false  # This parameter defines whether the signature authentication or MAC verification shall be performed on this Secured I-PDU. If set to false, the SecOC module extracts the Authentic I-PDU from the Secured I-PDU without verification.
          container SecOCRxAuthenticPdu  # This container specifies the PDU (that is received by the SecOC module from the PduR) which contains the Secured I-PDU Header and the Authentic I-PDU.
            integer SecOCAuthPduHeaderLength [0..1]: 0..4, set at pre-compile, default-value=0  # This parameter indicates the length (in bytes) of the Secured I-PDU Header in the Secured I-PDU. The length of zero means there's no header in the PDU.
            integer SecOCRxAuthenticPduId: 0..65535, set at pre-compile, symbolic-name-value=true, with-auto=true  # PDU identifier of the Authentic I-PDU assigned by SecOC module. Used by PduR for SecOC_IfRxIndication.
            reference SecOCRxAuthenticPduRef: post-build-variant-value=true, set at link in variant link-time / post-build in variant post-build / pre-compile in variant pre-compile, destination=Pdu  # Reference to the global Pdu.
          container SecOCRxCryptographicPdu  # This container specifies the Cryptographic Pdu that is received by the SecOC module from the PduR.
            integer SecOCRxCryptographicPduId: 0..65535, set at pre-compile, symbolic-name-value=true, with-auto=true  # PDU identifier of the Cryptographic I-PDU assigned by SecOC module. Used by PduR for SecOC_IfRxIndication.
            reference SecOCRxCryptographicPduRef: post-build-variant-value=true, set at link in variant link-time / post-build in variant post-build / pre-compile in variant pre-compile, destination=Pdu  # Reference to the global Pdu.
          container SecOCUseMessageLink [0..1]  # SecOC links an Authentic I-PDU and Cryptographic I-PDU together by repeating a specific part (Message Linker) of the Authentic I-PDU in the Cryptographic I-PDU.
            integer SecOCMessageLinkLen: 0..65535, set at pre-compile  # Length of the Message Linker inside the Authentic I-PDU in bits.
            integer SecOCMessageLinkPos: 0..65535, set at pre-compile  # The position of the Message Linker inside the Authentic I-PDU in bits. | The bit counting is done according to 01068 and the bit ordering is done according to TPS_SYST_01069.
    container SecOCSameBufferPduCollection [0..*]: multiplicity set at pre-compile  # SecOCBuffer configuration that may be used by a collection of Pdus.
      integer SecOCBufferLength: 0..4294967295, set at pre-compile  # This parameter defines the Buffer in bytes that is used by the SecOC module.
    container SecOCTxPduProcessing [0..*]  # Contains the parameters to configure the TxPdus to be secured by the SecOC module.
      integer SecOCAuthenticationBuildAttempts [0..1]: 0..65535, set at pre-compile  # This parameter specifies the number of authentication build attempts.
      integer SecOCAuthInfoTruncLength: 1..65535, post-build-variant-value=true, set at link in variant link-time / post-build in variant post-build / pre-compile in variant pre-compile  # This parameter defines the length in bits of the authentication code to be included in the payload of the Secured I-PDU.
      integer SecOCDataId: 0..65535, post-build-variant-value=true, set at link in variant link-time / post-build in variant post-build / pre-compile in variant pre-compile  # This parameter defines a unique numerical identifier for the Secured I-PDU.
      integer SecOCFreshnessValueId: 0..65535, post-build-variant-value=true, set at link in variant link-time / post-build in variant post-build / pre-compile in variant pre-compile  # This parameter defines the Id of the Freshness Value. | The Freshness Value might be a normal counter or a time value.
      integer SecOCFreshnessValueLength: 0..64, post-build-variant-value=true, set at link in variant link-time / post-build in variant post-build / pre-compile in variant pre-compile  # This parameter defines the complete length in bits of the Freshness Value. As long as the key doesn't change the counter shall not overflow. The length of the counter shall be determined based on the expected life time of the corresponding key and frequency of usage of the counter.
      integer SecOCFreshnessValueTruncLength: 0..64, post-build-variant-value=true, set at link in variant link-time / post-build in variant post-build / pre-compile in variant pre-compile  # This parameter defines the length in bits of the Freshness Value to be included in the payload of the Secured I-PDU. This length is specific to the least significant bits of the complete Freshness Counter. If the parameter is 0 no Freshness Value is included in the Secured I-PDU.
      boolean SecOCProvideTxTruncatedFreshnessValue: set at pre-compile, default-value=false  # This parameter specifies if the Tx query freshness function provides the truncated freshness info instead of generating this by SecOC In this case, SecOC shall add this data to the Authentic PDU instead of truncating the freshness value.
      boolean SecOCReAuthenticateAfterTriggerTransmit: post-build-variant-value=true, set at link in variant link-time / post-build in variant post-build / pre-compile in variant pre-compile, default-value=true  # This parameter specifies if the authentication information of the Secured PDU is updated after | the successful transmission of a triggered transmission was confirmed. TRUE if the authentication information shall be updated after triggered transmission. FALSE if the authentication information shall not be updated after triggered transmission. Note: This parameter should only be set to FALSE if the upper layer SecOC_IfTransmit have the same or a higher frequency than the SecOC_TriggerTransmit calls.
      integer SecOCTxPduUnusedAreasDefault: 0..255, set at link in variant link-time+post-build / pre-compile in variant pre-compile, default-value=0  # The AUTOSAR SecOC module fills not used areas of a transmitted Secured Pdu or a transmitted Cryptographic Pdu with this byte pattern. This attribute is mandatory to avoid undefined behavior.
      boolean SecOCUseTxConfirmation [0..1]: set at pre-compile, default-value=false  # A Boolean value that indicates if the function SecOC_SPduTxConfirmation shall be called for this PDU.
      reference SecOCSameBufferPduRef [0..1]: multiplicity set at pre-compile, set at pre-compile, destination=SecOCSameBufferPduCollection  # This reference is used to collect Pdus that are using the same SecOC buffer.
      reference SecOCTxAuthServiceConfigRef: requires-symbolic-name-value=true, destination=CsmJob  # This reference is used to define which crypto service function is called for authentication. | If PDUs with a dynamic length are used (e.g. CanTP or Dynamic Length PDUs) a MAC algorithm has to be chosen, that is not vulnerable to length extension attack (e.g. CMAC/HMAC).
      reference SecOCTxPduMainFunctionRef [0..1]: multiplicity set at pre-compile, set at pre-compile, destination=SecOCMainFunctionTx  # Reference to the SecOC_MainFunctionTx this PDU belongs to. | Mandatory, if multiple main functions are defined.
      container SecOCTxAuthenticPduLayer  # This container specifies the Pdu that is received by the SecOC module from the PduR. For this Pdu the Mac generation is provided.
        enumeration SecOCPduType: {SECOC_IFPDU, SECOC_TPPDU}, set at pre-compile  # This parameter defines API Type to use for communication with PduR.
        integer SecOCTxAuthenticLayerPduId: 0..65535, set at pre-compile, symbolic-name-value=true, with-auto=true  # PDU identifier assigned by SecOC module. Used by PduR for <nowiki>SecOC_[If|Tp]Transmit</nowiki>.
        reference SecOCTxAuthenticLayerPduRef: post-build-variant-value=true, set at link in variant link-time / post-build in variant post-build / pre-compile in variant pre-compile, destination=Pdu  # Reference to the global Pdu.
      container SecOCTxPduSecuredArea [0..1]  # This container specifies an area in the Authentic I-Pdu that will be the input to the Authenticator generation algorithm. If this container does not exist in the configuration the complete Authentic I-Pdu will be the input to the Authenticator generation algorithm.
        integer SecOCSecuredTxPduLength: 1..4294967295, post-build-variant-value=true, set at link in variant link-time / post-build in variant post-build / pre-compile in variant pre-compile  # This parameter defines the length (in bytes) of the area within the Pdu which shall be secured
        integer SecOCSecuredTxPduOffset: 0..4294967295, post-build-variant-value=true, set at link in variant link-time / post-build in variant post-build / pre-compile in variant pre-compile, default-value=0  # This parameter defines the start position (offset in bytes) of the area within the Pdu which shall be secured
      choice container SecOCTxSecuredPduLayer  # This container specifies the Pdu that is transmitted by the SecOC module to the PduR after the Mac was generated.
        container SecOCTxSecuredPdu [0..1]  # This container specifies one Pdu that is transmitted by the SecOC module to the PduR after the Mac was generated. This Pdu contains the cryptographic information.
          integer SecOCAuthPduHeaderLength [0..1]: 0..4, set at pre-compile, default-value=0  # This parameter indicates the length (in bytes) of the Secured I-PDU Header in the Secured I-PDU. The length of zero means there's no header in the PDU.
          integer SecOCTxSecuredLayerPduId: 0..65535, set at pre-compile, symbolic-name-value=true, with-auto=true  # PDU identifier assigned by SecOC module. | Used by PduR for confirmation (<nowiki>SecOC_[If|Tp]TxConfirmation</nowiki>) and for TriggerTransmit.
          reference SecOCTxSecuredLayerPduRef: post-build-variant-value=true, set at link in variant link-time / post-build in variant post-build / pre-compile in variant pre-compile, destination=Pdu  # Reference to the global Pdu.
        container SecOCTxSecuredPduCollection [0..1]  # This container specifies the Pdu that is transmitted by the SecOC module to the PduR after the Mac was generated. Two separate Pdus are transmitted to the PduR: | Authentic I-PDU and Cryptographic I-PDU.
          container SecOCTxAuthenticPdu  # This container specifies the PDU (that is transmitted by the SecOC module to the PduR) which contains the Secured I-PDU Header and the Authentic I-PDU.
            integer SecOCAuthPduHeaderLength [0..1]: 0..4, set at pre-compile, default-value=0  # This parameter indicates the length (in bytes) of the Secured I-PDU Header in the Secured I-PDU. The length of zero means there's no header in the PDU.
            integer SecOCTxAuthenticPduId: 0..65535, set at pre-compile, symbolic-name-value=true, with-auto=true  # PDU identifier of the Authentic I-PDU assigned by SecOC module. Used by PduR for confirmation (SecOC_IfTxConfirmation) and for TriggerTransmit.
            reference SecOCTxAuthenticPduRef: post-build-variant-value=true, set at link in variant link-time / post-build in variant post-build / pre-compile in variant pre-compile, destination=Pdu  # Reference to the global Pdu.
          container SecOCTxCryptographicPdu  # This container specifies the Cryptographic Pdu that is transmitted by the SecOC module to the PduR after the Mac was generated.
            integer SecOCTxCryptographicPduId: 0..65535, set at pre-compile, symbolic-name-value=true, with-auto=true  # PDU identifier of the Cryptographic I-PDU assigned by SecOC module. Used by PduR for confirmation (SecOC_IfTxConfirmation) and for TriggerTransmit.
            reference SecOCTxCryptographicPduRef: post-build-variant-value=true, set at link in variant link-time / post-build in variant post-build / pre-compile in variant pre-compile, destination=Pdu  # Reference to the global Pdu.
          container SecOCUseMessageLink [0..1]  # SecOC links an Authentic I-PDU and Cryptographic I-PDU together by repeating a specific part (Message Linker) of the Authentic I-PDU in the Cryptographic I-PDU.
            integer SecOCMessageLinkLen: 0..65535, set at pre-compile  # Length of the Message Linker inside the Authentic I-PDU in bits.
            integer SecOCMessageLinkPos: 0..65535, set at pre-compile  # The position of the Message Linker inside the Authentic I-PDU in bits. | The bit counting is done according to 01068 and the bit ordering is done according to TPS_SYST_01069.
  module definition SoAd [0..1]: post-build-variant-support=true, variants link-time/post-build/pre-compile  # Configuration of the SoAd (Socket Adaptor) module.
    container SoAdBswModules [0..*]  # Each container describes a specific BSW module that the SoAd shall interface to.
      boolean SoAdIf: set at pre-compile  # Specifies if the BSW module supports the Communication Interface APIs or not. Value true means that the APIs are supported. A module can have both Communication Interface APIs and Transport Protocol APIs (e.g. the PduR module).
      boolean SoAdIfTriggerTransmit: set at pre-compile, default-value=false  # Specifies if the BSW module supports the TriggerTransmit API or not. Value true means that the API is supported.
      boolean SoAdIfTxConfirmation: set at pre-compile  # Specifies if the BSW module supports the TxConfirmation API or not. Value true means that the API is supported.
      boolean SoAdLocalIpAddrAssigmentChg: set at pre-compile  # Specifies if the BSW module supports the LocalIpAddrAssigmentChg API or not. Value true means that the API is supported.
      boolean SoAdSoConModeChg: set at pre-compile  # Specifies if the BSW module supports the SoConModeChg API or not. Value true means that the API is supported.
      boolean SoAdTp: set at pre-compile  # Specifies if the BSW module supports the TransportProtocol APIs or not. Value true means that the APIs are supported. A module can have both Communication Interface APIs and Transport Protocol APIs (e.g. the PduR module).
      boolean SoAdUseCallerInfix: set at pre-compile, default-value=true  # Specifies if SoAd shall use (TRUE) the infix "SoAd" when calling an upper layer module function or not (FALSE). E.g. if SoAdUseCallerInfix is TRUE for the upper layer "ABC" then SoAd will call ABC_SoAdIfRxIndication() otherwise SoAd would call ABC_IfRxIndication().
      boolean SoAdUseTypeInfix: set at pre-compile, default-value=true  # Specifies if SoAd shall use (TRUE) the API type infix "Tp" or "If" when calling an upper layer module function or not (FALSE). E.g. if SoAdUseTypeInfix is TRUE for the upper layer "ABC" then SoAd will call ABC_IfRxIndication(), otherwise SoAd would call ABC_RxIndication().
      foreign reference SoAdBswModuleRef: set at pre-compile, destination-type=ECUC-MODULE-CONFIGURATION-VALUES  # This is a reference to one BSW module's configuration (i.e. not the ECUC parameter definition template). | Example, there could be several configurations of PduR and this reference selects one of them. SoAd has to figure out from the structure of the referenced BSW module's configuration, what kind of upper layer he deals with. In case of a CDD SoAd expects UL-APIs in form of _SoAd<If|Tp><function> and expects CDD Pdu configuration structures according to the Ecu Configuration specification (chapter CDD module\Socket Adaptor). In case it is one of the standardized AUTOSAR BSW modules, the configuration structures and API names for interaction with SoAd are defined in the corresponding SWS.
    container SoAdConfig  # This container contains the configuration parameters and sub containers of the AUTOSAR SoAd module.
      container SoAdPduRoute [0..*]  # Describes the path of a PDU from an upper layer of the SoAd to the socket in the TCP/IP stack for transmission. This PDU can consume meta data items of type SOCKET_CONNECTION_ID_16.
        enumeration SoAdTxPduCollectionSemantics: {SOAD_COLLECT_LAST_IS_BEST, SOAD_COLLECT_QUEUED}, post-build-variant-value=true, set at link in variant link-time / post-build in variant post-build / pre-compile in variant pre-compile, default-value=SOAD_COLLECT_QUEUED  # Specifies if this PDU shall be collected using a queued or last-is-best semantics. This parameter is only relevant if the PDU collection feature is enabled. Shall only be set to SOAD_COLLECT_LAST_IS_BEST if the related upper layer is configured with SoAdIfTriggerTransmit set to TRUE.
        integer SoAdTxPduId: 0..65535, scope=ECU, set at pre-compile, symbolic-name-value=true, with-auto=true  # Tx PDU ID of the PDU coming from the PDU Router.
        enumeration SoAdTxUpperLayerType: {IF, TP}, scope=ECU, post-build-variant-value=true, set at link in variant link-time / post-build in variant post-build / pre-compile in variant pre-compile  # Specifies the upper layer interface type (must be "IF" in case of multiple PduRoutes).
        reference SoAdTxPduRef: scope=ECU, post-build-variant-value=true, set at link in variant link-time / post-build in variant post-build / pre-compile in variant pre-compile, destination=Pdu  # Reference to the global PDU structure
        container SoAdPduRouteDest [1..*]  # Specifies the PDU route destination.
          integer SoAdTxPduHeaderId [0..1]: 0..4294967296, multiplicity set at link in variant link-time / post-build in variant post-build / pre-compile in variant pre-compile, post-build-variant-multiplicity=true, post-build-variant-value=true, set at link in variant link-time / post-build in variant post-build / pre-compile in variant pre-compile  # ID to be sent on the TCP/IP connection if the PDU header option is enabled.
          enumeration SoAdTxUdpTriggerMode [0..1]: {TRIGGER_ALWAYS, TRIGGER_NEVER}, multiplicity set at link in variant link-time / post-build in variant post-build / pre-compile in variant pre-compile, post-build-variant-multiplicity=true, post-build-variant-value=true, set at link in variant link-time / post-build in variant post-build / pre-compile in variant pre-compile  # Specifies whether a PDU triggers the transmission of the nPduUdpTxBuffer. | If this parameter is set to TRIGGER_NEVER, SoAd shall use an nPduUdpTxBuffer for the related socket connection. nPduUdpTxBuffer can only be used for upper layers with IF API, i.e. this parameter shall only be set to TRIGGER_NEVER if all upper layers belonging to the related socket connection have SoAdTxUpperLayerType set to "IF". This parameter is only relevant for UDP connections.
          float SoAdTxUdpTriggerTimeout [0..1]: 0..INF, multiplicity set at link in variant link-time / post-build in variant post-build / pre-compile in variant pre-compile, post-build-variant-multiplicity=true, post-build-variant-value=true, set at link in variant link-time / post-build in variant post-build / pre-compile in variant pre-compile  # Specifies the timeout in [s] the nPduUdpTxBuffer shall be transmitted at the latest after this PDU is put into the buffer. This optional parameter is only relevant if SoAdTxUdpTriggerMode is TRIGGER_NEVER.
          reference SoAdTxRoutingGroupRef [0..*]: multiplicity set at link in variant link-time / post-build in variant post-build / pre-compile in variant pre-compile, post-build-variant-multiplicity=true, post-build-variant-value=true, set at link in variant link-time / post-build in variant post-build / pre-compile in variant pre-compile, destination=SoAdRoutingGroup  # Reference to the routing group.
          choice reference SoAdTxSocketConnOrSocketConnBundleRef: post-build-variant-value=true, set at link in variant link-time / post-build in variant post-build / pre-compile in variant pre-compile, destination=[SoAdSocketConnection, SoAdSocketConnectionGroup]  # Choice Reference to a SocketConnection or to a SocketConnectionGroup on which the PDU is to be sent on. The reference to a SocketConnectionGroup shall only be used for upper layers with IF API.
      container SoAdRoutingGroup [0..*]  # Each container describes a specific routing group which can be enabled or disabled. A routing group consists of PDUs. Routing of PDUs can either be forwarding of PDUs from the upper layer to a TCP or UDP socket of the TCP/IP stack specified by a SoAdPduRoute or the other way around specified by a SoAdSocketRoute.
        integer SoAdRoutingGroupId: 0..65535, scope=ECU, set at pre-compile, symbolic-name-value=true, with-auto=true  # Unique ID of Routing Group
        boolean SoAdRoutingGroupIsEnabledAtInit: post-build-variant-value=true, set at link in variant link-time / post-build in variant post-build / pre-compile in variant pre-compile  # If set to true this routing group will be enabled after initializing the SoAd module (i.e. enabled in the SoAd_Init function).
        boolean SoAdRoutingGroupTxTriggerable: set at pre-compile, default-value=false  # Specifies if the If-TxPDUs related to the PduRouteDest containers | referenced by this routing group can be triggered via SoAd_IfRoutingGroupTransmit (TRUE) or not (FALSE).
      container SoAdSocketConnectionGroup [1..*]  # Specifies the configuration of a socket connection group, i.e. specifies the socket connections belonging to the group and the parameters which are common for all socket connections of the group. A socket connection specifies how data can be received and transmited via a TCP or UDP socket.
        boolean SoAdPduHeaderEnable: post-build-variant-value=true, set at link in variant link-time / post-build in variant post-build / pre-compile in variant pre-compile  # Enables the transmission of the PDU header (ID, length) on this socket connection. | TRUE: add SoAd PDU header before PDU data FALSE: No SoAd PDU header is used
        boolean SoAdSocketAutomaticSoConSetup: post-build-variant-value=true, set at link in variant link-time / post-build in variant post-build / pre-compile in variant pre-compile, default-value=true  # Specifies if the setup of the socket connection shall be done automatically (TRUE) or manually (FALSE) via SoAd_OpenSoCon() and SoAd_CloseSoCon().
        integer SoAdSocketDifferentiatedServicesField [0..1]: 0..63, multiplicity set at link in variant link-time / post-build in variant post-build / pre-compile in variant pre-compile, post-build-variant-multiplicity=true, post-build-variant-value=true, set at link in variant link-time / post-build in variant post-build / pre-compile in variant pre-compile  # The 6-bit Differentiated Service Field in the IP headers may be used for classifying network traffic. If not set a value of zero is used to indicate packets that have not been classified.
        integer SoAdSocketFlowLabel [0..1]: 0..1048575, multiplicity set at link in variant link-time / post-build in variant post-build / pre-compile in variant pre-compile, post-build-variant-multiplicity=true, post-build-variant-value=true, set at link in variant link-time / post-build in variant post-build / pre-compile in variant pre-compile  # The 20-bit Flow Label field in the IPv6 header may be used by a source to label sequences of packets for which it requests special handling by the IPv6 routers, such as non-default quality of service. If not set a Flow Label of zero is used to indicate packets that have not been labeled.
        integer SoAdSocketFramePriority [0..1]: 0..7, multiplicity set at link in variant link-time / post-build in variant post-build / pre-compile in variant pre-compile, post-build-variant-multiplicity=true, post-build-variant-value=true, set at link in variant link-time / post-build in variant post-build / pre-compile in variant pre-compile  # Specifies the priority of the Ethernet frame. | If IEEE 802.1Q VLAN Tags are used, the specified priority will be used in the VLAN Tag PCP filed. If this optional parameter is not available the default priority specified in the TcpIp module is used.
        boolean SoAdSocketIpAddrAssignmentChgNotification: post-build-variant-value=true, set at link in variant link-time / post-build in variant post-build / pre-compile in variant pre-compile, default-value=false  # Specifies if the local IP address assignment change notification callback function of the upper layer shall be called if the assignment of the local IP address used by this socket connection changes.
        integer SoAdSocketLocalPort: 0..65535, post-build-variant-value=true, set at link in variant link-time / post-build in variant post-build / pre-compile in variant pre-compile, default-value=0  # Local UDP or TCP port used for this connection. If this parameter set to 0 SoAd requests TcpIp to select an ephemeral port.
        boolean SoAdSocketMsgAcceptanceFilterEnabled: post-build-variant-value=true, set at link in variant link-time / post-build in variant post-build / pre-compile in variant pre-compile, default-value=true  # Specifies if the message acceptance filter is enabled (TRUE) or not (FALSE). | Note: if a wildcard is used in SoAdSocketRemoteAddress AND SoAdSocketUdpListenOnly is FALSE, this parameter must be TRUE. Note: if multiple SoAdSocketConnections are configured for one SoAdSocketConnectionGroup, this parameter must be TRUE.
        boolean SoAdSocketPathMTUEnable [0..1]: multiplicity set at link in variant link-time / post-build in variant post-build / pre-compile in variant pre-compile, post-build-variant-multiplicity=true, post-build-variant-value=true, set at link in variant link-time / post-build in variant post-build / pre-compile in variant pre-compile, default-value=false  # Specifies if path MTU discovery shall be performed for this connection. If this optional parameter is not available the default behavior configured for the controller in the TcpIp module via the parameter TcpIpIpV4PathMtuEnabled or TcpIpIpV6PathMtuEnabled is applied.
        boolean SoAdSocketSoConModeChgBswMNotification [0..1]: multiplicity set at link in variant link-time / post-build in variant post-build / pre-compile in variant pre-compile, post-build-variant-multiplicity=true, post-build-variant-value=true, set at link in variant link-time / post-build in variant post-build / pre-compile in variant pre-compile  # Specifies if the BswM_SoAd_SoConModeChg notification shall be called in case of SoCon mode change
        boolean SoAdSocketSoConModeChgNotification: post-build-variant-value=true, set at link in variant link-time / post-build in variant post-build / pre-compile in variant pre-compile, default-value=false  # Specifies if the SoCon mode change notification callback function of the upper layer shall be called in case of SoCon mode change.
        integer SoAdSocketTimeToLive [0..1]: 1..255, multiplicity set at link in variant link-time / post-build in variant post-build / pre-compile in variant pre-compile, post-build-variant-multiplicity=true, post-build-variant-value=true, set at link in variant link-time / post-build in variant post-build / pre-compile in variant pre-compile  # This parameter defines a value set in the header of an Internet Protocol (IP) packet that tells network devices the maximum number of router hops the packet can make before it is discarded. The TTL value is a counter that is decremented by 1 every time the packet passes through a router.
        integer SoAdSocketTpRxBufferMin [0..1]: 0..65535, multiplicity set at link in variant link-time / post-build in variant post-build / pre-compile in variant pre-compile, post-build-variant-multiplicity=true, post-build-variant-value=true, set at link in variant link-time / post-build in variant post-build / pre-compile in variant pre-compile  # Specifies the amount of data in bytes (PDU data for the upper layer and PDU Header if used) the SoAd shall at least be able to buffer for data reception via each socket connection of the socket connection group and using an upper layer with TP. | Note: in case of a TCP socket where PduHeaderMode is used and an upper layer with IF-API, the required buffer size can be determined automatically.
        reference SoAdSocketIpAddrAssignmentChgNotifUpperLayerRef [0..1]: multiplicity set at pre-compile, set at pre-compile, destination=SoAdBswModules  # Reference to an additional upper layer that shall be called if the assignment of the local IP address used by this socket connection changes (although it is not a direct upper layer of the socket connection). Tags: atp.Status=draft
        reference SoAdSocketLocalAddressRef: post-build-variant-value=true, set at link in variant link-time / post-build in variant post-build / pre-compile in variant pre-compile, requires-symbolic-name-value=true, destination=TcpIpLocalAddr  # Local IP address and interface used for this connection.
        reference SoAdSocketSoConModeChgNotifUpperLayerRef [0..1]: multiplicity set at pre-compile, set at pre-compile, destination=SoAdBswModules  # Reference to an additional upper layer that shall receive socket connection state changes (although it is not a direct upper layer of the socket connection).
        container SoAdSocketConnection [1..*]  # Specifies the socket connection (Id and remote address information). | Note: Parameters which are common to all socket connections of a socket connection group are specified directly at the group.
          integer SoAdSocketId: 0..65535, scope=ECU, set at pre-compile, symbolic-name-value=true, with-auto=true  # Socket connection identifier used as SoConId in the interaction with upper layers.
          container SoAdSocketRemoteAddress [0..1]  # Subcontainer of SoAdSocketConnection to specify the remote address (IP address and port) for a socket connection. | If SoAdSocketRemoteAddress is not specified the remote address has to be set by the upper layer via SoAd_SetRemoteAddr().
            string SoAdSocketRemoteIpAddress: post-build-variant-value=true, set at link in variant link-time / post-build in variant post-build / pre-compile in variant pre-compile  # IP address of remote node. The configured address must be of the same TcpIpDomainType (i.e. IPv4 or IPv6) as the TcpIpLocalAddr referred by SoAdSocketLocalAddressRef . | To accept any remote IP address, set SoAdSocketRemoteIpAddress to "ANY". See message acceptance policy for more details.
            integer SoAdSocketRemotePort: 0..65535, post-build-variant-value=true, set at link in variant link-time / post-build in variant post-build / pre-compile in variant pre-compile  # Remote UDP or TCP port used for this connection. | To accept any remote port, set SoAdSocketRemotePort to 0. See message acceptance policy for more details.
        choice container SoAdSocketProtocol  # Specifies the transport protocol and transport protocol specific parameters used for the socket connections of the socket connection group.
          container SoAdSocketTcp [0..1]  # Specifies that TCP is used as transport protocol for the socket connection group and parameters only related to TCP socket connections.
            float SoAdSocketTcpAutoConnectTimeout [0..1]: 0..INF, multiplicity set at link in variant link-time / post-build in variant post-build / pre-compile in variant pre-compile, post-build-variant-multiplicity=true, post-build-variant-value=true, set at link in variant link-time / post-build in variant post-build / pre-compile in variant pre-compile  # Specifies the time in seconds how long 'TCP connect attempts are repeated to reach SOAD_SOCON_ONLINE. This parameter is restricted to socket connection groups which are initiating a TCP connection and are under control of SoAd.
            boolean SoAdSocketTcpImmediateTpTxConfirmation: scope=ECU, post-build-variant-value=true, set at link in variant link-time / post-build in variant post-build / pre-compile in variant pre-compile, default-value=false  # If set to FALSE, SoAd notifies the TP upper layer via transmit confirmation after a Tcp Ack has been received. If set to TRUE, SoAd notifies the TP upper layer via transmit confirmation immediately after transmit has been accepted by TcpIp.
            boolean SoAdSocketTcpInitiate: post-build-variant-value=true, set at link in variant link-time / post-build in variant post-build / pre-compile in variant pre-compile  # Specifies the initiator for this TCP connection. It will not be defined for UDP sockets. | TRUE: This TCP connection is initiated by this module. FALSE: This TCP connection is to be initiated in the listen mode.
            boolean SoAdSocketTcpKeepAlive: post-build-variant-value=true, set at link in variant link-time / post-build in variant post-build / pre-compile in variant pre-compile, default-value=false  # Specifies to use the keep-alive mechanism for this connection. It will not be defined for UDP sockets. | TRUE: This TCP connection will use the keep-alive mechanism. FALSE: This TCP connection will not use the keep-alive mechanism. Note: This parameter must not be set to TRUE if TcpIpTcpKeepAliveEnabled is set to FALSE.
            float SoAdSocketTcpKeepAliveInterval [0..1]: 0..INF, multiplicity set at link in variant link-time / post-build in variant post-build / pre-compile in variant pre-compile, post-build-variant-multiplicity=true, post-build-variant-value=true, set at link in variant link-time / post-build in variant post-build / pre-compile in variant pre-compile  # Specifies the interval in seconds between subsequent keepalive probes.
            integer SoAdSocketTcpKeepAliveProbesMax [0..1]: 0..65535, multiplicity set at link in variant link-time / post-build in variant post-build / pre-compile in variant pre-compile, post-build-variant-multiplicity=true, post-build-variant-value=true, set at link in variant link-time / post-build in variant post-build / pre-compile in variant pre-compile  # Maximum number of times that TCP retransmits an individual data segment before aborting the connection.
            float SoAdSocketTcpKeepAliveTime [0..1]: 0..INF, multiplicity set at link in variant link-time / post-build in variant post-build / pre-compile in variant pre-compile, post-build-variant-multiplicity=true, post-build-variant-value=true, set at link in variant link-time / post-build in variant post-build / pre-compile in variant pre-compile, default-value=7200  # Specifies the time in seconds between the last data packet sent and the first keepalive probe.
            boolean SoAdSocketTcpNoDelay [0..1]: multiplicity set at link in variant link-time / post-build in variant post-build / pre-compile in variant pre-compile, post-build-variant-multiplicity=true, post-build-variant-value=true, set at link in variant link-time / post-build in variant post-build / pre-compile in variant pre-compile  # Specifies not to use the congestion control mechanism for this connection. It will not be defined for UDP sockets. | TRUE: This TCP connection will NOT use congestion control. FALSE: This TCP connection will use congestion control. If the optional parameter is not enabled, the default behavior configured for TcpIp via the parameter TcpIpTcpNagleEnabled is applied. Note: This parameter must not be set to FALSE if TcpIpTcpNagleEnabled is set to FALSE.
            float SoAdSocketTcpRetransmissionTimeout [0..1]: 0.001..INF, multiplicity set at link in variant link-time / post-build in variant post-build / pre-compile in variant pre-compile, post-build-variant-multiplicity=true, post-build-variant-value=true, set at link in variant link-time / post-build in variant post-build / pre-compile in variant pre-compile  # Timeout in [s] before an unacknowledged TCP segment is sent again. | If the timeout is set to INF, no TCP segments shall be retransmitted.
            integer SoAdSocketTcpTxQuota [0..1]: 0..4294967295, multiplicity set at link in variant link-time / post-build in variant post-build / pre-compile in variant pre-compile, post-build-variant-multiplicity=true, post-build-variant-value=true, set at link in variant link-time / post-build in variant post-build / pre-compile in variant pre-compile  # Specifies the maximum amount of bytes (PDU data provided by the upper layer and PDU Header if used) the SoAd may queue for transmission via TCP at the TcpIp module for each socket connection of this socket connection group. | Rationale: prohibits that a socket connection consumes all available transmit buffers at the TcpIp and blocks transmissions via other socket connections. If the optional parameter is not enabled, the amount of data is not limited.
            reference SoAdSocketTCPOptionFilterRef [0..1]: multiplicity set at link in variant link-time / post-build in variant post-build / pre-compile in variant pre-compile, post-build-variant-multiplicity=true, post-build-variant-value=true, set at link in variant link-time / post-build in variant post-build / pre-compile in variant pre-compile, requires-symbolic-name-value=true, destination=TcpIpTcpConfigOptionFilter  # Specifies which TCP option filter shall be applied on the related socket.
            reference SoAdSocketTcpTlsConnectionRef [0..1]: multiplicity set at pre-compile, set at pre-compile, requires-symbolic-name-value=true, destination=TcpIpTlsConnection  # If set the TCP socket is assigned to a TLS connection. The SoAd need to call Tcpip_ChangeParameter with the reference to the TLS connection as the parameter.
          container SoAdSocketUdp [0..1]  # Specifies that UDP is used as transport protocol for the socket connection group and parameters only related to UDP socket connections.
            integer SoAdSocketnPduUdpTxBufferMin [0..1]: 0..65535, multiplicity set at link in variant link-time / post-build in variant post-build / pre-compile in variant pre-compile, post-build-variant-multiplicity=true, post-build-variant-value=true, set at link in variant link-time / post-build in variant post-build / pre-compile in variant pre-compile  # Specifies the amount of data in bytes (PDU data provided by the upper layer and PDU Header if used) the SoAd shall be able to buffer for data transmission via this socket connection in case the UDP message shall be buffered for transmission of multiple PDUs per UDP. | Note: in case of a UDP socket and an upper layer with TP API is configured, the required buffer size can be determined automatically. This optional parameter is only relevant if a nPduUdpTxBuffer is used.
            float SoAdSocketUdpAliveSupervisionTimeout [0..1]: 0..INF, multiplicity set at link in variant link-time / post-build in variant post-build / pre-compile in variant pre-compile, post-build-variant-multiplicity=true, post-build-variant-value=true, set at link in variant link-time / post-build in variant post-build / pre-compile in variant pre-compile  # Specifies the time in [s] a UDP socket connection remains in the mode SOAD_SOCON_ONLINE after the latest reception of a frame from the remote peer specified by the remote address. If this optional parameter is not enabled UDP Alive Supervision is deactivated for the related socket connection group.
            boolean SoAdSocketUdpChecksumEnabled: post-build-variant-value=true, set at link in variant link-time / post-build in variant post-build / pre-compile in variant pre-compile, default-value=true  # Specifies if UDP checksum calculation shall be enabled (TRUE) or skipped (FALSE) on the related socket. FALSE implies that the upper layer of the socket connection is either capable to handle malformed messages or applies a checksum mechanism itself.
            boolean SoAdSocketUdpListenOnly: post-build-variant-value=true, set at link in variant link-time / post-build in variant post-build / pre-compile in variant pre-compile, default-value=false  # Specifies if the socket connection group is only used for reception (TRUE) or used for both reception and transmission (FALSE).
            boolean SoAdSocketUdpStrictHeaderLenCheckEnabled: post-build-variant-value=true, set at link in variant link-time / post-build in variant post-build / pre-compile in variant pre-compile, default-value=false  # Specifies if UDP messages shall be dropped (TRUE) if the length of all contained PDUs does not match the length of the whole message or not (FALSE). Shall only be set to TRUE if SoAdPduHeaderEnable is also set to TRUE.
            float SoAdSocketUdpTriggerTimeout [0..1]: 0..INF, multiplicity set at link in variant link-time / post-build in variant post-build / pre-compile in variant pre-compile, post-build-variant-multiplicity=true, post-build-variant-value=true, set at link in variant link-time / post-build in variant post-build / pre-compile in variant pre-compile  # Specifies the timeout in [s] a nPduUdpTxBuffer is waiting for a PDU with TriggerMode = TRIGGER_ALWAYS, i.e. when the timeout expires the nPduUdpTxBuffer is transmitted. Timer is reset after each UDP transmission. This optional parameter is only relevant if a nPduUdpTxBuffer is used.
      container SoAdSocketRoute [0..*]  # Describes the path of a PDU from a socket in the TCP/IP stack to an upper layer of the SoAd after reception in the TCP/IP Stack.
        integer SoAdRxPduHeaderId [0..1]: 0..4294967296, multiplicity set at link in variant link-time / post-build in variant post-build / pre-compile in variant pre-compile, post-build-variant-multiplicity=true, post-build-variant-value=true, set at link in variant link-time / post-build in variant post-build / pre-compile in variant pre-compile  # ID contained in the packet received on the TCP/IP connection if the PDU header option is enabled.
        choice reference SoAdRxSocketConnOrSocketConnBundleRef: post-build-variant-value=true, set at link in variant link-time / post-build in variant post-build / pre-compile in variant pre-compile, destination=[SoAdSocketConnection, SoAdSocketConnectionGroup]  # Choice Reference to a SocketConnection or to a SocketConnectionGroup on which the PDU was received. The reference to a SocketConnectionGroup shall only be used for upper layers with IF API.
        container SoAdSocketRouteDest [1..*]  # Describes the upper layer destination PDU for a message received on a TcpIp socket. This PDU can produce meta data items of type SOCKET_CONNECTION_ID_16. | Multiple socket route destinations in the SoAdSocketRoute can only be used for upper layers of interface type (IF) and only for SoAdSocketRoute referring a SocketConnectionGroup. In this case SoAdRoutingGroups shall be used to map each SoAdSocketRouteDest uniquely to different socket connections of the SocketConnectionGroup.
          integer SoAdRxPduId [0..1]: 0..65535, scope=ECU, multiplicity set at link in variant link-time / post-build in variant post-build / pre-compile in variant pre-compile, post-build-variant-multiplicity=true, post-build-variant-value=true, set at link in variant link-time / post-build in variant post-build / pre-compile in variant pre-compile, with-auto=true  # This unique identifier is used for a receive cancellation request from an upper layer of the SoAd.
          enumeration SoAdRxUpperLayerType: {IF, TP}, scope=ECU, post-build-variant-value=true, set at link in variant link-time / post-build in variant post-build / pre-compile in variant pre-compile  # Specifies the upper layer interface type (must be "IF" in case of multiple RxPdus).
          reference SoAdRxPduRef: scope=ECU, post-build-variant-value=true, set at link in variant link-time / post-build in variant post-build / pre-compile in variant pre-compile, destination=Pdu  # Reference to the global PDU structure
          reference SoAdRxRoutingGroupRef [0..*]: multiplicity set at link in variant link-time / post-build in variant post-build / pre-compile in variant pre-compile, post-build-variant-multiplicity=true, post-build-variant-value=true, set at link in variant link-time / post-build in variant post-build / pre-compile in variant pre-compile, destination=SoAdRoutingGroup  # Reference to the routing group. Mandatory if the parent SoAdSocketRoute contains more than one SoAdSocketRouteDest."
    container SoAdGeneral  # This container contains all global configuration parameters of SoAd.
      boolean SoAdDevErrorDetect: set at pre-compile, default-value=false  # Switches the development error detection and notification on or off. | * true: detection and notification is enabled. * false: detection and notification is disabled.
      boolean SoAdEnableSecurityEventReporting: scope=ECU, set at pre-compile, default-value=false  # Switches the reporting of security events to the IdsM: Tags: atp.Status=draft | - true: reporting is enabled. - false: reporting is disabled.
      boolean SoAdGetAndResetMeasurementDataApi: scope=ECU, set at pre-compile  # Enables / Disables the Get and Reset Measurement Data API
      boolean SoAdIPv6AddressEnabled: scope=ECU, set at pre-compile  # Allows for increased memory allocation to store IPv6 addresses. | TRUE: Enables support for IPv6 addresses FALSE: Only IPv4 addresses are supported
      float SoAdMainFunctionPeriod: 0..INF, scope=ECU, set at pre-compile  # Determines the frequency at which the SoAd_MainFunction() is called in [s].
      integer SoAdRoutingGroupMax: 0..65535, set at pre-compile  # Specifies the maximum number of SoAd routing groups. Furthermore it defines the platform type used for RoutingGroupIdType. If SoAdRoutingGroupMax is not greater than 256, a uint8 is used, | otherwise a uint16.
      integer SoAdSoConMax: 0..65535, set at pre-compile  # Specifies the maximum number of SoAd socket connections. | Furthermore it defines the platform type used for SoAd_SoConIdType. If SoAdSoConMax is not greater than 256, a uint8 is used, otherwise uint16.
      boolean SoAdVersionInfoApi: set at pre-compile, default-value=false  # Activates the SoAd_GetVersionInfo() API. | TRUE: Enables the SoAd_GetVersionInfo() API. FALSE: SoAd_GetVersionInfo() API is not included.
      container SoAdSecurityEventRefs [0..1]: multiplicity set at pre-compile  # Container for the references to IdsMEvent elements representing the security events that the SoAd module shall report to the IdsM in case the coresponding security related event occurs (and if SoAdEnableSecurityEventReporting is set to "true"). The standardized security events in this container can be extended by vendor-specific security events. Tags: atp.Status=draft
        reference SEV_DROP_MSG_RX_UDP_LENGTH [0..1]: multiplicity set at pre-compile, set at pre-compile, requires-symbolic-name-value=true, destination=IdsMEvent  # SoAd dropped a message. The message contains at least one PDU which violates stack configuration and was received via a UDP socket. Tags: atp.Status=draft | The violation relates to the length of the PDUs compared to the overall length of the message.
        reference SEV_DROP_MSG_RX_UDP_SOCKET [0..1]: multiplicity set at pre-compile, requires-symbolic-name-value=true, destination=IdsMEvent  # SoAd received a UDP message which violates stack configuration and was dropped. Tags: atp.Status=draft | No suitable socket connection matching to configuration was found.
        reference SEV_DROP_PDU_RX_TCP [0..1]: multiplicity set at pre-compile, set at pre-compile, requires-symbolic-name-value=true, destination=IdsMEvent  # SoAd dropped a PDU. The PDU violates stack configuration and was received via a TCP socket. Tags: atp.Status=draft
        reference SEV_DROP_PDU_RX_UDP [0..1]: multiplicity set at pre-compile, set at pre-compile, requires-symbolic-name-value=true, destination=IdsMEvent  # SoAd dropped a PDU. The PDU violates stack configuration and was received via a UDP socket. Tags: atp.Status=draft
        reference SEV_REJECTED_TCP_CONNECTION [0..1]: multiplicity set at pre-compile, requires-symbolic-name-value=true, destination=IdsMEvent  # SoAd rejected a TCP connection. The connection request violates stack configuration. Tags: atp.Status=draft
  module definition SomeIpTp [0..1]: post-build-variant-support=true, variants link-time/post-build/pre-compile  # Configuration of the SomeIpTp module.
    container SomeIpTpChannel [1..*]: multiplicity set at link in variant link-time / post-build in variant post-build / pre-compile in variant pre-compile, post-build-variant-multiplicity=true  # This container contains the configuration parameters of the SomeIpTp channel.
      float SomeIpTpNPduSeparationTime: 0..INF, post-build-variant-value=true, set at link in variant link-time / post-build in variant post-build / pre-compile in variant pre-compile  # Sets the duration of the minimum time in seconds the SomeIpTp module shall wait between the transmissions of N-PDUs.
      float SomeIpTpRxTimeoutTime: 0..INF, post-build-variant-value=true, set at link in variant link-time / post-build in variant post-build / pre-compile in variant pre-compile  # Timer to monitor the successful reception (see FO_PRS_SOMEIP_00378). It is started when the first NPdu is received, restarted after reception of intermediate NPdus, and is stopped when the last NPdu has been received. The value shall be calculated as follows: (SomeIpTpRxTimeoutTime = SomeIpTpNPduSeparationTime + budget), where the time budget compensates intermediary hops and jitters within the ECU implementation.
      integer SomeIpTpTxBurstSize [0..1]: 1..18446744073709551615, post-build-variant-multiplicity=true, post-build-variant-value=true, set at link in variant link-time / post-build in variant post-build / pre-compile in variant pre-compile, default-value=1  # Specifies the number of segments SomeIpTp shall transmit without applying the SomeIpTpNPduSeparationTime.
      container SomeIpTpRxNSdu [0..*]: multiplicity set at link in variant link-time / post-build in variant post-build / pre-compile in variant pre-compile, post-build-variant-multiplicity=true  # The following parameters needs to be configured for each N-SDU which has to be passed as one assembled RxPdu to the upper layer.
        reference SomeIpTpRxSduRef: post-build-variant-value=true, set at link in variant link-time / post-build in variant post-build / pre-compile in variant pre-compile, destination=Pdu  # Reference to a Pdu in the COM-Stack that represents the assembled RxPdu which is passed via the PduR to the upper layer.
        container SomeIpTpRxNPdu  # This container contains the configuration parameters of the NPdu that is received from a lower layer
          integer SomeIpTpRxNPduHandleId: 0..65535, scope=ECU, set at pre-compile, symbolic-name-value=true, with-auto=true  # This parameter defines the handle ID that is used by the PduR when calling SomeIpTp_RxIndication.
          reference SomeIpTpRxNPduRef: post-build-variant-value=true, set at link in variant link-time / post-build in variant post-build / pre-compile in variant pre-compile, destination=Pdu  # Reference to a global Pdu that is used to harmonize HandleIDs in the COM-Stack.
      container SomeIpTpTxNSdu [0..*]: multiplicity set at link in variant link-time / post-build in variant post-build / pre-compile in variant pre-compile, post-build-variant-multiplicity=true  # The following parameters needs to be configured for each N-SDU that the SomeIpTp module transmits via the SomeIpTpChannel.
        integer SomeIpTpTxNSduHandleId: 0..65535, scope=ECU, set at pre-compile, symbolic-name-value=true, with-auto=true  # This parameter defines the handle ID of the NSdu that represents the original TxSdu which is segmented and passed via the PduR to the lower layer. This handle ID is used by PduR when calling SomeIpTp_Transmit.
        reference SomeIpTpTxNSduRef: post-build-variant-value=true, set at link in variant link-time / post-build in variant post-build / pre-compile in variant pre-compile, destination=Pdu  # Reference to a global Pdu in the COM-Stack that represents the original TxSdu which is segmented and passed via the PduR to the lower layer.
        container SomeIpTpTxNPdu  # This container contains the configuration parameters of the segmented Tx NPdus that are transmitted to a lower layer.
          integer SomeIpTpTxNPduHandleId: 0..65535, scope=ECU, set at pre-compile, symbolic-name-value=true, with-auto=true  # This parameter defines the handle ID that is used by PduR when calling SomeIpTp_TriggerTransmit.
          reference SomeIpTpTxNPduRef: post-build-variant-value=true, set at link in variant link-time / post-build in variant post-build / pre-compile in variant pre-compile, destination=Pdu  # Reference to a global Pdu that is used to harmonize HandleIDs in the COM-Stack.
    container SomeIpTpGeneral  # This container contains the general configuration parameters of the SomeIpTp module.
      boolean SomeIpTpDevErrorDetect: set at pre-compile  # Switches the Development Error Detection and Notification ON or OFF.
      float SomeIpTpRxMainFunctionPeriod: 0..INF, set at pre-compile  # This parameter defines the cycle time in seconds of the periodic call of the SomeIpTp_MainFunctionRx.
      float SomeIpTpTxMainFunctionPeriod: 0..INF, set at pre-compile  # This parameter defines the cycle time in seconds of the periodic call of the SomeIpTp_MainFunctionTx.
      boolean SomeIpTpVersionInfoApi: set at pre-compile, default-value=false  # Activates the SomeIpTp_GetVersionInfo() API. | TRUE: Enables the SomeIpTp_GetVersionInfo() API. FALSE: SomeIpTp_GetVersionInfo() API is not included.
  module definition Spi [0..1]: post-build-variant-support=true, variants link-time/post-build/pre-compile  # Configuration of the Spi (Serial Peripheral Interface) module.
    container SpiDemEventParameterRefs [0..1]  # Container for the references to DemEventParameter elements which shall be invoked using the API Dem_SetEventStatus in case the corresponding error occurs. The EventId is taken from the referenced DemEventParameter's DemEventId symbolic value. The standardized errors are provided in this container and can be extended by vendor-specific error references.
      reference SPI_E_HARDWARE_ERROR [0..1]: multiplicity set at pre-compile, set at pre-compile, requires-symbolic-name-value=true, destination=DemEventParameter  # Reference to configured DEM event to report "Hardware failure". If the reference is not configured the error shall not be reported.
    container SpiDriver  # This container contains the configuration parameters and sub containers of the AUTOSAR Spi module.
      integer SpiMaxChannel [0..1]: 0..65535, multiplicity set at link in variant link-time / post-build in variant post-build / pre-compile in variant pre-compile, post-build-variant-multiplicity=true, post-build-variant-value=true, set at link in variant link-time / post-build in variant post-build / pre-compile in variant pre-compile, default-value=0  # This parameter contains the number of Channels configured. It will be gathered by tools during the configuration stage.
      integer SpiMaxJob [0..1]: 0..65535, multiplicity set at link in variant link-time / post-build in variant post-build / pre-compile in variant pre-compile, post-build-variant-multiplicity=true, post-build-variant-value=true, set at link in variant link-time / post-build in variant post-build / pre-compile in variant pre-compile, default-value=0  # Total number of Jobs configured.
      integer SpiMaxSequence [0..1]: 0..65535, multiplicity set at link in variant link-time / post-build in variant post-build / pre-compile in variant pre-compile, post-build-variant-multiplicity=true, post-build-variant-value=true, set at link in variant link-time / post-build in variant post-build / pre-compile in variant pre-compile, default-value=0  # Total number of Sequences configured.
      container SpiChannel [1..*]  # All data needed to configure one SPI-channel
        integer SpiChannelId: 0..255, set at pre-compile, symbolic-name-value=true  # SPI Channel ID, used as parameter in SPI API functions.
        enumeration SpiChannelType: {EB, IB}, post-build-variant-value=true, set at link in variant link-time / post-build in variant post-build / pre-compile in variant pre-compile  # Buffer usage with EB/IB channel.
        integer SpiDataWidth: 1..64, post-build-variant-value=true, set at link in variant link-time / post-build in variant post-build / pre-compile in variant pre-compile, default-value=32  # This parameter is the width of a transmitted data unit.
        integer SpiDefaultData [0..1]: 0..4294967295, multiplicity set at link in variant link-time / post-build in variant post-build / pre-compile in variant pre-compile, post-build-variant-multiplicity=true, post-build-variant-value=true, set at link in variant link-time / post-build in variant post-build / pre-compile in variant pre-compile  # The default data to be transmitted when (for internal buffer or external buffer) the pointer passed to Spi_WriteIB (for internal buffer) or to Spi_SetupEB (for external buffer) is NULL.
        integer SpiEbMaxLength [0..1]: 1..1048576, post-build-variant-multiplicity=true, post-build-variant-value=true, set at link in variant link-time / post-build in variant post-build / pre-compile in variant pre-compile, default-value=1024  # This parameter contains the maximum size (number of data elements) of data buffers in case of EB Channels and only.
        integer SpiIbNBuffers [0..1]: 1..65535, post-build-variant-multiplicity=true, post-build-variant-value=true, set at link in variant link-time / post-build in variant post-build / pre-compile in variant pre-compile, default-value=1  # This parameter contains the maximum number of data buffers in case of IB Channels and only.
        enumeration SpiTransferStart: {LSB, MSB}, post-build-variant-value=true, set at link in variant link-time / post-build in variant post-build / pre-compile in variant pre-compile  # This parameter defines the first starting bit for transmission.
      container SpiExternalDevice [1..*]  # The communication settings of an external device. Closely linked to SpiJob.
        float SpiBaudrate: 0..INF, post-build-variant-value=true, set at link in variant link-time / post-build in variant post-build / pre-compile in variant pre-compile, default-value=1000000  # This parameter is the communication baudrate - This parameter allows | using a range of values, from the point of view of configuration tools, from Hz up to MHz.
        enumeration SpiCsBehavior: {CS_KEEP_ASSERTED, CS_TOGGLE}, post-build-variant-value=true, set at link in variant link-time / post-build in variant post-build / pre-compile in variant pre-compile, default-value=CS_KEEP_ASSERTED  # This parameter is used to define the chip select behavior. | Either the CS is toggled for each data frame (bit frame on the SPI bus in relation with SpiDataWidth) inside the channel(s) composing the job or the CS is kept asserted for the whole job.
        string SpiCsIdentifier: set at pre-compile, symbolic-name-value=true  # This parameter is the symbolic name to identify the Chip Select (CS) allocated to this Job.
        enumeration SpiCsPolarity: {HIGH, LOW}, post-build-variant-value=true, set at link in variant link-time / post-build in variant post-build / pre-compile in variant pre-compile  # This parameter defines the active polarity of Chip Select.
        enumeration SpiCsSelection [0..1]: {CS_VIA_GPIO, CS_VIA_PERIPHERAL_ENGINE}, multiplicity set at link in variant link-time / post-build in variant post-build / pre-compile in variant pre-compile, post-build-variant-multiplicity=true, post-build-variant-value=true, set at link in variant link-time / post-build in variant post-build / pre-compile in variant pre-compile, default-value=CS_VIA_PERIPHERAL_ENGINE  # When the Chip select handling is enabled (see SpiEnableCs), then this parameter specifies if the chip select is handled automatically by Peripheral HW engine or via general purpose IO by Spi driver.
        enumeration SpiDataShiftEdge: {LEADING, TRAILING}, post-build-variant-value=true, set at link in variant link-time / post-build in variant post-build / pre-compile in variant pre-compile  # This parameter defines the SPI data shift edge.
        boolean SpiEnableCs: post-build-variant-value=true, set at link in variant link-time / post-build in variant post-build / pre-compile in variant pre-compile  # This parameter enables or not the Chip Select handling functions. If this parameter is enabled then parameter SpiCsSelection further details the type of chip selection.
        enumeration SpiHwUnit: {CSIB0, CSIB1, CSIB2, CSIB3}, post-build-variant-value=true, set at link in variant link-time / post-build in variant post-build / pre-compile in variant pre-compile  # This parameter is the symbolic name to identify the HW SPI Hardware | microcontroller peripheral allocated to this Job.
        enumeration SpiShiftClockIdleLevel: {HIGH, LOW}, post-build-variant-value=true, set at link in variant link-time / post-build in variant post-build / pre-compile in variant pre-compile  # This parameter defines the SPI shift clock idle level.
        float SpiTimeClk2Cs: 1E-8..0.01, post-build-variant-value=true, set at link in variant link-time / post-build in variant post-build / pre-compile in variant pre-compile, default-value=1E-6  # Timing between clock and chip select assertion (in seconds) - This parameter allows to use a range of values from 10 ns up to 0.01 seconds. | The real configuration-value used in software BSW-SPI is calculated out of this by the generator-tools.
        float SpiTimeCs2Clk: 1E-8..0.01, post-build-variant-value=true, set at link in variant link-time / post-build in variant post-build / pre-compile in variant pre-compile, default-value=1E-6  # Timing between chip select assertion and clock (in seconds) - This parameter allows | to use a range of values from 10ns up to 0.01 seconds. The real configuration-value used in software BSW-SPI is calculated out of this by the generator-tools.
        float SpiTimeCs2Cs: 1E-8..0.01, post-build-variant-value=true, set at link in variant link-time / post-build in variant post-build / pre-compile in variant pre-compile, default-value=1E-6  # Timing between the negation of the chip select at the end of frame and the assertion of the chip select at the beginning of the next frame (in seconds) - This parameter allows to use a range of values from 10ns up to 0.01 seconds. | The real configuration-value used in software BSW-SPI is calculated out of this by the generator-tools.
        reference SpiDeviceEcucPartitionRef [0..*]: scope=ECU, multiplicity set at pre-compile, post-build-variant-multiplicity=true, post-build-variant-value=true, set at pre-compile, destination=EcucPartition  # Maps an SPI external device to zero or multiple ECUC partitions to limit the access to this external device. The ECUC partitions referenced are a subset of the ECUC partitions where the SPI driver is mapped to.
      container SpiJob [1..*]  # All data needed to configure one SPI-Job, amongst others the connection between the internal SPI unit and the special settings for an external device is done.
        function name SpiJobEndNotification [0..1]: multiplicity set at link in variant link-time / post-build in variant post-build / pre-compile in variant pre-compile, post-build-variant-multiplicity=true, post-build-variant-value=true, set at link in variant link-time / post-build in variant post-build / pre-compile in variant pre-compile  # This parameter is a reference to a notification function.
        integer SpiJobId: 0..65535, set at pre-compile, symbolic-name-value=true  # SPI Job ID, used as parameter in SPI API functions.
        integer SpiJobPriority: 0..3, post-build-variant-value=true, set at link in variant link-time / post-build in variant post-build / pre-compile in variant pre-compile  # Priority: 0, lowest, 3, highest (see SWS_Spi_00093)
        reference SpiDeviceAssignment: set at pre-compile, destination=SpiExternalDevice  # Reference to the external device used by this job
        container SpiChannelList [1..*]  # References to SPI channels and their order within the Job.
          integer SpiChannelIndex: 0..65535, post-build-variant-value=true, set at link in variant link-time / post-build in variant post-build / pre-compile in variant pre-compile, default-value=0  # This parameter specifies the order of Channels within the Job.
          reference SpiChannelAssignment: post-build-variant-value=true, set at link in variant link-time / post-build in variant post-build / pre-compile in variant pre-compile, destination=SpiChannel  # A job reference to a SPI channel.
      container SpiSequence [1..*]  # All data needed to configure one SPI-sequence
        boolean SpiInterruptibleSequence: post-build-variant-value=true, set at link in variant link-time / post-build in variant post-build / pre-compile in variant pre-compile  # This parameter allows or not this Sequence to be suspended by another one.
        function name SpiSeqEndNotification [0..1]: multiplicity set at link in variant link-time / post-build in variant post-build / pre-compile in variant pre-compile, post-build-variant-multiplicity=true, post-build-variant-value=true, set at link in variant link-time / post-build in variant post-build / pre-compile in variant pre-compile  # This parameter is a reference to a notification function.
        integer SpiSequenceId: 0..255, scope=ECU, set at pre-compile, symbolic-name-value=true  # SPI Sequence ID, used as parameter in SPI API functions.
        reference SpiJobAssignment [1..*]: multiplicity set at link in variant link-time / post-build in variant post-build / pre-compile in variant pre-compile, post-build-variant-multiplicity=true, post-build-variant-value=true, set at link in variant link-time / post-build in variant post-build / pre-compile in variant pre-compile, destination=SpiJob  # A sequence references several jobs, which are executed during a communication sequence
    container SpiGeneral  # General configuration settings for SPI-Handler
      boolean SpiCancelApi: set at pre-compile  # Switches the Spi_Cancel function ON or OFF.
      integer SpiChannelBuffersAllowed: 0..2, set at pre-compile  # Selects the SPI Handler/Driver Channel Buffers usage allowed and | delivered. IB = 0; EB = 1; IB/EB = 2;
      boolean SpiDevErrorDetect: set at pre-compile, default-value=false  # Switches the development error detection and notification on or off. | * true: detection and notification is enabled. * false: detection and notification is disabled.
      boolean SpiHwStatusApi: set at pre-compile  # Switches the Spi_GetHWUnitStatus function ON or OFF.
      boolean SpiInterruptibleSeqAllowed: set at pre-compile  # Switches the Interruptible Sequences handling functionality ON or OFF.
      integer SpiLevelDelivered: 0..2, set at pre-compile  # Selects the SPI Handler/Driver level of scalable functionality that is | available and delivered.
      float SpiMainFunctionPeriod [0..1]: 0..INF, multiplicity set at pre-compile, set at pre-compile, default-value=0.01  # This parameter defines the cycle time of the function Spi_MainFunction_Handling in seconds. The parameter is not used by the driver it self, but it is used by upper layer.
      boolean SpiSupportConcurrentSyncTransmit: set at pre-compile  # Specifies whether concurrent Spi_SyncTransmit() calls for different sequences shall be configurable.
      boolean SpiVersionInfoApi: set at pre-compile, default-value=false  # Switches the Spi_GetVersionInfo function ON or OFF.
      reference SpiEcucPartitionRef [0..*]: scope=ECU, multiplicity set at pre-compile, post-build-variant-multiplicity=true, post-build-variant-value=true, set at pre-compile, destination=EcucPartition  # Maps the SPI driver to zero or multiple ECUC partitions to make the driver API available in the according partition.
      reference SpiKernelEcucPartitionRef [0..1]: scope=ECU, multiplicity set at pre-compile, post-build-variant-multiplicity=true, post-build-variant-value=true, set at pre-compile, destination=EcucPartition  # Maps the SPI kernel to zero or one ECUC partitions to assign the driver kernel to a certain core. The ECUC partition referenced is a subset of the ECUC partitions where the SPI driver is mapped to.
    container SpiPublishedInformation  # Container holding all SPI specific published information parameters
      integer SpiMaxHwUnit: 0..65535, set at published-information, default-value=0  # Number of different SPI hardware microcontroller peripherals (units/busses) available and handled by this SPI Handler/Driver module.
  module definition StbM [0..1]: post-build-variant-support=true, variants pre-compile  # Configuration of the Synchronized Time-base Manager (StbM) module.
    container StbMFreshnessValueInformation  # Container with the Freshness Value configurations
      function name StbMGetRxFreshnessValueFuncName [0..1]: multiplicity set at pre-compile, set at pre-compile  # Function pointer to call within StbM_GetRxFreshness() context.
      function name StbMGetTxConfFreshnessValueFuncName [0..1]: multiplicity set at pre-compile, set at pre-compile  # Function pointer to call within StbM_SPduTxConfirmation() context.
      function name StbMGetTxFreshnessValueFuncName [0..1]: multiplicity set at pre-compile, set at pre-compile  # Function pointer to call within StbM_GetTxFreshness() context.
      function name StbMGetTxTruncFreshnessValueFuncName [0..1]: multiplicity set at pre-compile, set at pre-compile  # Function pointer to call within StbM_GetTxFreshnessTruncData() context.
      enumeration StbMQueryFreshnessValue: {CFUNC, NONE, SERVICE}, set at pre-compile, default-value=NONE  # This parameter specifies if the freshness value shall be determined through a C-function (CD) or a software component (SW-C).
      container StbMFreshnessValue [0..*]: multiplicity set at pre-compile  # Container with the Freshness Value configurations
        integer StbMFreshnessValueId: 0..65535, set at pre-compile, symbolic-name-value=true  # This parameter defines the Id of the Freshness Value. The Freshness Value might be a normal counter or a time value.
        integer StbMFreshnessValueLength: 0..64, set at pre-compile  # This parameter defines the complete length in bits of the Freshness Value. As long as the key doesn't change the counter shall not overflow. The length of the counter shall be determined based on the expected life time of the corresponding key and frequency of usage of the counter.
        integer StbMFreshnessValueTruncLength: 0..64, set at pre-compile  # This parameter defines the length in bits of the Freshness Value to be included in the payload of the Secured Time Synchronization Messages. This length is specific to the least significant bits of the complete Freshness Counter. If the parameter is 0 no Freshness Value is included in the Secured Time Synchronization Messages.
        boolean StbMProvideTxTruncatedFreshnessValue: set at pre-compile, default-value=false  # This parameter specifies if the FVM shall provide the truncated freshness value directly or if the FV shall be truncated by the StbM.
    container StbMGeneral  # This container holds the general parameters of the Synchronized Time-base Manager
      boolean StbMDevErrorDetect: set at pre-compile, default-value=false  # Switches the development error detection and notification on or off. | * true: detection and notification is enabled. * false: detection and notification is disabled.
      float StbMMainFunctionPeriod: 0..INF, set at pre-compile  # Schedule period of the main function StbM_MainFunction. Unit: [s].
      boolean StbMTimeRecordingSupport: set at pre-compile  # Enables/Disables the usage of the recording functionality for Synchronized Time Bases for Global Time precision measurement purpose.
      float StbMTimerStartThreshold [0..1]: 0..INF, multiplicity set at pre-compile, set at pre-compile  # This interval defines, when a GPT Timer shall be started for Time Notification Customers for which the corresponding Customer Timer is running [unit: seconds].
      boolean StbMVersionInfoApi: set at pre-compile, default-value=false  # Activate/Deactivate the version information API (StbM_GetVersionInfo). True: version information API activated False: version information API deactivated.
      reference StbMEcucPartitionRef [0..1]: multiplicity set at pre-compile, set at pre-compile, destination=EcucPartition  # Reference to EcucPartition, where StbM module is assigned to.
      reference StbMGptTimerRef [0..1]: multiplicity set at pre-compile, set at pre-compile, requires-symbolic-name-value=true, destination=GptChannelConfiguration  # This represents an optional sub-container in case any Time Notification Customer is configured. | The designated GPT timer has to be configured to have a tick duration of one micro second.
    container StbMSynchronizedTimeBase [1..*]: multiplicity set at pre-compile  # Synchronized time.base collects the information about a specific time-base provider within the system.
      boolean StbMAllowSystemWideGlobalTimeMaster [0..1]: multiplicity set at pre-compile, set at pre-compile  # For postbuild variant of the StbM this parameter has to be set to true for a Global Time Master that may act as a system-wide source of time. Otherwise no corresponding service ports/interfaces is provided. | The Global Time Master functionality behind the service ports/interfaces has to be enabled/disabled separately via parameter StbMIsSystemWideGlobalTimeMaster.
      integer StbMClearTimeleapCount [0..1]: 1..65535, multiplicity set at pre-compile, set at pre-compile, default-value=1  # This attribute describes the required number of updates to the Time Base where the time difference to the previous value has to remain below StbMTimeLeapPastThreshold/StbMTimeLeapFutureThreshold until the TIMELEAP_PAST/TIMELEAP_FUTURE bit within timeBaseStatus of the Time Base is cleared.
      float StbMCyclicBackupInterval [0..1]: 0..65535, multiplicity set at pre-compile, set at pre-compile  # Time interval to calculate the "backup" time to be stored in NvM [unit: seconds].
      boolean StbMIsSystemWideGlobalTimeMaster: post-build-variant-value=true, set at pre-compile  # This parameter shall be set to true for a Global Time Master that acts as a system-wide source of time information with respect to Global Time. | It is possible that several Global Time Masters exist that have set this parameter set to true because the Global Time Masters exist once per Global Time Domain and one ECU may own several Global Time Domains on different buses it is connected to.
      float StbMMaxProgressionMismatchThreshold: 0..INF, multiplicity set at pre-compile, post-build-variant-multiplicity=true, set at pre-compile  # This represents the maximum allowed difference between local time and fallback time of the time base [unit: seconds]. Tags: atp.Status=draft
      enumeration StbMNotificationInterface: {CALLBACK, CALLBACK_AND_SR_INTERFACE, NO_NOTIFICATION, SR_INTERFACE}, multiplicity set at pre-compile, set at pre-compile  # The parameter defines what type of interface shall be used to notify a customer of a status event.
      function name StbMStatusNotificationCallback [0..1]: multiplicity set at pre-compile, set at pre-compile  # Name of the customer specific status notification callback function, which shall be called, if a non-masked status event occurs.
      integer StbMStatusNotificationMask [0..1]: 0..4294967295, multiplicity set at pre-compile, set at pre-compile, default-value=0  # The parameter defines the initial value for NotificationMask mask, which defines the events for which the event notification callback function shall be called.
      enumeration StbMStoreTimebaseNonVolatile [0..1]: {NO_STORAGE, STORAGE}, multiplicity set at pre-compile, set at pre-compile  # This allows for specifying that the Time Base shall be stored in the NvRam.
      integer StbMSynchronizedTimeBaseIdentifier: 0..65535, set at pre-compile, symbolic-name-value=true  # Identification of a Synchronized Time Base via a unique identifier. | Range: * 0 .. 127: Synchronized Time Bases and Pure Local Time Bases * 128 .. 65535: Reserved
      enumeration StbMSynchronizedTimeBaseType: set at pre-compile, default-value=TBTYPE_SYNCHRONIZED  # Definition of the type of a Time Base. Tags: atp.Status=draft
        TBTYPE_PURELOCAL  # Tags: atp.Status=draft
        TBTYPE_SYNCHRONIZED  # Tags: atp.Status=draft
      float StbMSyncLossTimeout [0..1]: 0..INF, multiplicity set at pre-compile, set at pre-compile  # This attribute describes the timeout for the situation that the time synchronization gets lost in the scope of the time domain. Unit: seconds
      float StbMTimeLeapFutureThreshold [0..1]: 0..INF, multiplicity set at pre-compile, set at pre-compile  # This represents the maximum allowed positive difference between a newly received Global Time Base value and the current Local Time Base value [unit: seconds].
      float StbMTimeLeapPastThreshold [0..1]: 0..INF, multiplicity set at pre-compile, set at pre-compile  # This represents the maximum allowed negative difference between the current Local Time Base value and a newly received Global Time Base value [unit: seconds].
      reference StbMSourceTimeBase [0..1]: multiplicity set at pre-compile, set at pre-compile, destination=StbMSynchronizedTimeBase  # This is a reference to a Time Base, which the current Time Base is cloned from. This makes the referenced Time Base the source Time Base for cloning and the current Time the destination Time Base for cloning.
      container StbMDisciplinedClock [0..1]: multiplicity set at pre-compile  # This container holds parameters relevant for the adjustable/disciplined hardware clock of this Synchronized Time Base. Tags: atp.Status=draft
        reference StbMDisciplinedClockHardwareRef: scope=ECU, set at pre-compile, destination=EthTSynGlobalTimeDomain  # Reference to the adjustable/disciplined hardware clock. Tags: atp.Status=draft
      container StbMFallbackTimeClock [0..1]: multiplicity set at pre-compile  # References the hardware reference clock of this Synchronized Time Base for fallback time feature. Tags: atp.Status=draft
        integer StbMFallbackTimeClockFrequency [0..1]: 0..4294967295, multiplicity set at pre-compile, set at pre-compile  # Represents the frequency [Hz] of the HW reference clock used by the StbM. Tags: atp.Status=draft
        integer StbMFallbackTimeClockPrescaler [0..1]: 0..4294967295, multiplicity set at pre-compile, set at pre-compile  # Represents the prescaler to calculate the resulting frequency of the HW reference clock used by the StbM. Tags: atp.Status=draft
        choice reference StbMFallbackTimeHardware: multiplicity set at pre-compile, set at pre-compile, destination=[CanTSynGlobalTimeDomain, EthTSynGlobalTimeDomain, GptChannelConfiguration, OsCounter]  # Reference to the local time hardware. Tags: atp.Status=draft
      container StbMLocalTimeClock [0..1]: multiplicity set at pre-compile  # References the hardware reference clock of this Synchronized Time Base.
        integer StbMClockFrequency [0..1]: 0..4294967295, set at pre-compile  # Represents the frequency [Hz] of the HW reference clock used by the StbM.
        integer StbMClockPrescaler [0..1]: 0..4294967295, set at pre-compile  # Represents the prescaler to calculate the resulting frequency of the HW reference clock used by the StbM.
        choice reference StbMLocalTimeHardware: multiplicity set at pre-compile, set at pre-compile, destination=[CanTSynGlobalTimeDomain, EthTSynGlobalTimeDomain, GptChannelConfiguration, OsCounter]  # Reference to the local time hardware.
      container StbMNotificationCustomer [0..*]: multiplicity set at pre-compile  # This container holds the configuration of a notification customer, which is notified is informed about the occurance of a Time-base related event.
        integer StbMNotificationCustomerId: 0..65535, set at pre-compile, symbolic-name-value=true  # Identification of a event notification customer.
        function name StbMTimeNotificationCallback [0..1]: set at pre-compile  # Name of the customer specific notification callback function, which shall be called, if the time previously set by the customer is reached.
      container StbMTimeCorrection [0..1]: multiplicity set at pre-compile  # Collects the information relevant for the rate- and offset correction of a Time Base.
        boolean StbMAllowMasterRateCorrection [0..1]: multiplicity set at pre-compile, set at pre-compile, default-value=false  # This attribute describes whether the rate correction value of a Time Base can be set by StbM_SetRateCorrection(): | * false: the rate correction value can not be set by StbM_SetRateCorrection() * true: the rate correction value can be set by StbM_SetRateCorrection()
        integer StbMMasterRateDeviationMax [0..1]: 0..32000, multiplicity set at pre-compile, set at pre-compile, default-value=0  # This attribute describes the maximum allowed absolute value of the rate deviation value to be set by StbM_SetRateCorrection() [unit: ppm].
        float StbMOffsetCorrectionAdaptionInterval [0..1]: 0..INF, multiplicity set at pre-compile, set at pre-compile  # Defines the interval during which the adaptive rate correction cancels out the rate- and time deviation [unit: seconds].
        float StbMOffsetCorrectionJumpThreshold [0..1]: 0..INF, multiplicity set at pre-compile, set at pre-compile  # Threshold for the correction method. Deviations below this value will be corrected by a linear reduction over a defined timespan. Values equal- and greater than this value will be corrected by immediately setting the correct time- and rate in form of a jump [unit: seconds].
        float StbMRateCorrectionMeasurementDuration [0..1]: 0..INF, multiplicity set at pre-compile, set at pre-compile, default-value=1  # Definition of the time span [s] which is used to calculate the rate deviation.
        integer StbMRateCorrectionsPerMeasurementDuration [0..1]: 1..65535, multiplicity set at pre-compile, set at pre-compile, default-value=1  # Number of simultaneous rate measurements to determine the current rate deviation.
        integer StbMRateCorrectionThreshold [0..1]: 0..32000, multiplicity set at pre-compile, set at pre-compile, default-value=0  # Threshold for rate correction calculation to determine whether the absolute value of the calculated rate deviation exceeds the accepted range. A value of 0 deactivates the check.
        enumeration StbMRateSource [0..1]: {RATE_SOURCE_STBM, RATE_SOURCE_TIMESYNC_MODULE}, scope=ECU, multiplicity set at pre-compile, post-build-variant-multiplicity=true, set at pre-compile  # Selects which module does the rate measurement. Tags: atp.Status=draft
      container StbMTimeRecording [0..1]: multiplicity set at pre-compile  # Collects the information relevant for configuration of the precision measurement of a Time Base.
        function name StbMSyncTimeRecordBlockCallback [0..1]: multiplicity set at pre-compile, set at pre-compile  # Name of the customer specific callback function, which shall be called, if a measurement data for a Synchronized Time Base are available.
        integer StbMSyncTimeRecordTableBlockCount: 0..65535, set at pre-compile  # Represents the number of Blocks used for queing time measurement events for the Synchronized Time Base Record Table.
      container StbMTimeValidation [0..1]: multiplicity set at pre-compile  # Container with Time Validation configuration for Time Base.
        float StbMPdelayValidationThreshold [0..1]: 0..INF, multiplicity set at pre-compile, set at pre-compile  # This represents the maximum allowed threshold of the Pdelay value of the time base [unit: seconds].
        float StbMRateJitterThreshold [0..1]: 0..INF, multiplicity set at pre-compile, set at pre-compile  # This represents the maximum allowed threshold for rate jitter.
        integer StbMRateWanderIntervalWindow [0..1]: 0..255, multiplicity set at pre-compile, set at pre-compile  # This represents the window to take sample for calculation of rate wander.
        float StbMRateWanderThreshold [0..1]: 0..INF, multiplicity set at pre-compile, set at pre-compile  # This represents the maximum allowed threshold for rate wander.
        integer StbMTimeValidationRecordTableBlockCount: 0..65535, set at pre-compile  # Size of record table for Time Validation (number of blocks).
    container StbMTriggeredCustomer [0..*]: multiplicity set at pre-compile  # The triggered customer is directly triggered by the Synchronized Time-base Manager by getting synchronized with the current (global) definition of time and passage of time.
      integer StbMTriggeredCustomerPeriod: 0..4294967295, set at pre-compile  # The triggering period of the triggered customer, called by the StbM_MainFunction. | The period is documented in microseconds.
      reference StbMOSScheduleTableRef: set at pre-compile, destination=OsScheduleTable  # Mandatory reference to synchronized OS ScheduleTable, which will be explicitly synchronized by the StbM.
      reference StbMSynchronizedTimeBaseRef: set at pre-compile, destination=StbMSynchronizedTimeBase  # Mandatory reference to the required synchronized time-base.
