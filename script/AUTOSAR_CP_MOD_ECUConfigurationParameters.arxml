[part 6 of 14: package /AUTOSAR/EcucDefs]
AUTOSAR XML (schema 00053)
package /AUTOSAR/EcucDefs  (continued)
  module definition DoIP [0..1]: post-build-variant-support=true, variants link-time/post-build/pre-compile  # Configuration of the DoIP (Diagnostic over IP) module.
    container DoIPConfigSet  # This container contains the configuration parameters and sub containers of the AUTOSAR DoIP module.
      integer DoIPGid [0..1]: 0..281474976710655, multiplicity set at link in variant link-time / post-build in variant post-build / pre-compile in variant pre-compile, post-build-variant-multiplicity=true, post-build-variant-value=true, set at link in variant link-time / post-build in variant post-build / pre-compile in variant pre-compile  # Configured GID (Group ID of) for vehicle identification/vehicle announcement.
      integer DoIPLogicalAddress: 0..65535, post-build-variant-value=true, set at link in variant link-time / post-build in variant post-build / pre-compile in variant pre-compile  # Describes the logical address of the DoIP entity, i.e. the LA that will route diagnostic requests to the Dcm of the DoIP entity.
      container DoIPInterface [1..255]  # This container defines a logical IP interface and collects properties to configure this interface.
        float DoIPAliveCheckResponseTimeout: 0..INF, set at pre-compile  # Timeout in [s] for waiting for a response to an Alive Check request before the connection is considered to be disconnected. Represents parameter T_TCP_AliveCheck of ISO 13400-2.
        integer DoIPEid [0..1]: 0..281474976710655, multiplicity set at link in variant link-time / post-build in variant post-build / pre-compile in variant pre-compile, post-build-variant-multiplicity=true, post-build-variant-value=true, set at link in variant link-time / post-build in variant post-build / pre-compile in variant pre-compile  # Configured EID (Entity ID of) for vehicle identification/vehicle announcement. Only necessary if DoIPUseMacAddressForIdentification is set to FALSE.
        float DoIPGeneralInactivityTime: 0..INF, set at pre-compile  # Timeout in [s] for maximum inactivity of a TCP socket connection before the DoIP module will close the according socket connection. Represents parameter T_TCP_General_Inactivity of ISO 13400-2.
        float DoIPInitialInactivityTime: 0..INF, set at pre-compile  # Timeout in [s] used for initial inactivity of a connected TCP socket connection directly after socket connection. Represents parameter T_TCP_Initial_Inactivity of ISO 13400-2.
        float DoIPInitialVehicleAnnouncementTime: 0..INF, set at pre-compile  # Time to wait in [s] for sending first vehicle anouncement message after IP address assignment. Represents parameter A_DoIP_Announce_Wait of ISO 13400-2.
        boolean DoIPInterfaceActLineCtrl: set at pre-compile  # This attribute defines whether the network interface | * is started "on-demand" when an activation line is sensed (TRUE) or * is always available (FALSE).
        enumeration DoIPInterfaceAnnouncementStart: {DOIP_AUTOMATIC_ANNOUNCE, DOIP_ONTRIGGER_ANNOUNCE}, set at pre-compile, default-value=DOIP_AUTOMATIC_ANNOUNCE  # This attribute defines, when vehicle announcement is started on a DoIPInterface | * Automatic: As soon as the underlying UDP vehicle announcement connection switches to SOAD_SOCON_ONLINE * OnTrigger: As soon as the API DoIP_TriggerVehicleAnnouncement is called for the given DoIPInterface instance
        integer DoIPInterfaceId: 0..255, set at pre-compile, symbolic-name-value=true  # This parameter is an identifier of the DoIPInterface. The value of this parameter will be assigned to the symbolic name derived from the container short name.
        integer DoIPMaxTesterConnections: 1..255, set at pre-compile  # Maximum amount of tester connections that shall be maintained at one time before alive check is performed.
        boolean DoIPUseMacAddressForIdentification: set at pre-compile  # Provided the information if a configured EID at vehicle identification response/vehicle announcement is used or the MAC address. | TRUE: Use MAC Address instead of EID for Vehicle identification/announcement. FALSE: Use configured EID for vehicle identification/announcement.
        boolean DoIPUseVehicleIdentificationSyncStatus: set at pre-compile  # Defines if the optional VIN/GID synchronization status is used additionally in the vehicle identification/announcement.
        integer DoIPVehicleAnnouncementCount [0..1]: 1..255, set at pre-compile  # Number of vehicle announcement messages on IP address assignment. Represents parameter A_DoIP_Announce_Num of ISO 13400-2.
        float DoIPVehicleAnnouncementInterval [0..1]: 0..INF, set at pre-compile  # Time to wait in [s] for sending subsequent vehicle anouncement messages. Represents parameter A_DoIP_Announce_Interval of ISO 13400-2.
        container DoIPChannel [1..65536]  # Configuration of one DoIPChannel.
          reference DoIPChannelSARef: destination=DoIPTester  # Reference to the DoIPTester.
          reference DoIPChannelTARef: destination=DoIPTargetAddress  # Reference to the target address.
          container DoIPPduRRxPdu [0..1]  # This container contains the Rx Pdus to connect with the Rx Pdus of the PduR.
            integer DoIPPduRRxPduId: 0..65535, scope=ECU, set at pre-compile, symbolic-name-value=true, with-auto=true  # The DoIPPduRRxPduId is required by the API call DoIP_TpCancelReceive.
            reference DoIPPduRRxPduRef: post-build-variant-value=true, set at link in variant link-time / post-build in variant post-build / pre-compile in variant pre-compile, destination=Pdu  # Reference to the "global" Pdu structure to allow harmonization of handle IDs in the COM-Stack.
          container DoIPPduRTxPdu [0..1]  # This container contains the Tx Pdus to connect with the Tx Pdus of the PduR. If the parameter is not configured the channel is for functional addressing.
            integer DoIPPduRTxPduId: 0..65535, scope=ECU, set at pre-compile, symbolic-name-value=true, with-auto=true  # The DoIPPduRTxPduId is required by DoIP_TpTransmit or DoIP_IfTransmit and DoIP_TpCancelTransmit.
            enumeration DoIPPduType [0..1]: {DOIP_IFPDU, DOIP_TPPDU}, multiplicity set at link in variant link-time / post-build in variant post-build / pre-compile in variant pre-compile, post-build-variant-multiplicity=true, post-build-variant-value=true, set at link in variant link-time / post-build in variant post-build / pre-compile in variant pre-compile, default-value=DOIP_TPPDU  # API Type to use for communication with PduR. DOIP_IFPDU for UUDT messages, DOIP_TPPDU for all other diagnostic messages.
            reference DoIPPduRTxPduRef: post-build-variant-value=true, set at link in variant link-time / post-build in variant post-build / pre-compile in variant pre-compile, destination=Pdu  # Reference to the "global" Pdu structure to allow harmonization of handle IDs in the COM-Stack.
        container DoIPConnections  # Container contains all lower layer connection specific information, i.e. the single Pdu References and Handle IDs to the SoAd.
          container DoIPTargetAddress [1..65535]  # This container describes a possible TargetAddress that is supported by DoIP.
            integer DoIPTargetAddressValue: 0..65535, post-build-variant-value=true, set at link in variant link-time / post-build in variant post-build / pre-compile in variant pre-compile  # Valid Target Address of a DoIP target address.
          container DoIPTcpConnection [2..255]  # This container describes a TCP connection to the lower layer SoAd module.
            boolean DoIPRequestAddressAssignment: set at pre-compile, default-value=true  # The DoIP module shall request IP address assignment by calling SoAd_RequestIpAddrAssignment() for the TcpIpLocalAddr related to this DoIpConnection.
            boolean DoIPTcpConnectionSecurityRequired [0..1]: default-value=false  # Indicates if the associated TCP socket uses a secure connection (e.g. TLS)
            container DoIPSoAdTcpRxPdu  # This container describes a Rx PDU received via SoAd over TCP
              integer DoIPSoAdTcpRxPduId: 0..65535, scope=ECU, set at pre-compile, symbolic-name-value=true, with-auto=true  # The DoIPSoAdTcpRxPduId is required by the API call DoIP_SoAdTpRxIndication to receive I-PDUs from the SoAd.
              reference DoIPSoAdTcpRxPduRef: post-build-variant-value=true, set at link in variant link-time / post-build in variant post-build / pre-compile in variant pre-compile, destination=Pdu  # Reference to the "global" Pdu structure to allow harmonization of handle IDs in the COM-Stack.
            container DoIPSoAdTcpTxPdu  # This container describes a Tx PDU sent via SoAd over TCP
              integer DoIPSoAdTcpTxPduId: 0..65535, scope=ECU, set at pre-compile, symbolic-name-value=true, with-auto=true  # The DoIPSoAdTcpTxPduId is required by the API call DoIP_SoAdTpTxConfirmation that is called by the SoAd to confirm that the IPdu has been transmitted successfully.
              reference DoIPSoAdTcpTxPduRef: post-build-variant-value=true, set at link in variant link-time / post-build in variant post-build / pre-compile in variant pre-compile, destination=Pdu  # Reference to the "global" Pdu structure to allow harmonization of handle IDs in the COM-Stack.
          container DoIPUdpConnection [1..255]  # This Container describes a Udp connection to the lower layer SoAd module.
            boolean DoIPRequestAddressAssignment: set at pre-compile, default-value=true  # The DoIP module shall request IP address assignment by calling SoAd_RequestIpAddrAssignment() for the TcpIpLocalAddr related to this DoIpConnection.
            container DoIPSoAdUdpRxPdu  # This container describes a Rx PDU received via SoAd over UDP.
              integer DoIPSoAdUdpRxPduId: 0..65535, scope=ECU, set at pre-compile, symbolic-name-value=true, with-auto=true  # The DoIPSoAdUdpRxPduId is required by the API call DoIP_SoAdIfRxIndication to receive I-PDUs from the SoAd.
              reference DoIPSoAdUdpRxPduRef: post-build-variant-value=true, set at link in variant link-time / post-build in variant post-build / pre-compile in variant pre-compile, destination=Pdu  # Reference to the "global" Pdu structure to allow harmonization of handle IDs in the COM-Stack.
            container DoIPSoAdUdpTxPdu  # This container describes a Tx PDU sent via SoAd over UDP.
              integer DoIPSoAdUdpTxPduId: 0..65535, scope=ECU, set at pre-compile, symbolic-name-value=true, with-auto=true  # The DoIPSoAdUdpTxPduId is required by the API call DoIP_SoAdIfTxConfirmation that is called by the SoAd to confirm that the IPdu has been transmitted successfully.
              reference DoIPSoAdUdpTxPduRef: post-build-variant-value=true, set at link in variant link-time / post-build in variant post-build / pre-compile in variant pre-compile, destination=Pdu  # Reference to the "global" Pdu structure to allow harmonization of handle IDs in the COM-Stack.
          container DoIPUdpVehicleAnnouncementConnection [0..255]  # This container describes the UDP multicast connections to the lower layer SoAd module.
            boolean DoIPRequestAddressAssignment: set at pre-compile, default-value=true  # The DoIP module shall request IP address assignment by calling SoAd_RequestIpAddrAssignment() for the TcpIpLocalAddr related to this DoIpConnection.
            container DoIPSoAdUdpVehicleAnnouncementTxPdu  # This container describes the vehicle announcement TxPdu sent via the SoAd.
              integer DoIPSoAdUdpVehicleAnnouncementTxPduId: 0..4294967295, scope=ECU, set at pre-compile, symbolic-name-value=true, with-auto=true  # The DoIPSoAdUdpVehicleAnnouncementTxPduId is required by the API call DoIP_SoAdIfTxConfirmation() that is called by the SoAd to confirm that the IPdu has been transmitted successfully.
              reference DoIPSoAdUdpVehicleAnnouncementTxPduRef: post-build-variant-value=true, set at link in variant link-time / post-build in variant post-build / pre-compile in variant pre-compile, destination=Pdu  # Reference to the "global" PDU structure to allow harmonization of handle IDs in the COM-Stack.
        container DoIPFurtherActionByteCallback [0..1]  # This container describes the Callbackfunction to get the Further Action byte. This container shall always be present. If the DoIPFurtherActionByteDirect parameter is not present, the DoIP module will use an RPort of ServiceInterface CallbackGetFurtherActionByte with the name "CBGetFurtherActionByte_<shortname of enclosing DoIPInterface container>".
          function name DoIPFurtherActionByteDirect [0..1]: set at link in variant link-time+post-build / pre-compile in variant pre-compile  # Direct C Callback function to get the OEM specific Further Action Byte for the DoIP vehicle identification response/vehicle announcement. If the DoIPFurtherActionByteDirect parameter is present, the DoIP module will not use an RPort of ServiceInterface "CBGetFurtherActionByte" but will call the configured function.
        container DoIPProtocolVersion  # This container defines the protocol version of the DoIP entity.
          boolean DoIP_ISO13400_2_2012: set at pre-compile, default-value=true  # If this parameter is enabled, the DoIP entity supports communication with ISO13400-2:2012 compliant tester using protocol version 0x02.
          boolean DoIP_ISO13400_2_2019: set at pre-compile, default-value=true  # If this parameter is enabled, the DoIP entity supports communication with ISO13400-2:2019 compliant tester using protocol version 0x03.
          enumeration DoIPAnnouncedProtocolVersion: {DOIP_ISO13400_2_2012, DOIP_ISO13400_2_2019}, set at pre-compile  # This parameter defines the used protocol version for vehicle announcements and vehicle identification responses if the vehicle identification request contains protocol version 0xFF.
        container DoIPRoutingActivation [0..255]  # This container describes the routing activation possibilities by representing for each container a possible routing activation request message to the DoIP entity and the according references to the activated diagnostic messages.
          integer DoIPRoutingActivationNumber: 0..255, post-build-variant-value=true, set at link in variant link-time / post-build in variant post-build / pre-compile in variant pre-compile  # Identifies the Routing activation Number which is received for a DoIP routing activation request message.
          boolean DoIPRoutingActivationSecurityRequired [0..1]: default-value=false  # Indicates if a routing activation requires a secure TCP connection
          reference DoIPTargetAddressRef [1..65535]: multiplicity set at link in variant link-time / post-build in variant post-build / pre-compile in variant pre-compile, post-build-variant-multiplicity=true, post-build-variant-value=true, set at link in variant link-time / post-build in variant post-build / pre-compile in variant pre-compile, destination=DoIPTargetAddress  # Reference to all DoIPTargetAddress which are activated on this Routing activation.
          container DoIPRoutingActivationAuthenticationCallback [0..1]  # Container describes the Callbackfunction to call on a Routing Activation Request for Authentication. If this container is configured but the DoIPRoutingActivationAuthenticationFunc parameter is not present, the DoIP module will use an RPort of ServiceInterface <RoutingActivation>_RoutingActivation with the name "CB<RoutingActivation>RoutingActivation". <RoutingActivation> is the ShortName of the DoIPRoutingActiviation container.
            function name DoIPRoutingActivationAuthenticationFunc [0..1]: multiplicity set at link in variant link-time+post-build / pre-compile in variant pre-compile, set at link in variant link-time+post-build / pre-compile in variant pre-compile  # Direct C Callback function to trigger the authentication function for routing activation. If the DoIPRoutingActivationAuthenticationFunc parameter is present, the DoIP module will not use an RPort of ServiceInterface <RoutingActivation>_RoutingActivation but call the configured function.
            integer DoIPRoutingActivationAuthenticationReqLength: 0..4, set at link in variant link-time+post-build / pre-compile in variant pre-compile  # Describes the amount of bytes used to handle to the authentication function on routing activation. If 0 is configured as length the parameter AuthenticationReqData will not be handled to the API.
            integer DoIPRoutingActivationAuthenticationResLength: 0..4, set at link in variant link-time+post-build / pre-compile in variant pre-compile  # Describes the amount of bytes used to read by the authentication function on routing activation. If 0 is configured as length the parameter AuthenticationResData will not be fetched via the API.
          container DoIPRoutingActivationConfirmationCallback [0..1]  # Container describes the Callbackfunction to call on a Routing Activation Request for Confirmation. If this container is configured but the DoIPRoutingActivationConfirmationFunc parameter is not present the DoIP module will use an RPort of ServiceInterface <RoutingActivation>_RoutingActivation with the name "CB<RoutingActivation>RoutingActivation". <RoutingActivation> is the ShortName of the DoIPRoutingActiviation container.
            function name DoIPRoutingActivationConfirmationFunc [0..1]: multiplicity set at link in variant link-time+post-build / pre-compile in variant pre-compile, set at link in variant link-time+post-build / pre-compile in variant pre-compile  # Direct C Callback function to trigger the confirmation function for routing activation. If the DoIPRoutingActivationConfirmationFunc parameter is present the DoIP module will not use an RPort of ServiceInterface <RoutingActivation>_RoutingActivation but call the configured function.
            integer DoIPRoutingActivationConfirmationReqLength: 0..4, set at link in variant link-time+post-build / pre-compile in variant pre-compile  # Describes the amount of bytes used to handle to the confirmation function on routing activation. If 0 is configured as length the parameter ConfirmedReqData will not be handled to the API.
            integer DoIPRoutingActivationConfirmationResLength: 0..4, set at link in variant link-time+post-build / pre-compile in variant pre-compile  # Describes the amount of bytes used to read by the confirmation function on routing activation. If 0 is configured as length the parameter ConfirmedResData will not be fetched via the API.
        container DoIPTester [1..255]  # This container describes the properties of the possible connectable Tester for the DoIP entity.
          integer DoIPNumByteDiagAckNack: 0..4294967295, post-build-variant-value=true, set at link in variant link-time / post-build in variant post-build / pre-compile in variant pre-compile  # Specifies the number of original Diagnostic request bytes the DoIP entity responses on a NACK of a diagnostic response message to the Tester.
          integer DoIPTesterSA: 0..65535, post-build-variant-value=true, set at link in variant link-time / post-build in variant post-build / pre-compile in variant pre-compile  # Source Address of the Tester sent via routing activation or diagnostic message.
          reference DoIPRoutingActivationRef [1..255]: multiplicity set at link in variant link-time / post-build in variant post-build / pre-compile in variant pre-compile, post-build-variant-multiplicity=true, post-build-variant-value=true, set at link in variant link-time / post-build in variant post-build / pre-compile in variant pre-compile, destination=DoIPRoutingActivation  # Reference to a DoIPRoutingActivation describing the possible routing activations of the DoIPTester
    container DoIPGeneral  # This container specifies the general configuration parameters of the DoIP module.
      boolean DoIPDevelopmentErrorDetect: set at pre-compile  # Switches the development error detection and notification on or off. | * true: detection and notification is enabled. * false: detection and notification is disabled.
      boolean DoIPDhcpOptionVinUse: set at pre-compile  # If DoIPDhcpOptionVinUse is set to true the DoIP module will add the VIN to the Dhcp host name if no valid Dhcp host name is already set.
      boolean DoIPEntityStatusMaxByteFieldUse: set at pre-compile  # This parameter is used to distinguish the optional support of the Max data size element of a diagnostic entity status response.
      integer DoIPGIDInvalidityPattern: 0..255, set at pre-compile  # Specifies the Byte pattern that is used for response messages if no valid GID could be retrieved. | Only the value '0' or '255' is allowed".
      integer DoIPHostNameSizeMax: 5..255, set at pre-compile  # Maximum Size of the DHCP HostName in ASCII. This parameter is necessary to reserve the correct amount of bytes for working with the DHCP HostName option. Minimum range is 5 because Dhcp Host Name should be at least "DoIP-" on any configuration.
      float DoIPMainFunctionPeriod: 0..INF, set at pre-compile  # Determines the frequency at which the DoIP_MainFunction() is called in [s].
      integer DoIPMaxRequestBytes: 1..4294967295, set at pre-compile  # Specifies the maximum allowed bytes of a DoIP message request without the DoIP header.
      integer DoIPMaxUDPRequestPerConnection: 1..255, set at pre-compile  # This parameter captures the maximum amount of UDP Requests necessary to handle parallel within a single UDP connection.
      enumeration DoIPNodeType: {DOIP_GATEWAY, DOIP_NODE}, set at pre-compile  # Describes the Type of the DoIP node.
      boolean DoIPVersionInfoApi: set at pre-compile, default-value=false  # Activates the DoIP_GetVersionInfo() API. | TRUE: Enables the DoIP_GetVersionInfo() API. FALSE: DoIP_GetVersionInfo() API is not included.
      boolean DoIPVinGidMaster: set at pre-compile  # Specifies if the DoIP entity is the Vehicle identification Master for the GID (Group ID).
      integer DoIPVinInvalidityPattern: 0..255, set at pre-compile  # Specifies the Byte pattern that is used for response messages if no valid VIN could be retrieved. | Only the value '0' or '255' is allowed".
      reference DoIPUseEidAsGidRef [0..1]: multiplicity set at pre-compile, set at pre-compile, destination=DoIPInterface  # Reference to the interface containing the EID which shall be used as GID. Depending on the configuration, the GID is derived either from DoIPEid or from DoIPUseMacAddressForIdentification.
      container DoIPGetGidCallback [0..1]  # This container describes the usage of a callback function to get the GID. (If this container is not present no callback function shall be used by DoIP module to retrive the GID.)
        function name DoIPGetGidDirect [0..1]: multiplicity set at link in variant link-time+post-build / pre-compile in variant pre-compile, set at link in variant link-time+post-build / pre-compile in variant pre-compile  # If the DoIPGetGidDirect parameter exist the DoIP module shall call the configured callback function (<User>_DoIPGetGID) direct. (It is not needed to specify a service port to the DoIP service component.) | If the DoIPGetGidDirect parameter does NOT exist the DoIP module shall use a RPort with a CallbackGetGID type of client-server port interface to retrive the GID.
      container DoIPPowerModeCallback  # This container describes the usage of a callback function to retrieve the current power mode. This container shall always be present.
        function name DoIPPowerModeDirect [0..1]: multiplicity set at link in variant link-time+post-build / pre-compile in variant pre-compile, set at link in variant link-time+post-build / pre-compile in variant pre-compile  # If the DoIPPowerModeDirect parameter exist the DoIP module shall call the configured callback function (<User>_DoIPGetPowerModeCallback) direct. (It is not needed to specify a service port to the DoIP service component.) | If the DoIPPowerModeDirect parameter does NOT present the DoIP module shall use a RPort with a CallbackGetPowerMode type of client-server port interface to retrive the current power mode.
      container DoIPTriggerGidSyncCallback [0..1]  # This container describes the usage of a callback function to trigger the GID synchronization. (If this container does not exist no callback function shall be used by DoIP module to trigger the GID synchronization.)
        function name DoIPTriggerGidSyncDirect [0..1]: multiplicity set at link in variant link-time+post-build / pre-compile in variant pre-compile, set at link in variant link-time+post-build / pre-compile in variant pre-compile  # If the DoIPTriggerGidSyncDirect parameter exist the DoIP module shall call the configured callback function (<User>_DoIPTriggerGidSyncCallback) direct. (It is not needed to specify a service port to the DoIP service component.) | If the DoIPTriggerGidSyncDirect parameter does NOT present the DoIP module shall use a RPort with a CallbackTriggerGIDSynchnonization type of client-server port interface to trigger the GID synchronization.
  module definition Ea [0..1]: variants pre-compile  # Configuration of the Ea (EEPROM Abstraction) module. | The module shall abstract from the device specific addressing scheme and segmentation and provide the upper layers with a virtual addressing scheme and segmentation as well as a 'virtually' unlimited number of erase cycles.
    container EaBlockConfiguration [1..*]  # Configuration of block specific parameters for the EEPROM abstraction module.
      integer EaBlockNumber: 1..65534, scope=ECU, set at pre-compile, symbolic-name-value=true  # Block identifier (handle). | 0x0000 and 0xFFFF shall not be used for block numbers (see SWS_Ea_00006). Range: min = 2^NVM_DATASET_SELECTION_BITS max = 0xFFFF -2^NVM_DATASET_SELECTION_BITS Note: Depending on the number of bits set aside for dataset selection several other block numbers shall also be left out to ease implementation.
      integer EaBlockSize: 1..65535, scope=ECU, set at pre-compile  # Size of a logical block in bytes.
      boolean EaImmediateData: scope=ECU, set at pre-compile  # Marker for high priority data. | true: Block contains immediate data. false: Block does not contain immediate data.
      integer EaNumberOfWriteCycles: 0..4294967295, set at pre-compile  # Number of write cycles required for this block.
      reference EaDeviceIndex [0..1]: multiplicity set at pre-compile, set at pre-compile, requires-symbolic-name-value=true, destination=EepGeneral  # Reference to the device this block is stored in. Tags: atp.Status=obsolete | This reference is mutually exclusive to EaMemAccAddressArea. This element is obsolete and will be removed in a future revision.
      reference EaMemAccAddressArea [0..1]: multiplicity set at pre-compile, set at pre-compile, requires-symbolic-name-value=true, destination=MemAccAddressAreaConfiguration  # Reference to the MemAccAddressAreaConfiguration. Tags: atp.Status=draft | This reference is mutually exclusive to EaDeviceIndex.
    container EaGeneral  # General configuration of the EEPROM abstraction module. This container lists block independent configuration parameters.
      boolean EaDevErrorDetect: set at pre-compile, default-value=false  # Switches the development error detection and notification on or off. | * true: detection and notification is enabled. * false: detection and notification is disabled.
      float EaMainFunctionPeriod: 0..INF, scope=ECU, set at pre-compile  # The period between successive calls to the main function in seconds.
      integer EaMinimumReadPageSize: 0..65535, set at pre-compile  # Minimum Page size will be a multiple of the minimum page size. Ea shall align read requests to this size. Tags: atp.Status=draft
      function name EaNvmJobEndNotification [0..1]: multiplicity set at pre-compile, set at pre-compile  # Mapped to the job end notification routine provided by the upper layer module (NvM_JobEndNotification).
      function name EaNvmJobErrorNotification [0..1]: multiplicity set at pre-compile, set at pre-compile  # Mapped to the job error notification routine provided by the upper layer module (NvM_JobErrorNotification).
      boolean EaPollingMode: set at pre-compile  # Pre-processor switch to enable and disable the polling mode for this module. | true: Polling mode enabled, callback functions (provided to EEP module) disabled. false: Polling mode disabled, callback functions (provided to EEP module) enabled.
      boolean EaVersionInfoApi: set at pre-compile, default-value=false  # Pre-processor switch to enable / disable the API to read out the modules version information. | true: Version info API enabled. false: Version info API disabled.
      integer EaVirtualPageSize: 0..65535, set at pre-compile  # The size in bytes to which logical blocks shall be aligned.
      reference EaBufferAlignmentValue: set at pre-compile, requires-symbolic-name-value=true, destination=MemAccAddressAreaConfiguration  # Parameter determines the alignment of the start address that Ea buffers need to have. Tags: atp.Status=draft | Value shall be inherited from MemAccBufferAlignmentValue.
    container EaPublishedInformation  # Additional published parameters not covered by CommonPublishedInformation container. | Note that these parameters do not have any configuration class setting, since they are published information.
      integer EaBlockOverhead: 0..65535, set at published-information  # Management overhead per logical block in bytes. | Note: If the management overhead depends on the block size or block location a formula has to be provided that allows the configurator to calculate the management overhead correctly.
      integer EaPageOverhead: 0..65535, set at published-information  # Management overhead per page in bytes. | Note: If the management overhead depends on the block size or block location a formula has to be provided that allows the configurator to calculate the management overhead correctly.
  module definition EcuC [0..1]: post-build-variant-support=true, variants post-build/pre-compile  # Virtual module to collect ECU Configuration specific / global configuration information.
    container EcucConfigSet [0..1]  # This container contains the configuration parameters and sub containers of the global PduCollection.
      container EcucPduCollection [0..1]  # Collection of all Pdu objects flowing through the Com-Stack.
        enumeration PduIdTypeEnum: {UINT16, UINT8}  # The PduIdType is used within the entire AUTOSAR Com Stack except for bus drivers. The size of this global type depends on the maximum number of PDUs used within one software module. If no software module deals with more PDUs that 256, this type can be set to uint8. If at least one software module handles more than 256 PDUs, this type shall be set to uint16. See AUTOSAR_SWS_CommunicationStackTypes for more details.
        enumeration PduLengthTypeEnum: {UINT16, UINT32, UINT8}  # The PduLengthType is used within the entire AUTOSAR Com Stack except for bus drivers. The size of this global type depends on the maximum length of PDUs to be sent by an ECU. If no segmentation is used the length depends on the maximum payload size of a frame of the underlying communication system (for FlexRay maximum size is 255 bytes, therefore uint8). If segmentation is used it depends on the maximum length of a segmented N-SDU (in general uint16 is used). See AUTOSAR_SWS_CommunicationStackTypes for more details.
        container MetaDataType [0..*]: multiplicity set at pre-compile  # Meta data serves to transport information through the AUTOSAR layers. It is transported by the PduInfoType structure via a separate pointer to a byte array alongside the length of and a pointer to the payload of the PDU. This container defines the content of the meta data.
          container MetaDataItem [1..*]: multiplicity set at pre-compile, requires-index=true  # The content of meta data in a Pdu consists of an ordered list of meta data items. | This container represents a meta data item that is contained in meta data of a Pdu.
            integer MetaDataItemLength: 1..64, set at pre-compile  # This parameter defines the length of a meta data item in bytes.
            enumeration MetaDataItemType: set at pre-compile  # This parameter defines the type of a meta data item.
              ACCEPTANCEFIELD_32
              ADDRESS_EXTENSION_8
              BROADCAST_8  # Tags: atp.Status=draft
              CAN_ID_32
              CAN_ID_PROPS_8  # Tags: atp.Status=draft
              ETHERNET_MAC_64
              FILTER_RULE_ID_16  # Tags: atp.Status=draft
              IEEE1722TP_COMMON_STREAM_HEADER_PTR  # Tags: atp.Status=draft
              IEEE1722TP_RX_AAF_AES3_PTR  # Tags: atp.Status=draft
              IEEE1722TP_RX_AAF_PCM_PTR  # Tags: atp.Status=draft
              IEEE1722TP_RX_CRF_PTR  # Tags: atp.Status=draft
              IEEE1722TP_RX_IEC68133_CIP_NO_SPH_PTR  # Tags: atp.Status=draft
              IEEE1722TP_RX_IEC68133_CIP_WITH_SPH_PTR  # Tags: atp.Status=draft
              IEEE1722TP_RX_IEC68133_IIDC_PTR  # Tags: atp.Status=draft
              IEEE1722TP_RX_IEC68133_PTR  # Tags: atp.Status=draft
              IEEE1722TP_RX_RVF_PTR  # Tags: atp.Status=draft
              IEEE1722TP_TX_AAF_AES3_PTR  # Tags: atp.Status=draft
              IEEE1722TP_TX_AAF_PCM_PTR  # Tags: atp.Status=draft
              IEEE1722TP_TX_CRF_PTR  # Tags: atp.Status=draft
              IEEE1722TP_TX_IEC68133_CIP_NO_SPH_PTR  # Tags: atp.Status=draft
              IEEE1722TP_TX_IEC68133_CIP_WITH_SPH_PTR  # Tags: atp.Status=draft
              IEEE1722TP_TX_IEC68133_IIDC_PTR  # Tags: atp.Status=draft
              IEEE1722TP_TX_IEC68133_PTR  # Tags: atp.Status=draft
              IEEE1722TP_TX_RVF_PTR  # Tags: atp.Status=draft
              LIN_NAD_8
              LISTELEM_PTR  # Tags: atp.Status=draft
              MESSAGE_TIMESTAMP_64  # Tags: atp.Status=draft
              MESSAGE_TIMESTAMP_VALID_8  # Tags: atp.Status=draft
              PRIORITY_16
              PRIORITY_8
              SDUTYPE_8
              SOCKET_CONNECTION_ID_16
              SOURCE_ADDRESS_16
              TARGET_ADDRESS_16
              TIMETUPLE_TYPE_PTR  # Tags: atp.Status=draft
              VLAN_16
        container Pdu [0..*]: multiplicity set at post-build in variant post-build / pre-compile in variant pre-compile, post-build-variant-multiplicity=true  # One Pdu flowing through the COM-Stack. | This Pdu is used by all Com-Stack modules to agree on referencing the same Pdu.
          boolean DynamicLength [0..1]: multiplicity set at post-build in variant post-build / pre-compile in variant pre-compile, post-build-variant-multiplicity=true, post-build-variant-value=true, set at post-build in variant post-build / pre-compile in variant pre-compile  # This parameter defines whether the Pdu has dynamic length (true) or not (false). Please note that the usage of this attribute is restricted by [constr_3448].
          boolean J1939Requestable [0..1]: multiplicity set at post-build in variant post-build / pre-compile in variant pre-compile, post-build-variant-multiplicity=true, post-build-variant-value=true, set at post-build in variant post-build / pre-compile in variant pre-compile  # Pdu can be triggered by the J1939 request message.
          boolean KeepLocalPduBuffer [0..1]: multiplicity set at pre-compile, set at pre-compile, default-value=false  # This parameter defines whether a module that handles the PDU would keep a temporary local buffer Tags: atp.Status=draft | * until a confirmation or release-rx-buffer function call arrives (KeepLocalPduBuffer = TRUE) or * if a temporary local buffer is released after transmission or rx indication return (KeepLocalPduBuffer = FALSE).
          integer PduBufferAlignment [0..1]: 1..8, scope=ECU, multiplicity set at pre-compile, set at pre-compile, default-value=2  # This parameter defines the byte alignment of temporary local buffers that is required by the hardware. Using this parameter, a configuration can ensure that an upper layer module is aware of the alignment requirements of a driver. Tags: atp.Status=draft | Unit: Byte
          integer PduLength: 0..4294967295, post-build-variant-value=true, set at post-build in variant post-build / pre-compile in variant pre-compile  # Length of the Pdu in bytes. It should be noted that in former AUTOSAR releases (Rel 2.1, Rel 3.0, Rel 3.1, Rel 4.0 Rev. 1) this parameter was defined in bits.
          reference EcucPduDefaultPartitionRef [0..1]: multiplicity set at pre-compile, set at pre-compile, destination=EcucPartition  # Reference to EcucPartition, where the according Pdu is assigned to.
          reference MetaDataTypeRef [0..1]: set at pre-compile, destination=MetaDataType  # Reference to meta data that is transported in the Pdu through the AUTOSAR layers.
          foreign reference SysTPduToFrameTriggeringRef [0..1]: multiplicity set at post-build in variant post-build / pre-compile in variant pre-compile, post-build-variant-multiplicity=true, post-build-variant-value=true, set at post-build in variant post-build / pre-compile in variant pre-compile, destination-type=FRAME-TRIGGERING  # Reference to the FrameTriggering from the SystemTemplate which this Pdu belongs to. | SysTPduToFrameTriggeringRef shall be used for UserDefinedPdus, NmPdus and NPdus which are not going through the Pdu Router. This reference shall not be used if SysTPduToPduTriggeringRef exists.
          foreign reference SysTPduToPduTriggeringRef [0..1]: multiplicity set at post-build in variant post-build / pre-compile in variant pre-compile, post-build-variant-multiplicity=true, post-build-variant-value=true, set at post-build in variant post-build / pre-compile in variant pre-compile, destination-type=PDU-TRIGGERING  # Reference to the PduTriggering from the SystemTemplate which this Pdu represents. | SysTPduToPduTriggeringRef shall be used for all Pdus except UserDefinedPdus, NmPdus and NPdus which are not going through the Pdu Router. For these Pdus, SysTPduToFrameTriggeringRef shall be used.
          container EcucPduDedicatedPartition [0..*]: multiplicity set at pre-compile, post-build-variant-multiplicity=true  # Module specific container for Pdu to partition assignment.
            foreign reference EcucPduDedicatedPartitionBswModuleRef: set at pre-compile, destination-type=ECUC-MODULE-CONFIGURATION-VALUES  # Reference to BSW module, for which the according dedicated Pdu assignment is valid.
            reference EcucPduDedicatedPartitionRef: set at pre-compile, destination=EcucPartition  # Module specific reference to EcucPartition, where the according Pdu is assigned to. The dedicated partition reference shall overrule the default partition reference for the respective module.
    container EcucHardware  # Hardware definition of this Ecu.
      container EcucCoreDefinition [1..*]  # Definition of one Core on this Ecu.
        integer EcucCoreId: 0..65535, set at pre-compile  # ID of the core.
        foreign reference EcucCoreHwRef [0..1]: multiplicity set at pre-compile, set at pre-compile, destination-type=HW-ELEMENT  # Optional reference to the HwElement of HwCategory ProcessingUnit that represents this Core in the ECU Resource Template.
    container EcucPartitionCollection [0..1]  # Collection of Partitions defined for this ECU.
      container EcucPartition [0..*]: multiplicity set at pre-compile  # Definition of one Partition on this ECU. | One Partition will be implemented using one Os-Application.
        integer EcucPartitionId: 0..65535, scope=ECU, set at pre-compile  # ID of the partition.
        foreign reference EcucEcuPartitionRef [0..1]: scope=ECU, multiplicity set at pre-compile, set at pre-compile, destination-type=ECU-PARTITION  # Reference to the EcuPartition to define the link to the partition described in the System description. Tags: atp.Status=draft
        foreign reference EcucPartitionBswModuleDistinguishedPartition [0..*]: multiplicity set at pre-compile, set at pre-compile, destination-type=BSW-DISTINGUISHED-PARTITION  # This maps the abstract partition of the Bsw Module to a concrete Partition existing in the ECU.
        reference EcucPartitionCoreRef: scope=ECU, multiplicity set at pre-compile, set at pre-compile, destination=EcucCoreDefinition  # Reference to the core definition. This reference is used to describe to which core the EcucPartition is bound.
        instance reference EcucPartitionSoftwareComponentInstanceRef [0..*]: multiplicity set at pre-compile, set at pre-compile, destination-context=ROOT-SW-COMPOSITION-PROTOTYPE, destination-type=SW-COMPONENT-PROTOTYPE  # References the SW Component instances from the Ecu Extract that shall be executed in this partition.
    container EcucPostBuildVariants [0..1]  # Collection of toplevel PostBuildSelectable variants. The PredefinedVariants linked inside this container will determine how many PostBuildSelectableVariants exist. If this container exist the name pattern for initialization of BSW modules will be <Mip>_Config_<PredefinedVariant.shortName>. If this container does not exist the name pattern for initialization of BSW modlues will be <Mip>_Config.
      foreign reference EcucPostBuildVariantRef [1..*]: multiplicity set at pre-compile, set at pre-compile, destination-type=PREDEFINED-VARIANT  # Reference to a PredefinedVariant that defines one toplevel postBuild configuration set (covering all post-build capable BSW modules). PredefinedVariants that are referenced here shall contain only PostBuildVariantCriterionValueSets.
    container EcucUnitGroupAssignment [0..1]  # Collection of UnitGroup references to support the generation of ASAM MCD file.
      foreign reference EcucUnitGroupRef [1..*]: multiplicity set at pre-compile, set at pre-compile, destination-type=UNIT-GROUP  # Optional reference to the UnitGroup to support the generation of ASAM MCD file. These UnitGroups are selecting a set of units for a specific country.
    container EcucVariationResolver [0..1]  # Collection of PredefinedVariant elements containing definition of values for SwSystemconst which shall be applied when resolving the variability during ECU Configuration.
      foreign reference PredefinedVariantRef [1..*]: multiplicity set at pre-compile, set at pre-compile, destination-type=PREDEFINED-VARIANT
  module definition EcuM [0..1]: post-build-variant-support=true, variants post-build/pre-compile  # Configuration of the EcuM (ECU State Manager) module.
    container EcuMConfiguration  # This container contains the configuration (parameters) of the ECU State Manager.
      container EcuMCommonConfiguration  # This container contains the common configuration (parameters) of the ECU State Manager.
        integer EcuMConfigConsistencyHash [0..1]: 0..18446744073709551615, multiplicity set at pre-compile, set at post-build in variant post-build / pre-compile in variant pre-compile  # In the pre-compile and link-time configuration phase a hash value is generated across all pre-compile and link-time parameters of all BSW modules. | In the post-build phase a hash value is generated across all pre-compile and link-time parameters, except for parameters located in EcucParamConfContainerDef instances or subContainers which have been introduced at post-build configuration time. This hash value is compared against each other and allows checking the consistency of the entire configuration. Note: In systems which do not make use of post-build configurations this parameter can be omitted.
        boolean EcuMIgnoreWakeupEvValOffPreOS: set at pre-compile, default-value=false  # Defines the wakeup events that must be considered in OffPreOS | true: only wakeup events which do not need validation shall be considered false: wakeup events which do not need validation and pending wakeup events that need validation.
        reference EcuMDefaultAppMode: post-build-variant-value=true, set at post-build in variant post-build / pre-compile in variant pre-compile, destination=OsAppMode  # The default application mode loaded when the ECU comes out of reset.
        reference EcuMOSResource [1..*]: multiplicity set at pre-compile, set at pre-compile, destination=OsResource  # This parameter is a reference to a OS resource which is used to bring the ECU into sleep mode. | In case of multi core each core shall have an own OsResource.
        container EcuMDefaultShutdownTarget  # This container describes the default shutdown target to be selected by EcuM. The actual shutdown target may be overridden by the EcuM_SelectShutdownTarget service.
          enumeration EcuMDefaultShutdownTarget: {EcuMShutdownTargetOff, EcuMShutdownTargetReset, EcuMShutdownTargetSleep}, post-build-variant-value=true, set at post-build in variant post-build / pre-compile in variant pre-compile  # This parameter describes the state part of the default shutdown target selected when the ECU comes out of reset. If EcuMShutdownTargetSleep is selected, the parameter EcuMDefaultSleepModeRef selects the specific sleep mode.
          reference EcuMDefaultResetModeRef: multiplicity set at post-build in variant post-build / pre-compile in variant pre-compile, post-build-variant-multiplicity=true, post-build-variant-value=true, set at post-build in variant post-build / pre-compile in variant pre-compile, requires-symbolic-name-value=true, destination=EcuMResetMode  # If EcuMDefaultShutdownTarget is EcuMShutdownTargetReset, this parameter selects the default reset mode. Otherwise this parameter may be ignored.
          reference EcuMDefaultSleepModeRef: multiplicity set at post-build in variant post-build / pre-compile in variant pre-compile, post-build-variant-multiplicity=true, post-build-variant-value=true, set at post-build in variant post-build / pre-compile in variant pre-compile, requires-symbolic-name-value=true, destination=EcuMSleepMode  # If EcuMDefaultShutdownTarget is EcuMShutdownTargetSleep, this parameter selects the default sleep mode. Otherwise this parameter may be ignored.
        container EcuMDriverInitListOne [0..1]: multiplicity set at pre-compile  # Container for Init Block I. | This container holds a list of modules to be initialized. Each module in the list will be called for initialization in the list order. All modules in this list are initialized before the OS is started and so these modules require no OS support.
          container EcuMDriverInitItem [1..*]: multiplicity set at pre-compile, requires-index=true  # These containers describe the entries in a driver init list.
            enumeration EcuMModuleParameter: {NULL_PTR, POSTBUILD_PTR, VOID}, set at pre-compile  # Definition of the function prototype and the parameter passed to the function.
            string EcuMModuleService [0..1]: multiplicity set at pre-compile, set at pre-compile  # The service to be called to initialize that module, e.g. Init, PreInit, Start etc. If nothing is defined "Init" is taken by default.
            reference EcuMEcucCoreDefinitionRef [0..1]: multiplicity set at pre-compile, set at pre-compile, destination=EcucCoreDefinition  # Reference denotes the core the EcuM AUTOSAR services shall be offered on.
            foreign reference EcuMModuleRef: set at pre-compile, destination-type=ECUC-MODULE-CONFIGURATION-VALUES  # Foreign reference to the configuration of a module instance which shall be initialized by EcuM
        container EcuMDriverInitListZero [0..1]: multiplicity set at pre-compile  # Container for Init Block 0. | This container holds a list of modules to be initialized. Each module in the list will be called for initialization in the list order. All modules in this list are initialized before the post-build configuration has been loaded and the OS is initialized. Therefore, these modules may not use post-build configuration.
          container EcuMDriverInitItem [1..*]: multiplicity set at pre-compile, requires-index=true  # These containers describe the entries in a driver init list.
            enumeration EcuMModuleParameter: {NULL_PTR, POSTBUILD_PTR, VOID}, set at pre-compile  # Definition of the function prototype and the parameter passed to the function.
            string EcuMModuleService [0..1]: multiplicity set at pre-compile, set at pre-compile  # The service to be called to initialize that module, e.g. Init, PreInit, Start etc. If nothing is defined "Init" is taken by default.
            reference EcuMEcucCoreDefinitionRef [0..1]: multiplicity set at pre-compile, set at pre-compile, destination=EcucCoreDefinition  # Reference denotes the core the EcuM AUTOSAR services shall be offered on.
            foreign reference EcuMModuleRef: set at pre-compile, destination-type=ECUC-MODULE-CONFIGURATION-VALUES  # Foreign reference to the configuration of a module instance which shall be initialized by EcuM
        container EcuMDriverRestartList [0..1]: multiplicity set at pre-compile  # List of modules to be initialized.
          container EcuMDriverInitItem [1..*]: multiplicity set at pre-compile, requires-index=true  # These containers describe the entries in a driver init list.
            enumeration EcuMModuleParameter: {NULL_PTR, POSTBUILD_PTR, VOID}, set at pre-compile  # Definition of the function prototype and the parameter passed to the function.
            string EcuMModuleService [0..1]: multiplicity set at pre-compile, set at pre-compile  # The service to be called to initialize that module, e.g. Init, PreInit, Start etc. If nothing is defined "Init" is taken by default.
            reference EcuMEcucCoreDefinitionRef [0..1]: multiplicity set at pre-compile, set at pre-compile, destination=EcucCoreDefinition  # Reference denotes the core the EcuM AUTOSAR services shall be offered on.
            foreign reference EcuMModuleRef: set at pre-compile, destination-type=ECUC-MODULE-CONFIGURATION-VALUES  # Foreign reference to the configuration of a module instance which shall be initialized by EcuM
        container EcuMSleepMode [1..256]: multiplicity set at pre-compile  # These containers describe the configured sleep modes. | The names of these containers specify the symbolic names of the different sleep modes.
          integer EcuMSleepModeId: 0..255, scope=ECU, set at pre-compile, symbolic-name-value=true  # This ID identifies this sleep mode in services like EcuM_SelectShutdownTarget.
          boolean EcuMSleepModeSuspend: set at pre-compile  # Flag, which is set true, if the CPU is suspended, halted, or powered off in the sleep mode. If the CPU keeps running in this sleep mode, then this flag must be set to false.
          reference EcuMSleepModeMcuModeRef: set at pre-compile, requires-symbolic-name-value=true, destination=McuModeSettingConf  # This parameter is a reference to the corresponding MCU mode for this sleep mode.
          reference EcuMWakeupSourceMask [1..*]: multiplicity set at pre-compile, set at pre-compile, requires-symbolic-name-value=true, destination=EcuMWakeupSource  # These parameters are references to the wakeup sources that shall be enabled for this sleep mode.
        container EcuMWakeupSource [1..32]: multiplicity set at post-build in variant post-build / pre-compile in variant pre-compile, post-build-variant-multiplicity=true  # These containers describe the configured wakeup sources.
          float EcuMCheckWakeupTimeout [0..1]: 0..10, multiplicity set at pre-compile, set at pre-compile, default-value=0  # This Parameter is the initial Value for the Time of the EcuM to delay shut down of the ECU if the check of the Wakeup Source is done asynchronously (CheckWakeupTimer). | The unit is in seconds.
          float EcuMValidationTimeout [0..1]: 0..INF, multiplicity set at pre-compile, set at pre-compile  # The validation timeout (period for which the ECU State Manager will wait for the validation of a wakeup event) can be defined for each wakeup source independently. The timeout is specified in seconds. | When the timeout is not instantiated, there is no validation routine and the ECU Manager shall not validate the wakeup source.
          integer EcuMWakeupSourceId: 5..31, scope=ECU, set at pre-compile, symbolic-name-value=true  # This parameter defines the identifier of this wakeup source. | The first five bits are reserved values from the EcuM_WakeupSourceType.
          boolean EcuMWakeupSourcePolling: set at pre-compile  # This parameter describes if the wakeup source needs polling.
          reference EcuMComMChannelRef [0..*]: multiplicity set at pre-compile, set at pre-compile, requires-symbolic-name-value=true, destination=ComMChannel  # This parameter could reference multiple Networks (channels) defined in the Communication Manager. No reference indicates that the wakeup source is not a communication channel.
          reference EcuMComMPNCRef [0..*]: multiplicity set at pre-compile, post-build-variant-multiplicity=true, set at pre-compile, requires-symbolic-name-value=true, destination=ComMPnc  # This is a reference to a one or more PNC's defined in the Communication Manager. | No reference indicates that the wakeup source is not assigned to a partial network.
          reference EcuMResetReasonRef [0..*]: multiplicity set at pre-compile, set at pre-compile, requires-symbolic-name-value=true, destination=McuResetReasonConf  # This parameter describes the mapping of reset reasons detected by the MCU driver into wakeup sources.
      container EcuMFlexConfiguration [0..1]: multiplicity set at pre-compile  # This container contains the configuration (parameters) of the EcuMFlex. | Only applicable if EcuMFlex is implemented.
        reference EcuMNormalMcuModeRef: set at pre-compile, requires-symbolic-name-value=true, destination=McuModeSettingConf  # This parameter is a reference to the normal MCU mode to be restored after a sleep.
        reference EcuMPartitionRef [0..*]: multiplicity set at pre-compile, set at pre-compile, destination=EcucPartition  # Reference denotes the partition a EcuM shall run inside. | Please note that in case of a multicore ECU this reference is mandatory.
        container EcuMAlarmClock [0..*]: multiplicity set at pre-compile  # These containers describe the configured alarm clocks. | The name of these conatiners allows giving a symbolic name to one alarm clock.
          integer EcuMAlarmClockId: 0..255, set at pre-compile, symbolic-name-value=true  # This ID identifies this alarmclock.
          float EcuMAlarmClockTimeOut: 0..INF, set at pre-compile  # This parameter allows to define a timeout for this alarm clock.
          reference EcuMAlarmClockUser: set at pre-compile, requires-symbolic-name-value=true, destination=EcuMFlexUserConfig  # This parameter allows an alarm to be assigned to a user.
        container EcuMDriverInitListBswM [0..*]: multiplicity set at pre-compile  # This container holds a list of modules to be initialized by the BswM.
          container EcuMDriverInitItem [1..*]: multiplicity set at pre-compile, requires-index=true  # These containers describe the entries in a driver init list.
            enumeration EcuMModuleParameter: {NULL_PTR, POSTBUILD_PTR, VOID}, set at pre-compile  # Definition of the function prototype and the parameter passed to the function.
            string EcuMModuleService [0..1]: multiplicity set at pre-compile, set at pre-compile  # The service to be called to initialize that module, e.g. Init, PreInit, Start etc. If nothing is defined "Init" is taken by default.
            reference EcuMEcucCoreDefinitionRef [0..1]: multiplicity set at pre-compile, set at pre-compile, destination=EcucCoreDefinition  # Reference denotes the core the EcuM AUTOSAR services shall be offered on.
            foreign reference EcuMModuleRef: set at pre-compile, destination-type=ECUC-MODULE-CONFIGURATION-VALUES  # Foreign reference to the configuration of a module instance which shall be initialized by EcuM
        container EcuMFlexUserConfig [1..256]: multiplicity set at pre-compile  # These containers describe the identifiers that are needed to refer to a software component or another appropriate entity in the system which uses the EcuMFlex Interfaces.
          integer EcuMFlexUser: 0..255, set at pre-compile, symbolic-name-value=true  # Parameter used to identify one user.
          reference EcuMFlexEcucPartitionRef [0..1]: multiplicity set at pre-compile, set at pre-compile, destination=EcucPartition  # Denotes in which "EcucPartition" the user of the EcuM is executed.
        container EcuMGoDownAllowedUsers [0..1]: multiplicity set at pre-compile  # This container describes the collection of allowed users which are allowed to call the EcuM_GoDownHaltPoll API (only applies in the case that the previously set shutdown target is TARGET_RESET or TARGET_OFF).
          reference EcuMGoDownAllowedUserRef [1..*]: multiplicity set at pre-compile, set at pre-compile, requires-symbolic-name-value=true, destination=EcuMFlexUserConfig  # This references an allowed user.
        container EcuMResetMode [1..256]: multiplicity set at pre-compile  # These containers describe the configured reset modes. | The name of these containers allows one of the following symbolic names to be given to the different reset modes: * ECUM_RESET_MCU * ECUM_RESET_WDG * ECUM_RESET_IO.
          integer EcuMResetModeId: 0..255, set at pre-compile, symbolic-name-value=true  # This ID identifies this reset mode in services like EcuM_SelectShutdownTarget.
        container EcuMSetClockAllowedUsers [0..1]: multiplicity set at pre-compile  # This container describes the collection of allowed users which are allowed to call the EcuM_SetClock API.
          reference EcuMSetClockAllowedUserRef [1..*]: multiplicity set at pre-compile, set at pre-compile, requires-symbolic-name-value=true, destination=EcuMFlexUserConfig  # These parameters describe the references to the users which are allowed to call the EcuM_SetClock API.
        container EcuMShutdownCause [1..256]: multiplicity set at pre-compile  # These containers describe the configured shut down or reset causes. | The name of these containers allows to give one of the following symbolic names to the different shut down causes: * ECUM_CAUSE_ECU_STATE - ECU state machine entered a state for shutdown, * ECUM_CAUSE_WDGM - WdgM detected failure, * ECUM_CAUSE_DCM - Dcm requests shutdown (split into UDS services?), * and values from configuration.
          integer EcuMShutdownCauseId: 0..255, set at pre-compile, symbolic-name-value=true  # This ID identifies this shut down cause.
    container EcuMFlexGeneral [0..1]: multiplicity set at pre-compile  # This container holds the general, pre-compile configuration parameters for the EcuMFlex. | Only applicable if EcuMFlex is implemented.
      boolean EcuMAlarmClockPresent: set at pre-compile  # This flag indicates whether the optional AlarmClock feature is present.
      boolean EcuMModeHandling [0..1]: multiplicity set at pre-compile, set at pre-compile  # If false, Run Request Protocol is not performed.
      boolean EcuMResetLoopDetection [0..1]: multiplicity set at pre-compile, set at pre-compile  # If false, no reset loop detection is performed. If this configuration parameter exists and is set to true, the callout "EcuM_LoopDetection" is called during startup of EcuM (during StartPreOS).
      boolean EcuMSetProgrammableInterrupts [0..1]: multiplicity set at pre-compile, set at pre-compile  # If this configuration parameter exists and is to true, the callout "EcuM_AL_SetProgrammableInterrupts" is called during startup of EcuM (during StartPreOS).
      reference EcuMAlarmWakeupSource [0..1]: multiplicity set at pre-compile, set at pre-compile, requires-symbolic-name-value=true, destination=EcuMWakeupSource  # This parameter describes the reference to the EcuMWakeupSource being used for the EcuM AlarmClock.
    container EcuMGeneral  # This container holds the general, pre-compile configuration parameters.
      boolean EcuMDevErrorDetect: set at pre-compile, default-value=false  # Switches the development error detection and notification on or off. | * true: detection and notification is enabled. * false: detection and notification is disabled.
      float EcuMMainFunctionPeriod: 0..INF, scope=ECU, set at pre-compile  # This parameter defines the schedule period of EcuM_MainFunction. | Unit: [s]
      boolean EcuMVersionInfoApi: set at pre-compile, default-value=false  # Switches the version info API on or off
  module definition Eep [0..*]: post-build-variant-support=true, variants post-build/pre-compile  # Configuration of the Eep (internal or external EEPROM driver) module. Tags: atp.Status=obsolete | Its multiplicity describes the number of EEPROM drivers present, so there will be one container for each EEPROM driver in the ECUC template. When no EEPROM driver is present then the multiplicity is 0.
    container EepGeneral  # Container for general configuration parameters of the EEPROM driver. These parameters are always pre-compile. Tags: atp.Status=obsolete
      boolean EepDevErrorDetect: set at pre-compile, default-value=false  # Switches the development error detection and notification on or off. Tags: atp.Status=obsolete | * true: detection and notification is enabled. * false: detection and notification is disabled. This element is obsolete and will be removed in a future revision.
      integer EepDriverIndex: 0..254, scope=ECU, set at pre-compile, symbolic-name-value=true  # Specifies the InstanceId of this module instance. If only one instance is present it shall have the Id 0. Tags: atp.Status=obsolete
      float EepMainFunctionPeriod [0..1]: 0..INF, multiplicity set at pre-compile, set at pre-compile  # Call cycle time of the EEPROM driver's main function. Unit: [s] Tags: atp.Status=obsolete
      boolean EepUseInterrupts: set at pre-compile, default-value=false  # Switches to activate or deactivate interrupt controlled job processing. Tags: atp.Status=obsolete | true: Interrupt controlled job processing enabled. false: Interrupt controlled job processing disabled. This element is obsolete and will be removed in a future revision.
      boolean EepVersionInfoApi: set at pre-compile, default-value=false  # Pre-processor switch to enable / disable the API to read out the modules version information. Tags: atp.Status=obsolete | true: Version info API enabled. false: Version info API disabled. This element is obsolete and will be removed in a future revision.
      boolean EepWriteCycleReduction: set at pre-compile, default-value=false  # Switches to activate or deactivate write cycle reduction (EEPROM value is read and compared before being overwritten). Tags: atp.Status=obsolete | true: Write cycle reduction enabled. false: Write cycle reduction disabled. This element is obsolete and will be removed in a future revision.
      reference EepEcucPartitionRef [0..1]: scope=ECU, multiplicity set at pre-compile, post-build-variant-multiplicity=true, post-build-variant-value=true, set at pre-compile, destination=EcucPartition  # Maps the EEP driver to zero or one ECUC partition to make the driver API available in this partition. Tags: atp.Status=obsolete
    container EepInitConfiguration  # Container for runtime configuration parameters of the EEPROM driver. Tags: atp.Status=obsolete | Implementation Type: Eep_ConfigType. This element is obsolete and will be removed in a future revision.
      integer EepBaseAddress: 0..4294967295, post-build-variant-value=true, set at post-build in variant post-build / pre-compile in variant pre-compile  # This parameter is the EEPROM device base address. Tags: atp.Status=obsolete | Implementation Type: Eep_AddressType. This element is obsolete and will be removed in a future revision.
      enumeration EepDefaultMode: post-build-variant-value=true, set at post-build in variant post-build / pre-compile in variant pre-compile, default-value=MEMIF_MODE_SLOW  # This parameter is the default EEPROM device mode after initialization. Tags: atp.Status=obsolete | Implementation Type: MemIf_ModeType. This element is obsolete and will be removed in a future revision.
        MEMIF_MODE_FAST  # Tags: atp.Status=obsolete
        MEMIF_MODE_SLOW  # Tags: atp.Status=obsolete
      integer EepFastReadBlockSize: 0..4294967295, post-build-variant-value=true, set at post-build in variant post-build / pre-compile in variant pre-compile  # Number of bytes read within one job processing cycle in fast mode. If the hardware does not support burst mode this parameter shall be set to the same value as EepNormalReadBlockSize. Tags: atp.Status=obsolete | Implementation Type: Eep_LengthType. This element is obsolete and will be removed in a future revision.
      integer EepFastWriteBlockSize: 0..4294967295, post-build-variant-value=true, set at post-build in variant post-build / pre-compile in variant pre-compile  # Number of bytes written within one job processing cycle in fast mode. If the hardware does not support burst mode this parameter shall be set to the same value as EepNormalWriteBlockSize. Tags: atp.Status=obsolete | Implementation Type: Eep_LengthType. This element is obsolete and will be removed in a future revision.
      function name EepJobEndNotification [0..1]: multiplicity set at post-build in variant post-build / pre-compile in variant pre-compile, post-build-variant-multiplicity=true, post-build-variant-value=true, set at post-build in variant post-build / pre-compile in variant pre-compile  # This parameter is a reference to a callback function for positive job result (see EEP045). Tags: atp.Status=obsolete
      function name EepJobErrorNotification [0..1]: multiplicity set at post-build in variant post-build / pre-compile in variant pre-compile, post-build-variant-multiplicity=true, post-build-variant-value=true, set at post-build in variant post-build / pre-compile in variant pre-compile  # This parameter is a reference to a callback function for negative job result (see EEP046). Tags: atp.Status=obsolete
      integer EepNormalReadBlockSize: 0..4294967295, post-build-variant-value=true, set at post-build in variant post-build / pre-compile in variant pre-compile  # Number of bytes read within one job processing cycle in normal mode. Tags: atp.Status=obsolete | Implementation Type: Eep_LengthType. This element is obsolete and will be removed in a future revision.
      integer EepNormalWriteBlockSize: 0..4294967295, post-build-variant-value=true, set at post-build in variant post-build / pre-compile in variant pre-compile  # Number of bytes written within one job processing cycle in normal mode. Tags: atp.Status=obsolete | Implementation Type: Eep_LengthType. This element is obsolete and will be removed in a future revision.
      integer EepSize: 0..4294967295, post-build-variant-value=true, set at post-build in variant post-build / pre-compile in variant pre-compile  # This parameter is the used size of EEPROM device in bytes. Tags: atp.Status=obsolete | Implementation Type: Eep_LengthType. This element is obsolete and will be removed in a future revision.
      container EepDemEventParameterRefs [0..1]  # Container for the references to DemEventParameter elements which shall be invoked using the API Dem_SetEventStatus in case the corresponding error occurs. The EventId is taken from the referenced DemEventParameter's DemEventId symbolic value. The standardized errors are provided in this container and can be extended by vendor-specific error references. Tags: atp.Status=obsolete
        reference EEP_E_COMPARE_FAILED [0..1]: multiplicity set at post-build in variant post-build / pre-compile in variant pre-compile, post-build-variant-multiplicity=true, post-build-variant-value=true, set at post-build in variant post-build / pre-compile in variant pre-compile, requires-symbolic-name-value=true, destination=DemEventParameter  # Reference to the DemEventParameter which shall be issued when the error "EEPROM compare failed (HW)" has occurred. Tags: atp.Status=obsolete
        reference EEP_E_ERASE_FAILED [0..1]: multiplicity set at post-build in variant post-build / pre-compile in variant pre-compile, post-build-variant-multiplicity=true, post-build-variant-value=true, set at post-build in variant post-build / pre-compile in variant pre-compile, requires-symbolic-name-value=true, destination=DemEventParameter  # Reference to the DemEventParameter which shall be issued when the error "EEPROM erase failed (HW)" has occurred. Tags: atp.Status=obsolete
        reference EEP_E_READ_FAILED [0..1]: multiplicity set at post-build in variant post-build / pre-compile in variant pre-compile, post-build-variant-multiplicity=true, post-build-variant-value=true, set at post-build in variant post-build / pre-compile in variant pre-compile, requires-symbolic-name-value=true, destination=DemEventParameter  # Reference to the DemEventParameter which shall be issued when the error "EEPROM read failed (HW)" has occurred. Tags: atp.Status=obsolete
        reference EEP_E_WRITE_FAILED [0..1]: multiplicity set at post-build in variant post-build / pre-compile in variant pre-compile, post-build-variant-multiplicity=true, post-build-variant-value=true, set at post-build in variant post-build / pre-compile in variant pre-compile, requires-symbolic-name-value=true, destination=DemEventParameter  # Reference to the DemEventParameter which shall be issued when the error "EEPROM write failed (HW)" has occurred. Tags: atp.Status=obsolete
      container EepExternalDriver [0..1]  # This container is present for external EEPROM drivers only. Internal EEPROM drivers do not use the parameter listed in this container, hence its multiplicity is 0 for internal drivers. Tags: atp.Status=obsolete
        choice reference EepExternalContainerRef [0..1]: multiplicity set at post-build in variant post-build / pre-compile in variant pre-compile, post-build-variant-multiplicity=true, post-build-variant-value=true, set at post-build in variant post-build / pre-compile in variant pre-compile, requires-symbolic-name-value=true, destination=[I2cSequence, SpiSequence]  # Reference to either: Tags: atp.Status=draft | * an SpiSequenceConfiguration container in case the EEP hardware is accessed via SPI * an I2CSequenceConfiguration container in case the EEPhardware is accessed via I2C
    container EepPublishedInformation  # Additional published parameters not covered by CommonPublishedInformation container. Tags: atp.Status=obsolete | Note that these parameters do not have any configuration class setting, since they are published information. This element is obsolete and will be removed in a future revision.
      integer EepAllowedWriteCycles: 0..4294967295, set at published-information  # Specified maximum number of write cycles under worst case conditions of specific EEPROM hardware (e.g. +90°C) Tags: atp.Status=obsolete
      float EepEraseTime: 0..INF, set at published-information  # Maximum time for erasing one EEPROM data unit. Tags: atp.Status=obsolete
      integer EepEraseUnitSize: 0..4294967295, set at published-information  # Size of smallest erasable EEPROM data unit in bytes. Tags: atp.Status=obsolete
      integer EepEraseValue: 0..255, set at published-information  # Value of an erased EEPROM cell. Tags: atp.Status=obsolete
      integer EepMinimumAddressType: 0..4294967295, set at published-information  # Minimum expected size of Eep_AddressType. Tags: atp.Status=obsolete
      integer EepMinimumLengthType: 0..4294967295, set at published-information  # Minimum expected size of Eep_LengthType. Tags: atp.Status=obsolete
      integer EepReadUnitSize: 0..4294967295, set at published-information  # Size of smallest readable EEPROM data unit in bytes. Tags: atp.Status=obsolete
      integer EepSpecifiedEraseCycles: 0..4294967295, set at published-information  # Number of erase cycles specified for the EEP device (usually given in the device data sheet). Tags: atp.Status=obsolete
      integer EepTotalSize: 0..4294967295, set at published-information  # Total size of EEPROM in bytes. Tags: atp.Status=obsolete | Implementation Type: Eep_LengthType. This element is obsolete and will be removed in a future revision.
      float EepWriteTime: 0..INF, set at published-information  # Maximum time for writing one EEPROM data unit. Tags: atp.Status=obsolete
      integer EepWriteUnitSize: 0..4294967295, set at published-information  # Size of smallest writeable EEPROM data unit in bytes. Tags: atp.Status=obsolete
  module definition Eth [0..*]: post-build-variant-support=true, variants link-time/post-build/pre-compile  # Configuration of the Eth (Ethernet Driver) module.
    container EthConfigSet  # This container contains the configuration parameters and sub containers of the AUTOSAR Eth module.
      container EthCtrlConfig [1..*]  # Configuration of the individual controller
        integer EthCtrEgressHardwareSupportedDataTransferThreshold: 0..65535, set at pre-compile, default-value=0  # EthCtrEgressHardwareSupportedDataTransferThreshold define a threshold in bytes, if data, which is requested to be transmitted, shall be transferred with an hardware supported instruction (e.g. DMA) or via CPU copying process. Tags: atp.Status=draft | If given data length for transmission exceeds the configured threshold, then the Eth driver shall initiate a hardware supported data transfer from the given source address(es) to the used egress queue entry (e.g. via DMA instruction). Otherwise the Eth driver shall perform a CPU driven copy of data to the used egress queue entry to the corresponding egress queue (e.g. via DMA instruction).
        boolean EthCtrlConfigSwBufferHandling: set at pre-compile  # Enables / Disables SW buffer management
        boolean EthCtrlEnableEgressHardwareSupportedDataTransfer: set at pre-compile, default-value=false  # Eth driver shall use hardware supported data transfer form the upper layers to the corresponding egress queue (e.g. via DMA instruction) Tags: atp.Status=draft | true: hardware supported data transfer is enabled false: hardware supported data transfer is disabled
        boolean EthCtrlEnableMii: set at pre-compile  # Enables / Disables Media Independent Interface (MII) for transceiver access. | Note: In case a MACPHY (external Ethernet controller) is use this parameter has to be enabled to ensure the existence of Eth_WriteMii and Eth_ReadMii. Within the function call of Eth_WriteMii and Eth_ReadMii, the register access is transformed to an SPI command.
        boolean EthCtrlEnableMmd: set at pre-compile, default-value=false  # Enables/Disables Clause 45 Media Independent Interface (MII) for transceiver access
        boolean EthCtrlEnableRxInterrupt: set at pre-compile  # Enables / Disables receive interrupt. | Note: If this parameter is set to TRUE, then all ingress queues are handled in interrupt mode. If specific ingress queue need to be handled in interrupt mode, then this global parameter need to be set to FALSE and the specific ingress queue parameter EthCtrlEnableIngressQueueInterrupt need to be set to TRUE.
        boolean EthCtrlEnableSpiInterface [0..1]: post-build-variant-value=true, set at pre-compile, default-value=false  # This optional parameter enables the processing of control data and Ethernet frames over the SPI interface specific for MACPHY device. The use of this parameter implies the respect of the SPI protocol described in TC6 [26].
        boolean EthCtrlEnableTxInterrupt: set at pre-compile  # Enables / Disables transmit interrupt
        boolean EthCtrlFramePreemptionEnable: set at pre-compile, default-value=false  # Configures whether frame preemption for this Ethernet controller is enabled. Tags: atp.Status=draft | If this parameter is set to TRUE and the Ethernet controller hardware supports frame preemption, then frame preemption for this Ethernet controller is enabled.
        integer EthCtrlIdx: 0..255, scope=ECU, set at pre-compile, symbolic-name-value=true, with-auto=true  # Specifies the instance ID of the configured controller.
        integer EthCtrlInterPacketGap [0..1]: 0..10000, multiplicity set at pre-compile, set at pre-compile, default-value=12  # This parameter defines the transmit Inter-Packet Gap (IPG) (also called interframe gap (IFG)) between transmitted Ethernet packets in "byte times". This parameter can only exist if the hardware and driver support setting the IPG.
        enumeration EthCtrlMacLayerSpeed [0..1]: {ETH_MAC_LAYER_SPEED_100M, ETH_MAC_LAYER_SPEED_10G, ETH_MAC_LAYER_SPEED_10M, ETH_MAC_LAYER_SPEED_1G, ETH_MAC_LAYER_SPEED_2500M, ETH_MAC_LAYER_SPEED_5G}, scope=ECU, multiplicity set at link in variant link-time / post-build in variant post-build / pre-compile in variant pre-compile, post-build-variant-multiplicity=true, post-build-variant-value=true, set at link in variant link-time / post-build in variant post-build / pre-compile in variant pre-compile  # Defines the baud rate of the MAC layer.
        enumeration EthCtrlMacLayerSubType [0..1]: {REDUCED, REVERSED, SERIAL, STANDARD, UNIVERSAL_SERIAL}, scope=ECU, multiplicity set at link in variant link-time / post-build in variant post-build / pre-compile in variant pre-compile, post-build-variant-multiplicity=true, post-build-variant-value=true, set at link in variant link-time / post-build in variant post-build / pre-compile in variant pre-compile  # Defines the MAC layer subtype of a switch port
        enumeration EthCtrlMacLayerType: {ETH_MAC_LAYER_TYPE_XGMII, ETH_MAC_LAYER_TYPE_XMII, ETH_MAC_LAYER_TYPE_XXGMII}, scope=ECU, post-build-variant-value=true, set at link in variant link-time / post-build in variant post-build / pre-compile in variant pre-compile  # Defines the physical MAC/PHY Ethernet Interface type of the ethernet controller.
        string EthCtrlPhyAddress [0..1]: multiplicity set at link in variant link-time / post-build in variant post-build / pre-compile in variant pre-compile, post-build-variant-multiplicity=true, post-build-variant-value=true, set at link in variant link-time / post-build in variant post-build / pre-compile in variant pre-compile, max-length=17, min-length=17, regular-expression=([0-9a-fA-F]\{2}:)\{5}[0-9a-fA-F]\{2}  # Specifies the unique 48-bit physical address (MAC address) of the controller in network byte order.
        reference EthCtrlEcucPartitionRef [0..1]: scope=ECU, multiplicity set at pre-compile, post-build-variant-multiplicity=true, post-build-variant-value=true, set at pre-compile, destination=EcucPartition  # Maps the Ethernet controller to zero or one ECUC partitions. The ECUC partition referenced is a subset of the ECUC partitions where the Ethernet driver is mapped to.
        container EthClkUnit [0..*]: multiplicity set at pre-compile  # This container contains the configuration of HW clock unit in the Ethernet Controller, which encapsulates a HW clock for ingress/egress timestamping and optionally an adjustable HW clock to follow the PTP time. Tags: atp.Status=draft
          enumeration EthClkUnitCrossTimestampingSupport: scope=ECU, set at pre-compile, default-value=NO_XTIMESTAMPING  # Defines the type of cross-timestamping between 2 HW clocks in the Ethernet Controller. Tags: atp.Status=draft
            HW_XTIMESTAMPING  # Tags: atp.Status=draft
            NO_XTIMESTAMPING  # Tags: atp.Status=draft
            SW_XTIMESTAMPING  # Tags: atp.Status=draft
          integer EthClkUnitIdx: 0..255, scope=ECU, set at pre-compile, symbolic-name-value=true, with-auto=true  # Zero-based consecutive index of the HW clock units in the Ethernet Controller. Upper layer BSW modules and the Eth itself use this index to identify a clock in the Ethernet Controller. Tags: atp.Status=draft
          reference EthClkUnitTimePhcRef [0..1]: scope=ECU, multiplicity set at pre-compile, set at pre-compile, destination=EthCtrlClk  # Reference to a HW clock in the Ethernet controller, which can be configured as PTP hardware clock (PHC). Tags: atp.Status=draft
          reference EthClkUnitTimeStampingRef: scope=ECU, set at pre-compile, destination=EthCtrlClk  # Reference to a HW clock in the Ethernet controller, which is used by the Ethernet Controller for ingress/egrees timestamping of frames. Tags: atp.Status=draft
        container EthCtrlClk [0..*]: multiplicity set at pre-compile  # This container contains the configuration of a HW clock in the Ethernet Controller. Tags: atp.Status=draft | Please note: It is recommended to always use the same hardware clock tree of the used platform for Ethernet hardware clocks which refer to the same EthClkUnit, otherwise cross-timestamping is needed.
          boolean EthCtrlClkAdjustmentEnable: scope=ECU, set at pre-compile, default-value=false  # Defines whether clock adjustment is enabled for this EthCtrlClk. Tags: atp.Status=draft
          integer EthCtrlClkIdx: 0..255, scope=ECU, set at pre-compile  # Zero-based consecutive index of the HW clocks in the Ethernet Controller. Upper layer BSW modules and the Eth itself use this index to identify a clock in the Ethernet Controller. Tags: atp.Status=draft
        container EthCtrlConfigEgress  # Configuration of one Ethernet controler egress behavior.
          reference EthCtrlConfigEgressLastSchedulerRef: set at pre-compile, destination=EthCtrlConfigScheduler  # Reference to the scheduler which is the last in the egress structure.
          container EthCtrlConfigEgressFifo [0..*]: multiplicity set at link in variant link-time / post-build in variant post-build / pre-compile in variant pre-compile, post-build-variant-multiplicity=true  # Represents a Fifo at the egress side. Tags: atp.Status=obsolete
            integer EthCtrlConfigEgressFifoBufLenByte: 0..65535, post-build-variant-value=true, set at link in variant link-time / post-build in variant post-build / pre-compile in variant pre-compile  # Length of Fifo elements in bytes. Tags: atp.Status=obsolete
            integer EthCtrlConfigEgressFifoBufTotal: 0..65535, post-build-variant-value=true, set at link in variant link-time / post-build in variant post-build / pre-compile in variant pre-compile  # Fifo buffer count. Tags: atp.Status=obsolete
            integer EthCtrlConfigEgressFifoIdx: 0..255, post-build-variant-value=true, set at link in variant link-time / post-build in variant post-build / pre-compile in variant pre-compile  # Egress Fifo index. Tags: atp.Status=obsolete
            integer EthCtrlConfigEgressFifoPriorityAssignment [0..*]: 0..7, multiplicity set at link in variant link-time / post-build in variant post-build / pre-compile in variant pre-compile, post-build-variant-multiplicity=true, post-build-variant-value=true, set at link in variant link-time / post-build in variant post-build / pre-compile in variant pre-compile  # Message egress prority assignment. Tags: atp.Status=obsolete
          container EthCtrlConfigEgressQueue [1..*]: multiplicity set at link in variant link-time / post-build in variant post-build / pre-compile in variant pre-compile, post-build-variant-multiplicity=true, requires-index=true  # Represents a queue at the egress side. Tags: atp.Status=draft
            integer EthCtrlConfigEgressQueueBufLenByte: 0..65535, post-build-variant-value=true, set at link in variant link-time / post-build in variant post-build / pre-compile in variant pre-compile  # Defines the length of one queue element in bytes. Tags: atp.Status=draft
            integer EthCtrlConfigEgressQueueBufTotal: 0..65535, post-build-variant-value=true, set at link in variant link-time / post-build in variant post-build / pre-compile in variant pre-compile  # Defines the count of queue elements for one queue. Tags: atp.Status=draft
            integer EthCtrlConfigEgressQueueIdx: 0..255, post-build-variant-value=true, set at link in variant link-time / post-build in variant post-build / pre-compile in variant pre-compile, symbolic-name-value=true, with-auto=true  # Defines the queue index. Tags: atp.Status=draft
            container EthCtrlConfigEgressQueueSortingType [0..1]: multiplicity set at pre-compile  # Defines the sorting filter for the queue. Optional if only one queue is available. Tags: atp.Status=draft
              container EthCtrlConfigEgressQueueSortingEntry [1..*]: multiplicity set at link in variant link-time / post-build in variant post-build / pre-compile in variant pre-compile, post-build-variant-multiplicity=true  # Defines a field of the sorting filter. Tags: atp.Status=draft
                integer EthCtrlConfigEgressQueueSortingKey: 0..18446744073709551615, set at link in variant link-time / post-build in variant post-build / pre-compile in variant pre-compile  # Defines the value the masked filtered field has to match. Tags: atp.Status=draft
                integer EthCtrlConfigEgressQueueSortingMask: 0..18446744073709551615, set at link in variant link-time / post-build in variant post-build / pre-compile in variant pre-compile  # Defines the mask for matching the filtered field. Tags: atp.Status=draft
                integer EthCtrlConfigEgressQueueSortingOffset: 0..47, set at link in variant link-time / post-build in variant post-build / pre-compile in variant pre-compile  # Defines the offset of the filtered field in bytes, where 0 denotes the position of the destination MAC address. Tags: atp.Status=draft
                enumeration EthCtrlConfigEgressQueueSortingSize: set at link in variant link-time / post-build in variant post-build / pre-compile in variant pre-compile  # Defines the size of the filtered field. Tags: atp.Status=draft
                  UINT16  # Tags: atp.Status=draft
                  UINT32  # Tags: atp.Status=draft
                  UINT64  # Tags: atp.Status=draft
                  UINT8  # Tags: atp.Status=draft
            container EthCtrlConfigEgressQueueTransmissionSelection  # Represents the transmission selection of a queue at the egress side. Tags: atp.Status=draft
              enumeration EthCtrlConfigEgressQueueTransmissionSelectionAlgorithm: post-build-variant-value=true, set at link in variant link-time / post-build in variant post-build / pre-compile in variant pre-compile, default-value=ETH_TRANSMISSION_SELECTION_UNSHAPED  # Represents the transmission selection of a queue at the egress side. Tags: atp.Status=draft
                ETH_TRANSMISSION_SELECTION_ATS  # Tags: atp.Status=draft
                ETH_TRANSMISSION_SELECTION_CBS  # Tags: atp.Status=draft
                ETH_TRANSMISSION_SELECTION_ETS  # Tags: atp.Status=draft
                ETH_TRANSMISSION_SELECTION_UNSHAPED  # Tags: atp.Status=draft
              container EthCtrlConfigEgressQueueTransmissionSelectionCBSConfig [0..1]: multiplicity set at link in variant link-time / post-build in variant post-build / pre-compile in variant pre-compile, post-build-variant-multiplicity=true  # Represents the configuration of a credit based shaper transmission selection algorithm for an queue at the egress side. Tags: atp.Status=draft | This configuration is used if the EthCtrlConfigEgressQueueTransmissionSelectionAlgorithm is set to ETH_TRANSMISSION_SELECTION_CBS.
                integer EthCtrlConfigEgressQueueCreditBasedShaperMaxCredit [0..1]: 0..18446744073709551615, multiplicity set at pre-compile, post-build-variant-value=true, set at link in variant link-time / post-build in variant post-build / pre-compile in variant pre-compile  # Defines the maximum amount of credits that can be accumulated for a queue. Tags: atp.Status=draft
                integer EthCtrlConfigEgressQueueCreditBasedShaperMinCredit [0..1]: 0..18446744073709551615, multiplicity set at pre-compile, post-build-variant-value=true, set at link in variant link-time / post-build in variant post-build / pre-compile in variant pre-compile  # Defines the minimum amount of credits that can be accumulated for a queue. Tags: atp.Status=draft
                integer EthCtrlConfigEgressQueueCreditBasedShaperSendSlope [0..1]: 0..18446744073709551615, multiplicity set at pre-compile, post-build-variant-value=true, set at link in variant link-time / post-build in variant post-build / pre-compile in variant pre-compile  # Defines the send slope of queue at egress side. Tags: atp.Status=draft
              container EthCtrlConfigEgressQueueTransmissionSelectionETS [0..1]: multiplicity set at pre-compile  # Represents the configuration of an enhanced transmission selection algorithm of an egress queue. This configuration is used if the EthCtrlConfigEgressQueueTransmissionSelection is set to ETH_SCHEDULER_ENHANCED_TRAFFIC_SHAPER. The subordinated configuration parameters allow to configure the ETS in different variants to support commonly used scheduler algorithms (e.g. weighted round robin). Tags: atp.Status=draft
                integer EthCtrlETSConfigAvailableBandwidthInPercent [0..1]: 0..100, multiplicity set at pre-compile, set at pre-compile, default-value=30  # Represents the configuration of an enhanced transmission selection algorithm for one egress queue, where the available bandwidth is configured in percent. The percent value represents the available bandwidth for emission opportunities to transmit Ethernet frames calculated in bits. Tags: atp.Status=draft | The resolution is 1%.
                integer EthCtrlETSConfigAvailableBandwidthInWeightValue [0..1]: 1..255, multiplicity set at pre-compile, set at pre-compile, default-value=1  # Represents the configuration of an enhanced transmission selection algorithm of an egress queue, where the available bandwidth is configured as weight value. The weight value represents the number of emission opportunities to transmit Ethernet frames. Tags: atp.Status=draft
          container EthCtrlConfigScheduler [1..*]  # Represents a Scheduler on the egress side.
            enumeration EthCtrlConfigSchedulerAlgorithm: {ETH_SCHEDULER_ENHANCED_TRAFFIC_SHAPER, ETH_SCHEDULER_STRICT_PRIORITY}, post-build-variant-value=true, set at link in variant link-time / post-build in variant post-build / pre-compile in variant pre-compile  # Defines the scheduler algorithm.
            container EthCtrlConfigSchedulerPredecessor [1..*]  # Defines an ordered list of predecessors for this scheduler.
              integer EthCtrlConfigSchedulerPredecessorOrder: 0..18446744073709551615, post-build-variant-value=true, set at link in variant link-time / post-build in variant post-build / pre-compile in variant pre-compile  # Defines the order of the scheduler predecessors.
              choice reference EthCtrlConfigSchedulerPredecessorRef: set at pre-compile, destination=[EthCtrlConfigEgressFifo, EthCtrlConfigEgressQueue, EthCtrlConfigScheduler, EthCtrlConfigShaper]  # Choice reference to the scheduler predecessor.
          container EthCtrlConfigShaper [0..*]  # Represents a Shaper an the egress side. Tags: atp.Status=obsolete
            integer EthCtrlConfigShaperIdleSlope [0..1]: 0..18446744073709551615, post-build-variant-value=true, set at link in variant link-time / post-build in variant post-build / pre-compile in variant pre-compile  # Defines the increase of credit in bits per second for the AVB shaper. Tags: atp.Status=obsolete
            integer EthCtrlConfigShaperMaxCredit: 0..18446744073709551615, post-build-variant-value=true, set at link in variant link-time / post-build in variant post-build / pre-compile in variant pre-compile  # Maximum amount of credits that can be accumulated for a queue. Tags: atp.Status=obsolete
            integer EthCtrlConfigShaperMinCredit: 0..18446744073709551615, post-build-variant-value=true, set at link in variant link-time / post-build in variant post-build / pre-compile in variant pre-compile  # Minimum amount of credits in bytes that can be accumulated for a queue. Tags: atp.Status=obsolete
            reference EthCtrlConfigShaperPredecessorFifoRef: set at pre-compile, destination=EthCtrlConfigEgressFifo  # Reference to the fifo which is the predecessor for this shaper. Tags: atp.Status=obsolete
        container EthCtrlConfigIngress  # Configuration of one Ethernet controler ingress behavior.
          container EthCtrlConfigIngressFifo [0..*]: multiplicity set at link in variant link-time / post-build in variant post-build / pre-compile in variant pre-compile, post-build-variant-multiplicity=true  # Represents a Fifo at the ingress side. Tags: atp.Status=obsolete
            integer EthCtrlConfigIngressFifoBufLenByte: 0..65535, post-build-variant-value=true, set at link in variant link-time / post-build in variant post-build / pre-compile in variant pre-compile  # Length of Fifo elements in bytes. Tags: atp.Status=obsolete
            integer EthCtrlConfigIngressFifoBufTotal: 0..65535, post-build-variant-value=true, set at link in variant link-time / post-build in variant post-build / pre-compile in variant pre-compile  # Fifo buffer count. Tags: atp.Status=obsolete
            integer EthCtrlConfigIngressFifoIdx: 0..255, post-build-variant-value=true, set at link in variant link-time / post-build in variant post-build / pre-compile in variant pre-compile, symbolic-name-value=true, with-auto=true  # Ingress Fifo index. Tags: atp.Status=obsolete
            integer EthCtrlConfigIngressFifoPriorityAssignment [0..*]: 0..7, multiplicity set at link in variant link-time / post-build in variant post-build / pre-compile in variant pre-compile, post-build-variant-multiplicity=true, post-build-variant-value=true, set at link in variant link-time / post-build in variant post-build / pre-compile in variant pre-compile  # Message ingress prority assignment. Tags: atp.Status=obsolete
          container EthCtrlConfigIngressQueue [0..*]: multiplicity set at link in variant link-time / post-build in variant post-build / pre-compile in variant pre-compile, post-build-variant-multiplicity=true  # Represents a queue at the ingress side. Tags: atp.Status=draft
            integer EthCtrlConfigIngressQueueBufLenByte: 0..65535, post-build-variant-value=true, set at link in variant link-time / post-build in variant post-build / pre-compile in variant pre-compile  # Defines the length of one queue element in bytes. Tags: atp.Status=draft
            integer EthCtrlConfigIngressQueueBufTotal: 0..65535, post-build-variant-value=true, set at link in variant link-time / post-build in variant post-build / pre-compile in variant pre-compile  # Defines the count of queue elements for one queue. Tags: atp.Status=draft
            function name EthCtrlConfigIngressQueueHandlerFunction [0..1]: multiplicity set at pre-compile, set at pre-compile  # Specifies ingress queue handler function. Tags: atp.Status=draft
            integer EthCtrlConfigIngressQueueIdx: 0..255, post-build-variant-value=true, set at link in variant link-time / post-build in variant post-build / pre-compile in variant pre-compile, symbolic-name-value=true, with-auto=true  # Defines the queue index. Tags: atp.Status=draft
            boolean EthCtrlConfigIngressQueueOverwriteEnabled: set at pre-compile, default-value=false  # Defines the handling if all ingress queue elements are occupied and the Ethernet controller needs to enqueue a further Ethernet frame. Tags: atp.Status=draft | FALSE: Overwrite of the eldest available (i.e. not locked by a reception process) ingress queue element disabled. Enqueueing of further Ethernet frames is rejected. TRUE: Overwrite of the eldest available (i.e. not locked by an repetion process) ingress queue element enabled.
            boolean EthCtrlEnableIngressQueueInterrupt: set at pre-compile  # Enables / Disables receive interrupt of this specific queue. Tags: atp.Status=draft | Please note: This would enable an interrupt for this specific ingress queue upon reception of an Ethernet frame. Some ingress queue may be handled interrupt mode and some in polling mode. Therefore the global parameter EthCtrlEnableRxInterrupt, where all ingress queues are handled in interrupt mode, need to be set to FALSE.
            container EthCtrlConfigIngressQueueSortingType [0..1]: multiplicity set at pre-compile  # Defines one out of 4 possible sorting criteria for this ingress queue. Tags: atp.Status=draft
              integer EthCtrlIngressQueueSortingEtherTypeAssignment [0..1]: 0..65535, multiplicity set at pre-compile, set at pre-compile  # Defines that the EtherType shall be used to assign frames to this ingress queue. Tags: atp.Status=draft
              string EthCtrlIngressQueueSortingMacDestinationAssignment [0..1]: multiplicity set at pre-compile, set at pre-compile, max-length=17, min-length=17, regular-expression=([0-9a-fA-F]\{2}:)\{5}[0-9a-fA-F]\{2}  # Defines that the Destination MAC Address shall be used to assign frames to this ingress queue. Tags: atp.Status=draft
              integer EthCtrlIngressQueueSortingVlanIdAssignment [0..1]: 0..65535, multiplicity set at pre-compile, set at pre-compile  # Defines that the VLAN ID shall be used to assign frames to this ingress queue. Tags: atp.Status=draft
              integer EthCtrlIngressQueueSortingVlanPriorityAssignment [0..8]: 0..7, multiplicity set at pre-compile, set at pre-compile  # Defines that the VLAN priority shall be used to assign frames to this ingress queue. Tags: atp.Status=draft
          container EthCtrlConfigIngressQueueSortingPriority [0..1]: multiplicity set at pre-compile  # Defines the sorting priority of Ethernet frame attributes (priority, MacDstAddr, VlanId). Tags: atp.Status=draft | If an Ethernet frame is received and several ingress queues of the same EthCtrl have different EthCtrlConfigIngressQueueSortingTypes configured, then the Ethernet frames shall be sorted regarding the EthCtrlConfigIngressQueueSortingType set to the highest priority. If no matching queue was found, proceed in decending order with the next sorting EthCtrlConfigIngressQueueSortingType. If Ethernet frame could not be sorted in any ingress queue, then drop this Ethernet frame.
            integer SortingPriorityEtherTypeAssignment: 0..3, post-build-variant-value=true, set at link in variant link-time / post-build in variant post-build / pre-compile in variant pre-compile  # Defines the sorting priority for EtherType assignment. Tags: atp.Status=draft | 0 has the highest priority.
            integer SortingPriorityMacDestinationAssignment: 0..3, post-build-variant-value=true, set at link in variant link-time / post-build in variant post-build / pre-compile in variant pre-compile  # Defines the sorting priority for MAC destination assignment. Tags: atp.Status=draft | 0 has the highest priority.
            integer SortingPriorityVlanIdAssignment: 0..3, post-build-variant-value=true, set at link in variant link-time / post-build in variant post-build / pre-compile in variant pre-compile  # Defines the sorting priority for VLAN ID assignment. Tags: atp.Status=draft | 0 has the highest priority.
            integer SortingPriorityVlanPriorityAssignment: 0..3, post-build-variant-value=true, set at link in variant link-time / post-build in variant post-build / pre-compile in variant pre-compile  # Defines the sorting priority for VLAN priority assignment. Tags: atp.Status=draft | 0 has the highest priority.
        container EthCtrlConfigSpiConfiguration [0..*]  # SPI Interface configuration of one Ethernet controller (MACPHY use). Tags: atp.Status=draft | Configured only if EthCtrlEnableSpiInterface is set to TRUE.
          integer EthCtrlConfigSpiChunkPayloadSize: 8..64, post-build-variant-value=true, set at link in variant link-time / post-build in variant post-build / pre-compile in variant pre-compile, default-value=64  # Configures the size of the payload chunks which will be transferred over the SPI interface. Tags: atp.Status=draft | Note: The chunk is the basic element for data transaction over the SPI which can be a section of an Ethernet frame or management command. The configured value has to be a multiple of 8.
          integer EthCtrlConfigSpiCommRetries: 0..255, post-build-variant-value=true, set at link in variant link-time / post-build in variant post-build / pre-compile in variant pre-compile  # Indicates the maximum number of communication retries in case of a failed SPI communication (applies both to timed out communication and to errors/NACK in the response data). If configured value is '0', no retry is allowed (communication is expected to succeed at first try). Tags: atp.Status=draft
          float EthCtrlConfigSpiCommTimeout: 0..0.1, multiplicity set at link in variant link-time / post-build in variant post-build, post-build-variant-value=true, set at link in variant link-time / post-build in variant post-build / pre-compile in variant pre-compile  # Indicates the maximum time allowed to the Ethernet controller for replying (either positively or negatively) to a SPI command. Timeout is configured in seconds. Timeout value of '0' means that no specific timeout is to be used by Ethernet controller and the communication is executed at the best of the SPI HW capacity. Tags: atp.Status=draft
          boolean EthCtrlConfigSpiEnableControlDataProtection: set at pre-compile, default-value=false  # Enables the control data protection. Tags: atp.Status=draft | When set, all control data written to and read from the MACPHY will be transferred with its complement for detection of bit errors as defined in OA TC6 [26]. FALSE: Control data read/write protection is disabled (unprotected). TRUE: Control data read/write rotection is enabled (protected).
          boolean EthCtrlConfigSpiEnableRxCSAlign: post-build-variant-value=true, set at link in variant link-time / post-build in variant post-build / pre-compile in variant pre-compile, default-value=false  # Configures the CSn Align Receive frame. Tags: atp.Status=draft | TRUE: all received Ethernet frames data shall start at the beginning of the first receive data chunk payload following CSn assertion FALSE: received frames may begin within any receive data chunk of the transaction when this bit is clear.
          boolean EthCtrlConfigSpiEnableRxCutThrough [0..1]: multiplicity set at link in variant link-time / post-build in variant post-build / pre-compile in variant pre-compile, post-build-variant-multiplicity=true, post-build-variant-value=true, set at link in variant link-time / post-build in variant post-build / pre-compile in variant pre-compile, default-value=false  # When supported by the HW, enables the cut through mode of frame from the network to the SPI host. Tags: atp.Status=draft
          boolean EthCtrlConfigSpiEnableRxZeroAlign: post-build-variant-value=true, set at link in variant link-time / post-build in variant post-build / pre-compile in variant pre-compile, default-value=false  # Configures the zero-align receive frame. Tags: atp.Status=draft | TRUE: all received Ethernet frames data shall be aligned to start at the beginning of any receive data chunk payload. FALSE: Received frames may begin anywhere within the receive data chunk payload.
          boolean EthCtrlConfigSpiEnableTransmitDataHdrSequence [0..1]: multiplicity set at link in variant link-time / post-build in variant post-build / pre-compile in variant pre-compile, post-build-variant-multiplicity=true, post-build-variant-value=true, set at link in variant link-time / post-build in variant post-build / pre-compile in variant pre-compile, default-value=false  # When supported by the HW, enables the transmit data sequence monitoring. Tags: atp.Status=draft | FALSE: transmit data header sequence bit monitoring disabled. TRUE: transmit data header sequence bit monitoring enabled.
          boolean EthCtrlConfigSpiEnableTxChecksum [0..1]: multiplicity set at link in variant link-time / post-build in variant post-build / pre-compile in variant pre-compile, post-build-variant-multiplicity=true, post-build-variant-value=true, set at link in variant link-time / post-build in variant post-build / pre-compile in variant pre-compile, default-value=false  # When supported by the HW, enables the transmit frame check sequence validation. Tags: atp.Status=draft | * TRUE: the final 4 octets of all Ethernet frames received will be validated as an Ethernet FCS. * FALSE : validation deactivated. Note: additionnally the MAC must be configured to expect the SPI host to pad frames to the minimum frame size and append the FCS to the frame. The MAC should also be configured to pass the FCS to the SPI host with the received FCS for validation.
          boolean EthCtrlConfigSpiEnableTxCutThrough [0..1]: multiplicity set at pre-compile, set at pre-compile, default-value=false  # When supported by the HW, enables the cut through mode of frame from SPI host to the network. Tags: atp.Status=draft
          boolean EthCtrlConfigSpiSelectTimeStamp [0..1]: multiplicity set at link in variant link-time / post-build in variant post-build / pre-compile in variant pre-compile, post-build-variant-multiplicity=true, post-build-variant-value=true, set at link in variant link-time / post-build in variant post-build / pre-compile in variant pre-compile, default-value=false  # When timestamp supported by the HW, selects size and format of the timestamps. Tags: atp.Status=draft | FALSE: 32-bits timestamps TRUE: 64-bit timestamps
          integer EthCtrlConfigSpiTransmitCreditThreshold: 0..3, post-build-variant-value=true, set at link in variant link-time / post-build in variant post-build / pre-compile in variant pre-compile, default-value=0  # Configures the minimum of available transmit credit before the writing IRQn is asserted. Tags: atp.Status=draft | As per OA TC6, this information is notified by the TXC field. 0 = 1 credit 1 = 4 credits 2 = 8 credits 3 = 16 credits
          container EthCtrlConfigSpiSequence [0..*]  # Container gives Ethernet controller driver information about one SPI sequence. One SPI sequence used by Ethernet controller driver is in exclusive use for it. No other driver is allowed to access this sequence. Ethernet controller driver may use one sequence to access n Ethernet controller hardwares chips of the same type or n sequences are used to access one single Ethernet controller hardware chip. If a Ethernet controller hardware has no SPI interface, there is no instance of this container. Tags: atp.Status=draft
            boolean EthCtrlConfigSpiAccessSynchronous [0..1]: multiplicity set at link in variant link-time / post-build in variant post-build / pre-compile in variant pre-compile, post-build-variant-multiplicity=true, post-build-variant-value=true, set at link in variant link-time / post-build in variant post-build / pre-compile in variant pre-compile, default-value=false  # This parameter is used to define whether the access to the Spi sequence is synchronous or asynchronous. Tags: atp.Status=draft | true: SPI access is synchronous. false: SPI access is asynchronous.
            reference EthCtrlConfigSpiSequenceName [0..*]: multiplicity set at pre-compile, set at pre-compile, requires-symbolic-name-value=true, destination=SpiSequence  # Reference to a Spi sequence configuration container. Tags: atp.Status=draft
        container EthCtrlPulsePerSecondConfig [0..1]: multiplicity set at pre-compile  # This container contains the configuration of a HW Pulse per Second (PPS) feature. If not defined the PPS feature is not used. Tags: atp.Status=draft
          integer EthCtrlPulsePerSecondDutyCycle: 0..100, set at pre-compile  # Configuration how long each Pulse shall be defined in percent. Tags: atp.Status=draft
          integer EthCtrlPulsePerSecondFrequency: 0..100, set at pre-compile  # Configuration how many Pulse per Second pulses shall be created per second. Tags: atp.Status=draft
          enumeration EthCtrlPulsePerSecondStartEnum: set at pre-compile  # Defines whether the pulse starts with a rising or a falling edge. Tags: atp.Status=draft
            FALLING_EDGE  # Tags: atp.Status=draft
            RISING_EDGE  # Tags: atp.Status=draft
          reference EthCtrlPulsePerSecondClockRef [0..1]: multiplicity set at pre-compile, set at pre-compile, destination=EthCtrlClk  # Reference to a HW clock in the Ethernet controller, which is taken as the source for the PPS (Pulse Per Second). Tags: atp.Status=draft
        container EthDemEventParameterRefs [0..1]  # Container for the references to DemEventParameter elements which shall be invoked using the API Dem_SetEventStatus in case the corresponding error occurs. The EventId is taken from the referenced DemEventParameter's DemEventId symbolic value. The standardized errors are provided in this container and can be extended by vendor-specific error references.
          reference ETH_E_ACCESS [0..1]: multiplicity set at link in variant link-time / post-build in variant post-build / pre-compile in variant pre-compile, post-build-variant-multiplicity=true, post-build-variant-value=true, set at link in variant link-time / post-build in variant post-build / pre-compile in variant pre-compile, requires-symbolic-name-value=true, destination=DemEventParameter  # Reference to the DemEventParameter which shall be issued when the error "Controller access failed" has occured.
          reference ETH_E_ALIGNMENT [0..1]: multiplicity set at link in variant link-time / post-build in variant post-build / pre-compile in variant pre-compile, post-build-variant-multiplicity=true, post-build-variant-value=true, set at link in variant link-time / post-build in variant post-build / pre-compile in variant pre-compile, requires-symbolic-name-value=true, destination=DemEventParameter  # Reference to the DemEventParameter which shall be issued when the error "Alignment Error" has occured.
          reference ETH_E_CRC [0..1]: multiplicity set at link in variant link-time / post-build in variant post-build / pre-compile in variant pre-compile, post-build-variant-multiplicity=true, post-build-variant-value=true, set at link in variant link-time / post-build in variant post-build / pre-compile in variant pre-compile, requires-symbolic-name-value=true, destination=DemEventParameter  # Reference to the DemEventParameter which shall be issued when the error "CRC Failure" has occured.
          reference ETH_E_LATECOLLISION [0..1]: multiplicity set at link in variant link-time / post-build in variant post-build / pre-compile in variant pre-compile, post-build-variant-multiplicity=true, post-build-variant-value=true, set at link in variant link-time / post-build in variant post-build / pre-compile in variant pre-compile, requires-symbolic-name-value=true, destination=DemEventParameter  # Reference to the DemEventParameter which shall be issued when the error "Late Collisions" has occured.
          reference ETH_E_MULTIPLECOLLISION [0..1]: multiplicity set at link in variant link-time / post-build in variant post-build / pre-compile in variant pre-compile, post-build-variant-multiplicity=true, post-build-variant-value=true, set at link in variant link-time / post-build in variant post-build / pre-compile in variant pre-compile, requires-symbolic-name-value=true, destination=DemEventParameter  # Reference to the DemEventParameter which shall be issued when the error "Multiple Collisions" has occured.
          reference ETH_E_OVERSIZEFRAME [0..1]: multiplicity set at link in variant link-time / post-build in variant post-build / pre-compile in variant pre-compile, post-build-variant-multiplicity=true, post-build-variant-value=true, set at link in variant link-time / post-build in variant post-build / pre-compile in variant pre-compile, requires-symbolic-name-value=true, destination=DemEventParameter  # Reference to the DemEventParameter which shall be issued when the error "Oversized Frame" has occured.
          reference ETH_E_RX_FRAMES_LOST [0..1]: multiplicity set at link in variant link-time / post-build in variant post-build / pre-compile in variant pre-compile, post-build-variant-multiplicity=true, post-build-variant-value=true, set at link in variant link-time / post-build in variant post-build / pre-compile in variant pre-compile, requires-symbolic-name-value=true, destination=DemEventParameter  # Reference to the DemEventParameter which shall be issued when the error "receive frames lost" has occured.
          reference ETH_E_SINGLECOLLISION [0..1]: multiplicity set at link in variant link-time / post-build in variant post-build / pre-compile in variant pre-compile, post-build-variant-multiplicity=true, post-build-variant-value=true, set at link in variant link-time / post-build in variant post-build / pre-compile in variant pre-compile, requires-symbolic-name-value=true, destination=DemEventParameter  # Reference to the DemEventParameter which shall be issued when the error "Single Collisions" has occured.
          reference ETH_E_UNDERSIZEFRAME [0..1]: multiplicity set at link in variant link-time / post-build in variant post-build / pre-compile in variant pre-compile, post-build-variant-multiplicity=true, post-build-variant-value=true, set at link in variant link-time / post-build in variant post-build / pre-compile in variant pre-compile, requires-symbolic-name-value=true, destination=DemEventParameter  # Reference to the DemEventParameter which shall be issued when the error "Undersized Frame" has occured.
    container EthGeneral  # General configuration of Ethernet Driver module
      boolean EthDevErrorDetect: set at pre-compile, default-value=false  # Switches the development error detection and notification on or off. | * true: detection and notification is enabled. * false: detection and notification is disabled.
      boolean EthGetCounterValuesApi: set at pre-compile  # Enables / Disables Eth_GetCounterValues API.
      boolean EthGetRxStatsApi: set at pre-compile, default-value=false  # Enables/Disables Eth_GetRxStats API.
      boolean EthGetTxErrorCounterValuesApi: set at pre-compile, default-value=false  # Enables/Disables Eth_GetTxErrorCounterValues API.
      boolean EthGetTxStatsApi: set at pre-compile, default-value=false  # Enables/Disables Eth_GetTxStats API.
      boolean EthGlobalTimeSupport: set at pre-compile  # Enables/Disables the GlobalTime APIs used amongst others by Global Time Synchronization over Ethernet.
      integer EthIndex: 0..255, set at pre-compile  # Specifies the InstanceId of this module instance. If only one instance is present it shall have the Id 0.
      float EthMainFunctionPeriod: 0..INF, set at pre-compile  # Specifies the period of main function Eth_MainFunction in seconds. Ethernet driver does not require this information but the BSW scheduler.
      boolean EthPhcSupport: set at pre-compile  # Enables/Disables the PTP HW Clock (PHC). Tags: atp.Status=draft
      boolean EthVersionInfoApi: set at pre-compile, default-value=false  # Enables / Disables version info API
      reference EthEcucPartitionRef [0..*]: scope=ECU, multiplicity set at pre-compile, post-build-variant-multiplicity=true, post-build-variant-value=true, set at pre-compile, destination=EcucPartition  # Maps the Ethernet driver to zero or multiple ECUC partitions to make the modules API available in this partition.
      container EthCtrlOffloading  # Configuration of hardware offloading features.
        boolean EthCtrlEnableOffloadChecksumICMP: set at pre-compile  # Enables / Disables hardware offloading for ICMP checksums.
        boolean EthCtrlEnableOffloadChecksumIPv4: set at pre-compile  # Enables / Disables hardware offloading for IPv4 checksums.
        boolean EthCtrlEnableOffloadChecksumTCP: set at pre-compile  # Enables / Disables hardware offloading for TCP checksums.
        boolean EthCtrlEnableOffloadChecksumUDP: set at pre-compile  # Enables / Disables hardware offloading for UDP checksums.
  module definition EthIf [0..1]: post-build-variant-support=true, variants link-time/post-build/pre-compile  # Configuration of the EthIf (Ethernet Interface) module.
    container EthIfConfigSet  # Collecting container for all parameters with post-build configuration classes.
      container EthIfController [1..*]  # This container contains the configuration of EthIfController.
        integer EthIfCtrlIdx: 0..255, scope=ECU, set at pre-compile, symbolic-name-value=true, with-auto=true  # This parameter provides a zero-based consecutive index of the Ethernet Communication Controllers. Upper layer BSW modules and the EthIf itself use this index to identify a Ethernet CC.
        integer EthIfCtrlMtu: 64..9000, scope=ECU, post-build-variant-value=true, set at link in variant link-time / post-build in variant post-build / pre-compile in variant pre-compile  # Specifies the maximum transmission unit (MTU) of the EthIfCtrl in [bytes]. | Note: In case a VLAN tag is used for the EthIfCtrl, the frame length of the Ethernet frame will increase by 4 bytes.
        enumeration EthIfMacSecSupport [0..1]: multiplicity set at link in variant link-time / post-build in variant post-build / pre-compile in variant pre-compile, post-build-variant-multiplicity=true, post-build-variant-value=true, set at link in variant link-time / post-build in variant post-build / pre-compile in variant pre-compile, default-value=NO_MACSEC  # MACsec support of the ethernet interface controller. Tags: atp.Status=draft
          HW_MACSEC  # Tags: atp.Status=draft
          NO_MACSEC  # Tags: atp.Status=draft
          SW_MACSEC  # Tags: atp.Status=draft
        integer EthIfMaxTxBufsTotal: 1..4294967295, set at pre-compile  # Limits the total number of transmit buffers.
        integer EthIfVlanId [0..1]: 0..4095, scope=ECU, multiplicity set at link in variant link-time / post-build in variant post-build / pre-compile in variant pre-compile, post-build-variant-multiplicity=true, post-build-variant-value=true, set at link in variant link-time / post-build in variant post-build / pre-compile in variant pre-compile  # A virtual-LAN is identified by this attribute according to IEEE 802.1Q.
        reference EthIfEthTrcvRef [0..1]: scope=ECU, multiplicity set at link in variant link-time / post-build in variant post-build / pre-compile in variant pre-compile, post-build-variant-multiplicity=true, post-build-variant-value=true, set at link in variant link-time / post-build in variant post-build / pre-compile in variant pre-compile, requires-symbolic-name-value=true, destination=EthIfTransceiver  # Reference to an Ethernet transceiver, which is handled by the Ethernet Interface.
        reference EthIfPaeInstanceRef [0..254]: multiplicity set at link in variant link-time / post-build in variant post-build / pre-compile in variant pre-compile, post-build-variant-multiplicity=true, post-build-variant-value=true, set at link in variant link-time / post-build in variant post-build / pre-compile in variant pre-compile, requires-symbolic-name-value=true, destination=MkaPaeInstance  # Reference to MkaPaeInstance Tags: atp.Status=draft
        reference EthIfPhysControllerRef: scope=ECU, post-build-variant-value=true, set at link in variant link-time / post-build in variant post-build / pre-compile in variant pre-compile, requires-symbolic-name-value=true, destination=EthIfPhysController  # Reference to a physical Ethernet controller, which is handled by the Ethernet Interface.
        choice reference EthIfSwitchRefOrPortGroupRef [0..1]: multiplicity set at link in variant link-time / post-build in variant post-build / pre-compile in variant pre-compile, post-build-variant-multiplicity=true, post-build-variant-value=true, set at link in variant link-time / post-build in variant post-build / pre-compile in variant pre-compile, destination=[EthIfSwitch, EthIfSwitchPortGroup]  # The choice reference allows to configure that the EthIfController either references an EthIfSwitch or an EthIfSwitchPortGroup. | In case EhIfSwitchPortGroups are controlled by the BswM (e,g, according particular PNC requests), then EthIfSwitchPortGroupRefSemantics shall have the value ETHIF_SWITCH_PORT_GROUP_LINK_INFO. In case EhIfSwitchPortGroups are controlled by the EhtIfController, then EthIfSwitchPortGroupRefSemantics shall have the value ETHIF_SWITCH_PORT_GROUP_CONTROL.
      container EthIfFrameConfig [1..*]: multiplicity set at pre-compile  # Configuration of an Ethernet frame. Tags: atp.Status=draft
        integer EthIfFrameType: 0..65535, post-build-variant-value=true, set at link in variant link-time / post-build in variant post-build / pre-compile in variant pre-compile  # Selects the Ethernet frame type. Tags: atp.Status=draft
        container EthIfFrameRxPool [0..*]: multiplicity set at pre-compile  # Pool of Rx PDUs for the upper layer modules. Tags: atp.Status=draft | Several container instances can be defined for different EthIfControllers.
          reference EthIfFrameRxControllerRef [0..1]: multiplicity set at pre-compile, post-build-variant-value=true, set at link in variant link-time / post-build in variant post-build / pre-compile in variant pre-compile, destination=EthIfController  # Optional reference to an EthIfController. If this reference is defined then only messages to/from that EthIfController are assigned to the Pdu. Tags: atp.Status=draft | With this setup it is possible to define VLAN specific PDUs for dedicated EtherTypes.
          container EthIfFrameRxPdu [0..*]: multiplicity set at pre-compile  # PDU in the EthIfFrameRxPool to be used for the transport of a the corresponding Ethernet frame. Tags: atp.Status=draft | Supported MetaDataItemTypes: * TIMETUPLE_TYPE_PTR * ETHERNET_MAC_64 * BROADCAST_8
            integer EthIfFrameRxPduId: 0..65535, scope=ECU, post-build-variant-value=true, set at link in variant link-time / post-build in variant post-build / pre-compile in variant pre-compile, symbolic-name-value=true, with-auto=true  # PDU ID used by the upper layer module to indicated completed asynchronous reception of the corresponding Ethernet frame. Tags: atp.Status=draft
            reference EthIfFrameRxPduRef: scope=ECU, post-build-variant-value=true, set at link in variant link-time / post-build in variant post-build / pre-compile in variant pre-compile, destination=Pdu  # Reference to the global PDU representing the Ethernet frame to the upper layer module. Tags: atp.Status=draft
        container EthIfFrameTxPool [0..*]: multiplicity set at pre-compile  # Pool of Tx PDUs for the upper layer modules. Tags: atp.Status=draft | Several container instances can be defined for different EthIfControllers or with different EthIfFrameTxPriority.
          integer EthIfFrameTxPriority [0..1]: 0..7, multiplicity set at pre-compile, set at pre-compile  # Definition of a fixed VLAN priority of the pool. Tags: atp.Status=draft | This priority shall only be configured if the EthIfController referenced by this EthIfFrameTxPool has a EthIfVlanId. If this parameter is configured, the TxPdus of this pool shall not use MetaDataItems of type PRIORITY_8.
          reference EthIfFrameTxControllerRef [0..1]: multiplicity set at pre-compile, post-build-variant-value=true, set at link in variant link-time / post-build in variant post-build / pre-compile in variant pre-compile, destination=EthIfController  # Optional reference to an EthIfController. If this reference is defined then only messages to/from that EthIfController are assigned to the Pdu. Tags: atp.Status=draft | With this setup it is possible to define VLAN specific PDUs for dedicated EtherTypes.
          container EthIfFrameTxPdu [0..*]: multiplicity set at pre-compile  # PDU in the EthIfFrameTxPool to be used for the transport of the corresponding Ethernet frame. Tags: atp.Status=draft | Supported MetaDataItemTypes: * ETHERNET_MAC_64 * TIMETUPLE_TYPE_PTR * LISTELEM_PTR * PRIORITY_8
            integer EthIfFrameTxPduId: 0..65535, scope=ECU, post-build-variant-value=true, set at link in variant link-time / post-build in variant post-build / pre-compile in variant pre-compile, symbolic-name-value=true, with-auto=true  # PDU ID used by the upper layer module to transmit the corresponding Ethernet frame. Tags: atp.Status=draft
            reference EthIfFrameTxPduRef: scope=ECU, post-build-variant-value=true, set at link in variant link-time / post-build in variant post-build / pre-compile in variant pre-compile, destination=Pdu  # Reference to the global PDU representing the Ethernet frame to the upper layer module. Tags: atp.Status=draft
      container EthIfPhysController [1..*]  # This container contains the configuration of EthIfPhysController. | The usage of EthIfEthCtrlRef, EthIfCanXLCtrlRef, and EthIfWEthCtrlRef and EthIfCV2xCtrlRef is exclusive OR.
        integer EthIfPhysControllerIdx: 0..255, scope=ECU, set at pre-compile, symbolic-name-value=true, with-auto=true  # This parameter provides a zero-based consecutive index of the physical Ethernet controllers. Upper layer BSW modules and the Ethernet Interface itself use this index to identify a physical Ethernet controller.
        reference EthIfCanXLCtrlRef [0..1]: scope=ECU, multiplicity set at pre-compile, set at pre-compile, requires-symbolic-name-value=true, destination=CanController  # Reference to a physical CAN XL controller which is handled by a specific CAN XL driver.
        reference EthIfCV2xCtrlRef [0..1]: scope=ECU, multiplicity set at link in variant link-time / post-build in variant post-build / pre-compile in variant pre-compile, post-build-variant-multiplicity=true, post-build-variant-value=true, set at link in variant link-time / post-build in variant post-build / pre-compile in variant pre-compile, requires-symbolic-name-value=true, destination=CV2xCtrlConfig  # Reference to physical Cellular V2X controller, which is handled by a specific Cellular V2X controller driver Tags: atp.Status=draft
        reference EthIfEthCtrlRef [0..1]: scope=ECU, post-build-variant-value=true, set at link in variant link-time / post-build in variant post-build / pre-compile in variant pre-compile, requires-symbolic-name-value=true, destination=EthCtrlConfig  # Reference to a physical Ethernet controller, which is handled by a specific Ethernet controller driver.
        reference EthIfWEthCtrlRef [0..1]: scope=ECU, post-build-variant-value=true, set at link in variant link-time / post-build in variant post-build / pre-compile in variant pre-compile, requires-symbolic-name-value=true, destination=WEthCtrlConfig  # Reference to a physical Wireless Ethernet controller, which is handled by a specific Wireless Ethernet controller driver.
        container EthIfClkUnit [0..*]: multiplicity set at pre-compile  # This container contains the configuration of a HW clock unit in an Ethernet Controller. Tags: atp.Status=draft
          integer EthIfClkUnitIdx: 0..255, scope=ECU, set at pre-compile, symbolic-name-value=true  # Zero-based consecutive index of the HW clock units in the Ethernet Controller. Upper layer BSW modules and the Eth itself use this index to identify a clock in the Ethernet Controller. Tags: atp.Status=draft
          reference EthIfClkUnitRef: scope=ECU, set at pre-compile, requires-symbolic-name-value=true, destination=EthClkUnit  # Reference to a HW clock unit which is provided by the Ethernet controller for ingress/egrees timestamping of frames and optionally to follow PTP time. Tags: atp.Status=draft
        container EthIfPhysCtrlRxMainFunctionIngressQueueProcessing [0..*]: multiplicity set at pre-compile  # The function checks for new received Ethernet frames at the related Ethernet controller and the related ingress queue referenced via EthIfPhysCtrlRxIngressQueueRef, or at the related CanXL controller and the related ingress FIFO referenced via EthIfCanXLCtrlRxIngressFifoRef. Tags: atp.Status=draft | In case of Ethernet controller calling Eth_Receive() with the respective QueueIdx. In case of CanXL controller calling CanXL_Receive() with the respective FifoIdx.
          integer EthIfPhysCtrlRxIndicationIterations: 0..18446744073709551615, set at pre-compile  # Max number of Ethernet frames polled per main function invocation.
          float EthIfPhysCtrlRxMainFunctionPeriod: set at pre-compile  # Specifies the period of main function in seconds.
          reference EthIfCanXLCtrlRxIngressFifoRef [0..1]: multiplicity set at pre-compile, set at pre-compile, requires-symbolic-name-value=true, destination=CanXLEthIngressFifo  # Reference to the reception FIFO.
          reference EthIfPhysCtrlRxIngressFifoRef [0..1]: multiplicity set at pre-compile, set at pre-compile, requires-symbolic-name-value=true, destination=EthCtrlConfigIngressFifo  # Reference to the reception FIFO. Tags: atp.Status=obsolete
          reference EthIfPhysCtrlRxIngressQueueRef [0..1]: multiplicity set at pre-compile, set at pre-compile, requires-symbolic-name-value=true, destination=EthCtrlConfigIngressQueue  # Reference to the ingress Queue. Tags: atp.Status=draft
      container EthIfRxIndicationConfig [1..*]  # Configuration of receive callback functions.
        function name EthIfRxIndicationFunction: post-build-variant-value=true, set at link in variant link-time / post-build in variant post-build / pre-compile in variant pre-compile  # Specifies receive indication callback function.
      container EthIfSwitch [0..*]  # This container contains the configuration of EthIfSwitches.
        integer EthIfSwitchIdx: 0..255, scope=ECU, set at pre-compile, symbolic-name-value=true, with-auto=true  # This parameter provides a zero-based consecutive index of the Ethernet Interface Switches. Upper layer BSW modules and the EthIf itself use this index to identify a Ethernet Switch.
        reference EthIfSwitchRef: scope=ECU, post-build-variant-value=true, set at link in variant link-time / post-build in variant post-build / pre-compile in variant pre-compile, requires-symbolic-name-value=true, destination=EthSwtConfig  # Reference to a Ethernet Switch, which is handled by a specific Ethernet Switch driver.
      container EthIfSwitchPortGroup [0..*]  # This container contains the configuration of EthIfSwitchPortGroups. | If EthIfSwitchPortGroups are controlled by PNC one EthIfSwitchPortGroup per PNC shall exist. The host port shall be part of all EthIfSwitchPortGroups. The up link port of a master switch and the up link port of the slave switch shall be part of all EthIfSwitchPortGroups that contain EthSwtPorts belonging to the slave switch.
        integer EthIfSwitchPortGroupIdx: 0..255, scope=ECU, set at pre-compile, symbolic-name-value=true, with-auto=true  # This parameter provides a zero-based consecutive index of the Ethernet Switch Port Groups. Upper layer BSW modules and the EthIf itself use this index to identify an Ethernet Switch Port Group.
        enumeration EthIfSwitchPortGroupRefSemantics [0..1]: {ETHIF_SWITCH_PORT_GROUP_CONTROL, ETHIF_SWITCH_PORT_GROUP_LINK_INFO}, post-build-variant-value=true, set at link in variant link-time / post-build in variant post-build / pre-compile in variant pre-compile  # Defines how the EthIfSwitchRefOrPortGroupRef refering to a EthIfSwitchPortGroup shall be interpreted.
        reference EthIfPortRef [1..*]: post-build-variant-value=true, set at link in variant link-time / post-build in variant post-build / pre-compile in variant pre-compile, requires-symbolic-name-value=true, destination=EthSwtPort  # Reference to an Ethernet Switch Port.
      container EthIfTransceiver [0..*]  # This container contains the configuration of EthIfTransceiver. | The usage of EthIfEthTrcvRef, EthIfCanXLTrcvRef, and EthIfWEthTrcvRef is exclusive OR.
        float EthIfQualifiedUnexpectedLinkDownTime [0..1]: 0..INF, scope=ECU, set at link in variant link-time / post-build in variant post-build / pre-compile in variant pre-compile  # Specifies the time in seconds an unexpected link down is qualified. This parameter is only used for those Ethernet channels where the ECU act as a passive communication slave (referenced EthTrcv set EthTrcvActAsSlavePassiveEnabled = TRUE). | The value shall be a multiple integral of EthIf_MainFunctionState.
        integer EthIfTransceiverIdx: 0..255, scope=ECU, set at pre-compile, symbolic-name-value=true, with-auto=true  # This parameter provides a zero-based consecutive index of the Ethernet transceivers. Upper layer BSW modules and the Ethernet Interface itself use this index to identify an Ethernet tranceiver.
        reference EthIfCanXLTrcvRef [0..1]: scope=ECU, multiplicity set at pre-compile, set at pre-compile, requires-symbolic-name-value=true, destination=CanTrcvChannel  # Reference to a CAN XL transceiver, which is handled by a specific CAN XL transceiver driver.
        reference EthIfEthTrcvRef [0..1]: scope=ECU, post-build-variant-value=true, set at link in variant link-time / post-build in variant post-build / pre-compile in variant pre-compile, requires-symbolic-name-value=true, destination=EthTrcvConfig  # Reference to an Ethernet transceiver, which is handled by a specific Ethernet transceiver driver.
        reference EthIfWEthTrcvRef [0..1]: scope=ECU, post-build-variant-value=true, set at link in variant link-time / post-build in variant post-build / pre-compile in variant pre-compile, requires-symbolic-name-value=true, destination=WEthTrcvConfig  # Reference to an Wireless Ethernet transceiver, which is handled by a specific Wireless Ethernet transceiver driver.
      container EthIfTrcvLinkStateChgConfig [1..*]  # Specifies link state change callback function
        function name EthIfTrcvLinkStateChgFunction: post-build-variant-value=true, set at link in variant link-time / post-build in variant post-build / pre-compile in variant pre-compile  # Specifies link state change callback function
      container EthIfTxConfirmationConfig [0..*]  # Configuration of transmit indication callback functions.
        function name EthIfTxConfirmationFunction: post-build-variant-value=true, set at link in variant link-time / post-build in variant post-build / pre-compile in variant pre-compile  # Specifies transmit indication callback function
    container EthIfGeneral  # This container contains the general configuration parameters of the Ethernet Interface.
      boolean EthIfDevErrorDetect: set at pre-compile, default-value=false  # Switches the development error detection and notification on or off. | * true: detection and notification is enabled. * false: detection and notification is disabled.
      boolean EthIfEnableCV2xApi [0..1]: multiplicity set at pre-compile, set at pre-compile, default-value=false  # Enables / Disables API's for CV2x Tags: atp.Status=draft
      boolean EthIfEnableRxInterrupt: set at pre-compile  # Enables / Disables receive interrupt.
      boolean EthIfEnableSecurityEventReporting: scope=ECU, set at pre-compile, default-value=false  # Switches the reporting of security events to the IdsM: Tags: atp.Status=draft | - true: reporting is enabled. - false: reporting is disabled.
      boolean EthIfEnableSignalQualityApi: set at pre-compile  # Enable/disable the APIs read and clear the signal quality.
      boolean EthIfEnableTxInterrupt: set at pre-compile  # Enables / Disables the transmit interrupt.
      boolean EthIfEnableWEthApi [0..1]: multiplicity set at pre-compile, set at pre-compile, default-value=false  # Enables / Disables API's for WEth / WEthTrcv
      enumeration EthIfFwSupport: scope=ECU, set at pre-compile  # Enables / Disables the Firewall usage. Tags: atp.Status=draft
        FIREWALL_WITHOUT_PERSTREAMFILTERING  # Tags: atp.Status=draft
        FIREWALL_WITH_PERSTREAMFILTERING  # Tags: atp.Status=draft
        NO_FIREWALL  # Tags: atp.Status=draft
      boolean EthIfGetAndResetMeasurementDataApi: set at pre-compile, default-value=false  # Enables / Disables the Get and Reset Measurement Data API
      boolean EthIfGetBaudRate: set at pre-compile  # Enables / Disables GetBaudRate API.
      boolean EthIfGetCounterState: set at pre-compile  # Enables / Disables GetCounterState API.
      boolean EthIfGetCtrlIdxList: set at pre-compile, default-value=false  # Enables / Disables GetCtrlIdxList API.
      boolean EthIfGetPortMacAddrVlanApi [0..1]: multiplicity set at pre-compile, set at pre-compile  # Enables / Disables the GetPortMacAddrVlan API.
      boolean EthIfGetVlanIdSupport: set at pre-compile, default-value=false  # Enables / Disables GetVlanId API.
      boolean EthIfGlobalTimeSupport: set at pre-compile  # Enables/Disables the Global Time APIs used amongst others by Global Time Synchronization over Ethernet.
      float EthIfMainFunctionPeriod: 0..INF, set at pre-compile  # Specifies the period of main function EthIf_MainFunctionRx and EthIf_MainFunctionTx in seconds. Ethernet Interface does not require this information but the BSW scheduler.
      float EthIfMainFunctionStatePeriod [0..1]: 0..INF, multiplicity set at pre-compile, set at pre-compile  # Specifies the period of main function EthIf_MainFunctionState in seconds. Ethernet Interface does not require this information but the BSW scheduler.
      integer EthIfMaxTrcvsTotal: 1..255, set at pre-compile  # Limits the total number of transceivers.
      boolean EthIfPhcSupport: set at pre-compile  # Enables/Disables the PTP HW Clock (PHC). Tags: atp.Status=draft
      float EthIfPortStartupActiveTime [0..1]: 0.001..65.535, multiplicity set at link in variant link-time / post-build in variant post-build / pre-compile in variant pre-compile, post-build-variant-multiplicity=true, post-build-variant-value=true, set at link in variant link-time+post-build / pre-compile in variant pre-compile  # Denote the time delay after the mode "ETH_MODE_ACTIVE" of all EthIfSwitchPorts are requested via EthIf_StartAllPorts. | This is only used for ports in EthIfSwtPortGroups which are not referenced by any EthIfController.
      string EthIfPublicCddHeaderFile [0..*]: scope=ECU, multiplicity set at pre-compile, set at pre-compile, max-length=32, min-length=1  # Defines header files for callback functions which shall be included in case of CDDs. Range of characters is 1.. 32.
      integer EthIfRxIndicationIterations [0..1]: 0..65535, set at pre-compile  # Maximum number of Ethernet frames per Ethernet controller polled from the Ethernet driver within EthIf_MainFunctionRx.
      boolean EthIfSetForwardingModeApi: set at pre-compile, default-value=false  # Enables /disables EthIf_SetForwardingMode API.
      float EthIfSignalQualityCheckPeriod [0..1]: set at pre-compile  # Specifies the period in units of seconds in which the signal quality it polled in the context of EthIf_MainfunctionState. The value shall be an integral multiple of EthIfMainFunctionStatePeriod.
      boolean EthIfStartAutoNegotiation: set at pre-compile  # Enables / Disables StartAutoNegotiation API.
      boolean EthIfSwitchManagementSupport: set at pre-compile  # Enables/Disables the Switch management APIs to support a Switch-port specific communication attribute access.
      float EthIfSwitchOffPortTimeDelay [0..1]: 0.001..65.535, multiplicity set at link in variant link-time / post-build in variant post-build / pre-compile in variant pre-compile, post-build-variant-multiplicity=true, post-build-variant-value=true, set at link in variant link-time+post-build / pre-compile in variant pre-compile  # Denote the time delay after the mode "ETH_MODE_DOWN" of a EthIfSwitchPortGroup will be executed. | This is only used for EthIfSwtPortGroups which are not referenced by any EthIfController. The time delay shall be greater than the UdpNm timings, because UdpNm shall finish its shutdown handling. (Repeat Message State, Prepare Bus-Sleep state, Bus-Sleep state).
      integer EthIfTrcvLinkStateChgMainReload: 1..255, set at pre-compile  # Specifies the frequency of transceiver link state change checks in each | period of main function EthIf_MainFunctionTx.
      boolean EthIfVerifyConfigApi: set at pre-compile, default-value=false  # Enables /disables EthIf_VerifyConfig API.
      boolean EthIfVersionInfoApi: set at pre-compile, default-value=false  # Enables / Disables version info API
      boolean EthIfVersionInfoApiMacro: set at pre-compile, default-value=false  # Enables / Disables version info API macro implementation.
      boolean EthIfWakeUpSupport: set at pre-compile, default-value=false  # Configures if wake-up handling is supported or not: | TRUE: wake-up handling is supported FALSE: wake-up handling is not supported This configuration parameter also enables particular other the API at Pre-Compile-Time, e.g. EthIf_CheckWakeup.
      container EthIfSecurityEventRefs [0..1]: multiplicity set at pre-compile  # Container for the references to IdsMEvent elements representing the security events that the EthIf module shall report to the IdsM in case the coresponding security related event occurs (and if EthIfEnableSecurityEventReporting is set to "true"). The standardized security events in this container can be extended by vendor-specific security events. Tags: atp.Status=draft
        reference SEV_ETH_DROP_INV_VLAN [0..1]: multiplicity set at pre-compile, set at pre-compile, requires-symbolic-name-value=true, destination=IdsMEvent  # An Ethernet datagram was dropped due to an invalid CrtlIdx/VLAN. Tags: atp.Status=draft
        reference SEV_ETH_DROP_MAC_COLLISION [0..1]: multiplicity set at pre-compile, set at pre-compile, requires-symbolic-name-value=true, destination=IdsMEvent  # An Ethernet datagram was dropped because local MAC was same as source MAC in an incoming frame. Tags: atp.Status=draft
        reference SEV_ETH_DROP_UNKNOWN_ETHERTYPE [0..1]: multiplicity set at pre-compile, set at pre-compile, requires-symbolic-name-value=true, destination=IdsMEvent  # An Ethernet datagram was dropped due to an unknown Ethertype. Tags: atp.Status=draft
        reference SEV_ETH_DROP_VLAN_DOUBLE_TAG [0..1]: multiplicity set at pre-compile, set at pre-compile, requires-symbolic-name-value=true, destination=IdsMEvent  # An Ethernet datagram was dropped due to double VLAN tag. Tags: atp.Status=draft
  module definition EthSM [0..1]: variants pre-compile  # Configuration of the Ethernet State Manager
    container EthSMGeneral  # This container contains the global parameter of the Ethernet State Manager.
      boolean EthSMDataLinkInfoApi: set at pre-compile, default-value=false  # Enables and disables the API: ISO15118Chrg_DataLinkIndication Tags: atp.Status=draft
      boolean EthSMDevErrorDetect: set at pre-compile, default-value=false  # Switches the development error detection and notification on or off. | * true: detection and notification is enabled. * false: detection and notification is disabled.
      boolean EthSMDummyMode: set at pre-compile  # Disables the API to the EthIf. The API to the ComM is available but the functionality is deactivated. The function calls from the ComM will be answered with the return value E_OK.
      float EthSMMainFunctionPeriod: 0..INF, set at pre-compile  # Specifies the period in seconds that the MainFunction has to be triggered with.
      boolean EthSMVersionInfoApi: set at pre-compile, default-value=false  # Enables and disables the version info API.
    container EthSMNetwork [1..*]  # This container contains the Ethernet network-specific parameters of each Ethernet network. It also contains the reference to combination of controller and transceiver assigned to an Ethernet network.
      boolean EthSMForwardSilentCommunicationEnabled: set at pre-compile, default-value=false  # Specifies if a request COMM_SILENT_COMMUNICATION shall be forwarded to the corresponding EthIfController. | If the parameter is set to TRUE and EthSM in called with COMM_SILENT_COMMUNICATION, then EthSM call the corresponding EthIfController with ETH_MODE_ACTIVE_TX_OFFLINE to reject any transmission request. Therefore, only reception handling of Ethernet frames is performed. If the parameter is set to FALSE and EthSM in called with COMM_SILENT_COMMUNICATION, then EthSM will NOT forward the call to EthIf. Therefore, transmission AND reception handling of Ethernet frames is performed.
      boolean EthSMTcpIpUsed: set at pre-compile, default-value=true  # Specifies if the interaction with a TcpIp module is enabled or disabled for the EthSMNetwork
      boolean EthSMWakeupSleepOnDatalineEnabled: set at pre-compile, default-value=false  # Specifies if an active communication request shall be forwarded to the lower layer to trigger a wake-up on the Ethernet network, e.g. trigger a wake-up on dataline if OA TC10 compliant Ethernet hardware is used. | If the parameter is set to TRUE and EthSM in called with COMM_FULL_COMMUNICATION_WITH_WAKEUP_REQUEST, then EthSM call the corresponding EthIfController everytime with ETH_MODE_ACTIVE_WITH_WAKEUP_REQUEST to trigger an wake-up request in the lower layer.
      reference EthSMComMNetworkHandleRef: set at pre-compile, requires-symbolic-name-value=true, destination=ComMChannel  # Unique handle to identify one certain Ethernet network. Reference to one of the network handles configured for the ComM.
      reference EthSMEthIfControllerRef: set at pre-compile, requires-symbolic-name-value=true, destination=EthIfController  # Reference to EthIfCtrl container where a ETH controller and | transceiver (optional) combination is configured.
      container EthSMDemEventParameterRefs [0..1]  # Container for the references to DemEventParameter elements which shall be invoked using the API Dem_SetEventStatus in case the corresponding error occurs. The EventId is taken from the referenced DemEventParameter's DemEventId symbolic value. The standardized errors are provided in this container and can be extended by vendor-specific error references.
        reference ETHSM_E_LINK_DOWN [0..1]: multiplicity set at pre-compile, set at pre-compile, requires-symbolic-name-value=true, destination=DemEventParameter  # Reference to configured DEM event to report bus off errors for this Eth network.
