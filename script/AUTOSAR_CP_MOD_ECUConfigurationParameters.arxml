[part 13 of 14: package /AUTOSAR/EcucDefs]
AUTOSAR XML (schema 00053)
package /AUTOSAR/EcucDefs  (continued)
  module definition SwCluC [0..1]: post-build-variant-support=true, variants post-build/pre-compile  # Module to collect Software Cluster Connection specific configuration information.
    container SwCluCBManif [0..1]  # Configuration of the Binary Manifest of the Software Cluster Connection
      integer SwCluCBManifImmutableTablesChecksum: 0..4294967295, scope=ECU, multiplicity set at pre-compile, set at pre-compile  # This parameter defines the initialization value of the Immutable Tables Checksum. | If the Binary Manifest code generator already calculates the checksum, the value can be stored here (withAuto == true).
      integer SwCluCBManifSubscribedInterfaceValidityMarker: 0..4294967295, scope=ECU, multiplicity set at pre-compile, set at pre-compile  # This parameter defines the initialization value of the Subscribed Interface Validity Marker. The init value should be set to the erased value of the flash memory.
      container SwCluCBManifProvideResourceEntryGroup [0..*]  # Describes a group of provided resources in the Binary Manifest. | The belonging handles are put into the Binary Manifest's tables into an consecutive order which supports an array based access.
        string SwCluCBManifHeaderInclude [0..*]: multiplicity set at pre-compile, set at pre-compile  # Defines the header file(s) where the owner of the SwCluCBManifProvideResourceEntryGroup / SwCluCBManifRequireResourceEntryGroup has the declarations of the symbols for the handle initialization.
        enumeration SwCluCBManifMultipleNotifierSupport: {MULTIPLE_NOTIFIER_SETS, SINGLE_NOTIFIER_SET}, multiplicity set at pre-compile, set at pre-compile, default-value=SINGLE_NOTIFIER_SET  # SwCluCBManifMultipleNotifierSupport defines whether multiple Software Cluster can register on the notifier handles. | For each possible connection a set of notifier handles is allocated.
        reference SwCluCBManifResourceTypeRef: destination=SwCluCBManifResourceType  # Defines the resource type for all SwCluCBManifProvideResourceEntry / SwCluCBManifRequireResourceEntry
        container SwCluCBManifProvideResourceEntry [0..*]  # Describes a single entry for a provided resource in the Binary Manifest.
          string SwCluCBManifDefaultNotifierSymbol [0..*]: requires-index=true  # SwCluCBManifDefaultNotifierSymbol set the default value of a Notifier Handle put into the Modifiable Interface. | The number and order of SwCluCBManifDefaultNotifierSymbol needs to match the number and order of SwCluCBManifNotifierHandle in the referenced SwCluCBManifResourceType. The parameter is defined as string in order to support the usage of symbols as initialize. Values have to be set as string in a C supported number format, e.g. 0xC001CAFE. In case the provide handle holds a pointer the address operator is part of the string, e.g. &myExampleFunction
          integer SwCluCBManifMaxNumberOfNotifierSets [0..1]: 0..255, multiplicity set at pre-compile, set at pre-compile  # SwCluCBManifMaxNumberOfNotifierSets defines the maximum number of possible required resources using notifier handles. | It is required in case SwCluCBManifMultipleNotifierSupport is set to MULTIPLE_NOTIFIER_SETS.
          string SwCluCBManifProvideSymbol [0..*]: requires-index=true  # SwCluCBManifProvideSymbol set the value of a Provide Handle put into the Immutable Interface. | The number and order of SwCluCBManifProvideSymbols needs to match the number and order of SwCluCBManifProvideHandle in the referenced SwCluCBManifResourceType. The parameter is defined as string in order to support the usage of symbols as initialize. Values have to be set as string in a C supported number format, e.g. 0xC001CAFE. In case the provide handle holds a pointer the address operator is part of the string, e.g. &myExampleFunction
          integer SwCluCBManifResourceGuardValue: 0..4294967295  # SwCluCBManifResourceGuardValue provides guarding information checked by the Software Cluster connector. A provided resources and required resources of Software Clusters can only be connected, if the resource guarding values of provider and requester are equal.
          foreign reference SwCluCBManifResourceRef [0..1]: destination-type=CP-SOFTWARE-CLUSTER-RESOURCE  # Reference to the CpSoftwareClusterResource determining the global resource Id. If the reference is not set, the global resource Id in the Binary Manifest will be set to 0 for this resource entry in order to indicate an invalid resource.
      container SwCluCBManifRequireResourceEntryGroup [0..*]  # Describes a group of required resources in the Binary Manifest. | The belonging handles are put into the Binary Manifest's tables into an consecutive order which supports an array based access.
        string SwCluCBManifHeaderInclude [0..*]: multiplicity set at pre-compile, set at pre-compile  # Defines the header file(s) where the owner of the SwCluCBManifProvideResourceEntryGroup / SwCluCBManifRequireResourceEntryGroup has the declarations of the symbols for the handle initialization.
        reference SwCluCBManifResourceTypeRef: destination=SwCluCBManifResourceType  # Defines the resource type for all SwCluCBManifProvideResourceEntry / SwCluCBManifRequireResourceEntry
        container SwCluCBManifRequireResourceEntry [1..*]  # Describes a single entry for a required resource in the Binary Manifest.
          string SwCluCBManifDefaultProvideSymbol [0..*]: requires-index=true  # SwCluCBManifDefaultProvideSymbol set the default value of a Provide Handle put into the Modifiable Interface. | The number and order of SwCluCBManifDefaultProvideSymbols needs to match the number and order of SwclCBManifProvideHandles in the referenced SwCluCBManifResourceType. The parameter is defined as string in order to support the usage of symbols as initialize. Values have to be set as string in a C supported number format, e.g. 0xC001CAFE. In case the provide handle holds a pointer the address operator is part of the string, e.g. &myExampleFunction
          boolean SwCluCBManifIsMandatory  # SwCluCBManifIsMandatoryindicates, that the resource is mandatory to operate this Software Cluster. | If the resource is not provided on the machine the connection process for this Software Cluster requiring this resource gets aborted.
          string SwCluCBManifNotifierSymbol [0..*]: requires-index=true  # SwCluCBManifNotifierSymbol set the value of a Notifier Handle put into the Immutable Interface. | The number and order of SwCluCBManifNotifierSymbol needs to match the number and order of SwclCBManifNotifierHandles in the referenced SwCluCBManifResourceType. The parameter is defined as string in order to support the usage of symbols as initialize. Values have to be set as string in a C supported number format, e.g. 0xC001CAFE. In case the provide handle holds a pointer the address operator is part of the string, e.g. &myExampleFunction
          integer SwCluCBManifResourceGuardValue: 0..4294967295  # SwCluCBManifResourceGuardValue provides guarding information checked by the Software Cluster connector. A provided resources and required resources of Software Clusters can only be connected, if the resource guarding values of provider and requester are equal.
          foreign reference SwCluCBManifResourceRef [0..1]: destination-type=CP-SOFTWARE-CLUSTER-RESOURCE  # Reference to the CpSoftwareClusterResource determining the global resource Id. If the reference is not set, the global resource Id in the Binary Manifest will be set to 0 for this resource entry in order to indicate an invalid resource.
      container SwCluCBManifResourceType [0..*]: multiplicity set at pre-compile  # This container defines the structure of a resource type in the Binary Manifest.
        integer SwCluCBManifResourceId: 0..255, scope=ECU, multiplicity set at pre-compile, set at pre-compile  # Unique number of the resource type.
        container SwCluCBManifNotifierHandle [0..*]: requires-index=true  # Defines a Notifier Handle and its properties for this resource type.
          boolean SwCluCBManifIsOptional: set at pre-compile, default-value=false  # Indicates that this handle is optional and may not always exist for each Provide Resource Entry or Require Resource Entry.
          enumeration SwCluCBManifNativeHandleType: {DATA_REFERENCE, FUNCTION_REFERENCE, VALUE}, multiplicity set at pre-compile, set at pre-compile, default-value=DATA_REFERENCE  # This paramter determines the unterlying native type of the handle which can be | * pointer to variable * value * pointer to function This information is required to correctly initialize the handle in the Immutable Interface or Modifiable Interface.
          foreign reference SwCluCBManifHandleImpleTypeRef [0..1]: set at pre-compile, destination-type=IMPLEMENTATION-DATA-TYPE  # Reference to the ImplementationDataType of the handle. | This type can be additionally configured to get a correct casting of the native handle type to the returned handel type.
        container SwCluCBManifProvideHandle [0..*]: requires-index=true  # Defines a Provide Handle and its properties for this resource type.
          boolean SwCluCBManifIsOptional: set at pre-compile, default-value=false  # Indicates that this handle is optional and may not always exist for each Provide Resource Entry or Require Resource Entry.
          enumeration SwCluCBManifNativeHandleType: {DATA_REFERENCE, FUNCTION_REFERENCE, VALUE}, multiplicity set at pre-compile, set at pre-compile, default-value=DATA_REFERENCE  # This paramter determines the unterlying native type of the handle which can be | * pointer to variable * value * pointer to function This information is required to correctly initialize the handle in the Immutable Interface or Modifiable Interface.
          foreign reference SwCluCBManifHandleImpleTypeRef [0..1]: set at pre-compile, destination-type=IMPLEMENTATION-DATA-TYPE  # Reference to the ImplementationDataType of the handle. | This type can be additionally configured to get a correct casting of the native handle type to the returned handel type.
    container SwCluCBaseConfigurationCheck [0..*]: multiplicity set at pre-compile  # Configuration of the base configuration check of Software Cluster Connection. | This configuration places a mandatory entry in the Binary Manifest where the guard value is used to proof if the general setup of the Application Software Cluster is compatible to the general setup of the Host Software Cluster. For each Application Software Cluster an individual base configuration check should be defined.
      multiline string SwCluCAutoBaseConfigDescriptor [0..*]: scope=ECU, multiplicity set at pre-compile, set at pre-compile  # A machine determined string which represent the basic configuration assumption. | Multiple SwCluCAutoBaseConfigDescriptor values can be added to support that different tools contribute to the checksum. For instance Software Cluster Connection Tool, Compiler, Link, or Locate tooling. isAuto shall be set to true since tool chain adds its collected values automatically.
      multiline string SwCluCUserBaseConfigDescriptor [0..1]: scope=ECU, multiplicity set at pre-compile, set at pre-compile  # A user determined string which represent the basic configuration assumption.
      foreign reference SwCluCResourceRef: scope=ECU, destination-type=CP-SOFTWARE-CLUSTER-SERVICE-RESOURCE  # Reference to the CpSoftwareClusterServiceResource.
    container SwCluCDefinitionSet  # Definition of a set of Software Clusters
      container SwCluCDefinition [1..*]: multiplicity set at pre-compile  # Definition of the general properties of the Software Cluster. | The defintions are separated in a set of defintions in order to enable an holistic view about all exsiting Software Cluster Definitions.
        enumeration SwCluCBManifDescriptorTreatment: {EMBED_DESCRIPTORS, OMIT_DESCRIPTORS}, scope=ECU, multiplicity set at pre-compile, set at pre-compile, default-value=EMBED_DESCRIPTORS  # Configures the existence of the Interface Descriptor Table in the Binary Object of the Software Cluster.
        enumeration SwCluCBManifOnBoardConnectorControl [0..1]: {DISABLE_ON_ECU_CONNECTOR, ENABLE_ON_ECU_CONNECTOR}, scope=ECU, multiplicity set at pre-compile, set at pre-compile, default-value=ENABLE_ON_ECU_CONNECTOR  # SwCluCBManifOnBoardConnectorControl enables or disables the onECU execution of the Software Cluster Connector. | This setting is only applicable for the Host Software Cluster.
        integer SwCluCMachineId: 0..254, scope=ECU, multiplicity set at pre-compile, set at pre-compile  # Unique number of the (virtual or physical) machine to which the Software Cluster belongs.
        integer SwCluCSoftwareClusterId: 0..239, scope=ECU, multiplicity set at pre-compile, set at pre-compile  # Unique number of the Software Cluster | Numbers >= 0xFE are reserved to indicate special values or the unconnected state.
        enumeration SwCluCSoftwareClusterType: {APPLICATION_SW_CLUSTER, HOST_SW_CLUSTER, SUBSTITUTION_SW_CLUSTER}, scope=ECU, multiplicity set at pre-compile, set at pre-compile, default-value=APPLICATION_SW_CLUSTER  # The type of the Software Cluster
        foreign reference SwCluCSoftwareClusterRef [0..1]: scope=ECU, multiplicity set at pre-compile, set at pre-compile, destination-type=CP-SOFTWARE-CLUSTER  # Reference to the CpSoftwareCluster to define the link to the Software Cluster description in the System.
    container SwCluCGeneral: multiplicity set at pre-compile  # General configuration of the Software Cluster Connection
      reference SwCluCDefinitionSelection: multiplicity set at pre-compile, set at pre-compile, destination=SwCluCDefinition  # This reference selects the Software Cluster Definition which is applied for this Software Cluster.
    container SwCluCProxies: multiplicity set at pre-compile  # General configuration of the Proxy Modules of Software Cluster Connection
      enumeration SwCluCProxyGenerationCom: {HIGH_PROXY, LOW_PROXY, PROXY_DISABLED}, scope=ECU, multiplicity set at pre-compile, set at pre-compile  # Defines whether the Com Proxy code and models are generated.
      enumeration SwCluCProxyGenerationDcm: {HIGH_PROXY, LOW_PROXY, PROXY_DISABLED}, scope=ECU, multiplicity set at pre-compile, set at pre-compile  # Defines whether the Dcm Proxy code and models are generated.
      enumeration SwCluCProxyGenerationDem: {HIGH_PROXY, LOW_PROXY, PROXY_DISABLED}, scope=ECU, multiplicity set at pre-compile, set at pre-compile  # Defines whether the Dem Proxy code and models are generated.
      enumeration SwCluCProxyGenerationFiM: {HIGH_PROXY, LOW_PROXY, PROXY_DISABLED}, scope=ECU, multiplicity set at pre-compile, set at pre-compile  # Defines whether the FiM Proxy code and models are generated.
      enumeration SwCluCProxyGenerationLdCom: {HIGH_PROXY, LOW_PROXY, PROXY_DISABLED}, scope=ECU, multiplicity set at pre-compile, set at pre-compile  # Defines whether the LdCom Proxy code and models are generated.
      enumeration SwCluCProxyGenerationNvM: {HIGH_PROXY, LOW_PROXY, PROXY_DISABLED}, scope=ECU, multiplicity set at pre-compile, set at pre-compile  # Defines whether the NvM Proxy code and models are generated.
      enumeration SwCluCProxyGenerationOs: {HIGH_PROXY, LOW_PROXY, PROXY_DISABLED}, scope=ECU, multiplicity set at pre-compile, set at pre-compile  # Defines whether the Os Proxy code and models are generated.
      container SwCluCComProxy [0..1]: multiplicity set at pre-compile  # LdCom Proxy specific parameters.
        boolean SwCluCComProxyDevErrorDetect: set at pre-compile, default-value=false  # Switches the development error detection and notification on or off. | * true: detection and notification is enabled. * false: detection and notification is disabled.
        container SwCluCComProxyBaseSocket [1..*]: multiplicity set at pre-compile  # This container configures how many EcucPartitions specific API links are required for the Com Proxy and to which cluster resource the API set belongs. | In the Com Low Proxy all offered API sets (incl callbacks) needs to be configured. In the Com High Proxy only the ones are configured which are offered inside this Application Software Cluster. The reference SwCluCProxyEcucPartitionRef denotes the EcucPartition on which the API set is provided. The ComUserModuleCnf is only applicable in the Host Software Cluster and shall not be configured in the scope of a Application Software Cluster. One ComUserModuleCnf instance can either server for ComSignals and ComSignalGroups on multiple EcucPartitions or exactly one EcucPartition. How many ComUser instances an Rte in an related Application Software Cluster requires is vendor specific.
          boolean SwCluCNativeBswApi [0..1]: scope=ECU, multiplicity set at pre-compile, set at pre-compile, default-value=false  # Defines if the native C-API without pre or suffixes is offered in the Application Software Cluster on this EcucPartition.
          reference SwCluCComProxyUsedSatelliteRef [0..1]: scope=ECU, multiplicity set at pre-compile, set at pre-compile, destination=SwCluCComProxyBaseSocket  # Reference to the SwCluCComBaseSocket which has access to a satellite of the Com. The owning SwCluCComBaseSocket uses the Com satellite of the referenced SwCluCComBaseSocket.
          reference SwCluCProxyEcucPartitionRef [1..*]: scope=ECU, multiplicity set at pre-compile, set at pre-compile, destination=EcucPartition  # Reference to the EcucPartition.
          foreign reference SwCluCResourceRef: scope=ECU, destination-type=CP-SOFTWARE-CLUSTER-SERVICE-RESOURCE  # Reference to the CpSoftwareClusterServiceResource.
          container ComUserModuleCnf [0..1]: destination-uri=ComUser, multiplicity set at pre-compile  # Contains the configuration parameters of the Com user module.
            string ComUserHeaderInclude [0..1]: set at pre-compile  # Defines the header file where the Com user provides the function declarations for configured callbacks.
            container ComUserCallback [0..*]: multiplicity set at link in variant post-build / pre-compile in variant pre-compile, post-build-variant-multiplicity=true  # This container defines a Com callback function for signals and signal groups.
              function name ComUserCallbackName: scope=ECU, multiplicity set at link in variant post-build / pre-compile in variant pre-compile, set at link in variant post-build / pre-compile in variant pre-compile  # The name of the callback function to be called.
              enumeration ComUserCallbackType: {COM_RX_ACK, COM_RX_INV, COM_RX_TOUT, COM_TX_ACK, COM_TX_ERR, COM_TX_TOUT}, scope=ECU, multiplicity set at link in variant post-build / pre-compile in variant pre-compile, set at link in variant post-build / pre-compile in variant pre-compile  # The type of the Com callback
            container ComUserSignal [0..*]: multiplicity set at post-build in variant post-build / pre-compile in variant pre-compile, post-build-variant-multiplicity=true  # Contains the configuration parameters of a signal inside a Com user module. | Please note that it is valid to define ComUserSignal without any callback function.
              integer ComUserCbkHandleId [0..1]: 0..65535, scope=ECU, multiplicity set at pre-compile, set at pre-compile, symbolic-name-value=true  # The numerical value used as the Com user callback handle Id. | This ID identifies signals and signal groups in the COM callbacks using ComUserCbkHandleId parameter respectively.
              reference ComUserCallbackRef [0..*]: scope=ECU, multiplicity set at post-build in variant post-build / pre-compile in variant pre-compile, post-build-variant-multiplicity=true, post-build-variant-value=true, set at link in variant post-build / pre-compile in variant pre-compile, destination=ComUserModuleCnf/ComUserCallback  # Reference(s) to all callback(s) of this signal or signal group.
              foreign reference ComUserSystemTemplateSystemSignalRef [0..1]: scope=ECU, multiplicity set at post-build in variant post-build / pre-compile in variant pre-compile, post-build-variant-multiplicity=true, post-build-variant-value=true, set at post-build in variant post-build / pre-compile in variant pre-compile, destination-type=I-SIGNAL-TO-I-PDU-MAPPING  # Reference to the ISignalToIPduMapping that contains a reference to the ISignal (System Template) which this ComUserSignal (or ComUserGroupSignal) represents.
            container ComUserSignalGroup [0..*]: multiplicity set at post-build in variant post-build / pre-compile in variant pre-compile, post-build-variant-multiplicity=true  # Contains the configuration parameters of a signal group inside a Com user module. | Please note that it is valid to define ComUserSignalGroup without any callback function.
              integer ComUserCbkHandleId [0..1]: 0..65535, scope=ECU, multiplicity set at pre-compile, set at pre-compile, symbolic-name-value=true  # The numerical value used as the Com user callback handle Id. | This ID identifies signals and signal groups in the COM callbacks using ComUserCbkHandleId parameter respectively.
              reference ComUserCallbackRef [0..*]: scope=ECU, multiplicity set at post-build in variant post-build / pre-compile in variant pre-compile, post-build-variant-multiplicity=true, post-build-variant-value=true, set at link in variant post-build / pre-compile in variant pre-compile, destination=ComUserModuleCnf/ComUserCallback  # Reference(s) to all callback(s) of this signal or signal group.
              foreign reference ComUserSystemTemplateSignalGroupRef [0..1]: scope=ECU, multiplicity set at post-build in variant post-build / pre-compile in variant pre-compile, post-build-variant-multiplicity=true, post-build-variant-value=true, set at post-build in variant post-build / pre-compile in variant pre-compile, destination-type=I-SIGNAL-TO-I-PDU-MAPPING  # Reference to the ISignalToIPduMapping that contains a reference to the ISignalGroup (SystemTemplate) which this ComUserSignalGroup represents.
      container SwCluCDcmProxy [0..1]: multiplicity set at pre-compile  # Dcm Proxy specific parameters.
        boolean SwCluCDcmProxyDevErrorDetect: set at pre-compile, default-value=false  # Switches the development error detection and notification on or off. | * true: detection and notification is enabled. * false: detection and notification is disabled.
        container SwCluCDcmProxyBaseSocket [1..*]: multiplicity set at pre-compile  # This container configures how many EcucPartitions specific API links are required for the Dcm Proxy and to which cluster resource the API set belongs. | In the Dcm Low Proxy all offered API sets needs to be configured. In the Dcm High Proxy only the ones are configured which are offered inside this Application Software Cluster. The reference SwCluCProxyEcucPartitionRef denotes the EcucPartition on which the API set is provided.
          boolean SwCluCNativeBswApi [0..1]: scope=ECU, multiplicity set at pre-compile, set at pre-compile, default-value=false  # Defines if the native C-API without pre or suffixes is offered in the Application Software Cluster on this EcucPartition.
          reference SwCluCDcmProxyUsedSatelliteRef [0..1]: scope=ECU, multiplicity set at pre-compile, set at pre-compile, destination=SwCluCDcmProxyBaseSocket  # Reference to the SwCluCDemBaseSocket which has access to a satellite of the Dcm. The owning SwCluCDemBaseSocket uses the Dcm satellite of the referenced SwCluCDemBaseSocket.
          reference SwCluCProxyEcucPartitionRef: scope=ECU, multiplicity set at pre-compile, set at pre-compile, destination=EcucPartition  # Reference to the EcucPartition.
          foreign reference SwCluCResourceRef: scope=ECU, destination-type=CP-SOFTWARE-CLUSTER-SERVICE-RESOURCE  # Reference to the CpSoftwareClusterServiceResource.
        container SwCluCDcmProxyDiagnosticData [0..*]: multiplicity set at pre-compile  # Configures a Diagnostic Data proxy for a DID or PID or IOControl.
          choice reference SwCluCDcmProxyDataRef [0..*]: scope=ECU, destination=[DcmDspData, DcmDspDid, DcmDspPidService01, DemDataElementClass]  # Reference to the diagnostic data of Dcm which can either be a DcmDspData, or a DcmDspPidService01, or a DcmDspDid. | The DcmDspDid reference is only applicable in the Application Software Cluster if the DID has exactly one Diagnostic Data Element requiring the DID based interface. The reference is mandatory in the Application Software Cluster and can be used in the Host Software Cluster to identify the related diagnostic data in the Dcm configuration.
          foreign reference SwCluCDextDiagnosticDataElementRef [0..1]: scope=ECU, destination-type=DIAGNOSTIC-DATA-ELEMENT  # Reference to the DiagnosticDataElement in DEXT for back-tracing in case of DEXT based configuration approaches
          reference SwCluCProxyEcucPartitionRef: scope=ECU, multiplicity set at pre-compile, set at pre-compile, destination=EcucPartition  # Reference to the EcucPartition.
          foreign reference SwCluCResourceRef: scope=ECU, destination-type=CP-SOFTWARE-CLUSTER-SERVICE-RESOURCE  # Reference to the CpSoftwareClusterServiceResource.
        container SwCluCDcmProxyRoutineControl [0..*]: multiplicity set at pre-compile  # Configures a Routine Control proxy.
          reference SwCluCDcmProxyRoutineRef [0..1]: scope=ECU, destination=DcmDspRoutine  # Reference to the routine configuration of Dcm. | The reference is mandatory in the Application Software Cluster and can be used in the Host Software Cluster to identify the related routine control in the Dcm configuration.
          foreign reference SwCluCDextRoutineSubfunctionRef [0..1]: scope=ECU, destination-type=DIAGNOSTIC-ROUTINE-SUBFUNCTION  # Reference to the Routine Subfunction in DEXT for back-tracing in case of DEXT based configuration approaches
          reference SwCluCProxyEcucPartitionRef: scope=ECU, multiplicity set at pre-compile, set at pre-compile, destination=EcucPartition  # Reference to the EcucPartition.
          foreign reference SwCluCResourceRef: scope=ECU, destination-type=CP-SOFTWARE-CLUSTER-SERVICE-RESOURCE  # Reference to the CpSoftwareClusterServiceResource.
        container SwCluCDcmProxyServiceRequestNotification [0..*]: multiplicity set at pre-compile  # Configures a Service Request Notification proxy.
          choice reference SwCluCDcmProxyNotificationRef [0..1]: scope=ECU, destination=[DcmDsdServiceRequestManufacturerNotification, DcmDsdServiceRequestSupplierNotification]  # Reference to the Service Request Notifcation configuration of Dcm which can either be a DcmDsdServiceRequestSupplierNotification or DcmDsdServiceRequestManufacturerNotification | The reference is mandatory in the Application Software Cluster and can be used in the Host Software Cluster to identify the related notification in the Dcm configuration.
          reference SwCluCProxyEcucPartitionRef: scope=ECU, multiplicity set at pre-compile, set at pre-compile, destination=EcucPartition  # Reference to the EcucPartition.
          foreign reference SwCluCResourceRef: scope=ECU, destination-type=CP-SOFTWARE-CLUSTER-SERVICE-RESOURCE  # Reference to the CpSoftwareClusterServiceResource.
      container SwCluCDemProxy [0..1]: multiplicity set at pre-compile  # DemProxy specific parameters.
        boolean SwCluCDemProxyDevErrorDetect: set at pre-compile, default-value=false  # Switches the development error detection and notification on or off. | * true: detection and notification is enabled. * false: detection and notification is disabled.
        container SwCluCDemProxyBaseSocket [1..*]: multiplicity set at pre-compile  # This container configures how many EcucPartitions specific API links are required for the Dem Proxy and to which cluster resource the API set belongs. | In the Dem Low Proxy all offered API sets needs to be configured. In the Dem High Proxy only the ones are configured which are offered inside this Application Software Cluster. The reference SwCluCProxyEcucPartitionRef denotes the EcucPartition on which the API set is provided.
          boolean SwCluCNativeBswApi [0..1]: scope=ECU, multiplicity set at pre-compile, set at pre-compile, default-value=false  # Defines if the native C-API without pre or suffixes is offered in the Application Software Cluster on this EcucPartition.
          reference SwCluCDemProxyUsedSatelliteRef [0..1]: scope=ECU, multiplicity set at pre-compile, set at pre-compile, destination=SwCluCDemProxyBaseSocket  # Reference to the SwCluCDemBaseSocket which has access to a satellite of the Dem. The owning SwCluCDemBaseSocket uses the Dem satellite of the referenced SwCluCDemBaseSocket.
          reference SwCluCProxyEcucPartitionRef: scope=ECU, multiplicity set at pre-compile, set at pre-compile, destination=EcucPartition  # Reference to the EcucPartition.
          foreign reference SwCluCResourceRef: scope=ECU, destination-type=CP-SOFTWARE-CLUSTER-SERVICE-RESOURCE  # Reference to the CpSoftwareClusterServiceResource.
        container SwCluCDemProxyDiagnosticEvent [0..*]: multiplicity set at pre-compile  # Configures a Diagnostic Event proxy.
          reference SwCluCDemProxyEventRef: scope=ECU, destination=DemEventParameter  # Reference to the diagnostic event of Dem
          foreign reference SwCluCDextDiagnosticEventRef [0..1]: scope=ECU, destination-type=DIAGNOSTIC-EVENT  # Reference to the Diagnostic Event in DEXT for back-tracing in case of DEXT based configuration approaches
          reference SwCluCProxyEcucPartitionRef: scope=ECU, multiplicity set at pre-compile, set at pre-compile, destination=EcucPartition  # Reference to the EcucPartition.
          foreign reference SwCluCResourceRef: scope=ECU, destination-type=CP-SOFTWARE-CLUSTER-SERVICE-RESOURCE  # Reference to the CpSoftwareClusterServiceResource.
      container SwCluCFiMProxy [0..1]: multiplicity set at pre-compile  # FiM Proxy specific parameters.
        boolean SwCluCFiMProxyDevErrorDetect: set at pre-compile, default-value=false  # Switches the development error detection and notification on or off. | * true: detection and notification is enabled. * false: detection and notification is disabled.
        container SwCluCFiMProxyBaseSocket [1..*]: multiplicity set at pre-compile  # This container configures how many EcucPartitions specific API links are required for the FiM Proxy and to which cluster resource the API set belongs. | In the FiM Low Proxy all offered API sets needs to be configured. In the FiM High Proxy only the ones are configured which are offered inside this Application Software Cluster. The reference SwCluCProxyEcucPartitionRef denotes the EcucPartition on which the API set is provided.
          boolean SwCluCNativeBswApi [0..1]: scope=ECU, multiplicity set at pre-compile, set at pre-compile, default-value=false  # Defines if the native C-API without pre or suffixes is offered in the Application Software Cluster on this EcucPartition.
          reference SwCluCFiMProxyUsedSatelliteRef [0..1]: scope=ECU, multiplicity set at pre-compile, set at pre-compile, destination=SwCluCFiMProxyBaseSocket  # Reference to the SwCluCFiMBaseSocket which has access to a satellite of the FiM. The owning SwCluCFiMBaseSocket uses the FiM satellite of the referenced SwCluCFiMBaseSocket.
          reference SwCluCProxyEcucPartitionRef: scope=ECU, multiplicity set at pre-compile, set at pre-compile, destination=EcucPartition  # Reference to the EcucPartition.
          foreign reference SwCluCResourceRef: scope=ECU, destination-type=CP-SOFTWARE-CLUSTER-SERVICE-RESOURCE  # Reference to the CpSoftwareClusterServiceResource.
        container SwCluCFiMProxyFID [0..*]: multiplicity set at pre-compile  # Configures a Function Inhibition proxy.
          foreign reference SwCluCDextDiagnosticFunctionIdentifierRef [0..1]: scope=ECU, destination-type=DIAGNOSTIC-FUNCTION-IDENTIFIER  # Reference to the DiagnosticFunctionIdentifier in DEXT for back-tracing in case of DEXT based configuration approaches
          reference SwCluCFiMProxyFIDRef: scope=ECU, destination=FiMFID  # Reference to the FIMFID
          reference SwCluCProxyEcucPartitionRef: scope=ECU, multiplicity set at pre-compile, set at pre-compile, destination=EcucPartition  # Reference to the EcucPartition.
          foreign reference SwCluCResourceRef: scope=ECU, destination-type=CP-SOFTWARE-CLUSTER-SERVICE-RESOURCE  # Reference to the CpSoftwareClusterServiceResource.
      container SwCluCLdComProxy [0..1]: multiplicity set at pre-compile  # LdCom Proxy specific parameters.
        boolean SwCluCLdComProxyDevErrorDetect: set at pre-compile, default-value=false  # Switches the development error detection and notification on or off. | * true: detection and notification is enabled. * false: detection and notification is disabled.
        container SwCluCLdComProxyBaseSocket [1..*]: multiplicity set at pre-compile  # This container configures how many EcucPartitions specific API links are required for the LdCom Proxy and to which cluster resource the API set belongs. | In the LdCom Low Proxy all offered API sets (incl. callbacks) needs to be configured. In the LdCom High Proxy only the ones are configured which are offered inside this Application Software Cluster. The reference SwCluCProxyEcucPartitionRef denotes the EcucPartition on which the API set is provided. The LdComUserModuleCnf is only applicable in the Host Software Cluster and shall not be configured in the scope of a Application Software Cluster. One LdComUserModuleCnf instance can either server for LdComIPdus on multiple EcucPartitons or exactly one EcucPartiton. How many LdComUser instances an Rte in an related Application Software Cluster requires is vendor specific.
          boolean SwCluCNativeBswApi [0..1]: scope=ECU, multiplicity set at pre-compile, set at pre-compile, default-value=false  # Defines if the native C-API without pre or suffixes is offered in the Application Software Cluster on this EcucPartition.
          reference SwCluCLdComProxyUsedSatelliteRef [0..1]: scope=ECU, multiplicity set at pre-compile, set at pre-compile, destination=SwCluCLdComProxyBaseSocket  # Reference to the SwCluCLdComBaseSocket which has access to a satellite of the LdCom. The owning SwCluCLdComBaseSocket uses the LdCom satellite of the referenced SwCluCLdComBaseSocket.
          reference SwCluCProxyEcucPartitionRef [1..*]: scope=ECU, multiplicity set at pre-compile, set at pre-compile, destination=EcucPartition  # Reference to the EcucPartition.
          foreign reference SwCluCResourceRef: scope=ECU, destination-type=CP-SOFTWARE-CLUSTER-SERVICE-RESOURCE  # Reference to the CpSoftwareClusterServiceResource.
          container LdComUserModuleCnf [0..1]: destination-uri=LdComUser, multiplicity set at pre-compile  # Contains the configuration parameters of the LdCom user module.
            string LdComUserHeaderInclude [0..1]: multiplicity set at pre-compile, set at pre-compile  # Defines the header file where the LdLom user provides the function declarations for configured callbacks.
            container LdComUserCallback [0..*]: multiplicity set at link in variant post-build / pre-compile in variant pre-compile, post-build-variant-multiplicity=true  # This container defines a LdCom callback function for a LdComIPdu.
              function name LdComUserCallbackName: scope=ECU, multiplicity set at link in variant post-build / pre-compile in variant pre-compile, set at link in variant post-build / pre-compile in variant pre-compile  # The name of the callback function to be called.
              enumeration LdComUserCallbackType: {LDCOM_RX_INDICATION, LDCOM_RX_START_OF_RECEPTION, LDCOM_TP_COPY_RX_DATA, LDCOM_TP_COPY_TX_DATA, LDCOM_TP_RX_INDICATION, LDCOM_TP_TX_CONFIRMATION, LDCOM_TX_CONFIRMATION, LDCOM_TX_TRIGGER_TRANSMIT}, scope=ECU, multiplicity set at link in variant post-build / pre-compile in variant pre-compile, set at link in variant post-build / pre-compile in variant pre-compile  # The type of the LdCom callback
            container LdComUserIPdu [0..*]: multiplicity set at post-build in variant post-build / pre-compile in variant pre-compile, post-build-variant-multiplicity=true  # Contains the configuration parameters for the LdCom's signal (LdComIPdu) inside a LdCom user module.
              integer LdComUserCbkHandleId: 0..65535, scope=ECU, set at pre-compile, symbolic-name-value=true  # The numerical value used as the LdCom user callback handle Id. | This is the ID used by LdCom to invoke callbacks of a LdCom user (Rte, ScCluC LdCom Low Proxy or CDDs) using LdComUserCbkHandleId parameter respectively. A corresponding symbolic name reference is created, which may be used for the invocations of the user.
              reference LdComUserCallbackRef [0..*]: scope=ECU, multiplicity set at post-build in variant post-build / pre-compile in variant pre-compile, post-build-variant-multiplicity=true, post-build-variant-value=true, set at link in variant post-build / pre-compile in variant pre-compile, destination=LdComUserModuleCnf/LdComUserCallback  # Reference(s) to all callback(s) of this LdComIPdu.
              foreign reference LdComUserSystemTemplateSignalRef: scope=ECU, multiplicity set at post-build in variant post-build / pre-compile in variant pre-compile, post-build-variant-multiplicity=true, post-build-variant-value=true, set at post-build in variant post-build / pre-compile in variant pre-compile, destination-type=I-SIGNAL-TO-I-PDU-MAPPING  # Reference to the ISignalToIPduMapping that contains a reference to the ISignal (System Template).
      container SwCluCNvMProxy [0..1]: multiplicity set at pre-compile  # NvM Proxy specific parameters.
        boolean SwCluCNvMProxyDevErrorDetect: set at pre-compile, default-value=false  # Switches the development error detection and notification on or off. | * true: detection and notification is enabled. * false: detection and notification is disabled.
        integer SwCluCNvMProxyNvBlockFillValue [0..1]: 0..255, scope=ECU, multiplicity set at pre-compile, set at pre-compile, default-value=255  # Defines the default value used to fill unused bytes in NvBlock space in case NvBlock length in Application Software Cluster < NvBlock length configured in NvM of Host Software Cluster. | Dependent on NvM Proxy implementation this parameter is only relevant for NvM Low Proxy or NvM High Proxy
        container SwCluCNvMBaseSocket [1..*]: multiplicity set at pre-compile  # This container configures how many EcucPartitions specific API links are required for the NvM Proxy and to which cluster resource the API set belongs. | In the NvM Low Proxy all offered API sets needs to be configured. In the NvM High Proxy only the ones are configured which are offered inside this Application Software Cluster. The reference SwCluCProxyEcucPartitionRef denotes the EcucPartition on which the API set is provided.
          boolean SwCluCNativeBswApi [0..1]: scope=ECU, multiplicity set at pre-compile, set at pre-compile, default-value=false  # Defines if the native C-API without pre or suffixes is offered in the Application Software Cluster on this EcucPartition.
          reference SwCluCNvMProxyUsedSatelliteRef: scope=ECU, multiplicity set at pre-compile, set at pre-compile, destination=SwCluCNvMBaseSocket  # Reference to the SwCluCNvMBaseSocket which has access to a satellite of the NvM. The owning SwCluCNvMBaseSocket uses the NvM satellite of the referenced SwCluCNvMBaseSocket.
          reference SwCluCProxyEcucPartitionRef: scope=ECU, multiplicity set at pre-compile, set at pre-compile, destination=EcucPartition  # Reference to the EcucPartition.
          foreign reference SwCluCResourceRef: scope=ECU, destination-type=CP-SOFTWARE-CLUSTER-SERVICE-RESOURCE  # Reference to the CpSoftwareClusterServiceResource.
        container SwCluCNvMConfigIDProxyNvBlock [0..*]: multiplicity set at pre-compile  # Describes a Configuration ID block of an Application Software Cluster and maps it to | * a CpSoftwareClusterServiceResource describing the NvBlock resource in the clustered system * a EcucPartition * a NvMBlockDescriptor (only in the context of the Host Software Cluster) In the scope of an Application Software Cluster at most one SwCluCNvMConfigIDProxyNvBlock container can exist. In the scope of a Host Software Cluster multiple SwCluCNvMConfigIDProxyNvBlock container can exist, one for each Configuration ID block of Application Software Clusters.
          reference SwCluCNvMProxyHostNvMBlockDescriptorRef [0..1]: scope=ECU, multiplicity set at pre-compile, set at pre-compile, destination=NvMBlockDescriptor  # Reference to the NvMBlockDescriptor of the NvM module in Host Software Cluster. | This reference is only applicable in the context of a Host Software Cluster.
          reference SwCluCNvMProxyNvBlockEcucPartitionRef: scope=ECU, multiplicity set at pre-compile, set at pre-compile, destination=EcucPartition  # Reference to the EcucPartition on which the NvM Proxy offers the NvBlock access (call of APIfunctions, callback functions and Ports on the Service Software Component)
          foreign reference SwCluCResourceRef: scope=ECU, destination-type=CP-SOFTWARE-CLUSTER-SERVICE-RESOURCE  # Reference to the CpSoftwareClusterServiceResource.
        container SwCluCNvMProxyNvBlock [1..*]: multiplicity set at pre-compile  # Maps a NvMBlockDescriptor to the CpSoftwareClusterServiceResource describing the NvBlock resource in the clustered system.
          integer SwCluCNvMProxyNvBlockMaxLength: 1..65535, scope=ECU, multiplicity set at pre-compile, set at pre-compile  # Defines the maximum NV block data length in bytes.
          reference SwCluCNvMProxyNvBlockEcucPartitionRef: scope=ECU, multiplicity set at pre-compile, set at pre-compile, destination=EcucPartition  # Reference to the EcucPartition on which the NvM Proxy offers the NvBlock access (call of APIfunctions, callback functions and Ports on the Service Software Component)
          reference SwCluCNvMProxyNvMBlockDescriptorRef: scope=ECU, destination=NvMBlockDescriptor  # Reference to the NvMBlockDescriptor
          foreign reference SwCluCResourceRef: scope=ECU, destination-type=CP-SOFTWARE-CLUSTER-SERVICE-RESOURCE  # Reference to the CpSoftwareClusterServiceResource.
      container SwCluCOsProxy [0..1]: multiplicity set at pre-compile  # Os Proxy specific parameters.
        boolean SwCluCOsProxyIdTranslationEnabled: set at pre-compile, default-value=false  # Enables the translation of core IDs and application IDs between Host SW Cluster and Application SW Cluster | - true: IDs translation from HOST into Application SW Cluster specific ones is enabled. - false: IDs translation from HOST into Application SW Cluster specific ones is disabled.
        container SwCluCOsProxyFunctionDispatcher [0..*]: multiplicity set at pre-compile  # This container configures a function dispatcher. | In the Os High Proxy this configuration puts a function as a Dispatch Entry Point in the Binary Manifest which can be called by the Os Low Proxy. In the Os Low Proxy this configuration provides the Dispatcher Function (and according resource Entry in the Binary Manifest) which is able to call the MaxNumberOfCallee Dispatch Entry Points of Os High Proxies.
          function name SwCluCOsProxyDispatchEntryPointFunction [0..1]: scope=ECU, multiplicity set at pre-compile, set at pre-compile  # Name of the function which is put into the Binary Manifest as Dispatch Entry Point. | In the Os High Proxy this configuration parameter is mandatory
          foreign reference SwCluCResourceRef: scope=ECU, destination-type=CP-SOFTWARE-CLUSTER-SERVICE-RESOURCE  # Reference to the CpSoftwareClusterServiceResource.
        container SwCluCOsProxyOsApplication [0..*]: multiplicity set at pre-compile  # Maps a OsApplication to the CpSoftwareClusterServiceResource describing the OsApplication resource in the clustered system.
          reference SwCluCOsProxyOsApplicationRef: scope=ECU, destination=OsApplication  # Reference to the OsApplication
          foreign reference SwCluCResourceRef: scope=ECU, destination-type=CP-SOFTWARE-CLUSTER-SERVICE-RESOURCE  # Reference to the CpSoftwareClusterServiceResource.
        container SwCluCOsProxyOsBaseSocket [0..*]: multiplicity set at pre-compile  # Maps a OsBaseSocket to the CpSoftwareClusterServiceResource describing the OsBaseSocket resource in the clustered system.
          foreign reference SwCluCResourceRef: scope=ECU, destination-type=CP-SOFTWARE-CLUSTER-SERVICE-RESOURCE  # Reference to the CpSoftwareClusterServiceResource.
        container SwCluCOsProxyOsResource [0..*]: multiplicity set at pre-compile  # Maps a OsResource to the CpSoftwareClusterServiceResource describing the OsResource resource in the clustered system.
          reference SwCluCOsProxyOsResourceRef: scope=ECU, destination=OsResource  # Reference to the OsResource
          foreign reference SwCluCResourceRef: scope=ECU, destination-type=CP-SOFTWARE-CLUSTER-SERVICE-RESOURCE  # Reference to the CpSoftwareClusterServiceResource.
        container SwCluCOsProxyOsSpinlock [0..*]: multiplicity set at pre-compile  # Maps a OsSpinlock to the CpSoftwareClusterServiceResource describing the OsSpinlock resource in the clustered system.
          reference SwCluCOsProxyOsSpinlockRef: scope=ECU, destination=OsSpinlock  # Reference to the OsSpinlock
          foreign reference SwCluCResourceRef: scope=ECU, destination-type=CP-SOFTWARE-CLUSTER-SERVICE-RESOURCE  # Reference to the CpSoftwareClusterServiceResource.
        container SwCluCOsProxyOsTask [0..*]: multiplicity set at pre-compile  # Maps a OsTask to the CpSoftwareClusterServiceResource describing the OsTask resource in the clustered system.
          enumeration SwCluCOsProxyTaskActivation: {OMIT_TASK_ACTIVATION, PASS_TASK_ACTIVATION}, scope=ECU, multiplicity set at pre-compile, set at pre-compile, default-value=OMIT_TASK_ACTIVATION  # Configures for this particular OsTask whether ActivateTask is passed to the Host Software Cluster or not.
          reference SwCluCOsProxyOsTaskRef: scope=ECU, destination=OsTask  # Reference to the OsTask
          foreign reference SwCluCResourceRef: scope=ECU, destination-type=CP-SOFTWARE-CLUSTER-SERVICE-RESOURCE  # Reference to the CpSoftwareClusterServiceResource.
          container SwCluCOsProxyOsTaskDispatcher [0..*]: multiplicity set at pre-compile  # This container defines a task dispatcher for the owning proxy task. | In the Os High Proxy this configuration provides the OS Task body function as a Dispatch Entry Point in the Binary manifest which can be called by the Os Low Proxy. In the HIGH_PROXY configuration at most one SwCluCOsProxyOsTaskDispatcher can be owned by a SwCluCOsProxyOsTask In the Os Low Proxy this configuration provides the Dispatcher Runnable (and according resource Entry in the Binary Manifest) which is able to call the MaxNumberOfCallee Dispatch Entry Points of Os High Proxies. In the LOW_PROXY configuration multiple SwCluCOsProxyOsTaskDispatcher can be owned by a SwCluCOsProxyOsTask. If none of the SwCluCOsProxyDispatcher<xxx>Event containers is configured it's up to the integrator to model the appropriate RTEEvent.
            integer SwCluCOsProxyMaxNumberOfCallee [0..1]: 1..255, scope=ECU  # Defines how many Dispatch Entry Points the dispatcher of the Os Low Proxy is able to call at most. | In the Os Low Proxy this configuration parameter is mandatory.
            float SwCluCOsProxyMinimumStartInterval [0..1]: 0..INF, scope=ECU, default-value=0  # Specifies the time in seconds by which two consecutive starts of an dispatcher Runnable are guaranteed to be separated.
            reference SwCluCOsProxyEcucPartitionRef [0..1]: scope=ECU, multiplicity set at pre-compile, set at pre-compile, destination=EcucPartition  # If the reference is not provided, the task dispatcher is provided on the EcuPartition to which the OsApplication of the OsTask related to the owning SwCluCOsProxyOsTask belongs. | If the reference is provided, the task dispatcher is provided on the referenced EcuPartition. In this case the task dispatcher is scheduled in the OsTask related to the owning SwCluCOsProxyOsTask but is changing its partition before the task dispatcher schedules proxy tasks in the Application Software Cluster.
            foreign reference SwCluCResourceRef: scope=ECU, destination-type=CP-SOFTWARE-CLUSTER-SERVICE-RESOURCE  # Reference to the CpSoftwareClusterServiceResource.
            container SwCluCOsProxyDispatcherBackgroundEvent [0..*]: multiplicity set at pre-compile  # Configures a BackgroundEvent starting the owing Dispatcher Runnable.
              instance reference SwCluCOsProxyDisabledModeInstanceRef [0..*]: scope=ECU, destination-context=SW-COMPONENT-PROTOTYPE P-PORT-PROTOTYPE MODE-DECLARATION-GROUP-PROTOTYPE, destination-type=MODE-DECLARATION  # Reference to the Mode instance in a PPortPrototype that disable the Event.
            container SwCluCOsProxyDispatcherExternalTriggerOccurredEvent [0..*]: multiplicity set at pre-compile  # Configures a ExternalTriggerOccurredEvent starting the owing Dispatcher Runnable.
              instance reference SwCluCOsProxyDisabledModeInstanceRef [0..*]: scope=ECU, destination-context=SW-COMPONENT-PROTOTYPE P-PORT-PROTOTYPE MODE-DECLARATION-GROUP-PROTOTYPE, destination-type=MODE-DECLARATION  # Reference to the Mode instance in a PPortPrototype that disable the Event.
              instance reference SwCluCOsProxyTriggerInstanceRef: scope=ECU, destination-context=SW-COMPONENT-PROTOTYPE P-PORT-PROTOTYPE, destination-type=TRIGGER  # Reference to the Trigger instances in a PPortPrototype that raise the trigger.
            container SwCluCOsProxyDispatcherInitEvent [0..*]: multiplicity set at pre-compile  # Configures an InitEvent starting the owing Dispatcher Runnable.
            container SwCluCOsProxyDispatcherModeSwitchEvent [0..*]: multiplicity set at pre-compile  # Configures a ModeSwitchEvent starting the owing Dispatcher Runnable.
              enumeration SwCluCOsProxyDispatcherActivation: {ON_ENTRY, ON_EXIT, ON_TRANSITION}, scope=ECU, multiplicity set at pre-compile, set at pre-compile  # Specifies if the event is activated on entering or exiting the referenced Mode instance.
              instance reference SwCluCOsProxyDisabledModeInstanceRef [0..*]: scope=ECU, destination-context=SW-COMPONENT-PROTOTYPE P-PORT-PROTOTYPE MODE-DECLARATION-GROUP-PROTOTYPE, destination-type=MODE-DECLARATION  # Reference to the Mode instance in a PPortPrototype that disable the Event.
              instance reference SwCluCOsProxyModeInstanceRef [1..2]: scope=ECU, destination-context=SW-COMPONENT-PROTOTYPE P-PORT-PROTOTYPE MODE-DECLARATION-GROUP-PROTOTYPE, destination-type=MODE-DECLARATION  # Reference to one or two Mode instances in a PPortPrototype that that initiate the mode switch.
            container SwCluCOsProxyDispatcherTimingEvent [0..*]: multiplicity set at pre-compile  # Configures a TimingEvent starting the owing Dispatcher Runnable.
              float SwCluCOsProxyTimingEventPeriod [0..1]: 0..INF, scope=ECU  # Period of timing event in seconds. The value of this attribute shall be greater than zero.
              instance reference SwCluCOsProxyDisabledModeInstanceRef [0..*]: scope=ECU, destination-context=SW-COMPONENT-PROTOTYPE P-PORT-PROTOTYPE MODE-DECLARATION-GROUP-PROTOTYPE, destination-type=MODE-DECLARATION  # Reference to the Mode instance in a PPortPrototype that disable the Event.
    container SwCluCXcc [0..1]  # Configuration of the Binary Manifest of the Software Cluster Connection
      enumeration SwCluCXccDefaultDataHandling: {DEFAULTS_AS_CALPRMS, DEFAULTS_AS_CONSTANTS}, multiplicity set at pre-compile, set at pre-compile, default-value=DEFAULTS_AS_CONSTANTS  # SwCluCXccDefaultDataHandling defines whether the default data for unconnected RPortPrototypes of a Software Cluster are instantiated as fixed constants or as calibration parameter.
      enumeration SwCluCXccScheduleIntegration: {BASIC_SW_MODULE, SERVICE_SOFTWARE_COMPONENT}, set at pre-compile, default-value=SERVICE_SOFTWARE_COMPONENT  # Defines whether the SwCluC_Xcc_MainFunction is integrated via a Service Software Component with RunnableEntity or a Basic Software Module Description with SchedulableEntity.
      container RteRipsPluginProps: destination-uri=RteRipsPlugin  # This container defines the identity of the Rte Implementation Plug-in and provides the RTE relevant parameters of the Rte Implementation Plug-in. | The shortName of the container defines the name of the Rte Implementation Plug-in used for the API infixes.
        boolean RtePluginSupportsIReadIWrite: set at pre-compile, default-value=false  # Denotes if or if not the plug-in supports the Rte_Rips_IRead/IWrite macros for primitive data.
        enumeration RteRipsGlobalCopyInstantiationPolicy: {RTE_RIPS_INSTANTIATION_BY_PLUGIN, RTE_RIPS_INSTANTIATION_BY_RTE}, set at pre-compile, default-value=RTE_RIPS_INSTANTIATION_BY_RTE  # Select whether for the relevant communication graph a RIPS plugin should instantiate the associated global copies itself or use global copies which have been instantiated by the RTE.
        enumeration RteRipsPluginCommunicationScope [0..1]: {RTE_RIPS_CROSS_SW_CLUSTER_COM, RTE_RIPS_LOCAL_SW_CLUSTER_COM}, set at pre-compile, default-value=RTE_RIPS_LOCAL_SW_CLUSTER_COM  # Defines the communication scope for which the Rte Implementation Plug-Ins (RIPS) serves. If this parameter is not set, the default behavior RTE_RIPS_LOCAL_SW_CLUSTER_COM applies.
        container RteRipsPluginCommunicationTypeSupport [0..1]: multiplicity set at pre-compile  # This container defines the different elements of communication graphs that the plugin is responsible for. Tags: atp.Status=draft
          enumeration RteRipsPluginCommunicationType [1..*]: scope=ECU, multiplicity set at pre-compile, set at pre-compile  # The type of the communication. Tags: atp.Status=draft
            INTER_ECU  # Tags: atp.Status=draft
            INTER_PARTITION  # Tags: atp.Status=draft
            INTRA_PARTITION  # Tags: atp.Status=draft
      container SwCluCXccBaseSocket [0..1]  # Maps a XccBaseSocket to the CpSoftwareClusterServiceResource describing the XccBaseSocket resource in the clustered system. | Maps a XccBaseSocket to a specific EcucPartition on which the XccBaseSocket is working.
        foreign reference SwCluCResourceRef: scope=ECU, destination-type=CP-SOFTWARE-CLUSTER-SERVICE-RESOURCE  # Reference to the CpSoftwareClusterServiceResource.
        reference SwCluCXccEcucPartitionRef: scope=ECU, multiplicity set at pre-compile, set at pre-compile, destination=EcucPartition  # Reference to the EcucPartition on which the XccBaseSocket is available.
      container SwCluCXccMainFunction [0..*]: multiplicity set at pre-compile  # Defines the existence and properties of a SwCluC_Xcc_MainFunction.
        enumeration SwCluCXccClientAssignment: {DEFAULT_FOR_ECUC_PARTITION, ONLY_EXPLICIT_ASSIGNED_CLIENTS}, set at pre-compile, default-value=DEFAULT_FOR_ECUC_PARTITION  # Defines if the SwCluC_Xcc_MainFunction is used as default main function for all clients which are not referenced explicitly by a SwCluCXccClientInstanceRef on this EcucPartition
        float SwCluCXccMainTimeBase: 0..INF, set at pre-compile  # The period between successive calls to according instance of SwCluC_Xcc_MainFunction in seconds. This parameter may be used by the SwCluC generator to transform the given timeout values to internal implementation specific counter or tick values.
        instance reference SwCluCXccClientInstanceRef [0..*]: multiplicity set at pre-compile, set at pre-compile, destination-context=ROOT-SW-COMPOSITION-PROTOTYPE SW-COMPONENT-PROTOTYPE, destination-type=ASYNCHRONOUS-SERVER-CALL-POINT  # Reference to an AsynchronousServerCallPoint
        reference SwCluCXccMainPartitionRef: set at pre-compile, destination=EcucPartition  # Reference to EcucPartition, where the according SwCluC_Xcc_MainFunction instance is assigned to.
  module definition TcpIp [0..1]: post-build-variant-support=true, variants link-time/post-build/pre-compile  # Configuration of the TcpIp (TCP/IP stack) module.
    container TcpIpConfig  # This container contains the configuration parameters and sub containers of the AUTOSAR TcpIp module.
      container TcpIpCtrl [1..*]  # Specifies the EthIf controller used for IP communication.
        integer TcpIpIpFramePrioDefault [0..1]: 0..7, multiplicity set at link in variant link-time / post-build in variant post-build / pre-compile in variant pre-compile, post-build-variant-multiplicity=true, post-build-variant-value=true, set at link in variant link-time / post-build in variant post-build / pre-compile in variant pre-compile, default-value=0  # Specifies the default value for the priority for all outgoing frames. | Note: the value can be changed for each socket individually via TcpIp_ChangeParameter() service. If this optional parameter is not available, 0 is used as default priority.
        reference TcpIpDhcpServerConfigRef [0..1]: post-build-variant-value=true, set at link in variant link-time / post-build in variant post-build / pre-compile in variant pre-compile, destination=TcpIpDhcpServerConfig  # Reference to a TcpIpDhcpServerConfig which shall be used for this controller setting (VLAN).
        reference TcpIpEthIfCtrlRef: post-build-variant-value=true, set at link in variant link-time / post-build in variant post-build / pre-compile in variant pre-compile, requires-symbolic-name-value=true, destination=EthIfController  # Reference to EthIf controller where the IP address shall be assigned.
        reference TcpIpIpSecConfigSetRef [0..1]: multiplicity set at pre-compile, set at pre-compile, destination=TcpIpIpSecConfigSet  # Reference to set of SDP entries which shall be used for IPsec.
        container TcpIpCtrlRxPdu [1..*]: multiplicity set at pre-compile  # PDU used for reception of Ethernet frames. Tags: atp.Status=draft | Supported MetaDataItemTypes: * ETHERNET_MAC_64 * BROADCAST_8
          integer TcpIpCtrlRxPduId: 0..65535, scope=ECU, set at pre-compile, symbolic-name-value=true, with-auto=true  # The PDU identifier used for RxIndication from LSduR. Tags: atp.Status=draft
          reference TcpIpCtrlRxPduRef: scope=ECU, set at pre-compile, destination=Pdu  # Reference to the global PDU. Tags: atp.Status=draft
        container TcpIpCtrlTxPdu [1..*]: multiplicity set at pre-compile  # PDU used for transmission of Ethernet frames. Tags: atp.Status=draft | Supported MetaDataItemTypes: * ETHERNET_MAC_64 * PRIORITY_8 * LISTELEM_PTR
          integer TcpIpCtrlTxPduId: 0..65535, scope=ECU, set at pre-compile, symbolic-name-value=true, with-auto=true  # The PDU identifier used for TxConfirmation from LSduR. Tags: atp.Status=draft
          reference TcpIpCtrlTxPduRef: scope=ECU, set at pre-compile, destination=Pdu  # Reference to the global PDU. Tags: atp.Status=draft
        choice container TcpIpIpVXCtrl  # Specifies whether this controller is an Internet Protocol version 4 (IPv4) or Internet Protocol version 6 (IPv4) instance.
          container TcpIpIpV4Ctrl [0..1]  # Specifies an Internet Protocol version 4 (IPv4) instance.
            reference TcpIpArpConfigRef [0..1]: multiplicity set at pre-compile, set at pre-compile, destination=TcpIpArpConfig  # Reference to ARP configuration for this IPv4 instance. | (Multiple IPv4 instances may use the same configuration container but will operate independently)
            reference TcpIpAutoIpConfigRef [0..1]: multiplicity set at pre-compile, set at pre-compile, destination=TcpIpAutoIpConfig  # Reference to AutoIp configuration for this IPv4 instance. | (Multiple IPv4 instances may use the same configuration container but will operate independently)
            reference TcpIpDhcpConfigRef [0..1]: multiplicity set at pre-compile, set at pre-compile, destination=TcpIpDhcpConfig  # Reference to DHCP configuration for this IPv4 instance. | (Multiple IPv4 instances may use the same configuration container but will operate independently)
            reference TcpIpFragmentationConfigRef [0..1]: multiplicity set at pre-compile, set at pre-compile, destination=TcpIpIpFragmentationConfig  # Reference to Fragmentation configuration for this IPv4 instance. | (Multiple IPv4 instances may use the same configuration container but will operate independently)
            container TcpIpIpV4MtuConfig  # This container specifies the Maximum Transmission Unit parameters for this IPv4 instance.
              boolean TcpIpIpV4PathMtuEnabled: set at pre-compile, default-value=false  # If enabled the IPv4 processes incoming ICMPv4 "Packet Too Big" messages and stores a MTU value for each destination address.
              float TcpIpIpV4PathMtuTimeout: 1..86400, set at pre-compile, default-value=600  # If this value is >0 the IpV4 will reset the MTU value stored for each destination after n seconds. | see [RFC1191 6.3. Purging stale PMTU information] Default: 600 seconds (10 minutes)
          container TcpIpIpV6Ctrl [0..1]  # Specifies an Internet Protocol version 6 (IPv6) instance.
            reference TcpIpIpV6DhcpConfigRef [0..1]: multiplicity set at pre-compile, set at pre-compile, destination=TcpIpDhcpV6Config  # Reference to DHCPv6 configuration. | (Multiple IPv6 instances may use the same configuration container but will operate independently)
            reference TcpIpIpV6FragmentationConfigRef [0..1]: multiplicity set at pre-compile, set at pre-compile, destination=TcpIpIpV6FragmentationConfig  # Reference to IPv6 Fragmentation Configuration. | (Multiple IPv6 instances may use the same configuration container but will operate independently)
            reference TcpIpIpV6NdpConfigRef: set at pre-compile, destination=TcpIpNdpConfig  # Reference to Neighbor Discovery Protocol Configuration. | (Multiple IPv6 instances may use the same configuration container but will operate independently)
            container TcpIpIpV6MtuConfig  # This container specifies the Maximum Transmission Unit parameters for this IPv6 instance.
              boolean TcpIpIpV6PathMtuEnabled: set at pre-compile, default-value=false  # If enabled the IPv6 processes incoming ICMPv6 "Packet Too Big" messages and stores a MTU value for each destination address. | See RFC1981 "Path MTU Discovery for IP version 6" for details about PathMTU.
              float TcpIpIpV6PathMtuTimeout: 1..86400, set at pre-compile, default-value=600  # If this value is >0 the IpV6 will reset the MTU value stored for each destination after n seconds. | see [RFC1981 5.3. Purging stale PMTU information] Default: 600 seconds (10 minutes)
      container TcpIpDhcpServerConfig [0..*]: multiplicity set at link in variant link-time / post-build in variant post-build / pre-compile in variant pre-compile, post-build-variant-multiplicity=true  # Specifies the configuration parameters of the DHCP Server sub-module.
        string TcpIpDhcpDefaultRouter [0..1]: multiplicity set at link in variant link-time / post-build in variant post-build / pre-compile in variant pre-compile, post-build-variant-multiplicity=true, post-build-variant-value=true, set at link in variant link-time / post-build in variant post-build / pre-compile in variant pre-compile  # IP address of default router (gateway).
        integer TcpIpDhcpNetmask [0..1]: 0..128, multiplicity set at link in variant link-time / post-build in variant post-build / pre-compile in variant pre-compile, post-build-variant-multiplicity=true, post-build-variant-value=true, set at link in variant link-time / post-build in variant post-build / pre-compile in variant pre-compile  # Network mask of IPv4 address or address prefix of IPv6 address in CIDR Notation, i.e. decimal value between 0 and 32 (IPv4) or 0 and 128 (IPv6) that describes the number of significant bits defining the network number or prefix of an IP address.
        reference TcpIpDhcpEthIfSwitchRef [0..1]: scope=ECU, multiplicity set at link in variant link-time / post-build in variant post-build / pre-compile in variant pre-compile, post-build-variant-multiplicity=true, post-build-variant-value=true, set at link in variant link-time / post-build in variant post-build / pre-compile in variant pre-compile, requires-symbolic-name-value=true, destination=EthIfSwitch  # Reference to EthIfSwitch representation. | Optional in case the Dhcp server is operating without an Ethernet switch.
        container TcpIpDhcpAddressAssignment [0..*]: multiplicity set at link in variant link-time / post-build in variant post-build / pre-compile in variant pre-compile, post-build-variant-multiplicity=true  # Defines a Ethernet Switch port based IP address assignment.
          string TcpIpDhcpAddressLowerBound: post-build-variant-value=true, set at link in variant link-time / post-build in variant post-build / pre-compile in variant pre-compile  # The lower bound IP address which shall be assigned. | If lower bound and upper bound are identical exactly this IP address shall be assigned.
          string TcpIpDhcpAddressUpperBound: post-build-variant-value=true, set at link in variant link-time / post-build in variant post-build / pre-compile in variant pre-compile  # The upper bound IP address which shall be assigned. | If lower bound and upper bound are identical exactly this IP address shall be assigned.
          reference TcpIpDhcpSwitchPortRef [0..1]: scope=ECU, multiplicity set at link in variant link-time / post-build in variant post-build / pre-compile in variant pre-compile, post-build-variant-multiplicity=true, post-build-variant-value=true, set at link in variant link-time / post-build in variant post-build / pre-compile in variant pre-compile, requires-symbolic-name-value=true, destination=EthSwtPort  # Reference to Ethernet Switch port. | Optional in case the Dhcp server is operating without an Ethernet switch.
      container TcpIpDuplicateAddressDetectionConfig [0..1]  # Specifies the DAD callout function.
        function name TcpIpDuplicateAddressDetectionCalloutName: set at pre-compile  # This parameter defines the name of the DAD callout function <Up_DADAddressConflict>.
      container TcpIpIpConfig [0..1]  # Specifies the configuration parameters of the IP (Internet Protocol) sub-module
        container TcpIpIpV4Config [0..1]  # Specifies the configuration parameters of the IPv4 (Internet Protocol version 4) sub-module.
          container TcpIpArpConfig [0..*]  # Specifies the configuration parameters of the ARP (Address Resolution Protocol) sub-module.
            boolean TcpIpArpDefensiveProcessing [0..1]: multiplicity set at pre-compile, set at pre-compile, default-value=false  # If enabled the ARP shall only process ARP replies which are received in reaction to a previously transmitted ARP request as well as skipping updates to the ARP table based on received Gratuitous ARP packets. If disabled all ARP packets shall be processed as specified in IETF RFC 826.
            integer TcpIpArpNumGratuitousARPonStartup: 0..255, post-build-variant-value=true, set at link in variant link-time / post-build in variant post-build / pre-compile in variant pre-compile  # Specifies the number of gratuitous ARP replies which shall be sent on assignment of a new IP address.
            boolean TcpIpArpPacketQueueEnabled: set at pre-compile, default-value=false  # Enables (TRUE) or disables (FALSE) support of the ARP Packet Queue according to IETF RFC 1122, section 2.3.2.2.
            float TcpIpArpRequestTimeout: 0..INF, post-build-variant-value=true, set at link in variant link-time / post-build in variant post-build / pre-compile in variant pre-compile, default-value=1  # Specifies a timeout in seconds for the validity of ARP requests. After the transmission of an ARP request the TcpIp shall skip the transmission of any further ARP requests to the same destination within a duration of TcpIpArpRequestTimeout seconds. (IETF RFC 1122, section 2.3.2.1) The value for this parameter shall be an integral multiple of TcpIpMainFunctionPeriod or 0. If this parameter set to 0 this features is disabled and no delay between ARP requests is enforced.
            float TcpIpArpTableEntryTimeout: 0..INF, post-build-variant-value=true, set at link in variant link-time / post-build in variant post-build / pre-compile in variant pre-compile  # Timeout in seconds after which an unused ARP entry is removed.
            integer TcpIpArpTableSizeMax: 0..65535, set at pre-compile  # Maximum number of entries in the ARP table.
          container TcpIpAutoIpConfig [0..*]  # Specifies the configuration parameters of the Auto-IP (automatic private IP addressing) sub-module.
            float TcpIpAutoIpInitTimeout: 0..INF, post-build-variant-value=true, set at link in variant link-time / post-build in variant post-build / pre-compile in variant pre-compile  # The time in seconds Auto-IP waits at startup, before beginning with ARP probing. This delay is used to give DHCP time to acquire a lease in case a DHCP server is present.
          container TcpIpDhcpConfig [0..*]  # Specifies the configuration parameters of the DHCPv4. | This container may be referenced by multiple IPv4 instances if they shall use the same configuration. This container may have multiple instances if different configurations are required for different IPv4 instances.
          container TcpIpIcmpConfig [0..1]  # Specifies the configuration parameters of the ICMP (Internet Control Message Protocol) sub-module.
            boolean TcpIpIcmpEchoReplyEnabled: set at pre-compile, default-value=false  # Enables or disables transmission of ICMP echo reply message in case of a ICMP echo reception.
            integer TcpIpIcmpTtl: 1..255, post-build-variant-value=true, set at link in variant link-time / post-build in variant post-build / pre-compile in variant pre-compile  # Default Time-to-live value of outgoing ICMP packets.
            container TcpIpIcmpMsgHandler [0..1]  # This container is a subcontainer of TcpIpIcmpConfig and specifies the configuration parameters for the ICMP message handler.
              function name TcpIpIcmpMsgHandlerName: set at link in variant link-time+post-build / pre-compile in variant pre-compile  # This parameter defines the name of the ICMP message handler function <Up_IcmpMsgHandler>.
          container TcpIpIpFragmentationConfig [0..*]  # Specifies the configuration parameters of IPv4 packet fragmentation/reassembly. | This container may be referenced by multiple IPv4 instances if they shall use the same configuration. This container may have multiple instances if different configurations are required for different IPv4 instances.
            boolean TcpIpIpFragmentationRxEnabled: set at pre-compile, default-value=false  # Enables (TRUE) or disables (FALSE) support for reassembling of incoming datagrams that are fragmented according to IETF RFC 815 (IP Datagram Reassembly Algorithms).
            integer TcpIpIpNumFragments [0..1]: 0..255, multiplicity set at link in variant link-time / post-build in variant post-build / pre-compile in variant pre-compile, post-build-variant-multiplicity=true, post-build-variant-value=true, set at link in variant link-time / post-build in variant post-build / pre-compile in variant pre-compile, default-value=0  # Specifies the maximum number of IP fragments per datagram. | Note: this parameter is only relevant if TcpIpIpFragmentationRxEnabled is TRUE.
            integer TcpIpIpNumReassDgrams [0..1]: 0..65535, multiplicity set at link in variant link-time / post-build in variant post-build / pre-compile in variant pre-compile, post-build-variant-multiplicity=true, post-build-variant-value=true, set at link in variant link-time / post-build in variant post-build / pre-compile in variant pre-compile, default-value=3  # Specifies the maximum number of fragmented IP datagrams that can be reassembled in parallel. | Note: this parameter is only relevant if TcpIpIpFragmentationRxEnabled is TRUE.
            float TcpIpIpReassTimeout [0..1]: 0..INF, multiplicity set at link in variant link-time / post-build in variant post-build / pre-compile in variant pre-compile, post-build-variant-multiplicity=true, post-build-variant-value=true, set at link in variant link-time / post-build in variant post-build / pre-compile in variant pre-compile, default-value=60  # Specifies the timeout in [s] after which an incomplete datagram gets discarded. | Note: this parameter is only relevant if TcpIpIpFragmentationRxEnabled is TRUE.
        container TcpIpIpV6Config [0..1]  # Specifies the configuration parameters of the IPv6 (Internet Protocol version 6) sub-module.
          container TcpIpDhcpV6Config [0..*]  # Specifies the configuration parameters of the DHCPv6. | This container may be referenced by multiple IPv6 instances if they shall use the same configuration. This container may have multiple instances if different configurations are required for different IPv6 instances.
            float TcpIpDhcpV6CnfDelayMax: 0..100, set at pre-compile, default-value=1  # Maximum delay (s) before sending the first Confirm message. If this value is bigger than the previous minimum delay value a random delay will be chosen from the interval.
            float TcpIpDhcpV6CnfDelayMin: 0..100, set at pre-compile, default-value=0  # Minimum delay (s) before the first Confirm message will be sent.
            float TcpIpDhcpV6InfDelayMax: 0..100, set at pre-compile, default-value=1  # Maximum delay (s) before sending the first Information Request message. If this value is bigger than the previous minimum delay value a random delay will be chosen from the interval.
            float TcpIpDhcpV6InfDelayMin: 0..100, set at pre-compile, default-value=0  # Minimum delay (s) before the first Information Request message will be sent.
            float TcpIpDhcpV6SolDelayMax: 0..100, set at pre-compile, default-value=1  # Maximum delay (s) before sending the first Solicit message. If this value is bigger than the previous minimum delay value a random delay will be chosen from the interval.
            float TcpIpDhcpV6SolDelayMin: 0..100, set at pre-compile, default-value=0  # Minimum delay (s) before the first Solicit message will be sent.
          container TcpIpIcmpV6Config  # Specifies the configuration parameters of the ICMPv6 (Internet Control Message Protocol for IPv6) sub-module.
            boolean TcpIpIcmpV6EchoReplyAvoidFragmentation: set at pre-compile, default-value=false  # If enabled, the stack will respond only to incoming ICMPv6 Echo Requests (Pings) that fit the MTU of the respective interface, i.e. can be transmitted without IPv6 fragmentation. Only relevant if TcpIpIcmpV6EchoReplyEnabled is enabled.
            boolean TcpIpIcmpV6EchoReplyEnabled: set at pre-compile, default-value=false  # If enabled, the stack will respond to incoming ICMPv6 Echo Requests (Pings).
            integer TcpIpIcmpV6HopLimit: 1..255, post-build-variant-value=true, set at link in variant link-time / post-build in variant post-build / pre-compile in variant pre-compile  # Default Hop-Limit value of outgoing ICMPv6 packets.
            boolean TcpIpIcmpV6MsgDestinationUnreachableEnabled: set at pre-compile  # Dis/Enables transmission of Destination Unreachable Messages
            boolean TcpIpIcmpV6MsgParameterProblemEnabled: set at pre-compile, default-value=true  # If enabled an ICMPv6 parameter problem message will be sent if a received packet has been dropped due to unknown options or headers that are found in the packet. | [RFC8200 4. IPv6 Extension Headers]
            container TcpIpIcmpV6MsgHandler [0..1]  # This container is a subcontainer of TcpIpIcmpConfig and specifies the configuration parameters for the ICMPv6 message handler.
              function name TcpIpIcmpV6MsgHandlerName: set at link in variant link-time+post-build / pre-compile in variant pre-compile  # This parameter defines the name of the ICMP message handler function <Up_IcmpMsgHandler>.
          container TcpIpIpV6ConfigExtHeaderFilter [0..*]  # This container describes the white list for the filtering of IPv6 extension headers, i.e. frames containing IPv6 extension headers not listed here shall be silently dropped.
            integer TcpIpIpV6ConfigExtHeaderFilterEntry [1..*]: 0..255, set at pre-compile  # IPv6 Extension Header type allowed by this filter.
          container TcpIpIpV6FragmentationConfig [0..*]  # Specifies the configuration parameters of IPv6 packet fragmentation/reassembly. | This container may be referenced by multiple IPv6 instances if they shall use the same configuration. This container may have multiple instances if different configurations are required for different IPv6 instances.
            integer TcpIpIpV6ReassemblyBufferCount: 0..255, set at pre-compile, default-value=255  # Number of buffers that can be used for fragment reassembly. In case of a reassembly error or if not all fragments are received in time this buffer will be blocked until the specified "Fragment Reassembly Timeout" has been exceeded. | A value of 0 disables fragment reassembly. [RFC8200 5. Packet Size Issues] "In order to send a packet larger than a path's MTU, a node may use the IPv6 Fragment header to fragment the packet at the source and have it reassembled at the destination(s). However, the use of such fragmentation is discouraged in any application that is able to adjust its packets to fit the measured path MTU (i.e., down to 1280 octets)."
            integer TcpIpIpV6ReassemblyBufferSize [0..1]: 1500..65535, multiplicity set at pre-compile, set at pre-compile, default-value=1500  # [RFC8200 5. Packet Size Issues] | "A node must be able to accept a fragmented packet that, after reassembly, is as large as 1500 octets. A node is permitted to accept fragmented packets that reassemble to more than 1500 octets."the measured path MTU (i.e., down to 1280 octets)."
            integer TcpIpIpV6ReassemblySegmentCount [0..1]: 1..255, multiplicity set at pre-compile, set at pre-compile, default-value=5  # Specifies the maximum number of consecutive data segments that can be managed in each reassembly buffer. If all fragments are received in order, only one segment will be needed. | To deal with fragments received out of order this value should be configured bigger than 1.
            float TcpIpIpV6ReassemblyTimeout [0..1]: 0.001..100, multiplicity set at pre-compile, set at pre-compile, default-value=60  # [RFC8200 4.5 Fragment Header] | Default: 60 seconds
            integer TcpIpIpV6TxFragmentBufferCount: 1..1000, set at pre-compile, default-value=2  # These buffers will be used if the IpV6 receives packets from the upper layer that do not fit into the MTU and thus must be fragmented. | A value of 0 disables tx fragmentation. If the upper layer transmits packets that do not fit into the link or path MTU, the IpV6 will split-up the packet into fragments. see "Enable Fragment Reassembly"
            integer TcpIpIpV6TxFragmentBufferSize [0..1]: 1500..65535, multiplicity set at pre-compile, set at pre-compile, default-value=1500  # Size of each fragment tx buffer in bytes
          container TcpIpNdpConfig [0..*]  # Specifies the configuration parameters of the Neighbor Discovery Protocol for IPv6 | This container may be referenced by multiple IPv6 instances if they shall use the same configuration. This container may have multiple instances if different configurations are required for different IPv6 instances.
            container TcpIpNdpArNudConfig [0..1]  # Specifies the configuration parameters for NDP Address Resolution and Neighbor Unreachability Detection.
              float TcpIpNdpDefaultReachableTime: 0..120, set at pre-compile, default-value=30  # Configuration of the ReachableTime (s) specified in [RFC4861 6.3.2. Host Variables]. | "The time a neighbor is considered reachable after receiving a reachability confirmation." If "TcpIpNdpDynamicReachableTimeEnabled" is checked, this value may be reconfigured based on received Router Advertisements. Default: REACHABLE_TIME = 30 seconds
              float TcpIpNdpDefaultRetransTimer: 0..60, set at pre-compile, default-value=1  # Configures the default value (s) for the RetransTimer variable specified in [RFC4861 6.3.2. Host Variables]. | "The time between retransmissions of Neighbor Solicitation messages to a neighbor when resolving the address or when probing the reachability of a neighbor." If "TcpIpNdpDynamicRetransTimeEnabled" is checked, this value may be reconfigured based on received Router Advertisements. Default: RETRANS_TIMER = 1 second
              boolean TcpIpNdpDefensiveProcessing: set at pre-compile, default-value=false  # If enabled the NDP shall only process Neighbor Advertisements which are received in reaction to a previously transmitted Neighbor Solicitation as well as skipping updates to the Neighbor Cache based on received Neighbor Solicitations. If disabled all Neighbor Advertisements and Solicitations shall be processed as specified in RFC4861. | [RFC4861 7.2.5. Receipt of Neighbor Advertisements]
              float TcpIpNdpDelayFirstProbeTime: 0..60, set at pre-compile, default-value=5  # Delay before sending the first NUD probe in (s). | [RFC4861 7.3.3. Node Behavior] Default: DELAY_FIRST_PROBE_TIME = 5 seconds
              integer TcpIpNdpMaxNeighborCacheSize: 1..254, set at pre-compile, default-value=5  # Maximum number of entries in the neighbor cache. | [RFC4861 5.1. Conceptual Data Structures]
              integer TcpIpNdpMaxRandomFactor: 0..100, set at pre-compile, default-value=15  # Maximum random factor used for randomization | [RFC4861 10. Protocol Constants] Default: 15 (MAX_RANDOM_FACTOR = 1.5)
              integer TcpIpNdpMinRandomFactor: 0..100, set at pre-compile, default-value=5  # Minimum random factor used for randomization | [RFC4861 10. Protocol Constants] Default: 5 (MIN_RANDOM_FACTOR = 0.5)
              boolean TcpIpNdpNeighborUnreachabilityDetectionEnabled: set at pre-compile, default-value=true  # Neighbor Unreachability Detection is used to remove unused entries from the neighbor cache. This feature is a basic feature of NDP and should be turned on.
              integer TcpIpNdpNumMulticastSolicitations: 0..255, set at pre-compile, default-value=3  # Maximum number of multicast solicitations that will be sent when performing address resolution. | [RFC4861 7.2.2. Sending Neighbor Solicitations] Default: MAX_MULTICAST_SOLICIT = 3
              integer TcpIpNdpNumUnicastSolicitations: 0..255, set at pre-compile, default-value=3  # Maximum number of unicast solicitations that will be sent when performig Neighbor Unreachability Detection. | [RFC4861 7.3.3. Node Behavior] Default: MAX_UNICAST_SOLICIT = 3
              boolean TcpIpNdpPacketQueueEnabled: set at pre-compile, default-value=true  # Enables (TRUE) or disables (FALSE) support of a NDP Packet Queue according to IETF RFC 4861, section 7.2.2.
              boolean TcpIpNdpRandomReachableTimeEnabled: set at pre-compile, default-value=true  # If enabled the value of ReachableTime will be multiplied with a random value between MIN_RANDOM_FACTOR and MAX_RANDOM_FACTOR in order to prevent multiple nodes from transmitting at exactly the same time | [RFC4861 6.3.2. Host Variables / ReachableTime]
            container TcpIpNdpPrefixRouterDiscoveryConfig [0..1]  # Specifies the configuration parameters for NDP Prefix and Router Discovery.
              integer TcpIpNdpDefaultRouterListSize: 2..254, set at pre-compile, default-value=2  # Maximum number of default router entries. | [RFC4861 5.1. Conceptual Data Structures]
              integer TcpIpNdpDestinationCacheSize: 1..254, set at pre-compile, default-value=5  # Maximum number of entries in the destination cache. | [RFC4861 5.1. Conceptual Data Structures]
              boolean TcpIpNdpDynamicHopLimitEnabled: set at pre-compile, default-value=true  # If enabled the default hop limit may be reconfigured based on received Router Advertisements. | [RFC4861 6.3.4. Processing Received Router Advertisements]
              boolean TcpIpNdpDynamicMtuEnabled: set at pre-compile, default-value=false  # Allow dynamic reconfiguration of link MTU via Router Advertisements. | [RFC4861 4.6.4. MTU]
              boolean TcpIpNdpDynamicReachableTimeEnabled: set at pre-compile, default-value=true  # If enabled the default Reachable Time value may be reconfigured based on received Router Advertisements. | [RFC4861 6.3.4. Processing Received Router Advertisements] Default: Enabled
              boolean TcpIpNdpDynamicRetransTimeEnabled: set at pre-compile, default-value=true  # If enabled the default Retransmit Timer value may be reconfigured based on received Router Advertisements. | [RFC4861 6.3.4. Processing Received Router Advertisements] Default: Enabled
              float TcpIpNdpMaxRtrSolicitationDelay: 0.001..60, set at pre-compile, default-value=1  # Maximum delay before the first Router Solicitation will be sent after interface initialization in (s). | [RFC4861 6.3.7. Sending Router Solicitations] Default: MAX_RTR_SOLICITATION_DELAY = 1 second
              integer TcpIpNdpMaxRtrSolicitations: 0..255, set at pre-compile, default-value=3  # Maximum number of Router Solicitations that will be sent before the first Router Advertisement has been received. | 0 = No Router Solicitations will be sent. This has no impact on handling Router Advertisements. [RFC4861 6.3.7. Sending Router Solicitations] Default: MAX_RTR_SOLICITATIONS = 3 transmissions
              integer TcpIpNdpPrefixListSize: 1..254, set at pre-compile, default-value=5  # Maximum number of entries in the on-link prefix list. | [RFC4861 5.1. Conceptual Data Structures]
              boolean TcpIpNdpRndRtrSolicitationDelayEnabled: set at pre-compile, default-value=true  # If enabled the first router solicitation will be delayed randomly from [0...MAX_RTR_SOLICITATION_DELAY]. Otherwise the first router solicitation will be sent after exactly MAX_RTR_SOLICITATION_DELAY milliseconds. | [RFC4861 6.3.7. Sending Router Solicitations] Default: Enabled
              float TcpIpNdpRtrSolicitationInterval: 0.001..60, set at pre-compile, default-value=4  # Interval between consecutive Router Solicitations in (s). | [RFC4861 6.3.7. Sending Router Solicitations] Default: RTR_SOLICITATION_INTERVAL = 4 seconds
              container TcpIpNdpPrefixList [0..1]  # Specifies a list of prefixes to be treated as "on-link" according to IETF RFC 4861 Section 5.1.
                container TcpIpNdpPrefixListEntry [1..*]  # Single entry in the prefix list.
                  string TcpIpNdpPrefixListEntryPrefixAddress: set at pre-compile  # The prefix of an IP address. This prefix can be used for on-link determination.
                  integer TcpIpNdpPrefixListEntryPrefixLength: 0..128, set at pre-compile  # The number of leading bits in the Prefix that are valid.
            container TcpIpNdpSlaacConfig [0..1]  # Specifies the configuration parameters for StateLess Address AutoConfiguration.
              integer TcpIpNdpSlaacDadNumberOfTransmissions: 0..254, set at pre-compile, default-value=1  # Number of Neighbor Solicitations that have to be unanswered in order to set an autoconfigurated address to PREFERRED (usable) state. | [RFC4861 5.1. Node Configuration Variables] Default: DupAddrDetectTransmits = 1 Setting this value to 0 turns off DAD.
              float TcpIpNdpSlaacDadRetransmissionDelay: 0..10, set at pre-compile, default-value=1  # Sets the maximum value for the address configuration delay (s). | According to [RFC4861 5.4.2. Sending Neighbor Solicitation Messages] this value should be the same as MAX_RTR_SOLICITATION_DELAY. Default: MAX_RTR_SOLICITATION_DELAY = 1 second
              boolean TcpIpNdpSlaacDelayEnabled: set at pre-compile, default-value=false  # If enabled transmission of the first DAD Neighbor Solicitation will be delayed by a random value from [0...MAX_DAD_DELAY]. | "This serves to alleviate congestion when many nodes start up on the link at the same time, such as after a power failure, and may help to avoid race conditions when more than one node is trying to solicit for the same address at the same time." "The delay will avoid similar congestion when multiple nodes are going to configure addresses by receiving the same single multicast router advertisement." [RFC4861 5.4.2. Sending Neighbor Solicitation Messages] Default: True
              boolean TcpIpNdpSlaacOptimisticDadEnabled: set at pre-compile, default-value=false  # Enable Optimistic Duplicate Address Detection (DAD) according to RFC4429.
      container TcpIpIpSecConfigSet [0..*]  # Specifies the IPsec configuration.
        function name TcpIpIpSecAuditEventCalloutFunction [0..1]: multiplicity set at pre-compile, set at pre-compile  # This parameter specifies the name of a callout function that will be called for each auditable event.
        string TcpIpIpSecCalloutHeaderFile [0..1]: multiplicity set at pre-compile, set at pre-compile  # This parameter specifies the name of the header file containing the definition for the functions specified in TcpIpIpSecSpdCalloutFunction and TcpIpIpSecAuditEvent
        function name TcpIpIpSecSpdCalloutFunction [0..1]: multiplicity set at pre-compile, set at pre-compile  # This parameter specifies the name of a callout function that shall be called for each Rx/Tx messag, after the IPsec has processed all corresponding SPD entries and has determined the policy. The callout function allows it to override the applied policy.
        integer TcpIpRemoteDeviceNum: 1..18446744073709551615, set at pre-compile  # Amount of remote clients which will negotiate a Security Association (SA).
        container TcpIpEncryptionAlgorithm [0..*]: multiplicity set at pre-compile  # Container for configuration of supported encryption algorithm transforms. This container is used to configure supported algorithms for ESP. The transform algorithm must be configured in the Crypto module.
          enumeration TcpIpEncryptionTransformIdentifier: {TCPIP_IPSEC_TRANSFORM_ENCR_3DES, TCPIP_IPSEC_TRANSFORM_ENCR_3IDEA, TCPIP_IPSEC_TRANSFORM_ENCR_AES_CBC, TCPIP_IPSEC_TRANSFORM_ENCR_AES_CCM_12, TCPIP_IPSEC_TRANSFORM_ENCR_AES_CCM_16, TCPIP_IPSEC_TRANSFORM_ENCR_AES_CCM_8, TCPIP_IPSEC_TRANSFORM_ENCR_AES_CCM_8_IIV, TCPIP_IPSEC_TRANSFORM_ENCR_AES_CTR, TCPIP_IPSEC_TRANSFORM_ENCR_AES_GCM_12, TCPIP_IPSEC_TRANSFORM_ENCR_AES_GCM_16, TCPIP_IPSEC_TRANSFORM_ENCR_AES_GCM_16_IIV, TCPIP_IPSEC_TRANSFORM_ENCR_AES_GCM_8, TCPIP_IPSEC_TRANSFORM_ENCR_BLOWFISH, TCPIP_IPSEC_TRANSFORM_ENCR_CAMELLIA_CBC, TCPIP_IPSEC_TRANSFORM_ENCR_CAMELLIA_CCM_12, TCPIP_IPSEC_TRANSFORM_ENCR_CAMELLIA_CCM_16, TCPIP_IPSEC_TRANSFORM_ENCR_CAMELLIA_CCM_8, TCPIP_IPSEC_TRANSFORM_ENCR_CAMELLIA_CTR, TCPIP_IPSEC_TRANSFORM_ENCR_CAST, TCPIP_IPSEC_TRANSFORM_ENCR_CHACHA20_POLY1305, TCPIP_IPSEC_TRANSFORM_ENCR_CHACHA20_POLY1305_II, TCPIP_IPSEC_TRANSFORM_ENCR_DES, TCPIP_IPSEC_TRANSFORM_ENCR_DES_IV32, TCPIP_IPSEC_TRANSFORM_ENCR_DES_IV64, TCPIP_IPSEC_TRANSFORM_ENCR_IDEA, TCPIP_IPSEC_TRANSFORM_ENCR_NULL, TCPIP_IPSEC_TRANSFORM_ENCR_RC5}, set at pre-compile, default-value=TCPIP_IPSEC_TRANSFORM_ENCR_DES  # Encryption algorithm transform identifier. Parameter values are defined as per IETF RFC 7296 3.3.2
          container TcpIpEncryptionTransformJobPair [1..*]: multiplicity set at pre-compile  # Container for storing the CSM integrity transform job references for performing authentication. Valid for ESP and AH.At least one Integrity transform job pair needs to be configured for each Integrity Algorithm.
            reference TcpIpCsmDecryptJobRef: set at pre-compile, requires-symbolic-name-value=true, destination=CsmJob  # The referenced Csm job is used for the execution of the CsmMacVerify primitive needed for this transform. | Must be a valid decryption job of the parent type.
            reference TcpIpCsmEncryptJobRef: set at pre-compile, requires-symbolic-name-value=true, destination=CsmJob  # The referenced Csm job is used for the execution of the CsmMacGenerate primitive needed for this transform. | Must be a valid encryption job of the parent type.
        container TcpIpIntegrityAlgorithm [1..*]: multiplicity set at pre-compile  # Container for configuration of supported integrity algorithm transforms. This container is used to configure supported algorithms for AH. The transform algorithm must be configured in the Crypto module.
          enumeration TcpIpIntegrityTransformIdentifier: {TCPIP_IPSEC_TRANSFORM_AUTH_AES_128_GMAC, TCPIP_IPSEC_TRANSFORM_AUTH_AES_192_GMAC, TCPIP_IPSEC_TRANSFORM_AUTH_AES_256_GMAC, TCPIP_IPSEC_TRANSFORM_AUTH_AES_CMAC_96, TCPIP_IPSEC_TRANSFORM_AUTH_AES_XCBC_96, TCPIP_IPSEC_TRANSFORM_AUTH_DES_MAC, TCPIP_IPSEC_TRANSFORM_AUTH_HMAC_MD5_128, TCPIP_IPSEC_TRANSFORM_AUTH_HMAC_MD5_96, TCPIP_IPSEC_TRANSFORM_AUTH_HMAC_SHA1_160, TCPIP_IPSEC_TRANSFORM_AUTH_HMAC_SHA1_96, TCPIP_IPSEC_TRANSFORM_AUTH_HMAC_SHA2_256_128, TCPIP_IPSEC_TRANSFORM_AUTH_HMAC_SHA2_384_192, TCPIP_IPSEC_TRANSFORM_AUTH_HMAC_SHA2_512_256, TCPIP_IPSEC_TRANSFORM_AUTH_KPDK_MD5}, set at pre-compile, default-value=TCPIP_IPSEC_TRANSFORM_AUTH_HMAC_SHA2_256_128  # Integrity algorithm transform identifier. Parameter values are defined as per IETF RFC 7296 3.3.2
          container TcpIpIntegrityTransformJobPair [1..*]: multiplicity set at pre-compile  # Container for storing the CSM integrity transform job references for performing authentication. Valid for ESP and AH.At least one Integrity transform job pair needs to be configured for each Integrity Algorithm.
            reference TcpIpCsmGenerateJobRef: set at pre-compile, requires-symbolic-name-value=true, destination=CsmJob  # The referenced Csm job is used for the execution of the CsmMacGenerate primitive needed for this transform. | Must be a valid MAC generate job of the parent type.
            reference TcpIpCsmVerifyJobRef: set at pre-compile, requires-symbolic-name-value=true, destination=CsmJob  # The referenced Csm job is used for the execution of the CsmMacVerify primitive needed for this transform. | Must be a valid MAC verify job of the parent type.
        container TcpIpSpdEntry [1..*]: multiplicity set at pre-compile  # Entry of the Security Policy Database (SPD).
          enumeration TcpIpIpSecHeaderType: {TCPIP_IPSEC_HDR_AH, TCPIP_IPSEC_HDR_ESP, TCPIP_IPSEC_HDR_NONE}, set at pre-compile, default-value=TCPIP_IPSEC_HDR_AH  # Header type specifying the IPsec security mechanism.
          enumeration TcpIpIpSecPolicy: {TCPIP_IPSEC_POLICY_BYPASS, TCPIP_IPSEC_POLICY_DISCARD, TCPIP_IPSEC_POLICY_OPTIONAL, TCPIP_IPSEC_POLICY_PROTECT}, set at pre-compile  # Policy for usage of IPsec.
          integer TcpIpIpSecPriority: 0..18446744073709551615, default-value=0  # Priority of the SPD entry. The processing of entries is based on priority, starting with the highest priority "0". The first matching SPD entry defines the policy.
          string TcpIpLocalIpAddrEnd [0..1]: multiplicity set at pre-compile, set at pre-compile  # End value of the remote IP address range.
          string TcpIpLocalIpAddrStart [0..1]: multiplicity set at pre-compile, set at pre-compile  # Start value of the local IP address range.
          integer TcpIpLocalPortRangeEnd [0..1]: 1..65535, multiplicity set at pre-compile, set at pre-compile  # End value of the local port range.
          integer TcpIpLocalPortRangeStart [0..1]: 1..65535, multiplicity set at pre-compile, set at pre-compile  # Start value of the local port range.
          enumeration TcpIpProtocol: {TCPIP_PROTOCOL_ANY, TCPIP_PROTOCOL_ICMP, TCPIP_PROTOCOL_TCP, TCPIP_PROTOCOL_UDP}, set at pre-compile  # Relevant IP protocol. | Note: As specified in IETF Rfc 4301 section 6, ICMP error messages will always be BYPASSed. The policy for TCPIP_PROTOCOL_ICMP only applies to ICMP non-error messages. (Echo reply/response).
          string TcpIpRemIpAddrEnd [0..1]: multiplicity set at pre-compile, set at pre-compile  # End value of the remote IP address range.
          string TcpIpRemIpAddrStart [0..1]: multiplicity set at pre-compile, set at pre-compile  # Start value of the remote IP address range.
          integer TcpIpRemPortRangeEnd [0..1]: 1..65535, multiplicity set at pre-compile, set at pre-compile  # End value of the remote port range.
          integer TcpIpRemPortRangeStart [0..1]: 1..65535, multiplicity set at pre-compile, set at pre-compile  # Start value of the remote port range.
      container TcpIpLocalAddr [1..*]  # Specifies the local IP (Internet Protocol) addresses used for IP communication.
        enumeration TcpIpAddressType: {TCPIP_ANYCAST, TCPIP_MULTICAST, TCPIP_UNICAST}, post-build-variant-value=true, set at link in variant link-time / post-build in variant post-build / pre-compile in variant pre-compile  # Address type.
        integer TcpIpAddrId: 0..65535, scope=ECU, set at pre-compile, symbolic-name-value=true, with-auto=true  # IP address table identifier assigned by TCP/IP stack.
        enumeration TcpIpDomainType: {TCPIP_AF_INET, TCPIP_AF_INET6}, post-build-variant-value=true, set at link in variant link-time / post-build in variant post-build / pre-compile in variant pre-compile  # Address family.
        reference TcpIpCtrlRef: post-build-variant-value=true, set at link in variant link-time / post-build in variant post-build / pre-compile in variant pre-compile, destination=TcpIpCtrl  # Reference to a TcpIpCtrl specifying the EthIf Controller where the IP address shall be assigned.
        reference TcpIpLocalAddrIPv6ExtHeaderFilterRef [0..1]: multiplicity set at link in variant link-time / post-build in variant post-build / pre-compile in variant pre-compile, post-build-variant-multiplicity=true, post-build-variant-value=true, set at link in variant link-time / post-build in variant post-build / pre-compile in variant pre-compile, destination=TcpIpIpV6ConfigExtHeaderFilter  # Reference to a set of IPv6 Extension Headers which are allowed for this local IPv6 address. | Note: this parameter is only relevant if the related TcpIpDomainType is TCPIP_AF_INET6.
        container TcpIpAddrAssignment [1..*]  # This container is a subcontainer of TcpIpLocalAddr and specifies the assignment policy for the IP address.
          enumeration TcpIpAssignmentLifetime [0..1]: {TCPIP_FORGET, TCPIP_STORE}, post-build-variant-value=true, set at link in variant link-time / post-build in variant post-build / pre-compile in variant pre-compile, default-value=TCPIP_FORGET  # Defines the lifetime of a dynamically fetched IP address. | If TcpIpAssignmentMethod = TCPIP_STATIC then TcpIpAssignmentLifetime shall be omitted.
          enumeration TcpIpAssignmentMethod: {TCPIP_DHCP, TCPIP_IPV6_ROUTER, TCPIP_LINKLOCAL, TCPIP_LINKLOCAL_DOIP, TCPIP_STATIC}, post-build-variant-value=true, set at link in variant link-time / post-build in variant post-build / pre-compile in variant pre-compile  # Method of address assignment
          integer TcpIpAssignmentPriority: 1..4, post-build-variant-value=true, set at link in variant link-time / post-build in variant post-build / pre-compile in variant pre-compile  # Priority of assignment (1 is highest). If a new address from an assignment method with a higher priority is available, it overwrites the IP address previously assigned by an assignment method with a lower priority.
          enumeration TcpIpAssignmentTrigger: {TCPIP_AUTOMATIC, TCPIP_MANUAL}, post-build-variant-value=true, set at link in variant link-time / post-build in variant post-build / pre-compile in variant pre-compile  # Trigger of address assignment.
        container TcpIpStaticIpAddressConfig [0..1]  # This container is a subcontainer of TcpIpLocalAddr and specifies a static IP address including directly related parameters.
          string TcpIpDefaultRouter [0..1]: multiplicity set at link in variant link-time / post-build in variant post-build / pre-compile in variant pre-compile, post-build-variant-multiplicity=true, post-build-variant-value=true, set at link in variant link-time / post-build in variant post-build / pre-compile in variant pre-compile  # IP address of default router (gateway)
          integer TcpIpNetmask [0..1]: 0..128, multiplicity set at link in variant link-time / post-build in variant post-build / pre-compile in variant pre-compile, post-build-variant-multiplicity=true, post-build-variant-value=true, set at link in variant link-time / post-build in variant post-build / pre-compile in variant pre-compile  # Network mask of IPv4 address or address prefix of IPv6 address in CIDR Notation, i.e. decimal value between 0 and 32 (IPv4) or 0 and 128 (IPv6) that describes the number of significant bits defining the network number or prefix of an IP address.
          string TcpIpStaticIpAddress: post-build-variant-value=true, set at link in variant link-time / post-build in variant post-build / pre-compile in variant pre-compile  # Static IP Address. | To specify any IP address for a certain EthIfCtrl, "ANY" has to be set as wildcard. See TcpIp_Bind() for more details.
      container TcpIpNvmBlock [0..1]: multiplicity set at link in variant link-time+post-build / pre-compile in variant pre-compile  # Configuration of optional usage of Nvm in case the TcpIp module requires non volatile memory in the Ecu to store information (e.g. IP Address received via DHCP and shall be stored).
        reference TcpIpNvmBlockDescriptorRef: scope=ECU, set at link in variant link-time+post-build / pre-compile in variant pre-compile, requires-symbolic-name-value=true, destination=NvMBlockDescriptor  # Reference to the Nvm block description in the Nvm module configuration.
      container TcpIpPhysAddrConfig [0..1]  # Specifies the physical address configuration.
        container TcpIpPhysAddrChgHandler [0..1]  # This container is a subcontainer of TcpIpPhysAddrConfig and | specifies the configuration parameters for physical address change handler.
          function name TcpIpPhysAddrChgHandlerName: scope=ECU, set at pre-compile  # This parameter defines the name of the physical address change function <Up>_PhysAddrTableChg.
      container TcpIpSocketOwnerConfig  # Specifies the upper layer modules of TcpIp using the socket API.
        container TcpIpSocketOwner [1..*]  # This container is a subcontainer of TcpIpSocketOwnerConfig and specifies an upper layer of TcpIp that uses the socket API.
          string TcpIpSocketOwnerCopyTxDataName [0..1]: set at link in variant link-time+post-build / pre-compile in variant pre-compile  # This parameter defines the name of the <Up_CopyTxData> function of the TcpIpSocketOwner module. The function name shall only be configurable if TcpIpSocketOwnerUpperLayerType is set to CDD.
          string TcpIpSocketOwnerHeaderFileName [0..1]: set at link in variant link-time+post-build / pre-compile in variant pre-compile  # This parameter specifies the name of the header file containing the definition of the TcpIpSocketOwner module functions. The header file name shall only be configurable if TcpIpSocketOwnerUpperLayerType is set to CDD.
          integer TcpIpSocketOwnerId: 0..65535, set at pre-compile, symbolic-name-value=true, default-value=0  # This value specifies the ID of the socket user.
          string TcpIpSocketOwnerLocalIpAddrAssignmentChgName [0..1]: set at link in variant link-time+post-build / pre-compile in variant pre-compile  # This parameter defines the name of the <Up_LocalIpAddrAssignmentChg> function of the TcpIpSocketOwner module. The function name shall only be configurable if TcpIpSocketOwnerUpperLayerType is set to CDD.
          string TcpIpSocketOwnerRxIndicationName [0..1]: set at link in variant link-time+post-build / pre-compile in variant pre-compile  # This parameter defines the name of the <Up_RxIndication> function of the TcpIpSocketOwner module. The function name shall only be configurable if TcpIpSocketOwnerUpperLayerType is set to CDD.
          string TcpIpSocketOwnerTcpAcceptedName [0..1]: set at link in variant link-time+post-build / pre-compile in variant pre-compile  # This parameter defines the name of the <Up_TcpAccepted> function of the TcpIpSocketOwner module. The function name shall only be configurable if TcpIpSocketOwnerUpperLayerType is set to CDD.
          string TcpIpSocketOwnerTcpConnectedName [0..1]: set at link in variant link-time+post-build / pre-compile in variant pre-compile  # This parameter defines the name of the <Up_TcpConnected> function of the TcpIpSocketOwner module. The function name shall only be configurable if TcpIpSocketOwnerUpperLayerType is set to CDD.
          function name TcpIpSocketOwnerTcpIpEventName [0..1]: set at link in variant link-time+post-build / pre-compile in variant pre-compile  # This parameter defines the name of the <Up_TcpIpEvent> function of the TcpIpSocketOwner module. The function name shall only be configurable if TcpIpSocketOwnerUpperLayerType is set to CDD.
          string TcpIpSocketOwnerTxConfirmationName [0..1]: set at link in variant link-time+post-build / pre-compile in variant pre-compile  # This parameter defines the name of the <Up_TxConfirmation> function of the TcpIpSocketOwner module. The function name shall only be configurable if TcpIpSocketOwnerUpperLayerType is set to CDD.
          enumeration TcpIpSocketOwnerUpperLayerType: {CDD, SOAD}, post-build-variant-value=true, set at link in variant link-time+post-build / pre-compile in variant pre-compile  # This parameter specifies the type of the upper layer module.
      container TcpIpTcpConfig [0..1]  # Specifies the configuration parameters of the TCP (Transmission Control Protocol) sub-module.
        float TcpIpDelayedAckTimeout: 0..0.5, post-build-variant-value=true, set at link in variant link-time / post-build in variant post-build / pre-compile in variant pre-compile, default-value=0.5  # The maximal time an acknowledgment is delayed for transmission in seconds.For further details, see also IETF RfC 1122 section 4.2.3.2.
        boolean TcpIpTcpCongestionAvoidanceEnabled: set at pre-compile  # Enables (TRUE) or disables (FALSE) support of TCP congestion avoidance algorithm according to IETF RFC 5681.
        boolean TcpIpTcpFastRecoveryEnabled: set at pre-compile  # Enables (TRUE) or disables (FALSE) support of TCP Fast Recovery according to IETF RFC 5681.
        boolean TcpIpTcpFastRetransmitEnabled: set at pre-compile  # Enables (TRUE) or disables (FALSE) support of TCP Fast Retransmission according to IETF RFC 5681.
        float TcpIpTcpFinWait2Timeout: 0..INF, post-build-variant-value=true, set at link in variant link-time / post-build in variant post-build / pre-compile in variant pre-compile  # Timeout in [s] to receive a FIN from the remote node (after this node has initiated connection termination), i.e. maximum time waiting in FINWAIT-2 for a connection termination request from the remote TCP.
        boolean TcpIpTcpKeepAliveEnabled: set at pre-compile, default-value=false  # Enables (TRUE) or disables (FALSE) TCP Keep Alive Probes according to IETF RFC 1122 chapter 4.2.3.6
        float TcpIpTcpKeepAliveInterval: 0..INF, post-build-variant-value=true, set at link in variant link-time / post-build in variant post-build / pre-compile in variant pre-compile  # Specifies the interval in [s] between subsequent keepalive probes.
        integer TcpIpTcpKeepAliveProbesMax: 0..65535, post-build-variant-value=true, set at link in variant link-time / post-build in variant post-build / pre-compile in variant pre-compile  # Maximum number of times that a TCP Keep Alive is retransmitted before the connection is closed.
        float TcpIpTcpKeepAliveTime: 0..INF, post-build-variant-value=true, set at link in variant link-time / post-build in variant post-build / pre-compile in variant pre-compile, default-value=7200  # Specifies the time in [s] between the last data packet sent (simple ACKs are not considered data) and the first keepalive probe. Note: Setting this configuration parameter to a value smaller or equal to the value of TcpIpMainFunctionPeriod results in the transmission of keep alive probes within every MainFunction cycle.
        float TcpIpTcpMaxRetransmissionTimeout [0..1]: 0.001..INF, post-build-variant-value=true, set at link in variant link-time / post-build in variant post-build / pre-compile in variant pre-compile  # Maximum value (clamp) of clamped exponential backoff timeout in [s] before an unacknowledged TCP segment is sent again. If the timeout is disabled or set to INF, clamped exponential backoff shall not be used.
        integer TcpIpTcpMaxRtx [0..1]: 0..255, post-build-variant-value=true, set at link in variant link-time / post-build in variant post-build / pre-compile in variant pre-compile  # Maximum number of times that a TCP segment is retransmitted before the TCP connection is closed. This parameter is only valid if TcpIpTcpRetransmissionTimeout/TcpIpTcpMaxRetransmissionTimeout is configured. | Note: This parameter also applies for FIN retransmissions.
        float TcpIpTcpMsl: 0..INF, post-build-variant-value=true, set at link in variant link-time / post-build in variant post-build / pre-compile in variant pre-compile  # Maximum segment lifetime in [s]. | (Note: TIME-WAIT = 2 x TcpIpTcpMsl - to ensure that the remote node received the acknowledgment to its connection termination request.)
        boolean TcpIpTcpNagleEnabled: set at pre-compile  # Enables (TRUE) or disables (FALSE) support of Nagle's algorithm according to IETF RFC 1122 (chapter 4.2.3.4 When to Send Data). If enabled the Nagle's algorithm is activated per default for all TCP sockets, but can be deactivated via TcpIp_ChangeParameter() API.
        integer TcpIpTcpReceiveWindowMax: 0..65535, post-build-variant-value=true, set at link in variant link-time / post-build in variant post-build / pre-compile in variant pre-compile  # Default value of maximum receive window in bytes.
        float TcpIpTcpRetransmissionTimeout [0..1]: 0.001..INF, post-build-variant-value=true, set at link in variant link-time / post-build in variant post-build / pre-compile in variant pre-compile  # Timeout in [s] before an unacknowledged TCP segment is sent again. If the timeout is disabled or set to INF, no TCP segments shall be retransmitted. Value can be overwritten by TcpIp_ChangeParameter() API for a particular connection. If TcpIpTcpMaxRetransmissionTimeout is enabled then TcpIpTcpRetransmissionTimeout or value overwritten by TcpIp_ChangeParameter() API is considered as initial value for first retransmission before the next valid acknowledgment arrives.
        boolean TcpIpTcpSackEnabled: set at pre-compile  # Defines if the SACK (selective acknowledgement) mechanism shall be supported according to IETF RFC 2018. Tags: atp.Status=draft
        boolean TcpIpTcpSlowStartEnabled: set at pre-compile  # Enables (TRUE) or disables (FALSE) support of TCP slow start algorithm according to IETF RFC 5681.
        integer TcpIpTcpSynMaxRtx: 0..255, post-build-variant-value=true, set at link in variant link-time / post-build in variant post-build / pre-compile in variant pre-compile  # Maximum number of times that a TCP SYN is retransmitted. | Note: SYN will be retried after TcpIpTcpRetransmissionTimeout/TcpIpTcpMaxRetransmissionTimeout. The connection will be dropped if no matching connection request has been received after the last TCP SYN has been sent and TcpIpTcpRetransmissionTimeout/TcpIpTcpMaxRetransmissionTimeout has been expired.
        float TcpIpTcpSynReceivedTimeout: 0..INF, post-build-variant-value=true, set at link in variant link-time / post-build in variant post-build / pre-compile in variant pre-compile  # Timeout in [s] to complete a remotely initiated TCP connection establishment, i.e. maximum time waiting in SYN-RECEIVED for a confirming connection request acknowledgment after having both received and sent a connection request.
        integer TcpIpTcpTtl: 1..255, post-build-variant-value=true, set at link in variant link-time / post-build in variant post-build / pre-compile in variant pre-compile  # Default Time-to-live value of outgoing TCP packets.
        integer TcpIpTcpWindowScale: 0..14, set at pre-compile  # Defines the TCP window scale. Tags: atp.Status=draft
        boolean TcpIpTcpWindowScaleOptionEnabled: set at pre-compile, default-value=false  # Defines if the TCP window scale option and mechanism shall be supported according to IETF RFC 7323, chapter 2. Tags: atp.Status=draft
        container TcpIpTcpConfigOptionFilter [0..*]: multiplicity set at link in variant link-time / post-build in variant post-build / pre-compile in variant pre-compile, post-build-variant-multiplicity=true  # This container describes the white list for the filtering of TCP options, i.e. segments containing TCP options not listed here shall be silently dropped.
          integer TcpIpTcpConfigOptionFilterEntry [0..*]: 0..255, multiplicity set at link in variant link-time / post-build in variant post-build / pre-compile in variant pre-compile, post-build-variant-multiplicity=true, post-build-variant-value=true, set at link in variant link-time / post-build in variant post-build / pre-compile in variant pre-compile  # TCP option kind allowed by this filter.
          integer TcpIpTcpConfigOptionFilterId: 0..255, post-build-variant-value=true, set at link in variant link-time / post-build in variant post-build / pre-compile in variant pre-compile, symbolic-name-value=true, with-auto=true  # Identification of the TCP option filter.
      container TcpIpTlsConfig [0..1]  # Specifies the configuration parameters of the TLS (Transport Layer Security) sub module.
        integer TcpIpTlsMaxConnections: 1..65535, set at pre-compile  # Defines the max. number of TLS connections that can be opened at the same time.
        reference TcpIpTlsCsmRandomGenerateJobRef: set at pre-compile, requires-symbolic-name-value=true, destination=CsmJob  # Reference to a CSM job to generate a random value.
        container TcpIpTlsCiphersuites  # This container provides the information about supported ciphersuites used by TLS.
          function name TcpIpTlsRootCertUpdateCalloutFunction [0..1]: multiplicity set at pre-compile, set at pre-compile  # This optional parameter specifies the name of a callout function that is used when a new, valid, root certificate is received during a TLS handshake. Can be used to perform actions based on the received certificate. Tags: atp.Status=draft
          string TcpIpTlsRootCertUpdateCalloutHeaderFile [0..1]: multiplicity set at pre-compile, set at pre-compile  # This optional parameter specifies the name of the header file containing the definition for the function specified in TcpIpTlsRootCertUpdateCalloutFunction. Tags: atp.Status=draft
          container TcpIpTlsCertificateIdentity [1..*]  # This container provides information about the certificates used for ciphersuites.
            string TcpIpTlsServerNameIdentification [0..1]: multiplicity set at pre-compile, set at pre-compile  # Defines a server identification name. If present, the name will be added as an extension with the "TLS client hello" handshake message. The TLS server will check for the name to identify the server certificate.
            reference TcpIpTlsCipherKeyMLocalCertificate [0..1]: multiplicity set at pre-compile, set at pre-compile, requires-symbolic-name-value=true, destination=KeyMCertificate  # Reference to a KeyM certificate used to address the local certificate.
            reference TcpIpTlsCipherKeyMRemoteCertificate [0..1]: multiplicity set at pre-compile, set at pre-compile, requires-symbolic-name-value=true, destination=KeyMCertificate  # Reference to KeyM certificate container to reference the remote certificate.
            container TcpIpTlsTrustedCAList [0..1]: multiplicity set at pre-compile  # This container contains references to trusted CA certificates, whose names are sent in the client's ClientHello message, if *TcpIpTlsUseExtensionTrustedCAKeys* is set to TRUE. Tags: atp.Status=draft
              reference TcpIpTlsTrustedCAListEntry [0..*]: multiplicity set at pre-compile, set at pre-compile, requires-symbolic-name-value=true, destination=KeyMCertificate  # Reference to a KeyM certificate of a root CA. The list is sent by the TLS client in the Client Hello's trusted_ca_keys extension Tags: atp.Status=draft
          container TcpIpTlsCiphersuiteDefinition [1..*]  # This container provides the static information of a ciphersuite used by TLS.
            integer TcpIpTlsCiphersuiteId: 0..65535, set at pre-compile  # ID that represents the ciphersuite according to IETF, e.g. RFC4492, Sect. 6, RFC8446, Appendix B.4 or RFC5246, Appendix A.5.
            string TcpIpTlsCiphersuiteName [0..1]: set at pre-compile  # Provides a verbal name for the ciphersuite. The name should be the one defined in the respective RFC, e.g. TLS_ECDHE_ECDSA_WITH_AES_128_CBC_SHA256 (TLS 1.2) or TLS_AES_128_GCM_SHA256 (TLS 1.3)
            integer TcpIpTlsCiphersuitePriority: 1..65535, set at pre-compile  # Defines the priority of the cipher. The higher the number the lower the priority.
            boolean TcpIpTlsUseAEADCipher: set at pre-compile, default-value=false  # Specifies if the ciphersuite supports AEAD for data en-/decryption.
            boolean TcpIpTlsUsePresharedKeys: set at pre-compile, default-value=false  # Defines if this ciphersuite uses pre-shared keys. If so, additional configuration or callbacks will be used for pre-shared key negotiation.
            boolean TcpIpTlsUseSecurityExtensionForceEncryptThenMac: set at pre-compile, default-value=false  # Defines if the security extension according to IETF RFC 7366 shall be supported. This is useful for ciphersuites using CBC mode.
            enumeration TcpIpTlsVersion: {TLS_VERSION_V12, TLS_VERSION_V13}, set at pre-compile  # Declares the TLS version that this ciphersuite shall be used for.
          container TcpIpTlsCiphersuiteWorker [1..*]  # This container provides the jobs and keys necessary for TLS data transmission and reception.
            integer TcpIpTlsCipherAEADCipherKeyLength [0..1]: 1..65535, multiplicity set at pre-compile, set at pre-compile  # Defines the key length for en- / decryption with authentication data (AEAD).
            integer TcpIpTlsCipherEncryptKeyLength [0..1]: 1..65535, set at pre-compile  # Defines the key length used for en- or decryption. The key length is valid for (symmetric) encryption and decryption.
            integer TcpIpTlsCipherMacKeyLength [0..1]: 1..65535, set at pre-compile  # Specifies the length of the MAC key
            reference TcpIpTlsCipherCsmDecryptJobRef [0..1]: set at pre-compile, requires-symbolic-name-value=true, destination=CsmJob  # Reference to a CSM job to perform the data decryption operation
            reference TcpIpTlsCipherCsmDecryptKeyRef [0..1]: set at pre-compile, requires-symbolic-name-value=true, destination=CsmKey  # Reference to a CSM key associated to the CSM job that performs the data decryption operation
            reference TcpIpTlsCipherCsmEncryptJobRef [0..1]: set at pre-compile, requires-symbolic-name-value=true, destination=CsmJob  # Reference to a CSM job to perform the data encryption operation
            reference TcpIpTlsCipherCsmEncryptKeyRef [0..1]: set at pre-compile, requires-symbolic-name-value=true, destination=CsmKey  # Reference to a CSM key associated to the CSM job that performs the data encryption operation
            reference TcpIpTlsCipherCsmMacGenerateJobRef: set at pre-compile, requires-symbolic-name-value=true, destination=CsmJob  # Reference to a CSM job to perform the MAC generate operation
            reference TcpIpTlsCipherCsmMacGenerateKeyRef: set at pre-compile, requires-symbolic-name-value=true, destination=CsmKey  # Reference to a CSM key associated to the CSM job that performs the MAC generate operation
            reference TcpIpTlsCipherCsmMacVerifyJobRef: set at pre-compile, requires-symbolic-name-value=true, destination=CsmJob  # Reference to a CSM job to perform the MAC verify operation
            reference TcpIpTlsCipherCsmMacVerifyKeyRef: set at pre-compile, requires-symbolic-name-value=true, destination=CsmKey  # Reference to a CSM key associated to the CSM job that performs the MAC verify operation
            reference TcpIpTlsCiphersuiteDefinitionRef: set at pre-compile, destination=TcpIpTlsCiphersuiteDefinition  # Reference to a ciphersuite definition container
            reference TcpIpTlsConnectionHandshakeRef [1..*]: multiplicity set at pre-compile, set at pre-compile, destination=TcpIpTlsHandshake  # References the container that contains the jobs and keys for handshake operation. | Referencing multiple handshake containers allow to share them between workers and to choose the next unused during the handshake.
          container TcpIpTlsHandshake [1..*]  # This container provides information that is needed to process a handshake. It contains the appropriate references to jobs and keys of the CSM to perform the key exchange cryptographic for the ciphersuite and involved certificates.
            enumeration TcpIpTlsCsmPRFSupportType [0..1]: {TLS_PRF_CSM_FULL_SUPPORT, TLS_PRF_CSM_INOUT_REDIRECT_SUPPORT, TLS_PRF_CSM_NO_SUPPORT, TLS_PRF_NO_SUPPORT}, multiplicity set at pre-compile, set at pre-compile  # Specifies how the CSM job supports the PRF operation.
            reference TcpIpTlsCsmHashVerifyJobRef: set at pre-compile, requires-symbolic-name-value=true, destination=CsmJob  # Reference to a CSM job to perform the hash operation for the whole handshake.
            reference TcpIpTlsCsmKeyExchangeCalcPubValJobRef [0..1]: multiplicity set at pre-compile, set at pre-compile, requires-symbolic-name-value=true, destination=CsmJob  # Reference to a CSM job to perform the DH Key Exchange algorithm operation
            reference TcpIpTlsCsmKeyExchangeCalcSecretJobRef [0..1]: multiplicity set at pre-compile, set at pre-compile, requires-symbolic-name-value=true, destination=CsmJob  # Reference to a CSM job to perform the Key Exchange algorithm operation
            reference TcpIpTlsCsmKeyExchangeDecryptJobRef [0..1]: multiplicity set at pre-compile, set at pre-compile, requires-symbolic-name-value=true, destination=CsmJob  # Reference to a CSM job to perform data decryption, e.g. with RSA key exchange operation.
            reference TcpIpTlsCsmKeyExchangeDecryptKeyRef [0..1]: multiplicity set at pre-compile, set at pre-compile, requires-symbolic-name-value=true, destination=CsmKey  # Reference to a CSM key to perform data decryption, e.g. with RSA, used for exchange operation.
            reference TcpIpTlsCsmKeyExchangeEncryptJobRef [0..1]: multiplicity set at pre-compile, set at pre-compile, requires-symbolic-name-value=true, destination=CsmJob  # Reference to a CSM job to perform data encryption, e.g. with RSA key exchange operation.
            reference TcpIpTlsCsmKeyExchangeEncryptKeyRef [0..1]: multiplicity set at pre-compile, set at pre-compile, requires-symbolic-name-value=true, destination=CsmKey  # Reference to a CSM key to perform data encryption, e.g. with RSA, used for exchange operation.
            reference TcpIpTlsCsmKeyExchangeKeyRef [0..1]: multiplicity set at pre-compile, set at pre-compile, requires-symbolic-name-value=true, destination=CsmKey  # Reference to a CSM key used for Diffie Hellman (DH) key exchange operation.
            reference TcpIpTlsCsmKeyExchangeSignatureGenerateJobRef [0..1]: multiplicity set at pre-compile, set at pre-compile, requires-symbolic-name-value=true, destination=CsmJob  # Reference to a CSM job to perform signature generation for DH operation
            reference TcpIpTlsCsmKeyExchangeSignatureGenerateKeyRef [0..1]: multiplicity set at pre-compile, set at pre-compile, requires-symbolic-name-value=true, destination=CsmKey  # Reference to a CSM key to perform signature generation for DH operation
            reference TcpIpTlsCsmKeyExchangeSignatureVerifyJobRef [0..1]: multiplicity set at pre-compile, set at pre-compile, requires-symbolic-name-value=true, destination=CsmJob  # Reference to a CSM job to perform signature verification for DH operation
            reference TcpIpTlsCsmKeyExchangeSignatureVerifyKeyRef [0..1]: multiplicity set at pre-compile, set at pre-compile, requires-symbolic-name-value=true, destination=CsmKey  # Reference to a CSM key to perform signature verification for DH operation
            reference TcpIpTlsCsmMasterSecretKeyRef [0..1]: multiplicity set at pre-compile, set at pre-compile, requires-symbolic-name-value=true, destination=CsmKey  # This is the reference to the master key that is calculated during the session.
            reference TcpIpTlsCsmPrfMacJobRef: set at pre-compile, requires-symbolic-name-value=true, destination=CsmJob  # Reference to a CSM job to perform the PRF hash operation
            reference TcpIpTlsCsmPrfMacKeyRef: set at pre-compile, requires-symbolic-name-value=true, destination=CsmKey  # Reference to a CSM key associated to the CSM job that performs the PRF hash operation
          container TcpIpTlsPskIdentity [0..*]  # This container provides information about static definition of pre-shared keys. It is used during the handshake to negotiate pre-shared keys between a client and a server. | Note: The callbacks for pre-shared keys are an alternative to the static definition. The callbacks allow to define the associated keys at runtime if pre-shared keys are used but no static definition is available. The container definition is used for static configuration.
            string TcpIpTlsPresharedKeyIdentity [0..1]: multiplicity set at pre-compile, set at pre-compile  # This item provides the key identification. The TLS client selects the pre-shared key based on the identification hint provided by the server and returns the key identification name back to the server.
            string TcpIpTlsPresharedKeyIdentityHint [0..1]: multiplicity set at pre-compile, set at pre-compile  # Provides the identity hint for a pre-shared key. This information is transmitted by the TLS Server to provide its identification to the TLS client. | The TLS client uses the same information to select the pre-shared key.
            function name TcpIpTlsPskGetClientKeyIdentityFunc [0..1]: multiplicity set at pre-compile, set at pre-compile  # Defines the function name for the Up_TlsClientGetPskIdentity() callback.
            function name TcpIpTlsPskGetKeyIdentityHintFunc [0..1]: multiplicity set at pre-compile, set at pre-compile  # Defines the function name for the Up_TlsServerGetPskIdentityHint() callback.
            function name TcpIpTlsPskGetServerKeyIdentityFunc [0..1]: multiplicity set at pre-compile, set at pre-compile  # Defines the function name for the Up_TlsServerGetPskIdentity () callback.
            reference TcpIpTlsPresharedKeyCsmKeyRef [0..1]: multiplicity set at pre-compile, set at pre-compile, requires-symbolic-name-value=true, destination=CsmKey  # Reference to a CSM key associated to the CSM job that performs the PRF hash operation
        container TcpIpTlsConnection [1..*]  # This container defines the properties of a TLS connection
          function name TcpIpTlsConnectionGetTimeFunc [0..1]: multiplicity set at pre-compile, set at pre-compile  # Defines the function name for the Up_TlsGetCurrentTimeStamp() callback.
          integer TcpIpTlsConnectionId: 0..65535, set at pre-compile, symbolic-name-value=true  # Identifier of the connection. The set of configured identifiers shall be consecutive and gapless.
          enumeration TcpIpTlsConnectionType: {TLS_CLIENT, TLS_SERVER}, set at pre-compile  # Specifies if the TLS connection is a server or a client.
          integer TcpIpTlsMaxFragmentLength: 1..16384, set at pre-compile  # Specifies the max length in bytes of a TLS fragment that is sent as a block. | If ISO 15118-2 shall be supported, the range is 512 .. 16384.
          integer TcpIpTlsPortAssignment [0..1]: 1..65535, multiplicity set at pre-compile, set at pre-compile  # Specifies the port address that is used for TLS communication.
          boolean TcpIpTlsUseClientAuthenticationRequest [0..1]: multiplicity set at pre-compile, set at pre-compile, default-value=false  # Defines if client authentication shall be applied for this TLS connection.
          boolean TcpIpTlsUseExtensionCertificateStatusRequest: set at pre-compile, default-value=false  # Defines if the optional extension status_request_v2 shall be supported. Tags: atp.Status=draft
          boolean TcpIpTlsUseExtensionMaxFragmentLength: set at pre-compile, default-value=false  # Defines if the optional extension for max_fragment_length shall be supported. Tags: atp.Status=draft
          boolean TcpIpTlsUseExtensionRecordSizeLimit: set at pre-compile, default-value=false  # Defines if the security extension for record_size_limit shall be supported as defined in IETF RFC 8449, chapter 4.1.
          boolean TcpIpTlsUseExtensionTrustedCAKeys: set at pre-compile, default-value=false  # Defines if the optional extension for trusted_ca_keys shall be supported Tags: atp.Status=draft
          reference TcpIpTlsCertificateIdentityRef [1..*]: multiplicity set at pre-compile, set at pre-compile, destination=TcpIpTlsCertificateIdentity  # References the container that contains the certificate and identity information.
          reference TcpIpTlsConnectionCiphersuiteWorkerRef [1..*]: multiplicity set at pre-compile, set at pre-compile, destination=TcpIpTlsCiphersuiteWorker  # References the container that contains the jobs and keys to process the application data.
          reference TcpIpTlsConnectionGroupRef [0..1]: multiplicity set at pre-compile, set at pre-compile, destination=TcpIpTlsConnectionGroup  # Assigns the TLS connection to a connection group.
          reference TcpIpTlsConnectionPskIdentityRef [0..*]: multiplicity set at pre-compile, set at pre-compile, destination=TcpIpTlsPskIdentity  # References the container that contains information about pre-shared keys.
          reference TcpIpTlsIpAddressAssignment [0..1]: multiplicity set at pre-compile, set at pre-compile, destination=TcpIpStaticIpAddressConfig  # Contains additional information about the endpoint IP address information. If this reference is present, the IP address of the connecting socket shall also be checked if a TLS connection shall be assigned automatically to a socket.
        container TcpIpTlsConnectionGroup [0..*]  # This optional container is used to collect all TlsConnections that belong to a TlsConnectionGroup. The intention of a TLS connection group is to share resources among TLS connections collected in a group, because only one connection of a group can be used at a time.
      container TcpIpUdpConfig [0..1]  # Specifies the configuration parameters of the UDP (User Datagram Protocol) sub-module
        integer TcpIpUdpTtl: 1..255, post-build-variant-value=true, set at link in variant link-time / post-build in variant post-build / pre-compile in variant pre-compile  # Default Time-to-live value of outgoing UDP packets.
    container TcpIpGeneral  # This container is a subcontainer of TcpIp and specifies the general configuration parameters of the TCP/IP stack.
      integer TcpIpBufferMemory: 0..4294967295, set at link in variant link-time+post-build / pre-compile in variant pre-compile  # Memory size in bytes reserved for TCP/IP buffers.
      boolean TcpIpDevErrorDetect: set at pre-compile, default-value=false  # Switches the development error detection and notification on or off. | * true: detection and notification is enabled. * false: detection and notification is disabled.
      boolean TcpIpDhcpServerEnabled: set at pre-compile  # Enables (TRUE) or disables (FALSE) the DHCP (Dynamic Host Configuration Protocol) Server.
      boolean TcpIpEnableSecurityEventReporting: scope=ECU, set at pre-compile, default-value=false  # Switches the reporting of security events to the IdsM: Tags: atp.Status=draft | - true: reporting is enabled. - false: reporting is disabled.
      boolean TcpIpGetAndResetMeasurementDataApi: set at pre-compile  # Enables / Disables the Get and Reset Measurement Data API
      float TcpIpMainFunctionPeriod: 0..INF, set at link in variant link-time+post-build / pre-compile in variant pre-compile  # Period of TcpIp_MainFunction in [s].
      boolean TcpIpResetIpAssignmentApi: set at pre-compile  # Enables/disables the API TcpIp_ResetIpAssignment of a DHCP-client.
      enumeration TcpIpScalabilityClass: {SC1, SC2, SC3}, set at pre-compile  # In order to customize the TcpIp Stack to the specific needs of the user it can be scaled according to the scalability classes.
      boolean TcpIpTcpEnabled: set at pre-compile  # Enables (TRUE) or disabled (FALSE) support of TCP (Transmission Control Protocol).
      integer TcpIpTcpSocketMax: 0..65535, set at pre-compile  # Maximum number of TCP sockets
      boolean TcpIpUdpEnabled: set at pre-compile  # Enables (TRUE) or disabled (FALSE) support of UDP (User Datagram Protocol)
      integer TcpIpUdpSocketMax: 0..65535, set at pre-compile  # Maximum number of UDP sockets.
      boolean TcpIpVersionInfoApi: set at pre-compile, default-value=false  # If true the TcpIp_GetVersionInfo API is available.
      container TcpIpIpV4General  # This container is a subcontainer of TcpIp and specifies the general configuration parameters of the TCP/IP stack for IPv4
        boolean TcpIpArpEnabled: set at pre-compile  # Enables (TRUE) or disables (FALSE) support of ARP (Address Resolution Protocol).
        boolean TcpIpAutoIpEnabled: set at pre-compile  # Enables (TRUE) or disables (FALSE) the Auto-IP (automatic private IP addressing) sub-module.
        boolean TcpIpDhcpClientEnabled: set at pre-compile  # Enables (TRUE) or disables (FALSE) the DHCP (Dynamic Host Configuration Protocol) Client.
        boolean TcpIpIcmpEnabled: set at pre-compile  # Enables (TRUE) or disabled (FALSE) support of ICMP (Internet Control Message Protocol).
        boolean TcpIpIpV4Enabled: set at pre-compile  # Enables (TRUE) or disables (FALSE) support of IPv4 (Internet Protocol version 4).
        integer TcpIpLocalAddrIpv4EntriesMax: 0..255, set at pre-compile  # Maximum number of LocalAddr table entries for IPv4.
        boolean TcpIpPathMtuDiscoveryEnabled: set at pre-compile  # Enables (TRUE) or disables (FALSE) the discovery of the maximum transmission unit on a path according to IETF RfC 1191.
      container TcpIpIpV6General  # This container is a subcontainer of TcpIp and specifies the general configuration parameters of the TCP/IP stack for IPv6.
        boolean TcpIpDhcpV6ClientEnabled: set at pre-compile  # Enables (TRUE) or disables (FALSE) the DHCPv6 (Dynamic Host Configuration Protocol for IPv6) Client.
        boolean TcpIpIpV6Enabled: set at pre-compile  # Enables (TRUE) or disables (FALSE) support of IPv6 (Internet Protocol version 6).
        boolean TcpIpIpV6PathMtuDiscoveryEnabled: set at pre-compile  # Enables (TRUE) or disables (FALSE) Path MTU Discovery support for IPv6 according to IETF RFC 1981.
        integer TcpIpLocalAddrIpv6EntriesMax: 0..255, set at pre-compile  # Maximum number of LocalAddr table entries for IPv6.
        boolean TcpIpNdpAddressResolutionUnrechabilityDetectionEnabled: set at pre-compile  # Enables (TRUE) or disables (FALSE) support of Address Resoultion and Neighbor Unreachability Detetion via NDP.
        boolean TcpIpNdpPrefixAndRouterDiscoveryEnabled: set at pre-compile  # Enables (TRUE) or disables (FALSE) support of Prefix and Router Discovery via NDP.
      container TcpIpSecurityEventRefs [0..1]: multiplicity set at pre-compile  # Container for the references to IdsMEvent elements representing the security events that the TcpIp module shall report to the IdsM in case the coresponding security related event occurs (and if TcpIpEnableSecurityEventReporting is set to "true"). The standardized security events in this container can be extended by vendor-specific security events. Tags: atp.Status=draft
        reference SEV_ARP_IP_ADDR_CONFLICT [0..1]: multiplicity set at pre-compile, set at pre-compile, requires-symbolic-name-value=true, destination=IdsMEvent  # Received local IP address in ARP reply for different MAC. Tags: atp.Status=draft
        reference SEV_IPV4_DROP_INV_ADDR [0..1]: multiplicity set at pre-compile, set at pre-compile, requires-symbolic-name-value=true, destination=IdsMEvent  # Dropped datagram because of invalid IPV4 address. Tags: atp.Status=draft
        reference SEV_IPV6_DROP_INV_ADDR [0..1]: multiplicity set at pre-compile, set at pre-compile, requires-symbolic-name-value=true, destination=IdsMEvent  # Dropped datagram because of invalid IPV6 address. Tags: atp.Status=draft
        reference SEV_TCP_DROP_INV_PORT [0..1]: multiplicity set at pre-compile, set at pre-compile, requires-symbolic-name-value=true, destination=IdsMEvent  # Dropped TCP packet because of invalid destination TCP-Port. Tags: atp.Status=draft
        reference SEV_TLS_CONNECTION_CLOSED [0..1]: multiplicity set at pre-compile, set at pre-compile, requires-symbolic-name-value=true, destination=IdsMEvent  # A TLS connection was closed normally. Tags: atp.Status=draft
        reference SEV_TLS_CONNECTION_ESTABLISHED [0..1]: multiplicity set at pre-compile, set at pre-compile, requires-symbolic-name-value=true, destination=IdsMEvent  # A TLS connection was successfully established. Tags: atp.Status=draft
        reference SEV_TLS_ERROR [0..1]: multiplicity set at pre-compile, set at pre-compile, requires-symbolic-name-value=true, destination=IdsMEvent  # An alert message was detected (either received or generated) by TLS. Tags: atp.Status=draft
        reference SEV_UDP_DROP_INV_PORT [0..1]: multiplicity set at pre-compile, set at pre-compile, requires-symbolic-name-value=true, destination=IdsMEvent  # Dropped UDP packet because of invalid destination UDP-Port. Tags: atp.Status=draft
  module definition Tm [0..1]: variants pre-compile  # Configuration of the Time Service module.
    container TmGeneral  # General configuration of Time Service module.
      boolean TmDevErrorDetect: set at pre-compile, default-value=false  # Switches the development error detection and notification on or off. | * true: detection and notification is enabled. * false: detection and notification is disabled.
      boolean TmVersionInfoApi: set at pre-compile, default-value=false  # Adds / removes the service Tm_GetVersionInfo() from the code. ON or OFF.
    container TmPreDefTimerInstance [0..*]  # Contains all configurable elements for timer instances
      integer TmPreDefTimerInstanceId: 0..4294967295, set at pre-compile, symbolic-name-value=true, with-auto=true  # Instance handle of the timer.
      enumeration TmPreDefTimerType: {TM_PREDEF_TIMER_100US_32BIT, TM_PREDEF_TIMER_1US_16BIT, TM_PREDEF_TIMER_1US_24BIT, TM_PREDEF_TIMER_1US_32BIT}, set at pre-compile  # Configures the type of PreDef timer used from GPT
      enumeration TmTimerUser: {CAPI, PORT}, scope=ECU, set at pre-compile  # Specifies if timer instance is used via C-API or via port interface.
  module definition UdpNm [0..1]: post-build-variant-support=true, variants link-time/pre-compile  # Configuration of the UdpNm module.
    container UdpNmGlobalConfig  # This container contains all global configuration parameters of UDP NM. The parameters and the parameters of the sub containers shall be mapped to the C data type UdpNm_ConfigType (for parameters where it is possible) which is passed to the UdpNm_Init function.
      boolean UdpNmBusSynchronizationEnabled: set at pre-compile  # Pre-processor switch for enabling bus synchronization support. | This feature is required for gateway nodes only. It must not be defined if UdpNmPassiveModeEnabled==true. This parameter shall be derived from NmBusSynchronizationEnabled.
      boolean UdpNmComControlEnabled: set at pre-compile  # Pre-processor switch for enabling the Communication Control support.
      boolean UdpNmComUserDataSupport: set at pre-compile  # Enable/disable the user data support.
      boolean UdpNmCoordinatorSyncSupport: set at pre-compile  # Enables/disables the coordinator synchronization support.
      boolean UdpNmDevErrorDetect: set at pre-compile, default-value=false  # Switches the development error detection and notification on or off. | * true: detection and notification is enabled. * false: detection and notification is disabled.
      boolean UdpNmDynamicPncToChannelMappingSupport: scope=ECU, set at pre-compile  # Precompile time switch to enable the dynamic PNC-to-channel-mapping handling. Tags: atp.Status=draft | False: Dynamic PNC-to-channel-mapping is disabled True: Dynamic PNC-to-channel-mapping is enabled
      boolean UdpNmImmediateRestartEnabled: set at pre-compile  # Pre-processor switch for enabling the immediate transmission of a NM PACKET upon bus-communication request in Prepare-Bus-Sleep mode. | Must not be defined if UdpNmPassiveModeEnabled== true.
      integer UdpNmNumberOfChannels: 1..255, set at pre-compile  # Number of NM channels allowed within one ECU.
      boolean UdpNmPassiveModeEnabled: set at pre-compile  # Pre-processor switch for enabling support of the Passive Mode.
      boolean UdpNmPduRxIndicationEnabled: set at pre-compile  # Pre-processor switch for enabling the PDU Rx Indication. | This parameter shall be derived from NmPduRxIndicationEnabled.
      boolean UdpNmRemoteSleepIndEnabled: set at pre-compile  # Pre-processor switch for enabling remote sleep indication support. | This feature is required for gateway nodes only. It must not be defined if UdpNmPassiveModeEnabled==true. This parameter shall be derived from NmRemoteSleepIndEnabled.
      boolean UdpNmStateChangeIndEnabled: set at pre-compile  # Pre-processor switch for enabling the UDP NM state change notification. | This parameter shall be derived from NmStateChangeIndEnabled.
      boolean UdpNmUserDataEnabled: set at pre-compile  # Pre-processor switch for enabling user data support. | This parameter shall be derived from NmUserDataEnabled.
      boolean UdpNmVersionInfoApi: set at pre-compile, default-value=false  # Pre-processor switch for enabling version info API support.
      container UdpNmChannelConfig [1..*]  # This container contains the channel-specific configuration parameters of the UdpNm.
        boolean UdpNmActiveWakeupBitEnabled [0..1]: multiplicity set at link in variant link-time / pre-compile in variant pre-compile, set at link in variant link-time / pre-compile in variant pre-compile, default-value=false  # Enables/Disables the handling of the Active Wakeup Bit in the UdpNm module.
        boolean UdpNmAllNmMessagesKeepAwake [0..1]: multiplicity set at link in variant link-time / pre-compile in variant pre-compile, set at link in variant link-time / pre-compile in variant pre-compile, default-value=false  # Specifies if UdpNm drops irrelevant NM PDUs. | false: Only NM PDUs with a PNI bit = true and containing a PN request for this ECU triggers the standard RX indication handling true: Every NM PDU triggers the standard RX indication handling
        integer UdpNmCarWakeUpBitPosition [0..1]: 0..7, multiplicity set at link in variant link-time / pre-compile in variant pre-compile, set at link in variant link-time / pre-compile in variant pre-compile  # Specifies the Bit position of the CWU within the NM PDU.
        integer UdpNmCarWakeUpBytePosition [0..1]: 0..7, multiplicity set at link in variant link-time / pre-compile in variant pre-compile, set at link in variant link-time / pre-compile in variant pre-compile  # Specifies the Byte position of the CWU within the NM PDU.
        boolean UdpNmCarWakeUpFilterEnabled [0..1]: multiplicity set at link in variant link-time / pre-compile in variant pre-compile, set at link in variant link-time / pre-compile in variant pre-compile, default-value=false  # If CWU filtering is supported, only the CWU bit within the NM PDU with source node identifier UdpNmCarWakeUpFilterNodeId is considered as CWU request. | FALSE - CWU filtering is not supported TRUE - CWU filtering is supported.
        integer UdpNmCarWakeUpFilterNodeId [0..1]: 0..255, multiplicity set at link in variant link-time / pre-compile in variant pre-compile, set at link in variant link-time / pre-compile in variant pre-compile  # Source node identifier for CWU filtering. If CWU filtering is supported, only the CWU bit within the NM PDU with source node identifier UdpNmCarWakeUpFilterNodeId is considered as CWU request.
        boolean UdpNmCarWakeUpRxEnabled: scope=ECU, set at link in variant link-time / pre-compile in variant pre-compile, default-value=false  # Enables or disables support of CarWakeUp bit evaluation in received NM PDUs. | FALSE - CarWakeUp not supported. TRUE - CarWakeUp supported.
        boolean UdpNmDynamicPncToChannelMappingEnabled [0..1]: set at link in variant link-time / pre-compile in variant pre-compile, default-value=false  # Channel-specific parameter to enable the dynamic PNC-to-channel-mapping feature. Tags: atp.Status=draft | False: Dynamic PNC-to-channel-mapping is disabled True: Dynamic PNC-to-channel-mapping is enabled
        float UdpNmImmediateNmCycleTime [0..1]: 0.001..65.535, multiplicity set at link in variant link-time / pre-compile in variant pre-compile, set at link in variant link-time / pre-compile in variant pre-compile  # Defines the immediate NM PDU cycle time in seconds which is used for UdpNmImmediateNmTransmissions NM PDU transmissions.
        integer UdpNmImmediateNmTransmissions: 0..255, set at link in variant link-time / pre-compile in variant pre-compile  # Defines the number of immediate NM PDUs which shall be transmitted. If the value is zero no immediate NM PDUs are transmitted. The cycle time of immeditate NM PDUs is defined by UdpNmImmediateNmCycleTime.
        float UdpNmMainFunctionPeriod: 0..INF, set at link in variant link-time / pre-compile in variant pre-compile  # Call cycle of UdpNm_MainFunction_x for the respective instance in [s].
        float UdpNmMsgCycleOffset: 0..65.535, post-build-variant-value=true, set at link in variant link-time / pre-compile in variant pre-compile  # Time offset in the periodic transmission node. It determines the start delay of the transmission. | < UdpNmMsgCycleTime This parameter is only valid if UdpNmPassiveModeEnabled is disabled.
        float UdpNmMsgCycleTime: 0.001..65.535, scope=ECU, set at link in variant link-time / pre-compile in variant pre-compile  # Period of a NM-message. It determines the periodic rate and is the basis for transmit scheduling. | NmTimeoutTime = n * UdpNmMsgCycleTime This parameter is only valid if UdpNmPassiveModeEnabled is disabled.
        boolean UdpNmNodeDetectionEnabled: set at link in variant link-time / pre-compile in variant pre-compile  # Pre-processor switch for enabling the node detection support. | This parameter shall be derived from NmNodeDetectionEnabled. This parameter shall only be enabled if UdpNmNodeIdEnabled == true. If(UdpNmPduCbvPosition != UDPNM_PDU_OFF) then Equal(NmNodeDetectionEnabled) else Equal(False).
        integer UdpNmNodeId [0..1]: 0..255, set at link in variant link-time / pre-compile in variant pre-compile  # Node identifier of local node.
        boolean UdpNmNodeIdEnabled: set at link in variant link-time / pre-compile in variant pre-compile  # Pre-processor switch for enabling the source node identifier. | This parameter shall be derived from NmNodeIdEnabled.
        enumeration UdpNmPduCbvPosition: {UDPNM_PDU_BYTE_0, UDPNM_PDU_BYTE_1, UDPNM_PDU_OFF}, set at link in variant link-time / pre-compile in variant pre-compile  # Defines the position of the control bit vector within the NM PACKET. | The value of the parameter represents the location of the control bit vector in the NM PACKET (UDPNM_PDU_BYTE_0 means byte 0, UDPNM_PDU_BYTE_1 means byte 1, UDPNM_PDU_OFF means the control bit vector is not part of the NM PACKET) See also UdpNmPduNidPosition if (UdpNmPduCbvPosition != UDPNM_PDU_OFF && UdpNmPduNidPosition != UDPNM_PDU_OFF) then UdpNmPduCbvPosition != UdpNmPduNidPosition if (UdpNmPduCbvPosition != UDPNM_PDU_OFF && UdpNmPduNidPosition == UDPNM_PDU_OFF) then UdpNmPduCbvPosition = UDPNM_PDU_BYTE0
        enumeration UdpNmPduNidPosition: {UDPNM_PDU_BYTE_0, UDPNM_PDU_BYTE_1, UDPNM_PDU_OFF}, set at link in variant link-time / pre-compile in variant pre-compile  # Defines the position of the source node identifier within the NM PACKET. | ImplementationType: UdpNm_PduPositionType The value of the parameter represents the location of the source node identifier in the NM PACKET (UDPNM_PDU_BYTE_0 means byte 0, UDPNM_PDU_BYTE_1 means byte 1, UDPNM_PDU_OFF means source node identifier is not part of the NM PACKET) See also UdpNmPduCbvPosition if (UdpNmPduNidPosition!= UDPNM_PDU_OFF && UdpNmPduCbvPosition != UDPNM_PDU_OFF) then UdpNmPduNidPosition != UdpNmPduCbvPosition if (UdpNmPduNidPosition != UDPNM_PDU_OFF && UdpNmPduCbvPosition == UDPNM_PDU_OFF) then UdpNmPduNidPosition = UDPNM_PDU_BYTE0
        boolean UdpNmPnEnabled [0..1]: multiplicity set at link in variant link-time / pre-compile in variant pre-compile, set at link in variant link-time / pre-compile in variant pre-compile, default-value=false  # Enables or disables support of partial networking. | false: Partial networking Range not supported true: Partial networking supported
        boolean UdpNmPnHandleMultipleNetworkRequests [0..1]: multiplicity set at link in variant link-time / pre-compile in variant pre-compile, set at link in variant link-time / pre-compile in variant pre-compile, default-value=false  # false: UdpNm_NetworkRequest is ignored in NO. | true: UdpNm_NetworkRequest triggers a change from NO to RM.
        float UdpNmRemoteSleepIndTime: 0.001..65.535, set at link in variant link-time / pre-compile in variant pre-compile  # Timeout for Remote Sleep Indication. | It defines the time in [s] how long it shall take to recognize that all other nodes are ready to sleep. Typically it should be equal to: n * UdpNmMsgCycleTime, where n denotes the number of NM packets that are normally sent before Remote Sleep Indication is detected. The value of n decremented by one determines the amount of lost NM packets that can be tolerated by the Remote Sleep Indication procedure.
        float UdpNmRepeatMessageTime: 0..65.535, set at link in variant link-time / pre-compile in variant pre-compile  # Timeout for Repeat Message State. | It defines the time in seconds how long the NM shall stay in the Repeat Message State.
        boolean UdpNmRepeatMsgIndEnabled: set at link in variant link-time / pre-compile in variant pre-compile  # Enable/disable the notification that a RepeatMessageRequest bit has been received.
        boolean UdpNmRetryFirstMessageRequest [0..1]: multiplicity set at link in variant link-time / pre-compile in variant pre-compile, set at link in variant link-time / pre-compile in variant pre-compile  # Specifies if first message request in UdpNm is repeated until accepted by SoAd.
        boolean UdpNmStayInPbsEnabled: set at link in variant link-time / pre-compile in variant pre-compile, default-value=false  # If this parameter is disabled Prepare Bus-Sleep Mode is left after UdpNmWaitBusSleepTime. If this parameter is enabled Prepare Bus-Sleep Mode can only be left if ECU is powered off or any restart reason applies.
        boolean UdpNmSynchronizedPncShutdownEnabled [0..1]: multiplicity set at link in variant link-time / pre-compile in variant pre-compile, set at link in variant link-time / pre-compile in variant pre-compile, default-value=false  # Specifies if UdpNm handle PN shutdown messages to support a synchronized PNC shutdown across a PN topology. This is only used for ECUs in the role of a top-level PNC coordinator or intermediate PNC coordinator. Thus, the PNC gateway functionality is enabled and therefore ERA calculation is used. | FALSE: synchronized PNC shutdown is disabled TRUE: synchronized PNC shutdown is enabled
        float UdpNmTimeoutTime: 0.002..65.535, scope=ECU, set at link in variant link-time / pre-compile in variant pre-compile  # Network Timeout for NM packets. | It denotes the time in [s] how long the NM shall stay in the Network Mode before transition into Prepare Bus-Sleep Mode shall take place. It shall be equal for all nodes in the cluster. It shall be greater than UdpNmMsgCycleTime. Typically, it should be equal to: x * UdpNmMsgCycleTime, where n denotes the number of NM PACKET cycle times in the Ready Sleep State before transition into the Bus-Sleep Mode is initiated. The value of n decremented by one determines the amount of lost NM packets that can be tolerated by the coordination algorithm.
        float UdpNmWaitBusSleepTime [0..1]: 0.001..65.535, set at link in variant link-time / pre-compile in variant pre-compile  # Timeout for bus calm down phase. | It denotes the time in [s] how long the NM shall stay in the Prepare Bus-Sleep Mode before transition into Bus-Sleep Mode shall take place. It shall be equal for all nodes in the cluster. It shall be long enough to empty all Tx-buffer empty.
        reference UdpNmComMNetworkHandleRef: scope=ECU, post-build-variant-value=true, set at link in variant link-time / pre-compile in variant pre-compile, requires-symbolic-name-value=true, destination=ComMChannel  # This reference points to the unique channel defined by the ComMChannel and provides access to the unique channel index value in ComMChannelId.
        container UdpNmRxPdu [1..*]  # This container describes the UdpNm RX PDU's.
          integer UdpNmRxPduId: 0..4294967296, post-build-variant-value=true, set at pre-compile, symbolic-name-value=true, with-auto=true  # ID of the RxPdu that will be used by a RxIndication of the lower layer.
          reference UdpNmRxPduRef: set at link in variant link-time / pre-compile in variant pre-compile, destination=Pdu  # The reference to a PDU in the global PDU structure described in the AUTOSAR ECU Configuration Specification. This reference will be used by the UdpNm module to derive the PDU Id.
        container UdpNmTxPdu [0..1]  # This container describes the UdpNm TX PDU's.
          integer UdpNmTxConfirmationPduId: 0..4294967296, post-build-variant-value=true, set at pre-compile, symbolic-name-value=true, with-auto=true  # Id of the TxPdu that will be used by a TxConfirmation from the lower layer.
          reference UdpNmTxPduRef: post-build-variant-value=true, set at link in variant link-time / pre-compile in variant pre-compile, destination=Pdu  # The reference to a PDU in the global PDU structure described in the AUTOSAR ECU Configuration Specification. This reference will be used by the UdpNm module to derive the PDU Id.
        container UdpNmUserDataTxPdu [0..1]  # Preprocessor switch for enabling the Tx path of Com User Data. | Use case: Setting of NMUserData via SWC.
          integer UdpNmTxUserDataPduId: 0..65535, set at pre-compile, symbolic-name-value=true, with-auto=true  # This parameter defines the Handle ID of the NM User Data I-PDU.
          reference UdpNmTxUserDataPduRef: set at link in variant link-time / pre-compile in variant pre-compile, destination=Pdu  # Reference to the NM User Data I-PDU in the global PDU collection.
  module definition V2xBtp [0..1]: variants pre-compile  # Configuration of the V2xBtp (Vehicle-2-X Basic Transport) module.
    container V2xBtpGeneral  # This container contains the general configuration parameters of the Vehicle-2-X Basic Transport.
      boolean V2xBtpDevErrorDetect: set at pre-compile, default-value=false  # Switches the Default Error Tracer (Det) detection and notification ON or OFF. | * true: enabled (ON) * false: disabled (OFF)
      boolean V2xBtpVersionInfoApi: set at pre-compile, default-value=false  # Enable/disables the API for reading the version information of the V2xBtp Module. | * true: enabled (ON) * false: disabled (OFF)
    container V2xBtpRxIndicationFunction [1..*]: multiplicity set at pre-compile  # This container contains the RxIndication functions for V2xBtp upper layers.
      string V2xBtpCddHeaderFile: set at pre-compile  # This parameter specifies the name of the header file containing the definition of the V2xBtpRxIndicationFunction module functions.
      integer V2xBtpDestinationPort: 0..65535, set at pre-compile, default-value=0  # Destination port for the <User>_RxIndication function.
      function name V2xBtpRxIndicationFunctionName: set at pre-compile  # Name of the <User>_RxIndication callback function.
  module definition V2xDM [0..1]: variants pre-compile  # Configuration of the V2XDM module
    container V2xDMConfigSet  # Container contains all configuration items for the V2xDM
      container V2xDMCatalogItem [0..*]: multiplicity set at pre-compile  # Contains all catalog items of the V2x DataManager
        foreign reference V2xDMCatalogItemTypeRef: set at pre-compile, destination-type=SW-BASE-TYPE  # Reference to the base type of this catalog item.
        container V2xDMConnection [0..*]: multiplicity set at pre-compile  # Collects all connection information for this catalog item.
          container V2xDMConnectionSource [1..*]: multiplicity set at pre-compile  # Contains definition for the connected sources of V2x message items.
            enumeration V2xDMConnectionSourceOperator [0..1]: {V2XDM_CONN_SRC_OP_EXISTS, V2XDM_CONN_SRC_OP_LENGTH}, multiplicity set at pre-compile, set at pre-compile  # Selects the source type of the operator.
            reference V2xDMConnectionSourceTargetRef: set at pre-compile, destination=V2xDMSimpleType  # Links to the simple type of a V2x message.
            container V2xDMConnectionSourceContext [0..*]: multiplicity set at pre-compile  # Contains information to uniquely address a V2X message element. I.e. the V2x message element can be contained in a SequenceOf. In that case the index inside the SequenceOf must be provided to avoid an ambiguous reference.
              integer V2xDMConnectionSourceContextIndex: 0..65535, set at pre-compile  # Index to the SequenceOf element that the SourceContextRef references to.
              reference V2xDMConnectionSourceContextRef: set at pre-compile, destination=V2xDMStructuredTypeSequenceOf  # Reference to the SequenceOf element of a V2x message.
          container V2xDMConversion [0..1]: multiplicity set at pre-compile  # Allows to define a conversion routine to adapt V2x simple item(s) to the data catalog element.
            function name V2xDMConversionFunc: set at pre-compile  # This parameter provides the function name for the callback <V2xDM_ItemConversionFunc>.It is used to convert the simple type information into the data catalog item value and its base type.
            choice container V2xDMConversionFunction [0..1]: multiplicity set at pre-compile  # Defines the conversion function container that shall be applied to convert the V2x message element into the unified data catalog item.
              container V2xDMConversionFunctionLinear [0..1]: multiplicity set at pre-compile  # This container defines th parameter for the linear conversion routine.
                float V2xDMConversionFunctionLinearConstant: set at pre-compile  # This parameter defines the offset to the linear conversion function
                float V2xDMConversionFunctionLinearFactor: set at pre-compile  # This defines the scale factor for the linear conversion function.
      container V2xDMLink [0..*]: multiplicity set at pre-compile  # Defines the links between the VariableDataPrototypes of the V2x object to the V2x catalog items.
        reference V2xDMLinkCatalogItemRef: set at pre-compile, destination=V2xDMCatalogItem  # References to the catalog item that is used for this link.
        instance reference V2xDMLinkV2xObjectElementInstanceRef [1..*]: multiplicity set at pre-compile, set at pre-compile, destination-context=ROOT-SW-COMPOSITION-PROTOTYPE SW-COMPONENT-PROTOTYPE PORT-PROTOTYPE AUTOSAR-DATA-PROTOTYPE IMPLEMENTATION-DATA-TYPE-ELEMENT*, destination-type=IMPLEMENTATION-DATA-TYPE-ELEMENT  # This container references to the port prototype and VariableDataPrototype as a V2x object.
      container V2xDMMsgQueue [0..1]: multiplicity set at pre-compile  # Specifies a message queue for incoming V2x messages of the data manager. If this container is not present, no queue is used for incoming V2x messages. If it is present, the elements of the container specifies the queue depth and its elements.
        integer V2xDMMsgQueueElementSize: 0..65535, set at pre-compile  # Size of a queue entry in bytes. All queue entries have the same size. The value shall be large enough to store the largest V2x message.
        integer V2xDMMsgQueueNumberOfEntries: 0..255, set at pre-compile, default-value=0  # Specifies the number of Queue entries for incoming V2x messages. One entry per V2x message. | A number of 0 in this field disables the queue and actions are performed only in the V2xDM_RxIndication.
      container V2xDMStack  # Holds the V2x stack specific container and parameter.
        container V2xDMMessage [1..*]: multiplicity set at pre-compile  # Definition of a V2x message and its layout
          integer V2xDMMsgId: 0..4294967295, set at pre-compile, symbolic-name-value=true  # Identifier of the message. The set of V2x message identifiers shall be consecutive and gapless.
          choice reference V2xDMMsgRootRef: set at pre-compile, destination=[V2xDMSimpleType, V2xDMStructuredType]  # This element links to the first structured element within the V2x message.
          container V2xDMPdu [0..1]: multiplicity set at pre-compile  # Container for parameters that are necessary for the configuration of the V2xDM to serve as the UpperLayer of the PDU-Router module.
            enumeration V2xDMPduDirection: {V2XDM_PDU_RECEIVE, V2XDM_PDU_SEND}, set at pre-compile  # Defines the direction of the PDU: | V2XDM_PDU_SEND - V2xDM passes on the V2x message as raw data to the PduR. V2XDM_PDU_RECEIVE - V2xDM receives the V2x message through the PduR (no V2x stack present in the ECU).
            integer V2xDMPduId: 0..65535, set at pre-compile, symbolic-name-value=true  # The numerical value used as the ID of this I-PDU. The ComIPduHandleId | is required by the API calls PduR_V2xDMRxIndication to receive I-PDUs from the PduR (ComIP-duDirection: Receive) For Tx-I-PDUs (ComIPduDirection: Send), this handle Id is used for the APIs call PduR_V2xDMTransmit to transmit I-PDUs.
            reference V2xDMPduRef: set at pre-compile, destination=Pdu  # Reference to the global Pdu structure.
          choice container V2xDMSimpleType [0..*]: multiplicity set at pre-compile  # Definition of simple types within a V2x message as a choice of simple types.
            container V2xDMSimpleTypeBitString [0..1]: multiplicity set at pre-compile  # Definition of the ASN.1 Bit String
              boolean V2xDMSimpleTypeBitStringIsExtensible: set at pre-compile  # Defines if the item is extensible in future releases.
              container V2xDMSimpleTypeBitStringConstr [0..65535]: multiplicity set at pre-compile  # Container defines the constraints for the length of the bit string (Min/Max).
                integer V2xDMSimpleTypeBitStringConstrMax [0..1]: 0..65535, multiplicity set at pre-compile, set at pre-compile  # Max length of the BitString parameter.
                integer V2xDMSimpleTypeBitStringConstrMin [0..1]: 0..4294967295, multiplicity set at pre-compile, set at pre-compile  # Min length of the BitString parameter.
              container V2xDMSimpleTypeBitStringItem [0..*]: multiplicity set at pre-compile  # Defines item values as Key-Pair-Values for the BitString.
                string V2xDMSimpleTypeBitStringItemIdentifier: set at pre-compile  # Defines the name for the Key-Pair-Values for the BitString.
                integer V2xDMSimpleTypeBitStringItemValue: 0..65535, set at pre-compile  # Defines the value representation for the Key-Pair-Values for the BitString.
            container V2xDMSimpleTypeBoolean [0..1]: multiplicity set at pre-compile  # Definition of the ASN.1 boolean type
            container V2xDMSimpleTypeCharString [0..1]: multiplicity set at pre-compile  # Definition of the ASN.1 type character string
              string V2xDMSimpleTypeCharStringAlphabet [0..1]: multiplicity set at pre-compile, set at pre-compile  # Defines the character set that is used and allowed for this CharString.
              boolean V2xDMSimpleTypeCharStringIsExtensible: set at pre-compile  # Defines if future extensions of this parameter shall be considered.
              enumeration V2xDMSimpleTypeCharStringType: {V2XDM_SIMPLETYPE_CHARSTR_IA5, V2XDM_SIMPLETYPE_CHARSTR_NUMERIC, V2XDM_SIMPLETYPE_CHARSTR_UTF8}, set at pre-compile  # Defines the type of CharString SimpleType.
              container V2xDMSimpleTypeCharStringConstr [0..*]: multiplicity set at pre-compile  # Container defines the constraints for the character string (Min/Max).
                integer V2xDMSimpleTypeCharStringConstrMax [0..1]: 0..65535, multiplicity set at pre-compile, set at pre-compile  # Max number of values for the char string parameter.
                integer V2xDMSimpleTypeCharStringConstrMin [0..1]: 0..65535, multiplicity set at pre-compile, set at pre-compile  # Min number of values for the char string parameter.
            container V2xDMSimpleTypeEnum [0..1]: multiplicity set at pre-compile  # Definition of the ASN.1 enumeration type
              boolean V2XDMSimpleTypeEnumerationIsExtensible: set at pre-compile  # Defines if the enumeration can be extended in future releases (...).
              container V2XDMSimpleTypeEnumerationItem [1..*]: multiplicity set at pre-compile  # Parameter description for the enumeration simple type.
                string V2XDMSimpleTypeEnumerationItemName: set at pre-compile  # Defines the name of the enumeration item.
                integer V2XDMSimpleTypeEnumerationItemValue: 0..255, set at pre-compile  # Definition of the item value of the enumeration.
            container V2xDMSimpleTypeInteger [0..1]: multiplicity set at pre-compile  # Definition of the ASN.1 integer type
              boolean V2xDMSimpleTypeIntegerIsExtensible: set at pre-compile  # Indicates if data for the integer simple types can be extended in the future (...).
              container V2xDMSimpleTypeIntegerConstr [0..*]: multiplicity set at pre-compile  # Defines the constraints for the integer simple type
                integer V2xDMSimpleTypeIntegerConstrMax: 0..4398046511103, set at pre-compile  # Defines the max value for this integer simple type.
                integer V2xDMSimpleTypeIntegerConstrMin [0..1]: -4398046511104..0, multiplicity set at pre-compile, set at pre-compile  # Defines the min value for this integer simple type.
              container V2xDMSimpleTypeIntegerItem  # Descriptor parameters of the simple type integer item.
                string V2xDMSimpleTypeIntegerItemName: set at pre-compile  # Provide a name for this integer item.
                integer V2xDMSimpleTypeIntegerItemValue: -4398046511104..4398046511103, set at pre-compile  # The default value for this integer
            container V2xDMSimpleTypeOctetString [0..1]: multiplicity set at pre-compile  # Definition of the ASN.1 Octet String.
              boolean V2xDMSimpleTypeOctetStringIsExtensible: set at pre-compile  # Defines if the octet string can be extended in future releases (...).
              container V2xDMSimpleTypeOctetStringConstr [0..1]: multiplicity set at pre-compile  # Defines the constraint for the octet string as simple type according to ASN.1.
                integer V2xDMSimpleTypeOctetStringConstrMax [0..1]: 0..65535, multiplicity set at pre-compile, set at pre-compile  # Defines the max length for the octet string.
                integer V2xDMSimpleTypeOctetStringConstrMin [0..1]: 0..65535, multiplicity set at pre-compile, set at pre-compile  # Defines the min length for the octet string.
          choice container V2xDMStructuredType [0..*]: multiplicity set at pre-compile  # Definition of structured types in a V2x message
            container V2xDMStructuredTypeChoice [0..1]: multiplicity set at pre-compile  # Defines a choice of elements within a V2x message.
              boolean V2xDMStructuredTypeChoiceCallbackEnabled: set at pre-compile  # Enables a callback when the structure has been decoded.
              boolean V2xDMStructuredTypeChoiceIsExtensible [0..1]: multiplicity set at pre-compile, set at pre-compile, default-value=false  # Indicates if the choice container can be extended in future releases (marked with '...' in ASN.1)
              container V2xDMStructuredTypeChoiceOption [1..*]: multiplicity set at pre-compile  # Defines the reference and order of types in this choice element.
                integer V2xDMStructuredTypeChoiceOptionIndex: 0..65535, set at pre-compile  # Defines the order of elements inside the choice container.
                choice reference V2xDMStructuredTypeChoiceOptionType: set at pre-compile, destination=[V2xDMSimpleType, V2xDMStructuredType]  # Define a link to a simple or structured type that is present in this choice container.
            container V2xDMStructuredTypeSequence [0..1]: multiplicity set at pre-compile  # Defines a sequence of elements within a V2x message.
              boolean V2xDMStructuredTypeSequenceCallbackEnabled: set at pre-compile  # Enables a callback when the structure has been decoded.
              boolean V2xDMStructuredTypeSequenceIsExtensible: set at pre-compile, default-value=false  # Defines if this sequence can be extended in the future (typically declared in ASN.1 with '...').
              container V2xDMStructuredTypeSequenceChild [1..*]: multiplicity set at pre-compile  # Declares all attributes for a child element in the ASN.1 structured type sequence element.
                enumeration V2xDMStructuredTypeSequenceChildAttribute: {V2XDM_STRUCTURED_TYPE_SEQUENCE_CHILD_ATTRIBUTE_DEFAULT, V2XDM_STRUCTURED_TYPE_SEQUENCE_CHILD_ATTRIBUTE_NONE, V2XDM_STRUCTURED_TYPE_SEQUENCE_CHILD_ATTRIBUTE_OPTIONAL}, set at pre-compile  # Select the attribute of a sequence element.
                string V2xDMStructuredTypeSequenceChildDefault [0..1]: multiplicity set at pre-compile, set at pre-compile  # Default values of the structure.
                integer V2xDMStructuredTypeSequenceChildIndex: 0..65535, set at pre-compile  # Define the index of the element within the structure.
                choice reference V2xDMStructuredTypeSequenceChildType: set at pre-compile, destination=[V2xDMSimpleType, V2xDMStructuredType]  # Reference to the child element in the structure as a simple or structured type.
            container V2xDMStructuredTypeSequenceOf [0..1]: multiplicity set at pre-compile  # Defines a list of elements within a V2x message. Comparable to an array.
              boolean V2xDMStructuredTypeSequenceOfCallbackEnabled: set at pre-compile  # Enables a generated callback when the structure is decoded.
              boolean V2xDMStructuredTypeSequenceOfIsExtensible [0..1]: multiplicity set at pre-compile, set at pre-compile, default-value=false  # Defines if the SequenceOf is extensible in the future (marked as '...' in ASN.1)
              choice reference V2xDMStructuredTypeSequenceOfType: set at pre-compile, destination=[V2xDMSimpleType, V2xDMStructuredType]  # Reference to the next structured or simple type.
              container V2xDMStructuredTypeSequenceOfConstr [0..*]: multiplicity set at pre-compile  # This container defines the constraints of the SequenceOf parent container.
                integer V2xDMStructuredTypeSequenceOfConstrMax [0..1]: 0..65535, multiplicity set at pre-compile, set at pre-compile  # Defines the max. number of SequenceOf values.
                integer V2xDMStructuredTypeSequenceOfConstrMin [0..1]: 0..65535, multiplicity set at pre-compile, set at pre-compile  # Defines the minimum number of the SequenceOf container.
    container V2xDMGeneral  # This container contains the general configuration parameters of the Vehicle-2-X Data Manager.
      boolean V2xDMDevErrorDetect: set at pre-compile, default-value=false  # Switches the Default Error Tracer (Det) detection and notification ON or OFF. | * true: enabled (ON) * false: disabled (OFF)
      float V2xDMMainFunctionPeriod: 0..INF, scope=ECU, set at pre-compile, default-value=0.01  # Specifies the period of main function V2xDM_MainFunction in seconds.
      boolean V2xDMVersionInfoApi: set at pre-compile, default-value=false  # Enable/disables the API for reading the version information of the V2xDM Module. | * true: enabled (ON) * false: disabled (OFF)
      reference V2xDMEcucPartitionRef [0..1]: multiplicity set at pre-compile, set at pre-compile, destination=EcucPartition  # Reference to EcucPartition, where V2x Data Manager module is assigned to.
  module definition V2xFac [0..1]: variants pre-compile  # Configuration of the V2xFac module.
    container V2xFacConfig  # This container contains the configuration parameters and sub containers of the AUTOSAR V2xFac module.
      container V2xFacDmMsgConfig [1..*]: multiplicity set at pre-compile, post-build-variant-multiplicity=true  # This container contains the configuration of all messages that shall be passed on to the V2x Data Manager.
        integer V2xFacDmPortId: 0..65535, set at pre-compile  # This parameter contains the destination port identifier that references the V2x message.
        integer V2xFacV2xMessageId: 0..255, set at pre-compile  # This parameter contains the message identifier related to the V2X message that can be received on the associated BTP port as specified in ETSI ITS 102 894-2. | Note: Nothing precludes to use several message configurations to receive the same type of message on several BTP ports or several messages on the same BTP port, even if this is not intended by the standard.
        reference V2xFacDmMsgRef: set at pre-compile, requires-symbolic-name-value=true, destination=V2xDMMessage  # Symbolic name reference to [V2xDMMessage]
    container V2xFacGeneral  # This container contains the general configuration parameters of the Vehicle-2-X Facilities
      float V2xFacCaBsMainFunctionPeriod: 0..INF, set at pre-compile, default-value=0.1  # This parameter defines the schedule period of V2xFac_CaBs_MainFunction.Unit: [s]
      float V2xFacDenBsMainFunctionPeriod: 0..INF, set at pre-compile, default-value=0.1  # This parameter defines the schedule period of V2xFac_DenBs_MainFunction.Unit: [s]
      boolean V2xFacDevErrorDetect: set at pre-compile, default-value=false  # Switches the Default Error Tracer (Det) detection and notification ON or OFF. | * true: enabled (ON) * false: disabled (OFF)
      float V2xFacRxSMainFunctionPeriod: 0..INF, set at pre-compile, default-value=0.1  # This parameter defines the schedule period of V2xFac_RxS_MainFunction.Unit: [s]
      enumeration V2xFacStationType: {V2XFAC_ST_BUS, V2XFAC_ST_CYCLIST, V2XFAC_ST_HEAVYTRUCK, V2XFAC_ST_LIGHTTRUCK, V2XFAC_ST_MOPED, V2XFAC_ST_MOTORCYCLE, V2XFAC_ST_PASSENGERCAR, V2XFAC_ST_PEDESTRIAN, V2XFAC_ST_SPECIALVEHICLES, V2XFAC_ST_TRAILER, V2XFAC_ST_TRAM, V2XFAC_ST_UNKNOWN}, set at pre-compile, default-value=V2XFAC_ST_UNKNOWN  # This configuration value defines the station type information of the originating ITS-S, RoadSideUnit (15) not supported by AUTOSAR.
      boolean V2xFacVersionInfoApi: set at pre-compile, default-value=false  # Enable/disables the API for reading the version information of the V2xFac Module. | * true: enabled (ON) * false: disabled (OFF)
  module definition V2xGn [0..1]: variants pre-compile  # Configuration of the V2xGn (Vehicle-2-X Geo Networking) module.
    container V2xGnBeaconService  # This container contains the GeoNetworking configuration parameters related to the beacon service.
      float V2xGnItsGnBeaconServiceMaxJitter: 0.001..INF, set at pre-compile, default-value=0.75  # Maximum beacon jitter [s]. The Jitter is used for the beacon retransmission. The actual jitter value is a random number between 0 and V2xGnItsGnBeaconServiceMaxJitter. The function introduces a random component for the timer to avoid synchronization issues among | GeoAdhoc routers.
      float V2xGnItsGnBeaconServiceRetransmitTimer: 0.001..INF, set at pre-compile, default-value=3  # Duration of Beacon service retransmit timer [s].
    container V2xGnConfig  # This container contains the configuration parameters and sub containers of the V2xGn module. Tags: atp.Status=draft
      reference V2xGnEthIfRef: set at pre-compile, requires-symbolic-name-value=true, destination=EthIfController  # This represents the reference to the Ethernet interface taken to transmit the V2X-Packets to.
      container V2xGnRxPdu  # Represents the received PDU. This PDU is usually linked to the EthIf via LSduR. It consumes meta data items of the types BROADCAST_8 and ETHERNET_MAC_64. Tags: atp.Status=draft
        integer V2xGnRxPduId: 0..65535, scope=ECU, set at pre-compile, symbolic-name-value=true, with-auto=true  # PDU identifier used for RxIndication from LSduR. Tags: atp.Status=draft
        reference V2xGnRxPduRef: scope=ECU, set at pre-compile, destination=Pdu  # Reference to the global PDU. Tags: atp.Status=draft
      container V2xGnTxPdu  # Represents the transmitted PDU. This PDU is usually linked to the EthIf via LSduR. It produces meta data items of the type ETHERNET_MAC_64. Tags: atp.Status=draft
        integer V2xGnTxPduId: 0..65535, scope=ECU, set at pre-compile, symbolic-name-value=true, with-auto=true  # PDU identifier used for TxConfirmation from LSduR. Tags: atp.Status=draft
        reference V2xGnTxPduRef: scope=ECU, set at pre-compile, destination=Pdu  # Reference to the global PDU. Tags: atp.Status=draft
    container V2xGnGeneral  # This container specifies the general configuration parameters of the V2xGn module.
      boolean V2xGnDevErrorDetect: set at pre-compile, default-value=false  # Switches the Default Error Tracer (Det) detection and notification ON or OFF. | * true: enabled (ON) * false: disabled (OFF)
      float V2xGnItsGnLifetimeLocTE: 0..65535, set at pre-compile, default-value=20  # Location table maintenance: Lifetime of an entry in the location table in [s]
      integer V2xGnItsGnLocalGnAddr: 0..18446744073709551615, set at pre-compile, default-value=1  # 64bit GeoNetworking Address.
      integer V2xGnItsGnMaxGeoNetworkingHeaderSize: 0..65535, set at pre-compile, default-value=88  # Maximum size of GeoNetworking header in [Byte].
      integer V2xGnItsGnMaxSduSize: 0..65535, set at pre-compile, default-value=1398  # Maximum size of GN-SDU in [Byte].
      float V2xGnItsGnMinUpdateFrequencyEPV: 0..65535, set at pre-compile  # Minimum update frequency of ego position vector (EPV) in [s].
      integer V2xGnItsGnPaiInterval: 0..100, set at pre-compile, default-value=80  # Distance related to the confidence interval for latitude and longitude [m]. Used to determine the PAI.
      integer V2xGnItsGnProtocolVersion: 0..255, set at pre-compile, default-value=1  # GeoNetworking protocol version as defined in Annex H of [14]
      enumeration V2xGnItsGnSnDecapResultHandling: {V2XGN_NON_STRICT_SEC_HANDLING, V2XGN_STRICT_SEC_HANDLING}, set at pre-compile  # Indicates the handling of the V2xM_ReqDecap result code.
      enumeration V2xGnItsGnStationType: {V2XFAC_ST_BUS, V2XFAC_ST_CYCLIST, V2XFAC_ST_HEAVYTRUCK, V2XFAC_ST_LIGHTTRUCK, V2XFAC_ST_MOPED, V2XFAC_ST_MOTORCYCLE, V2XFAC_ST_PASSENGERCAR, V2XFAC_ST_PEDESTRIAN, V2XFAC_ST_SPECIALVEHICLES, V2XFAC_ST_TRAILER, V2XFAC_ST_TRAM, V2XFAC_ST_UNKNOWN}, set at pre-compile  # Station Type used in GeoNetworking protocol, RoadSideUnit (15) not supported by AUTOSAR.
      float V2xGnMainFunctionPeriod: 0..INF, set at pre-compile, default-value=0.001  # Specifies the period of main function V2xGn_MainFunction in seconds. V2xGn does not require this information but the BSW scheduler.
      boolean V2xGnVersionInfoApi: set at pre-compile, default-value=false  # Enable/disables the API for reading the version information of the V2xGn Module. | * true: enabled (ON) * false: disabled (OFF)
    container V2xGnPacketForwarding  # This container contains the GeoNetworking configuration parameters related to packet forwarding.
      integer V2xGnItsGnBcForwardingPacketBufferSize: 0..18446744073709551615, set at pre-compile, default-value=1024000  # Size of BC forwarding packet buffer [Byte].
      float V2xGnItsGnCbfMaxTime: 0..INF, set at pre-compile, default-value=0.001  # Maximum duration a GeoNetworking packet shall be buffered in the CBF packet buffer [s]
      float V2xGnItsGnCbfMinTime: 0..INF, set at pre-compile, default-value=0.001  # Minimum duration a GeoNetworking packet shall be buffered in the CBF packet buffer [s]
      integer V2xGnItsGnCbfPacketBufferSize: 0..18446744073709551615, set at pre-compile, default-value=256000  # Size of CBF packet buffer [Byte]
      integer V2xGnItsGnDefaultHopLimit: 0..255, set at pre-compile, default-value=10  # Default hop limit indicating the maximum number of hops a packet travels.
      integer V2xGnItsGnDefaultMaxCommunicationRange: 0..65535, set at pre-compile, default-value=1000  # Default theoretical maximum communication range [m]
      float V2xGnItsGnDefaultPacketLifetime: 0..6300, set at pre-compile, default-value=60  # Default packet lifetime [s].
      integer V2xGnItsGnDefaultTrafficClass: 0..255, set at pre-compile, default-value=0  # Forwarding: Default traffic class
      integer V2xGnItsGnDplLength: 0..65535, set at pre-compile, default-value=8  # Length of Duplicate Packet List (DPL) per source (clause A.2 of [18])
      boolean V2xGnItsGnGeoAreaLineForwardingUsed: set at pre-compile, default-value=false  # Forwarding of GBC/GAC packet if GeoAdhoc router is located outside the destination GeoArea. | * true: enabled (ON) * false: disabled (OFF)
      integer V2xGnItsGnMaxGeoAreaSize: 0..18446744073709551615, set at pre-compile, default-value=80  # Maximum size of the geographical area for a GBC and GAC packet [km2]. If the geographical area size exceeds the maximum value, the GeoNetworking packet shall not be sent (source) and not be forwarded (forwarder).
      integer V2xGnItsGnMaxPacketDataRate: 0..4294967295, set at pre-compile, default-value=100000  # Maximum packet data rate for a GeoAdhoc router [Byte/s]. If the mean (EMA) packet data rate a of a GeoAdhoc router exceeds the value, packets from this GeoAdhoc router (source or sender) are not forwarded.
      float V2xGnItsGnMaxPacketDataRateEmaBeta: 0..1, set at pre-compile, default-value=0.9  # Weight factor for the Exponential Moving Average of the packet data rate PDR in percent.
      float V2xGnItsGnMaxPacketLifetime: 0..6300, set at pre-compile, default-value=600  # Upper limit of the maximum lifetime [s]
  module definition V2xM [0..1]: variants pre-compile  # Configuration of the V2xM (V2XManagement) module.
    container V2xMConfig  # This container contains the configuration parameters and sub containers of the AUTOSAR V2xM module.
      container V2xMSecurityConfig  # Configuration of the security services of V2xM.
        boolean V2xMSecurityVerificationOnDemand: set at pre-compile  # Switches the Verification on Demand (VoD) ON or OFF. | * true: enabled (ON) * false: disabled (OFF)
        reference V2xMSecurityNvMBlockDescriptorLongTermCertificates: set at pre-compile, requires-symbolic-name-value=true, destination=NvMBlockDescriptor  # Reference to NVRAM block containing the none volatile data of long term certificates.
        reference V2xMSecurityNvMBlockDescriptorPseudonymCertificates: set at pre-compile, requires-symbolic-name-value=true, destination=NvMBlockDescriptor  # Reference to NVRAM block containing the none volatile data of pseudonym certificates.
        reference V2xMSignatureGenerationJobRef: set at pre-compile, requires-symbolic-name-value=true, destination=CsmJob  # Reference to the CSM job to perform signature generation for a V2x message
        reference V2xMSignatureVerifyJobRef: set at pre-compile, requires-symbolic-name-value=true, destination=CsmJob  # Reference to the CSM job to perform signature verification for a V2x message
    container V2xMGeneral  # General configuration of V2xM module.
      boolean V2xMDevErrorDetect: set at pre-compile, default-value=false  # Switches the Default Error Tracer (Det) detection and notification ON or OFF. | * true: enabled (ON) * false: disabled (OFF)
      float V2xMMainFunctionPeriod: 0..0.1, set at pre-compile, default-value=0.1  # This parameter defines the schedule period of V2xM_MainFunction.Unit: [s]
      boolean V2xMVersionInfoApi: set at pre-compile, default-value=false  # Enable/disables the API for reading the version information of the V2xM Module. | * true: enabled (ON) * false: disabled (OFF)
      reference V2xMEthIfCtrlRef: set at pre-compile, requires-symbolic-name-value=true, destination=EthIfController  # Reference to EthIf controller where the channel and radio parameters should be read and written to.
      reference V2xMGptChannelConfigurationRef [0..1]: multiplicity set at pre-compile, set at pre-compile, requires-symbolic-name-value=true, destination=GptChannelConfiguration  # Reference to General Purpose Timer.
      reference V2xMNvMBlockDescriptor: set at pre-compile, requires-symbolic-name-value=true, destination=NvMBlockDescriptor  # Reference to NVRAM block containing the none volatile data.
