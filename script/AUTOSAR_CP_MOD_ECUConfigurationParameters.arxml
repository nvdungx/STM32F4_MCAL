[part 14 of 14: packages /AUTOSAR/EcucDefs to /AUTOSAR/LifeCycleInfoSets]
AUTOSAR XML (schema 00053)
package /AUTOSAR/EcucDefs  (continued)
  module definition WEth [0..*]: post-build-variant-support=true, variants link-time/post-build/pre-compile  # Configuration of the WEth (Wireless Ethernet Driver) module.
    container WEthConfigSet  # This container contains the configuration parameters and sub containers of the AUTOSAR WEth module.
      container WEthCtrlConfig [1..*]  # Configuration of the individual controller
        integer WEthCtrEgressHardwareSupportedDataTransferThreshold: 0..65535, set at pre-compile, default-value=0  # WEthCtrEgressHardwareSupportedDataTransferThreshold define a threshold in bytes, if data, which is requested to be transmitted, shall be transferred with an hardware supported instruction (e.g. DMA) or via CPU copying process. Tags: atp.Status=draft | If given data length for transmission exceeds the configured threshold, then the WEth driver shall initiate a hardware supported data transfer from the given source address(es) to the used egress queue entry (e.g. via DMA instruction). Otherwise the WEth driver shall perform a CPU driven copy of data to the used egress queue entry to the corresponding egress queue (e.g. via DMA instruction).
        boolean WEthCtrlEnableEgressHardwareSupportedDataTransfer: set at pre-compile, default-value=false  # WEth driver shall use hardware supported data transfer form the upper layers to the corresponding egress queue (e.g. via DMA instruction) Tags: atp.Status=draft | true: hardware supported data transfer is enabled false: hardware supported data transfer is disabled
        integer WEthCtrlIdx: 0..255, scope=ECU, set at pre-compile, symbolic-name-value=true, with-auto=true  # Specifies the instance ID of the configured controller.
        string WEthCtrlPhyAddress [0..1]: multiplicity set at link in variant link-time / post-build in variant post-build / pre-compile in variant pre-compile, post-build-variant-multiplicity=true, post-build-variant-value=true, set at link in variant link-time / post-build in variant post-build / pre-compile in variant pre-compile, max-length=17, min-length=17, regular-expression=([0-9a-fA-F]\{2}:)\{5}[0-9a-fA-F]\{2}  # Specifies the unique 48-bit physical address (MAC address) of the controller in network byte order.
        integer WEthCtrlRxBufLenByte: 0..1522, post-build-variant-value=true, set at link in variant link-time / post-build in variant post-build / pre-compile in variant pre-compile  # Limits the maximum receive buffer length (frame length) in bytes.
        integer WEthCtrlTxBufLenByte: 0..1522, post-build-variant-value=true, set at link in variant link-time / post-build in variant post-build / pre-compile in variant pre-compile  # Limits the maximum transmit buffer length (frame length) in bytes.
        integer WEthRxBufTotal: 0..255, post-build-variant-value=true, set at link in variant link-time / post-build in variant post-build / pre-compile in variant pre-compile  # Configures the number of receive buffers.
        integer WEthTxBufTotal: 0..255, post-build-variant-value=true, set at link in variant link-time / post-build in variant post-build / pre-compile in variant pre-compile  # Configures the number of transmit buffers.
        reference WEthCtrlEcucPartitionRef [0..1]: scope=ECU, multiplicity set at pre-compile, post-build-variant-multiplicity=true, post-build-variant-value=true, set at pre-compile, destination=EcucPartition  # Maps the Wireless Ethernet controller to zero or one ECUC partitions. The ECUC partition referenced is a subset of the ECUC partitions where the Wireless Ethernet driver is mapped to.
        container WEthDemEventParameterRefs [0..1]  # Container for the references to DemEventParameter elements which shall be invoked using the API Dem_SetEventStatus in case the corresponding error occurs. The EventId is taken from the referenced DemEventParameter's DemEventId symbolic value. The standardized errors are provided in this container and can be extended by vendor-specific error references.
          reference WETH_E_ACCESS [0..1]: multiplicity set at link in variant link-time / post-build in variant post-build / pre-compile in variant pre-compile, post-build-variant-multiplicity=true, post-build-variant-value=true, set at link in variant link-time / post-build in variant post-build / pre-compile in variant pre-compile, requires-symbolic-name-value=true, destination=DemEventParameter  # Reference to the DemEventParameter which shall be issued when the error "Controller access failed" has occured.
    container WEthGeneral  # General configuration of Wireless Ethernet Driver module.
      boolean WEthDevErrorDetect: set at pre-compile, default-value=false  # Switches the Default Error Tracer (Det) detection and notification ON or OFF. | * true: detection and notification is enabled. * false: detection and notification is disabled.
      boolean WEthGetWEtherStatsApi: set at pre-compile  # Enables / Disables WEth_GetWEtherStats_32 and WEth_GetWEtherStats_64 API.
      integer WEthIndex: 0..255, set at pre-compile  # Specifies the InstanceId of this module instance. If only one instance is present it shall have the Id 0.
      float WEthMainFunctionPeriod: 0..INF, set at pre-compile  # Specifies the period of main function WEth_MainFunction in seconds. Wireless Ethernet driver does not require this information but the BSW scheduler.
      boolean WEthUpdatePhysAddrFilter: set at pre-compile, default-value=false  # Enables/Disables optional API WEth_UpdatePhysAddrFilter.
      boolean WEthVersionInfoApi: set at pre-compile, default-value=false  # Enables / Disables version info API.
      reference WEthEcucPartitionRef [0..*]: scope=ECU, multiplicity set at pre-compile, post-build-variant-multiplicity=true, post-build-variant-value=true, set at pre-compile, destination=EcucPartition  # Maps the Wireless Ethernet driver to zero or multiple ECUC partitions to make the modules API available in this partition.
  module definition WEthTrcv [0..*]: post-build-variant-support=true, variants link-time/post-build/pre-compile  # Configuration of Ethernet Transceiver Driver module
    container WEthTrcvAntennaConfigSet  # This container contains the antenna configurations.
      container WEthTrcvAntennaConfig [1..*]  # Configuration of the individual antenna.
        integer WEthTrcvAntennaId: 0..255, scope=ECU, set at pre-compile, symbolic-name-value=true, with-auto=true  # Specifies the instance ID of the configured antenna.
    container WEthTrcvConfigSet  # This container contains the configuration parameters and sub containers of the AUTOSAR WEthTrcv module.
      container WEthTrcvConfig [1..*]  # Configuration of the individual transceiver
        integer WEthTrcvBusId: 0..255, post-build-variant-value=true, set at link in variant link-time / post-build in variant post-build / pre-compile in variant pre-compile  # Specifies the hardware id used for lower level bus interface access (e.g. MII/SPI) to the transceiver's hardware module. For example the MII index if MII would have been used.
        integer WEthTrcvId: 0..255, scope=ECU, set at pre-compile, symbolic-name-value=true, with-auto=true  # Specifies the instance ID of the configured transceiver.
        enumeration WEthTrcvPhysLayerType [0..1]: {TRCV_PHYS_LAYER_TYPE_80211_P}, multiplicity set at link in variant link-time / post-build in variant post-build / pre-compile in variant pre-compile, post-build-variant-multiplicity=true, post-build-variant-value=true, set at link in variant link-time / post-build in variant post-build / pre-compile in variant pre-compile  # Specifies the physical layer type of the Wireless Ethernet transceiver link.
        reference WEthTrcvConfigEcucPartitionRef [0..1]: scope=ECU, multiplicity set at pre-compile, post-build-variant-multiplicity=true, post-build-variant-value=true, set at pre-compile, destination=EcucPartition  # Maps one Wireless Ethernet transceiver to zero or one ECUC partitions. The ECUC partition referenced is a subset of the ECUC partitions where the Wireless Ethernet transceiver driver is mapped to.
        reference WEthTrcvCtrlRef: post-build-variant-value=true, set at link in variant link-time / post-build in variant post-build / pre-compile in variant pre-compile, requires-symbolic-name-value=true, destination=WEthCtrlConfig  # Specifies a reference to the wireless ethernet controller used for lower layer bus interface access to the transceiver.
        reference WEthTrcvRadioConfigSetRef: set at pre-compile, destination=WEthTrcvRadioConfigSet  # Reference to a WEthTrcvRadioConfigSet.
        container WEthTrcvDemEventParameterRefs [0..1]  # Container for the references to DemEventParameter elements which shall be invoked using the API Dem_SetEventStatus in case the corresponding error occurs. The EventId is taken from the referenced DemEventParameter's DemEventId symbolic value. The standardized errors are provided in this container and can be extended by vendor-specific error references.
          reference WETHTRCV_E_ACCESS [0..1]: multiplicity set at link in variant link-time / post-build in variant post-build / pre-compile in variant pre-compile, post-build-variant-multiplicity=true, post-build-variant-value=true, set at link in variant link-time / post-build in variant post-build / pre-compile in variant pre-compile, requires-symbolic-name-value=true, destination=DemEventParameter  # Reference to the DemEventParameter which shall be issued when the error "Transceiver access failed" has occurred.
    container WEthTrcvGeneral  # General configuration of Wireless Ethernet Transceiver Driver module
      boolean WEthTrcvDevErrorDetect: set at pre-compile, default-value=false  # Switches the Default Error Tracer (Det) detection and notification ON or OFF. | * true: detection and notification is enabled. * false: detection and notification is disabled.
      boolean WEthTrcvGetLinkStateApi: set at pre-compile  # Enables / Disables WEthTrcv_GetLinkState API
      boolean WEthTrcvGetTransceiverModeApi: set at pre-compile  # Enables / Disables WEthTrcv_GetTransceiverMode API
      integer WEthTrcvIndex: 0..255, set at pre-compile  # Specifies the InstanceId of this module instance. If only one instance is present it shall have the Id 0.
      float WEthTrcvMainFunctionPeriod [0..1]: 0..INF, multiplicity set at pre-compile, set at pre-compile  # Specifies the period of main function WEthTrcv_MainFunction in seconds.
      integer WEthTrcvMaxTrcvsSupported: 0..255, set at pre-compile, default-value=1
      boolean WEthTrcvSetTransceiverModeApi: set at pre-compile  # Enables / Disables WEthTrcv_SetTransceiverMode API
      boolean WEthTrcvVersionInfoApi: set at pre-compile, default-value=false  # Enables / Disables version info API
      boolean WEthTrcvVersionInfoApiMacro: set at pre-compile, default-value=false  # Enables / Disables version info API macro implementation
      reference WEthTrcvEcucPartitionRef [0..*]: scope=ECU, multiplicity set at pre-compile, post-build-variant-multiplicity=true, post-build-variant-value=true, set at pre-compile, destination=EcucPartition  # Maps the Wireless Ethernet transceiver driver to zero or multiple ECUC partitions to make the modules API available in this partition.
    container WEthTrcvRadioConfigSet [1..*]  # This container contains the radio configurations.
      container WEthTrcvRadioConfig [1..*]  # Configuration of the individual radio (PHY + MAC).
        enumeration WEthTrcvRadioChannelBandwidth: {BW_10MHZ, BW_20MHZ, BW_40MHZ, BW_5MHZ}, set at pre-compile  # Specifies the bandwidth of the physical channel.
        float WEthTrcvRadioChannelCsPowerThreshold: -100..100, set at pre-compile  # Specifies the threshold for carrier sense (CS) power of the physical channel [dBm].
        integer WEthTrcvRadioChannelFreq: 0..18446744073709551615, set at pre-compile  # Specifies the frequency of the physical channel [Hz].
        float WEthTrcvRadioChannelMaxTxPower: -100..100, set at pre-compile  # Specifies the transmit power of the physical channel [dBm].
        float WEthTrcvRadioChannelTxDatarate: 0..INF, set at pre-compile  # Specifies the transmit datarate of the physical channel. [bit/s]
        integer WEthTrcvRadioId: 0..255, scope=ECU, set at pre-compile, symbolic-name-value=true, with-auto=true  # Specifies the instance ID of the configured radio.
        enumeration WEthTrcvRadioMode: {OFF, RX_ON, RX_TX_ON, TX_ON, USED_FOR_CHANNEL_SWITCHING}, set at pre-compile  # Specifies the mode of the radio within a WEthTrcvRadioConfig. Inside of a WEthTrcvRadioConfigSet different modes for the respective WEthTrcvRadioConfigs are possible. The WEthTrcvRadioConfigSet can be selected at runtime.
        reference WEthTrcvRadioChannelRxAntenna: set at pre-compile, destination=WEthTrcvAntennaConfig  # Specifies the antenna used for reception of packets of the physical channel.
        reference WEthTrcvRadioChannelTxAntenna: set at pre-compile, destination=WEthTrcvAntennaConfig  # Specifies the antenna used for transmission of packets to the physical channel.
        container WEthTrcvRadioChannelTxQueueConfig [1..*]: multiplicity set at pre-compile  # Configuration of the individual EDCA transmit queue of a channel.
          integer WEthTrcvRadioChannelTxQueueAifsn: 0..15, set at pre-compile  # Specifies the arbitration inter frame space number (AIFSN) of the queue.
          integer WEthTrcvRadioChannelTxQueueCwMax: 0..255, set at pre-compile  # Specifies the maximum size of the contention windows (CW) of the queue.
          integer WEthTrcvRadioChannelTxQueueCwMin: 0..255, set at pre-compile  # Specifies the minimum size of the contention windows (CW) of the queue.
          integer WEthTrcvRadioChannelTxQueueId: 0..255, set at pre-compile  # Specifies the ID (equals priority) of the queue.
          float WEthTrcvRadioChannelTxQueueTxOpDurationLimit: 3.2E-5..0.00816, set at pre-compile  # Specifies the transmit operation duration limit of the queue in [s].
  module definition Wdg [0..*]: post-build-variant-support=true, variants link-time/post-build/pre-compile  # Configuration of the Wdg (Watchdog driver) module.
    container WdgDemEventParameterRefs [0..1]  # Container for the references to DemEventParameter elements which shall be invoked using the API Dem_SetEventStatus in case the corresponding error occurs. The EventId is taken from the referenced DemEventParameter's DemEventId symbolic value. The standardized errors are provided in this container and can be extended by vendor-specific error references.
      reference WDG_E_DISABLE_REJECTED [0..1]: multiplicity set at pre-compile, set at pre-compile, requires-symbolic-name-value=true, destination=DemEventParameter  # Reference to the DemEventParameter which shall be issued when the error "Initialization or mode switch failed because it would disable the watchdog" has occurred.
      reference WDG_E_MODE_FAILED [0..1]: multiplicity set at pre-compile, set at pre-compile, requires-symbolic-name-value=true, destination=DemEventParameter  # Reference to the DemEventParameter which shall be issued when the error "Setting a watchdog mode failed (during initialization or mode switch)" has occurred.
    container WdgGeneral  # All general parameters of the watchdog driver are collected here.
      boolean WdgDevErrorDetect: set at pre-compile, default-value=false  # Switches the development error detection and notification on or off. | * true: detection and notification is enabled. * false: detection and notification is disabled.
      boolean WdgDisableAllowed: set at pre-compile  # Compile switch to allow / forbid disabling the watchdog driver during runtime. | True: Disabling the watchdog driver at runtime is allowed. False: Disabling the watchdog driver at runtime is not allowed.
      integer WdgIndex: 0..255, set at pre-compile, symbolic-name-value=true  # Specifies the InstanceId of this module instance. If only one instance is present it shall have the Id 0.
      float WdgInitialTimeout: 0..65.535, set at pre-compile  # The initial timeout (sec) for the trigger condition to be initialized during Init function. It shall be not larger than WdgMaxTimeout.
      float WdgMaxTimeout: 0..65.535, set at pre-compile  # The maximum timeout (sec) to which the watchdog trigger condition can be initialized.
      enumeration WdgRunArea: {RAM, ROM}, set at pre-compile  # Represents the watchdog driver execution area is either from ROM(Flash) or RAM as required with the particular microcontroller.
      boolean WdgVersionInfoApi: set at pre-compile, default-value=false  # Compile switch to enable / disable the version information API | * True: API enabled * False: API disabled
      reference WdgEcucPartitionRef [0..1]: scope=ECU, multiplicity set at pre-compile, post-build-variant-multiplicity=true, post-build-variant-value=true, set at pre-compile, destination=EcucPartition  # Maps the Wdg driver to zero or one ECUC partitions to make the modules API available in this partition.
    container WdgPublishedInformation  # Container holding all Wdg specific published information parameters
      enumeration WdgTriggerMode: {WDG_BOTH, WDG_TOGGLE, WDG_WINDOW}, set at published-information  # Watchdog trigger mode (toggle/window/both)
    container WdgSettingsConfig  # Configuration items for the different watchdog settings, including those for external watchdog hardware. | Note: All postbuild parameters are handled via this container.
      enumeration WdgDefaultMode: {WDGIF_FAST_MODE, WDGIF_OFF_MODE, WDGIF_SLOW_MODE}, post-build-variant-value=true, set at link in variant link-time / post-build in variant post-build / pre-compile in variant pre-compile  # Default mode for watchdog driver initialization. | ImplementationType: WdgIf_ModeType
      container WdgExternalConfiguration [0..1]  # Configuration items for an external watchdog hardware
        choice reference WdgExternalContainerRef [0..1]: multiplicity set at link in variant link-time / post-build in variant post-build / pre-compile in variant pre-compile, post-build-variant-multiplicity=true, post-build-variant-value=true, set at link in variant link-time / post-build in variant post-build / pre-compile in variant pre-compile, destination=[DioChannelGroup, I2cSequence, SpiSequence]  # Reference to either | * a DioChannelGroup container in case the hardware watchdog is connected via DIO pins * an SpiSequenceConfiguration container in case the watchdog hardware is accessed via SPI * an I2CSequenceConfiguration container in case the watchdog hardware is accessed via I2C
      container WdgSettingsFast  # Hardware dependent settings for the watchdog driver's "fast" mode.
      container WdgSettingsOff  # Hardware dependent settings for the watchdog driver's "off" mode.
      container WdgSettingsSlow  # Hardware dependent settings for the watchdog driver's "slow" mode.
  module definition WdgIf [0..1]: variants pre-compile  # Configuration of the WdgIf (Watchdog Interface) module.
    container WdgIfDevice [1..*]  # It contains the information for the selection of a particular Watchdog device in case multiple Watchdog drivers are connected.
      integer WdgIfDeviceIndex: 0..255, scope=ECU, set at pre-compile, symbolic-name-value=true  # Represents the watchdog interface ID so that it can be referenced by the watchdog manager.
      reference WdgIfDriverRef: set at pre-compile, requires-symbolic-name-value=true, destination=WdgGeneral  # Reference to the watchdog drivers that are controlled by the watchdog interface.
    container WdgIfGeneral  # This container collects all generic watchdog interface parameters.
      boolean WdgIfDevErrorDetect: set at pre-compile, default-value=false  # Switches the development error detection and notification on or off. | * true: detection and notification is enabled. * false: detection and notification is disabled.
      boolean WdgIfVersionInfoApi: set at pre-compile, default-value=false  # Pre-processor switch to enable / disable the service returning the version information. | true: Version information service enabled false: Version information service disabled
  module definition WdgM [0..1]: post-build-variant-support=true, variants post-build/pre-compile  # Configuration of the WdgM (Watchdog Manager) module.
    container WdgMConfigSet  # This container describes one of multiple configuration sets of WdgM.
      reference WdgMInitialMode: post-build-variant-value=true, set at post-build in variant post-build / pre-compile in variant pre-compile, requires-symbolic-name-value=true, destination=WdgMMode  # The mode that the Watchdog Manager is in after it has been initialized.
      container WdgMDemEventParameterRefs [0..1]  # Container for the references to DemEventParameter elements which shall be invoked using the API Dem_SetEventStatus in case the corresponding error occurs. The EventId is taken from the referenced DemEventParameter's DemEventId symbolic value. The standardized errors are provided in this container and can be extended by vendor-specific error references.
        reference WDGM_E_SUPERVISION [0..1]: multiplicity set at post-build in variant post-build / pre-compile in variant pre-compile, post-build-variant-multiplicity=true, post-build-variant-value=true, set at post-build in variant post-build / pre-compile in variant pre-compile, requires-symbolic-name-value=true, destination=DemEventParameter  # Reference to the DemEventParameter which shall be issued when the error "Supervision has failed (Global Supervision Status has reached WDGM_GLOBAL_STATUS_STOPPED) and a watchdog reset will occur" has occurred.
      container WdgMMode [1..255]  # The container describes one of several modes of the Watchdog Manager.
        integer WdgMExpiredSupervisionCycleTol: 0..65535, scope=ECU, post-build-variant-value=true, set at post-build in variant post-build / pre-compile in variant pre-compile  # This parameter shall be used to define a value that fixes the amount of expired supervision cycles for how long the blocking of watchdog triggering shall be postponed, AFTER THE GLOBAL SUPERVISION STATUS HAS REACHED THE STATE EXPIRED.
        integer WdgMModeId: 0..255, set at pre-compile, symbolic-name-value=true  # This parameter fixes the identifier for the mode. This identifier is for instance passed as a parameter to the WdgM_SetMode service.
        container WdgMAliveSupervision [0..65535]  # This container collects all configuration parameters of Alive-Supervision of one Checkpoint. Note that each Checkpoint may have different parameters. For example, it may have different min and max margin.
          integer WdgMExpectedAliveIndications: 0..65535, post-build-variant-value=true, set at post-build in variant post-build / pre-compile in variant pre-compile  # This parameter contains the amount of expected alive indications of the Checkpoint within the referenced amount of defined supervision cycles according to corresponding SE.
          integer WdgMMaxMargin: 0..255, post-build-variant-value=true, set at post-build in variant post-build / pre-compile in variant pre-compile  # This parameter contains the amount of alive indications of the Checkpoint that are acceptable to be additional to the expected alive indications within the corresponding supervision reference cycle.
          integer WdgMMinMargin: 0..255, post-build-variant-value=true, set at post-build in variant post-build / pre-compile in variant pre-compile  # This parameter contains the amount of alive indications of the Checkpoint that are acceptable to be missed from the expected alive indications within the corresponding supervision reference cycle.
          integer WdgMSupervisionReferenceCycle: 1..65535, post-build-variant-value=true, set at post-build in variant post-build / pre-compile in variant pre-compile  # This parameter shall contain the amount of supervision cycles to be used as reference by the alive-supervision mechanism to perform the checkup with counted alive indications according to corresponding SE.
          reference WdgMAliveSupervisionCheckpointRef: post-build-variant-value=true, set at post-build in variant post-build / pre-compile in variant pre-compile, requires-symbolic-name-value=true, destination=WdgMCheckpoint  # Reference to Checkpoint within a Supervised Entity that shall be supervised.
        container WdgMDeadlineSupervision [0..65535]  # This container collects all configuration parameters for Deadline Supervision for a Supervised Entity.
          float WdgMDeadlineMax: 0..INF, post-build-variant-value=true, set at post-build in variant post-build / pre-compile in variant pre-compile  # This parameter contains the longest time span after which the deadline is considered to be met. | Unit: [s]
          float WdgMDeadlineMin: 0..INF, post-build-variant-value=true, set at post-build in variant post-build / pre-compile in variant pre-compile  # This parameter contains the shortest time span after which the deadline is considered to be met. | Unit: [s]
          reference WdgMDeadlineStartRef: post-build-variant-value=true, set at post-build in variant post-build / pre-compile in variant pre-compile, requires-symbolic-name-value=true, destination=WdgMCheckpoint  # This is the reference to the start Checkpoint for Deadline Supervision.
          reference WdgMDeadlineStopRef: post-build-variant-value=true, set at post-build in variant post-build / pre-compile in variant pre-compile, requires-symbolic-name-value=true, destination=WdgMCheckpoint  # This is the reference to the stop Checkpoint for Deadline Supervision.
        container WdgMExternalLogicalSupervision [0..65535]  # This container collects all configuration parameters for Logical Supervision for one external graph.
          choice reference WdgMExternalCheckpointFinalRef [1..65535]: multiplicity set at post-build in variant post-build / pre-compile in variant pre-compile, post-build-variant-multiplicity=true, post-build-variant-value=true, set at post-build in variant post-build / pre-compile in variant pre-compile, requires-symbolic-name-value=true, destination=[WdgMCheckpoint, WdgMTransitionProxy]  # This is the reference to the final Checkpoint(s) for this External Graph which can end with a WdgMCheckpoint or in case of cross cluster transitions with a WdgMTransitionProxy. | Both WdgMCheckpoint(s) and WdgMTransitionProxy(s) could be mixed inside the same WdgMExternalLogicalSupervision.
          choice reference WdgMExternalCheckpointInitialRef [1..65535]: multiplicity set at post-build in variant post-build / pre-compile in variant pre-compile, post-build-variant-multiplicity=true, post-build-variant-value=true, set at post-build in variant post-build / pre-compile in variant pre-compile, requires-symbolic-name-value=true, destination=[WdgMCheckpoint, WdgMTransitionProxy]  # This is the reference to the initial Checkpoint(s) for this External Graph which can start with a WdgMCheckpoint or in case of cross cluster transitions with a WdgMTransitionProxy. | Both WdgMCheckpoint(s) and WdgMTransitionProxy(s) could be mixed inside the same WdgMExternalLogicalSupervision.
          container WdgMCrossClusterTransition [0..65535]  # This container configures a cross cluster transition. Tags: atp.Status=draft | A WdgMCrossClusterTransition can be configured * from a WdgMCheckpoint to a WdgMTransitionProxy * from a WdgMTransitionProxy to a WdgMCheckpoint * from a WdgMTransitionProxy to another WdgMTransitionProxy (in Host Software Cluster only) * from a WdgMTransitionProxy to the identical WdgMTransitionProxy (in Application Software Cluster only for the case that no WdgMCheckpoint has to be reached in the Application Software Cluster) * from a WdgMCheckpoint to a WdgMCheckpoint (in case the cross cluster transition graph is entirely described with WdgMCrossClusterTransition containers)
            choice reference WdgMCrossClusterTransitionDestRef: post-build-variant-value=true, set at pre-compile, requires-symbolic-name-value=true, destination=[WdgMCheckpoint, WdgMTransitionProxy]  # This is the reference to the destination of a cross cluster transition. Tags: atp.Status=draft
            choice reference WdgMCrossClusterTransitionSourceRef: post-build-variant-value=true, set at pre-compile, requires-symbolic-name-value=true, destination=[WdgMCheckpoint, WdgMTransitionProxy]  # This is the reference to the source of a cross cluster transition. Tags: atp.Status=draft
          container WdgMExternalTransition [0..65535]  # This container collects the Checkpoints for an External Transition across Supervised Entities.
            reference WdgMExternalTransitionDestRef: post-build-variant-value=true, set at post-build in variant post-build / pre-compile in variant pre-compile, requires-symbolic-name-value=true, destination=WdgMCheckpoint  # This is the reference to the destination Checkpoint of an External Transition.
            reference WdgMExternalTransitionSourceRef: post-build-variant-value=true, set at post-build in variant post-build / pre-compile in variant pre-compile, requires-symbolic-name-value=true, destination=WdgMCheckpoint  # This is the reference to the source Checkpoint of an External Transition.
          container WdgMTransitionProxy [0..65535]  # The WdgMTransitionProxy defines a proxy for a transition between the Host Software Cluster and an Application Software Cluster and vice versa. Tags: atp.Status=draft | From the Host Software Cluster perspective a Cross Cluster Transition graph leaves the host after the transition which has the WdgMTransitionProxy as a destination or initial reference and returns in this WdgMTransitionProxy after the configured transitions are occurred in the related Application Software Cluster. Afterwards the transition in the host are expected which are referencing the WdgMTransitionProxy by a source or final reference.
            foreign reference WdgMResourceRef: scope=ECU, destination-type=CP-SOFTWARE-CLUSTER-SERVICE-RESOURCE  # Reference to the CpSoftwareClusterServiceResource. Tags: atp.Status=draft
        container WdgMLocalStatusParams [0..65535]  # This container collects all configuration parameters for the Local Status of a Supervised Entity.
          integer WdgMFailedAliveSupervisionRefCycleTol: 0..255, post-build-variant-value=true, set at post-build in variant post-build / pre-compile in variant pre-compile  # This parameter shall contain the acceptable amount of reference cycles with incorrect/failed alive supervisions for this Supervised Entity.
          reference WdgMLocalStatusSupervisedEntityRef: post-build-variant-value=true, set at post-build in variant post-build / pre-compile in variant pre-compile, requires-symbolic-name-value=true, destination=WdgMSupervisedEntity  # This is the reference to the Supervised Entity for which the Local Status parameters are specified.
        container WdgMMainFunctionModeProps [0..*]: multiplicity set at pre-compile  # This container provides configuration values for a WdgMMainFunction which apply in a specific WdgMMode. Tags: atp.Status=draft
          float WdgMMainFunctionModePropsTimePeriod: 0..INF, set at pre-compile  # The period between successive calls to according instance of WdgM_MainFunction in seconds. This parameter may be used by the WdgM generator to transform the values of the WdgMModes and/or WdhMSupervisedEntities timing configuration parameters of the WdgM module to internal implementation specific counter or tick values. The WdgM module's internal timing handling is implementation specific. The WdgM module (generator) may rely on the fact that Wdg_MainFunction is scheduled according to the value configured here. Tags: atp.Status=draft | Unit: [s]
          reference WdgMMainFunctionModePropsMainFunctionRef: set at pre-compile, destination=WdgMMainFunction  # Reference to the WdgMMainFunction for which the WdgMMainFunctionModeProps apply. Tags: atp.Status=draft
        container WdgMTrigger [0..255]  # This container collects all configuration parameters for the triggering of hardware watchdogs.
          integer WdgMTriggerConditionValue: 1..65535, post-build-variant-value=true, set at post-build in variant post-build / pre-compile in variant pre-compile  # This parameter shall contain the value that is passed to WdgIf_SetTriggerCondition for this watchdog.
          enumeration WdgMWatchdogMode: {WDGIF_FAST_MODE, WDGIF_OFF_MODE, WDGIF_SLOW_MODE}, post-build-variant-value=true, set at post-build in variant post-build / pre-compile in variant pre-compile  # This parameter contains the watchdog mode that shall be used for the referenced watchdog in this Watchdog Manager mode. | Implementation Type: WdgIf_ModeType
          reference WdgMTriggerWatchdogRef: post-build-variant-value=true, set at post-build in variant post-build / pre-compile in variant pre-compile, destination=WdgMWatchdog  # This parameter is a reference to the configured watchdog.
    container WdgMGeneral  # Container defines all general configuration parameters of the Watchdog Manager.
      boolean WdgMDevErrorDetect: set at pre-compile, default-value=false  # Switches the development error detection and notification on or off. | * true: detection and notification is enabled. * false: detection and notification is disabled.
      boolean WdgMEnableTimeoutDetection: set at pre-compile, default-value=false  # This parameter enables the timeout detection part of the Deadline Supervision (needed to detect deadline supervision violation when end checkpoint is never reached). | true : Timeout detection is enabled. false : Timeout detection is disabled. Note: By default this option is disabled for backward compatibility reasons.
      boolean WdgMImmediateReset [0..1]: set at pre-compile  # This parameter enables/disablse the immediate reset feature in case of alive-supervision failure. | true: Immediate reset is enabled false: Immediate reset is disabled
      boolean WdgMOffModeEnabled [0..1]: set at pre-compile  # This parameter enables/disables the selection of the "OffMode" of the watchdog driver. | true: "OffMode" selection is allowed false: "OffMode" selection is disallowed
      enumeration WdgMSwClusterSupport [0..1]: set at pre-compile, default-value=DISABLE_SW_CLUSTER_SUPPORT  # This parameter selects the support for SW Architecture with Software Clusters. Tags: atp.Status=draft | If the parameter is not set the default behavior DISABLE_SW_CLUSTER_SUPPORT applies.
        DISABLE_SW_CLUSTER_SUPPORT  # Tags: atp.Status=draft
        ENABLE_SW_CLUSTER_SUPPORT  # Tags: atp.Status=draft
      boolean WdgMVersionInfoApi: set at pre-compile, default-value=false  # Preprocessor switch to enable/disable the existence of the API WdgM_GetVersionInfo. Shall be used to remove unneeded code segments. | true: API is enabled false: API is disabled
      container WdgMBaseSocket [0..*]: multiplicity set at pre-compile  # This container configures how many EcucPartitions specific infrastructure links are required for the WdgM instances in Application Software Clusters provided by the Host Software Cluster. Tags: atp.Status=draft | Such infrastructure links serve for: the initialization of Application Software Cluster WdgM instances by Host WdgM instance the transmission of supervision results from Application Software Cluster WdgM instances to Host WdgM instance any other implementation specific purpose which is need for the interaction of Application Software Cluster WdgM instances and Host WdgM instance If the infrastructure connection is specific to one or several EcucPartition(s) the WdgMSocketEcucPartitionRef(s) denotes the applicable EcucPartition.
        foreign reference WdgMResourceRef: scope=ECU, destination-type=CP-SOFTWARE-CLUSTER-SERVICE-RESOURCE  # Reference to the CpSoftwareClusterServiceResource. Tags: atp.Status=draft
        reference WdgMSocketEcucPartitionRef [0..*]: scope=ECU, multiplicity set at pre-compile, set at pre-compile, destination=EcucPartition  # Reference to the EcucPartition. Tags: atp.Status=draft
      container WdgMMainFunction [0..*]: multiplicity set at pre-compile  # Reference to the WdgMInstanceMainFunction which this Supervised Entity belongs to. Relevant to Alive Supervision and Deadline Supervision Tags: atp.Status=draft
        reference WdgMMainFunctionPartitionRef [0..1]: multiplicity set at pre-compile, set at pre-compile, destination=EcucPartition  # Reference to EcucPartition, where the according WdgM_MainFunction instance is assigned to. For the software architecture with single partition, this reference is unnecessary. Tags: atp.Status=draft
      container WdgMSupervisedEntity [0..65535]  # This container collects all common (mode-independent) parameters of a Supervised Entity to be supervised by the Watchdog Manager.
        integer WdgMSupervisedEntityId: 0..65535, set at pre-compile, symbolic-name-value=true  # This parameter shall contain the unique identifier of the supervised entity.
        reference WdgMInternalCheckpointInitialRef [0..65535]: set at pre-compile, requires-symbolic-name-value=true, destination=WdgMCheckpoint  # This is the reference to the initial Checkpoint for this Supervised Entity.
        reference WdgMInternallCheckpointFinalRef [0..65535]: multiplicity set at pre-compile, set at pre-compile, requires-symbolic-name-value=true, destination=WdgMCheckpoint  # This is the reference to the final Checkpoint(s) for this Supervised Entity.
        reference WdgMMainFunctionRef [0..1]: multiplicity set at pre-compile, set at pre-compile, destination=WdgMMainFunction  # Reference to the WdgMInstanceMainFunction which this Supervised Entity belongs to. Relevant to Alive Supervision and Deadline Supervision Tags: atp.Status=draft
        reference WdgMOSCounter [0..1]: multiplicity set at pre-compile, set at pre-compile, destination=OsCounter  # OS counter used by Watchdog Manager to perform the deadline supervision of the Supervised Entity.
        container WdgMCheckpoint [1..65535]  # This container collects all Checkpoints of this Supervised Entity. Each Supervised Entity has at least one Checkpoint.
          integer WdgMCheckpointId: 0..65535, set at pre-compile, symbolic-name-value=true  # This parameter shall contain the unique identifier of Checkpoint.
        container WdgMInternalTransition [0..65535]  # This container defines the graph of Internal Transitions within this Supervised Entity.
          reference WdgMInternalTransitionDestRef: set at pre-compile, requires-symbolic-name-value=true, destination=WdgMCheckpoint  # This is the reference to the destination Checkpoint of a Internal Transition within this Supervised Entity.
          reference WdgMInternalTransitionSourceRef: set at pre-compile, requires-symbolic-name-value=true, destination=WdgMCheckpoint  # This is the reference to the source Checkpoint of a Internal Transition within this Supervised Entity.
      container WdgMWatchdog [0..255]  # This container collects all common (mode-independent) parameters of a Watchdog to be triggered by the Watchdog Manager.
        string WdgMWatchdogName: set at pre-compile  # This parameter shall contain the name of the watchdog instance.
        reference WdgMWatchdogDeviceRef: set at pre-compile, requires-symbolic-name-value=true, destination=WdgIfDevice  # Reference to one device container of Watchdog Interface. In the referenced container WdgIfDevice, the parameter WdgIfDeviceIndex contains the Index parameter that WdgM has to use for WdgIf_SetTriggerCondition calls for that watchdog instance.
  module definition Xcp [0..1]: post-build-variant-support=true, variants post-build/pre-compile  # Configuration of the XCP module
    container XcpConfig  # This container contains the configuration parameters and sub containers of the AUTOSAR Xcp module.
      container XcpCommunicationChannel [0..*]  # This container represents the configuration of the communication channel of XCP.
        reference XcpChannelRxPduRef [0..1]: scope=ECU, post-build-variant-value=true, set at post-build in variant post-build / pre-compile in variant pre-compile, destination=XcpRxPdu  # Optional reference to the XCP Rx PDU.
        reference XcpChannelTxPduRef: scope=ECU, post-build-variant-value=true, set at post-build in variant post-build / pre-compile in variant pre-compile, destination=XcpTxPdu  # Reference to the XCP Tx PDU.
        reference XcpComMChannelRef: scope=ECU, post-build-variant-value=true, set at post-build in variant post-build / pre-compile in variant pre-compile, destination=ComMChannel  # Reference to the ComM channel the PDUs belong to.
      container XcpDaqList [1..*]  # This container contains the configuration of the DAQs.
        integer XcpDaqListNumber: 0..65534, scope=ECU, set at pre-compile, symbolic-name-value=true  # Index number of the DAQ list
        enumeration XcpDaqListType: {DAQ, DAQ_STIM, STIM}, scope=ECU, set at pre-compile  # This indicates whether this DAQ list represents a DAQ or a STIM.
        integer XcpMaxOdt: 0..252, scope=ECU, set at pre-compile  # MAX_ODT indicates the maximum amount of ODTs in this DAQ list | (STATIC configuration)
        integer XcpMaxOdtEntries: 0..255, scope=ECU, set at pre-compile  # This parameter indicates the maximum amount of entries in an ODT of this DAQ list (STATIC configuration).
        container XcpDto [0..*]  # This container collects data transfer object specific parameters for the DAQ list.
          integer XcpDtoPid: 0..251, scope=ECU, set at pre-compile, symbolic-name-value=true  # Packet identifier (PID) of the DTO that identifies the ODT the content of the DTO.
          choice reference XcpDto2PduMapping: scope=ECU, set at pre-compile, destination=[XcpRxPdu, XcpTxPdu]  # This reference specifies the mapping of the DTO to the PDUs from the lower-layer interfaces (CanIf, FrIf, SoAd and Cdd). | A reference to a XcpRxPdu is only feasible if the the DaqListType is DAQ_STIM. A reference to a XcpTxPdu is only feasible if the DaqListType is DAQ.
        container XcpOdt [0..*]  # This container contains ODT-specific parameter for the DAQ list.
          integer XcpOdtEntryMaxSize: 0..254, scope=ECU, set at pre-compile  # This parameter indicates the upper limit for the size of the element described by an ODT entry. Depending on the DaqListType this ODT belongs to it describes the limit for a DAQ (MAX_ODT_ENTRY_SIZE_DAQ) or a STIM (MAX_ODT_ENTRY_SIZE_STIM).
          integer XcpOdtNumber [0..1]: 0..251, scope=ECU, multiplicity set at pre-compile, set at pre-compile, symbolic-name-value=true  # Index number of this ODT within the DAQ list.
          reference XcpOdt2DtoMapping [0..1]: scope=ECU, set at pre-compile, destination=XcpDto  # This reference maps the ODT to the according DTO in which it will be transmitted.
          container XcpOdtEntry [1..*]  # This container collects all configuration parameters that comprise an ODT entry.
            linker symbol XcpOdtEntryAddress [0..1]: scope=ECU, multiplicity set at pre-compile, set at pre-compile  # Memory address that the ODT entry is referencing to.
            integer XcpOdtEntryBitOffset [0..1]: 0..31, scope=ECU, multiplicity set at pre-compile, set at pre-compile  # Represent the bit offset in case of the element represents status bit.
            integer XcpOdtEntryLength [0..1]: 0..255, scope=ECU, multiplicity set at pre-compile, set at pre-compile  # Length of the referenced memory area that is referenced by the ODT entry.
            integer XcpOdtEntryNumber [0..1]: 0..254, scope=ECU, multiplicity set at pre-compile, set at pre-compile  # Index number of the ODT entry
      container XcpEventChannel [1..*]  # This container contains the configuration of event channels on the XCP slave.
        enumeration XcpEventChannelConsistency: {DAQ, EVENT, ODT}, set at pre-compile, default-value=ODT  # Type of consistency used by event channel
        integer XcpEventChannelMaxDaqList: 0..255, scope=ECU, set at pre-compile  # Maximum amount of DAQ lists that are handled by this event channel.
        integer XcpEventChannelNumber: 0..65534, scope=ECU, set at pre-compile, symbolic-name-value=true  # Index number of the event channel.
        integer XcpEventChannelPriority: 0..255, scope=ECU, set at pre-compile  # Priority of the event channel
        integer XcpEventChannelTimeCycle: 0..255, set at pre-compile  # The event channel time cycle indicates which sampling period is used to process this event channel. A value of 0 means 'Not cyclic'.
        enumeration XcpEventChannelTimeUnit [0..1]: {TIMESTAMP_UNIT_100MS, TIMESTAMP_UNIT_100NS, TIMESTAMP_UNIT_100PS, TIMESTAMP_UNIT_100US, TIMESTAMP_UNIT_10MS, TIMESTAMP_UNIT_10NS, TIMESTAMP_UNIT_10PS, TIMESTAMP_UNIT_10US, TIMESTAMP_UNIT_1MS, TIMESTAMP_UNIT_1NS, TIMESTAMP_UNIT_1PS, TIMESTAMP_UNIT_1S, TIMESTAMP_UNIT_1US}, multiplicity set at pre-compile, set at pre-compile  # This configuration parameter indicates the unit of the event channel time cycle.
        enumeration XcpEventChannelType: {DAQ, DAQ_STIM, STIM}, set at pre-compile, default-value=DAQ  # This configuration parameter indicates what kind of DAQ list can be allocated to this event channel.
        reference XcpEventChannelTriggeredDaqListRef [0..*]: scope=ECU, multiplicity set at pre-compile, set at pre-compile, destination=XcpDaqList  # References all DAQ lists that are trigged by this event channel.
      container XcpPageSwitching [0..1]  # This container represents configuration of the page switching feature.
        container XcpSegment [0..*]  # This container represents configuration of the page switching segment element.
          linker symbol XcpReferencePageAddress: set at pre-compile  # Memory address of the reference page (Page ID = 0).
          integer XcpSegmentLength: 0..18446744073709551615, set at pre-compile  # Length of the segment in bytes.
          linker symbol XcpWorkingPageAddress: set at pre-compile  # Memory address address of the working page (Page ID = 1).
          container XcpPage [0..254]  # This container represents configuration of the optional page element.
            linker symbol XcpPageAddress: set at pre-compile  # Memory address of the optional page (Page ID = 2 ... 255).
      choice container XcpPdu [1..*]  # Contains PDU information. A PDU may be either a transmission PDU or a reception PDU.
        container XcpRxPdu [0..1]  # This container specifies received PDUs.
          integer XcpRxPduId: 0..65535, scope=ECU, set at pre-compile, symbolic-name-value=true, with-auto=true  # ID of the PDU that will be received via a Xcp_<module>RxIndication.
          reference XcpRxPduRef: scope=ECU, post-build-variant-value=true, set at post-build in variant post-build / pre-compile in variant pre-compile, destination=Pdu
        container XcpTxPdu [0..1]  # This container specifies transmission PDUs.
          integer XcpTxPduId: 0..65535, scope=ECU, set at pre-compile, symbolic-name-value=true, with-auto=true  # The PDU identifier, which has to be used by the lower layer BSW module for TxConfirmations or TriggerTransmits.
          reference XcpTxPduRef: scope=ECU, post-build-variant-value=true, set at post-build in variant post-build / pre-compile in variant pre-compile, destination=Pdu  # Reference to the external PDU definition.
    container XcpGeneral  # This container contains the general configuration parameters of the XCP.
      enumeration XcpDaqConfigType: {DAQ_DYNAMIC, DAQ_STATIC}, scope=ECU, set at pre-compile  # Sets the DAQ_CONFIG_TYPE bit within the DAQ_PROPERTIES parameter to "static" or to "dynamic". If DAQ_STATIC is selected, the DAQ_CONFIG_TYPE bit is set to "0". If DAQ_DYNAMIC is selected, the DAQ_CONFIG_TYPE bit is set to "1".
      integer XcpDaqCount: 0..65535, scope=ECU, set at pre-compile  # Indicates the number of DAQ lists for dynamic configuration.
      boolean XcpDevErrorDetect: set at pre-compile, default-value=false  # Switches the development error detection and notification on or off. | * true: detection and notification is enabled. * false: detection and notification is disabled.
      boolean XcpFlashProgrammingEnabled: set at pre-compile  # Enabling of XCP Flash programming functionality
      enumeration XcpIdentificationFieldType: {ABSOLUTE, RELATIVE_BYTE, RELATIVE_WORD, RELATIVE_WORD_ALIGNED}, set at pre-compile  # Type of Identification Field the slave will use when transferring DAQ Packets to the master. The master has to use the same Type of Identification Field when transferring STIM Packets to the slave.
      float XcpMainFunctionPeriod: 0..INF, set at pre-compile  # The XCP does not require this information but the BSW scheduler, which invokes the main function, needs it in order to plan its tasks.
      integer XcpMaxCto: 8..255, set at pre-compile  # MAX_CTO shows the maximum length of a CTO packet in bytes.
      integer XcpMaxDto: 8..65535, set at pre-compile  # MAX_DTO shows the maximum length of a DTO packet in bytes.
      integer XcpMaxEventChannel: 0..65535, scope=ECU, set at pre-compile
      integer XcpMinDaq: 0..255, scope=ECU, set at pre-compile  # Indicates the number of predefined, read only DAQ lists on the XCP slave.
      integer XcpOdtCount: 0..252, scope=ECU, set at pre-compile  # This parameter indicates the amount of ODTs of a DAQ list using dynamic DAQ list configuration.
      integer XcpOdtEntriesCount: 0..255, scope=ECU, set at pre-compile  # Indicates the amount of entries into an ODT using dynamic DAQ list configuration.
      integer XcpOdtEntrySizeDaq: 0..255, scope=ECU, set at pre-compile  # Indicates the size of an element described by an ODT entry to the DaqListType for a DAQ.
      integer XcpOdtEntrySizeStim: 0..255, scope=ECU, set at pre-compile  # Indicates the size of an element described by an ODT entry to the DaqListType for a stim.
      boolean XcpOnCanEnabled: set at pre-compile  # Enabling of XCPonCAN functionality
      boolean XcpOnCddEnabled: set at pre-compile  # Enabling of XCPonCdd functionality
      boolean XcpOnEthernetEnabled: set at pre-compile  # Enabling of XCPonEthernet functionality
      boolean XcpOnFlexRayEnabled: set at pre-compile  # Enabling of XCPonFlexRay functionality
      boolean XcpPrescalerSupported: set at pre-compile  # This parameter enables and disables the support for Prescaler support. True is Enabled, False is disabled
      boolean XcpSuppressTxSupport: set at pre-compile  # Switches the support of suppressing transmission of PDUs per communication channel on or off. | TRUE: Suppressing of TxPDUs supported FALSE: Suppressing of TxPDUs not supported
      integer XcpTimestampTicks: 0..65535, set at pre-compile  # This parameter defines the timestamp that will increment based TIMESTAMP_TICKS per unit and wrap around if an overflow occurs.
      enumeration XcpTimestampType: {FOUR_BYTE, NO_TIME_STAMP, ONE_BYTE, TWO_BYTE}, set at pre-compile  # This parameter indicates the number of bytes used for the timestamp field. In case No_TIME_STAMP is selected the timestamp field is not available.
      enumeration XcpTimestampUnit: {TIMESTAMP_UNIT_100MS, TIMESTAMP_UNIT_100NS, TIMESTAMP_UNIT_100PS, TIMESTAMP_UNIT_100US, TIMESTAMP_UNIT_10MS, TIMESTAMP_UNIT_10NS, TIMESTAMP_UNIT_10PS, TIMESTAMP_UNIT_10US, TIMESTAMP_UNIT_1MS, TIMESTAMP_UNIT_1NS, TIMESTAMP_UNIT_1PS, TIMESTAMP_UNIT_1S, TIMESTAMP_UNIT_1US}, set at pre-compile  # This parameter indicates the resolution of the data acquisition clock of the slave when transferring data to master.
      boolean XcpVersionInfoApi: set at pre-compile, default-value=false  # Enables/disables the existence of the XCP_GetVersionInfo() API service. | TRUE: XCP_GetVersionInfo() API service exists FALSE: XCP_GetVersionInfo() API service does not exist
      reference XcpCounterRef: set at pre-compile, destination=OsCounter  # This parameter contains a reference to the counter, which is used by XCP.
      reference XcpNvRamBlockIdRef [0..1]: multiplicity set at post-build in variant post-build / pre-compile in variant pre-compile, post-build-variant-multiplicity=true, post-build-variant-value=true, set at post-build in variant post-build / pre-compile in variant pre-compile, requires-symbolic-name-value=true, destination=NvMBlockDescriptor  # This reference contains the link to a non-volatile memory block to be used in the feature "RESUME MODE" so this information has to be stored non volatile to be available directly after start-up of the ECU.
  module definition Xfrm [0..*]: variants pre-compile  # Configuration of the Xfrm module.
    container XfrmGeneral  # Contains the general configuration parameters of the module.
      boolean XfrmDevErrorDetect: set at pre-compile, default-value=false  # Switches the development error detection and notification on or off. | * true: detection and notification is enabled. * false: detection and notification is disabled.
      integer XfrmInstanceId: 0..255, set at pre-compile  # Specifies the InstanceId of this module instance. If only one instance is present it shall have the Id 0.
      boolean XfrmVersionInfoApi: set at pre-compile, default-value=false  # Activate/Deactivate the version information API. | * true: version information API activated * false: version information API deactivated
    container XfrmImplementationMapping [1..*]  # For each transformer (TransformationTechnology) in a transformer chain (DataTransformation) which is applied to an ISignal it is necessary to specify the BswModuleEntry which implements it. This is the container to hold these mappings.
      enumeration XfrmTransformerClassExtractProtocolHeaderFields [0..1]: {SAFETY, SECURITY, SERIALIZER}, multiplicity set at pre-compile, set at pre-compile  # Defines the transformerClass of the TransformationTechnology containing information in its protocol header that is required to distinguish between requests vs. responses and normal vs. error responses in C/S communication. Usually this shall be the TransformationTechnology with transformerClass equal to "serializer". | Setting this parameter basically instructs the RTE to pass a pointer to the Mip_ExtractProtocolHeaderFields() function of the respective transformer as an additional argument to the called transformer function. E.g., if the serializing transformer in the transformer chain is SomeIpXf and this parameter is set to SERIALIZER, then SomeIpXf_ExtractProtocolHeaderFields() will be passed as additional argument.
      foreign reference XfrmCSTransactionHandleImplementationDataTypeRef [0..1]: multiplicity set at pre-compile, set at pre-compile, destination-type=IMPLEMENTATION-DATA-TYPE  # Reference to the ImplementationDataType with category STRUCTURE which defines the type of the C/S transaction handle. Setting this parameter basically instructs the RTE to pass a reference to a variable of exactly this ImplementationDataType as an additional argument to the called transformer function.
      foreign reference XfrmInvTransformerBswModuleEntryRef [0..1]: multiplicity set at pre-compile, set at pre-compile, destination-type=BSW-MODULE-ENTRY  # Reference to the BswModuleEntry which implements the referenced inverse transformer on the receiving/called side.
      foreign reference XfrmTransformationTechnologyRef: set at pre-compile, destination-type=TRANSFORMATION-TECHNOLOGY  # Reference to the TransformationTechnology in the DataTransformation of the system description for which the implementation (BswModuleEntry) shall be mapped.
      foreign reference XfrmTransformerBswModuleEntryRef [0..1]: multiplicity set at pre-compile, set at pre-compile, destination-type=BSW-MODULE-ENTRY  # Reference to the BswModuleEntry which implements the referenced transformer on the sending/calling side.
      instance reference XfrmVariableDataPrototypeInstanceRef [0..1]: multiplicity set at pre-compile, set at pre-compile, destination-context=SW-COMPONENT-PROTOTYPE PORT-PROTOTYPE, destination-type=VARIABLE-DATA-PROTOTYPE  # Instance Reference to a VariableDataPrototype in case a dedicated transformer BswModuleEntry is required per VariableDataPrototype access.
      container XfrmDemEventParameterRefs [0..1]  # Container for the references to DemEventParameter elements which shall be invoked using the API Dem_SetEventStatus in case the corresponding error occurs. The EventId is taken from the referenced DemEventParameter's DemEventId symbolic value. The standardized errors are provided in this container and can be extended by vendor-specific error references.
        reference XFRM_E_MALFORMED_MESSAGE [0..1]: multiplicity set at pre-compile, set at pre-compile, requires-symbolic-name-value=true, destination=DemEventParameter  # Reference to configured DEM event to report if malformed messages were received by the transformer.
      container XfrmSignal [0..1]  # Reference to the signal in the system description that transports the transformed data.
        choice container XfrmSignalChoice  # Choice whether an ISignal or an ISignalGroup shall be referenced.
          container XfrmISignalGroupRefChoice [0..1]  # Reference to the ISignalGroup in the system description that transports the transformed data.
            foreign reference XfrmISignalGroupRef: set at pre-compile, destination-type=I-SIGNAL-GROUP  # Reference to the ISignalGroup in the system description that transports the transformed data.
          container XfrmISignalRefChoice [0..1]  # Reference to the ISignal in the system description that transports the transformed data.
            foreign reference XfrmISignalRef: set at pre-compile, destination-type=I-SIGNAL  # Reference to the ISignal in the system description that transports the transformed data.
package /AUTOSAR/EcucDestinationUriDefSets
  4 x ecuc destination uri def set:
    ComUserUriDefSet
      ecuc destination uri def ComUser
        destination-uri-policy destination-uri-nesting-contract=VERTEX-OF-TARGET-CONTAINER:
          container ComUserModuleCnf [0..1]: destination-uri=ComUser, multiplicity set at pre-compile  # Contains the configuration parameters of the Com user module.
            string ComUserHeaderInclude [0..1]: set at pre-compile  # Defines the header file where the Com user provides the function declarations for configured callbacks.
            container ComUserCallback [0..*]: multiplicity set at link in variant link-time+post-build / pre-compile in variant pre-compile, post-build-variant-multiplicity=true  # This container defines a Com callback function for signals and signal groups.
              function name ComUserCallbackName: scope=ECU, multiplicity set at link in variant link-time+post-build / pre-compile in variant pre-compile, set at link in variant link-time+post-build / pre-compile in variant pre-compile  # The name of the callback function to be called.
              enumeration ComUserCallbackType: {COM_RX_ACK, COM_RX_INV, COM_RX_TOUT, COM_TX_ACK, COM_TX_ERR, COM_TX_TOUT}, scope=ECU, multiplicity set at link in variant link-time+post-build / pre-compile in variant pre-compile, set at link in variant link-time+post-build / pre-compile in variant pre-compile  # The type of the Com callback
            container ComUserSignal [0..*]: multiplicity set at link in variant link-time / post-build in variant post-build / pre-compile in variant pre-compile, post-build-variant-multiplicity=true  # Contains the configuration parameters of a signal inside a Com user module. | Please note that it is valid to define ComUserSignal without any callback function.
              integer ComUserCbkHandleId [0..1]: 0..65535, scope=ECU, multiplicity set at pre-compile, set at pre-compile, symbolic-name-value=true  # The numerical value used as the Com user callback handle Id. | This ID identifies signals and signal groups in the COM callbacks using ComUserCbkHandleId parameter respectively.
              reference ComUserCallbackRef [0..*]: scope=ECU, multiplicity set at link in variant link-time / post-build in variant post-build / pre-compile in variant pre-compile, post-build-variant-multiplicity=true, post-build-variant-value=true, set at link in variant link-time+post-build / pre-compile in variant pre-compile, destination=ComUserModuleCnf/ComUserCallback  # Reference(s) to all callback(s) of this signal or signal group.
              foreign reference ComUserSystemTemplateSystemSignalRef [0..1]: scope=ECU, multiplicity set at link in variant link-time / post-build in variant post-build / pre-compile in variant pre-compile, post-build-variant-multiplicity=true, post-build-variant-value=true, set at link in variant link-time / post-build in variant post-build / pre-compile in variant pre-compile, destination-type=I-SIGNAL-TO-I-PDU-MAPPING  # Reference to the ISignalToIPduMapping that contains a reference to the ISignal (System Template) which this ComUserSignal (or ComUserGroupSignal) represents.
            container ComUserSignalGroup [0..*]: multiplicity set at link in variant link-time / post-build in variant post-build / pre-compile in variant pre-compile, post-build-variant-multiplicity=true  # Contains the configuration parameters of a signal group inside a Com user module. | Please note that it is valid to define ComUserSignalGroup without any callback function.
              integer ComUserCbkHandleId [0..1]: 0..65535, scope=ECU, multiplicity set at pre-compile, set at pre-compile, symbolic-name-value=true  # The numerical value used as the Com user callback handle Id. | This ID identifies signals and signal groups in the COM callbacks using ComUserCbkHandleId parameter respectively.
              reference ComUserCallbackRef [0..*]: scope=ECU, multiplicity set at link in variant link-time / post-build in variant post-build / pre-compile in variant pre-compile, post-build-variant-multiplicity=true, post-build-variant-value=true, set at link in variant link-time+post-build / pre-compile in variant pre-compile, destination=ComUserModuleCnf/ComUserCallback  # Reference(s) to all callback(s) of this signal or signal group.
              foreign reference ComUserSystemTemplateSignalGroupRef [0..1]: scope=ECU, multiplicity set at link in variant link-time / post-build in variant post-build / pre-compile in variant pre-compile, post-build-variant-multiplicity=true, post-build-variant-value=true, set at link in variant link-time / post-build in variant post-build / pre-compile in variant pre-compile, destination-type=I-SIGNAL-TO-I-PDU-MAPPING  # Reference to the ISignalToIPduMapping that contains a reference to the ISignalGroup (SystemTemplate) which this ComUserSignalGroup represents.
    LdComUserUriDefSet
      ecuc destination uri def LdComUser
        destination-uri-policy destination-uri-nesting-contract=VERTEX-OF-TARGET-CONTAINER:
          container LdComUserModuleCnf [0..1]: destination-uri=LdComUser, multiplicity set at pre-compile  # Contains the configuration parameters of the LdCom user module.
            string LdComUserHeaderInclude [0..1]: multiplicity set at pre-compile, set at pre-compile  # Defines the header file where the LdLom user provides the function declarations for configured callbacks.
            container LdComUserCallback [0..*]: multiplicity set at link in variant link-time+post-build / pre-compile in variant pre-compile, post-build-variant-multiplicity=true  # This container defines a LdCom callback function for a LdComIPdu.
              function name LdComUserCallbackName: scope=ECU, multiplicity set at link in variant link-time+post-build / pre-compile in variant pre-compile, set at link in variant link-time+post-build / pre-compile in variant pre-compile  # The name of the callback function to be called.
              enumeration LdComUserCallbackType: {LDCOM_RX_INDICATION, LDCOM_RX_START_OF_RECEPTION, LDCOM_TP_COPY_RX_DATA, LDCOM_TP_COPY_TX_DATA, LDCOM_TP_RX_INDICATION, LDCOM_TP_TX_CONFIRMATION, LDCOM_TX_CONFIRMATION, LDCOM_TX_TRIGGER_TRANSMIT}, scope=ECU, multiplicity set at link in variant link-time+post-build / pre-compile in variant pre-compile, set at link in variant link-time+post-build / pre-compile in variant pre-compile  # The type of the LdCom callback
            container LdComUserIPdu [0..*]: multiplicity set at link in variant link-time / post-build in variant post-build / pre-compile in variant pre-compile, post-build-variant-multiplicity=true  # Contains the configuration parameters for the LdCom's signal (LdComIPdu) inside a LdCom user module.
              integer LdComUserCbkHandleId: 0..65535, scope=ECU, set at pre-compile, symbolic-name-value=true  # The numerical value used as the LdCom user callback handle Id. | This is the ID used by LdCom to invoke callbacks of a LdCom user (Rte, ScCluC LdCom Low Proxy or CDDs) using LdComUserCbkHandleId parameter respectively. A corresponding symbolic name reference is created, which may be used for the invocations of the user.
              reference LdComUserCallbackRef [0..*]: scope=ECU, multiplicity set at link in variant link-time / post-build in variant post-build / pre-compile in variant pre-compile, post-build-variant-multiplicity=true, post-build-variant-value=true, set at link in variant link-time+post-build / pre-compile in variant pre-compile, destination=LdComUserModuleCnf/LdComUserCallback  # Reference(s) to all callback(s) of this LdComIPdu.
              foreign reference LdComUserSystemTemplateSignalRef: scope=ECU, multiplicity set at link in variant link-time / post-build in variant post-build / pre-compile in variant pre-compile, post-build-variant-multiplicity=true, post-build-variant-value=true, set at link in variant link-time / post-build in variant post-build / pre-compile in variant pre-compile, destination-type=I-SIGNAL-TO-I-PDU-MAPPING  # Reference to the ISignalToIPduMapping that contains a reference to the ISignal (System Template).
    RteRipsUriDefSet
      ecuc destination uri def RteRipsInvocationHandler
        destination-uri-policy destination-uri-nesting-contract=TARGET-CONTAINER:
          container RteRipsInvocationHandlerFnc [0..*]: destination-uri=RteRipsInvocationHandler, multiplicity set at pre-compile  # This container describes an invocation handler function implemented by an RTE Implementation Plug-In to handle the invocation of server runnables and triggered runnables via a transformer.
            function name RteRipsInvocationHandlerFncSymbol: set at pre-compile  # C-Symbol of the Rte_Rips_FillFlushRoutine function.
      ecuc destination uri def RteRipsPlugin
        destination-uri-policy destination-uri-nesting-contract=TARGET-CONTAINER:
          container RteRipsPluginProps: destination-uri=RteRipsPlugin  # This container defines the identity of the Rte Implementation Plug-in and provides the RTE relevant parameters of the Rte Implementation Plug-in. | The shortName of the container defines the name of the Rte Implementation Plug-in used for the API infixes.
            boolean RtePluginSupportsIReadIWrite: set at pre-compile, default-value=false  # Denotes if or if not the plug-in supports the Rte_Rips_IRead/IWrite macros for primitive data.
            enumeration RteRipsGlobalCopyInstantiationPolicy: {RTE_RIPS_INSTANTIATION_BY_PLUGIN, RTE_RIPS_INSTANTIATION_BY_RTE}, set at pre-compile, default-value=RTE_RIPS_INSTANTIATION_BY_RTE  # Select whether for the relevant communication graph a RIPS plugin should instantiate the associated global copies itself or use global copies which have been instantiated by the RTE.
            enumeration RteRipsPluginCommunicationScope [0..1]: {RTE_RIPS_CROSS_SW_CLUSTER_COM, RTE_RIPS_LOCAL_SW_CLUSTER_COM}, set at pre-compile, default-value=RTE_RIPS_LOCAL_SW_CLUSTER_COM  # Defines the communication scope for which the Rte Implementation Plug-Ins (RIPS) serves. If this parameter is not set, the default behavior RTE_RIPS_LOCAL_SW_CLUSTER_COM applies.
            container RteRipsPluginCommunicationTypeSupport [0..1]: multiplicity set at pre-compile  # This container defines the different elements of communication graphs that the plugin is responsible for. Tags: atp.Status=draft
              enumeration RteRipsPluginCommunicationType [1..*]: scope=ECU, multiplicity set at pre-compile, set at pre-compile  # The type of the communication. Tags: atp.Status=draft
                INTER_ECU  # Tags: atp.Status=draft
                INTER_PARTITION  # Tags: atp.Status=draft
                INTRA_PARTITION  # Tags: atp.Status=draft
      ecuc destination uri def RteRipsPluginFillFlushRoutine
        destination-uri-policy destination-uri-nesting-contract=TARGET-CONTAINER:
          container RteRipsPluginFillFlushRoutineFnc [0..*]: destination-uri=RteRipsPluginFillFlushRoutine, multiplicity set at pre-compile  # This container describes a Fill-Flush Routine function implemented by a RTE Implementation Plug-In to handle the buffering for implicit communication.
            enumeration RteRipsModeDisablingHandling: {RTE_RIPS_CONSIDER_MODE_DISABLINGS, RTE_RIPS_IGNORE_MODE_DISABLINGS}, set at pre-compile  # This parameter configures whether mode disabling dependencies are considered for the invocation of Rte_Rips_FillFlushRoutines.
            enumeration RteRipsOsSchedulePoint [0..1]: {NONE, UNCONDITIONAL}, multiplicity set at pre-compile, set at pre-compile  # Introduce a schedule point by explicitly calling Os Schedule service after the execution of the Rte_Rips_FillFlushRoutine.
            function name RteRipsPluginFillFlushRoutineFncSymbol: set at pre-compile  # C-Symbol of the Rte_Rips_FillFlushRoutine function.
    RteVfbTraceUriDefSet
      ecuc destination uri def RteVfbTraceHooksClient
        destination-uri-policy destination-uri-nesting-contract=TARGET-CONTAINER:
          container RteVfbTraceHooks: destination-uri=RteVfbTraceHooksClient  # This container defines the parent container to which all trace hook containers are added.
            container RteVfbTraceHook [0..*]: multiplicity set at pre-compile  # This container represents a specific VFB Trace hook. Its ShortName equals the hook function's C symbol.
              function name RteVfbTraceHookApi [0..1]: multiplicity set at pre-compile  # In case of a BSW Scheduler API Trace hook or RTE API Trace hook the value of this parameter is the API name part of the VFB Trace hook ( in SWS_Rte).
              enumeration RteVfbTraceHookType: {BSW_SCHEDULABLE_ENTITY_INVOCATION, BSW_SCHEDULABLE_ENTITY_TERMINATION, COM_SIGNAL_CALLBACK, COM_SIGNAL_GROUP_INVALIDATION, COM_SIGNAL_INVALIDATION, COM_SIGNAL_RECEPTION, COM_SIGNAL_TRANSMISSION, OS_RECEIVED_EVENT, OS_SET_EVENT, OS_TASK_ACTIVATION, OS_TASK_DISPATCH, OS_TASK_TERMINATION, OS_WAIT_EVENT, RPT_RECEPTION, RPT_TRANSMISSION, RTE_API_RETURN, RTE_API_START, RUNNABLE_ENTITY_INVOCATION, RUNNABLE_ENTITY_TERMINATION, SCHM_API_RETURN, SCHM_API_START}, set at pre-compile  # This specifies the type of the hook.
              function name RteVfbTraceHookVendorApiInfix [0..1]: multiplicity set at pre-compile  # In case of a BSW Scheduler API Trace hook or BSW Schedulable Entities Trace hook the value of this parameter is the optional VendorApiInfix name part of the VFB Trace hook ( in SWS_Rte).
              integer RteVfbTraceHookVendorId [0..1]: 0..65535, multiplicity set at pre-compile  # In case of a BSW Scheduler API Trace hook or BSW Schedulable Entities Trace hook the optional VendorId name part of the VFB Trace hook (<vi> in SWS_Rte) is defined.
              foreign reference RteVfbTraceHookEntryRef: set at pre-compile, destination-type=BSW-MODULE-ENTRY  # Reference to the BswModuleEntry of this VFB Trace hook in the BSWMD of the generated RTE
              container RteVfbTraceHookAccessPoint [0..1]: multiplicity set at pre-compile  # In case of an RTE API Trace hook the ShortName of this container is the Access Point name part of the VFB Trace hook (<ap> in SWS_Rte).
                foreign reference RteVfbTraceHookAccessPointElementRef [1..*]: multiplicity set at pre-compile, set at pre-compile, destination-type=IDENTIFIABLE  # Reference to the elements from which the Access Point was derived. Number and type of the referenced objects depend on the API.
              container RteVfbTraceHookBswSchedulerNamePrefix [0..1]: multiplicity set at pre-compile  # In case of a BSW Scheduler API Trace hook or BSW Schedulable Entities Trace hook the ShortName of this container is the BSW Scheduler Name Prefix name part of the VFB Trace hook (<bsnp> in SWS_Rte).
                foreign reference RteVfbTraceHookBswImplementationRef: set at pre-compile, destination-type=BSW-IMPLEMENTATION  # Reference to the BswImplementation from which the BSW Scheduler Name Prefix was derived
              container RteVfbTraceHookComHookEvent [0..1]: multiplicity set at pre-compile  # In case of a COM Trace hook the ShortName of this container is the COM hook event part of the VFB Trace hook (<Event> in SWS_Rte).
              container RteVfbTraceHookComponentTypeSymbol [0..1]: multiplicity set at pre-compile  # In case of an RTE API Trace hook, Runnable Entity Trace hook or RPT Trace hook the ShortName of this container is the component type symbol name part of the VFB Trace hook (<cts> in SWS_Rte).
                foreign reference RteVfbTraceHookSwComponentTypeRef: set at pre-compile, destination-type=SW-COMPONENT-TYPE  # Reference to the SwComponentType from which the component type symbol was derived
              container RteVfbTraceHookExecutableEntityName [0..1]: multiplicity set at pre-compile  # In case of a Runnable Entity Trace hook or BSW Schedulable Entities Trace hook the ShortName of this container is the Executable Entity name part of the VFB Trace hook (<reName> or <entityName> in SWS_Rte).
                foreign reference RteVfbTraceHookExecutableEntityRef: set at pre-compile, destination-type=EXECUTABLE-ENTITY  # Reference to the Executable Entity from which the Runnable Entity or BSW Schedulable Entitiy name was derived
              container RteVfbTraceHookName [0..1]: multiplicity set at pre-compile  # In case of a BSW Scheduler API Trace hook the ShortName of this container is the "Name provided by the API" name part of the VFB Trace hook (<name> in SWS_Rte).
                foreign reference RteVfbTraceHookNameElementRef [1..*]: multiplicity set at pre-compile, set at pre-compile, destination-type=IDENTIFIABLE  # Reference to the elements from which the "Name provided by the API" was derived. Number and type of the referenced objects depend on the API.
              container RteVfbTraceHookOsApplication [0..1]: multiplicity set at pre-compile  # In case of an OS Trace hook the ShortName of this container is the application name part of the VFB Trace hook (<application> in SWS_Rte).
                reference RteVfbTraceHookOsApplicationRef: set at pre-compile, destination=OsApplication  # Reference to the OsApplication from which the application name was derived
              container RteVfbTraceHookSignal [0..1]: multiplicity set at pre-compile  # In case of a COM Trace hook the ShortName of this container is the COM signal name part of the VFB Trace hook (<signalName> in SWS_Rte).
                reference RteVfbTraceHookSignalRef: set at pre-compile, destination=ComSignal  # Reference to the ComSignal from which the signal name was derived
              container RteVfbTraceHookSignalGroup [0..1]: multiplicity set at pre-compile  # In case of a COM Trace hook the ShortName of this container is the COM signal group name part of the VFB Trace hook (<signalGroupName> in SWS_Rte).
                reference RteVfbTraceHookSignalGroupRef: set at pre-compile, destination=ComSignalGroup  # Reference to the ComSignalGroup from which the signal group name was derived
              container RteVfbTraceHookTask [0..1]: multiplicity set at pre-compile  # In case of an OS Trace hook the ShortName of this container is the task name part of the VFB Trace hook (<task> in SWS_Rte).
                reference RteVfbTraceHookTaskRef: set at pre-compile, destination=OsTask  # Reference to the OsTask from which the task name was derived
              container RteVfbTraceHookVariable [0..1]: multiplicity set at pre-compile  # In case of an RPT Trace hook the ShortName of this container is the "identifying name of the RP global buffer" name part of the VFB Trace hook (<var> in SWS_Rte).
                foreign reference RteVfbTraceHookVariableElementRef [1..*]: multiplicity set at pre-compile, set at pre-compile, destination-type=IDENTIFIABLE  # Reference to the elements from which the "identifying name of the RP global buffer" was derived. Number and type of the referenced objects depend on the API.
package /AUTOSAR/LifeCycleInfoSets
  life cycle info set AUTOSARParameterDefinition
    life-cycle-infos:
      lc-object=BndMDeviceIndex, lc-state=obsolete
      lc-object=BswMIdsMBlockStateChangeRequest, lc-state=draft
      lc-object=BswMIdsMBlockStateChangeRequestRef, lc-state=draft
      lc-object=BswMSetFirewallState, lc-state=draft
      lc-object=BswMFirewallStateRef, lc-state=draft
      lc-object=CV2x, lc-state=draft
      lc-object=CV2xConfigSet, lc-state=draft
      lc-object=CV2xCtrlConfig, lc-state=draft
      lc-object=CV2xCtrlEcucPartitionRef, lc-state=draft
      lc-object=CV2xCtrlId, lc-state=draft
      lc-object=CV2xCtrlRxBufLenByte, lc-state=draft
      lc-object=CV2xCtrlRxBufTotal, lc-state=draft
      lc-object=CV2xCtrlTxBufLenByte, lc-state=draft
      lc-object=CV2xCtrlTxBufTotal, lc-state=draft
      lc-object=CV2xDemEventParameterRefs, lc-state=draft
      lc-object=CV2X_E_ACCESS, lc-state=draft
      lc-object=CV2xGeneral, lc-state=draft
      lc-object=CV2xDevErrorDetect, lc-state=draft
      lc-object=CV2xEcucPartitionRef, lc-state=draft
      lc-object=CV2xIndex, lc-state=draft
      lc-object=CV2xMainFunctionPeriod, lc-state=draft
      lc-object=CV2xVersionInfoApi, lc-state=draft
      lc-object=CanEnableSecurityEventReporting, lc-state=draft
      lc-object=CanGlobalTimeSupport, lc-state=draft
      lc-object=CanIfEnableSecurityEventReporting, lc-state=draft
      lc-object=CanIfGlobalTimeSupport, lc-state=draft
      lc-object=CanIfSecurityEventRefs, lc-state=draft
      lc-object=SEV_CAN_ERRORSTATE_BUSOFF, lc-state=draft
      lc-object=SEV_CAN_ERRORSTATE_PASSIVE, lc-state=draft
      lc-object=SEV_CAN_RX_ERROR_DETECTED, lc-state=draft
      lc-object=SEV_CAN_TX_ERROR_DETECTED, lc-state=draft
      lc-object=CanTSynHardwareTimestampSupport, lc-state=draft
      lc-object=CanTSynSyncTransmissionsPerCycle, lc-state=draft
      lc-object=CanTSynGlobalTimeTxIcvSecured, lc-state=draft
      lc-object=CanTSynGlobalTimeTxIcvSecured/ICV_NOT_SUPPORTED, lc-state=draft
      lc-object=CanTSynGlobalTimeTxIcvSecured/ICV_SUPPORTED, lc-state=draft
      lc-object=CddLSduRLowerLayerContribution, lc-state=draft
      lc-object=CddLSduRLowerLayerRxPdu, lc-state=draft
      lc-object=CddLSduRLowerLayerRxPdu/CddLSduRLowerLayerHandleId, lc-state=draft
      lc-object=CddLSduRLowerLayerRxPdu/CddLSduRLowerLayerPduRef, lc-state=draft
      lc-object=CddLSduRLowerLayerTxPdu, lc-state=draft
      lc-object=CddLSduRLowerLayerTxPdu/CddLSduRLowerLayerHandleId, lc-state=draft
      lc-object=CddLSduRLowerLayerTxPdu/CddLSduRLowerLayerPduRef, lc-state=draft
      lc-object=CddLSduRUpperLayerContribution, lc-state=draft
      lc-object=CddLSduRUpperLayerRxPdu, lc-state=draft
      lc-object=CddLSduRUpperLayerRxPdu/CddLSduRUpperLayerHandleId, lc-state=draft
      lc-object=CddLSduRUpperLayerRxPdu/CddLSduRUpperLayerPduRef, lc-state=draft
      lc-object=CddLSduRUpperLayerTxPdu, lc-state=draft
      lc-object=CddLSduRUpperLayerTxPdu/CddLSduRUpperLayerHandleId, lc-state=draft
      lc-object=CddLSduRUpperLayerTxPdu/CddLSduRUpperLayerPduRef, lc-state=draft
      lc-object=CnV2xM, lc-state=draft
      lc-object=CnV2xMGeneral, lc-state=draft
      lc-object=CnV2xMDevErrorDetect, lc-state=draft
      lc-object=CnV2xMEthIfCtrlRef, lc-state=draft
      lc-object=CnV2xMMainFunctionPeriod, lc-state=draft
      lc-object=CnV2xMVersionInfoApi, lc-state=draft
      lc-object=CnV2xMsg, lc-state=draft
      lc-object=CnV2xMsgConfig, lc-state=draft
      lc-object=CnV2xMsgDmMsgConfig, lc-state=draft
      lc-object=CnV2xMsgDmAid, lc-state=draft
      lc-object=CNV2XMSG_AID_DYNAMIC_RSI, lc-state=draft
      lc-object=CNV2XMSG_AID_EMERGENCY_EVENTTRIGGERED_BSM, lc-state=draft
      lc-object=CNV2XMSG_AID_EMERGENCY_REGULAR_BSM, lc-state=draft
      lc-object=CNV2XMSG_AID_MAP, lc-state=draft
      lc-object=CNV2XMSG_AID_NONEMERGENCY_EVENTTRIGGERED_BSM, lc-state=draft
      lc-object=CNV2XMSG_AID_NONEMERGENCY_REGULAR_BSM, lc-state=draft
      lc-object=CNV2XMSG_AID_RSM, lc-state=draft
      lc-object=CNV2XMSG_AID_SEMIDYNAMIC_RSI, lc-state=draft
      lc-object=CNV2XMSG_AID_SPAT, lc-state=draft
      lc-object=CNV2XMSG_AID_STATIC_RSI, lc-state=draft
      lc-object=CNV2XMSG_AID_V2X_TERMINAL_AFTERMARKET, lc-state=draft
      lc-object=CnV2xMsgGeneral, lc-state=draft
      lc-object=CnV2xMsgBsmBsMainFunction, lc-state=draft
      lc-object=CnV2xMsgDevErrorDetect, lc-state=draft
      lc-object=CnV2xMsgMapSMainFunction, lc-state=draft
      lc-object=CnV2xMsgMgtMainFunction, lc-state=draft
      lc-object=CnV2xMsgRsmSMainFunction, lc-state=draft
      lc-object=CnV2xMsgSpatSMainFunction, lc-state=draft
      lc-object=CnV2xMsgVehicleClass, lc-state=draft
      lc-object=CNV2XMSG_VC_BUS, lc-state=draft
      lc-object=CNV2XMSG_VC_EM_AMBULANCE, lc-state=draft
      lc-object=CNV2XMSG_VC_EM_ENGINEERING, lc-state=draft
      lc-object=CNV2XMSG_VC_EM_FIRETRUCK_HEAVY, lc-state=draft
      lc-object=CNV2XMSG_VC_EM_FIRETRUCK_LIGHT, lc-state=draft
      lc-object=CNV2XMSG_VC_EM_NURSING, lc-state=draft
      lc-object=CNV2XMSG_VC_EM_POLICE_HEAVY, lc-state=draft
      lc-object=CNV2XMSG_VC_EM_POLICE_LIGHT, lc-state=draft
      lc-object=CNV2XMSG_VC_GOODS_LIGHT, lc-state=draft
      lc-object=CNV2XMSG_VC_GOODS_SEMITRAILER, lc-state=draft
      lc-object=CNV2XMSG_VC_PASSENGER, lc-state=draft
      lc-object=CNV2XMSG_VC_SPECIAL, lc-state=draft
      lc-object=CNV2XMSG_VC_UNKNOWN, lc-state=draft
      lc-object=CnV2xMsgVersionInfoApi, lc-state=draft
      lc-object=CnV2xMsgvMaxCurveRadius, lc-state=draft
      lc-object=CnV2xMsgvMaxPHistDistance, lc-state=draft
      lc-object=CnV2xMsgvMaxPHistPoints, lc-state=draft
      lc-object=CnV2xMsgvMinCurveRadius, lc-state=draft
      lc-object=CnV2xMsgvMinPHistDistance, lc-state=draft
      lc-object=CnV2xMsgvPPredRadiusError, lc-state=draft
      lc-object=CnV2xMsgvPPredTransitionTime, lc-state=draft
      lc-object=CnV2xMsgvPathPerpendicularDist, lc-state=draft
      lc-object=CnV2xMsgvStationarySpeedThresh, lc-state=draft
      lc-object=Cnv2xMsgCRsiSMainFunction, lc-state=draft
      lc-object=CnV2xNet, lc-state=draft
      lc-object=CnV2xNetConfig, lc-state=draft
      lc-object=CnV2xNetDSMPSduSize, lc-state=draft
      lc-object=CnV2xNetDSMPprotocolVersion, lc-state=draft
      lc-object=CnV2xNetEthIfRef, lc-state=draft
      lc-object=CnV2xNetRxPdu, lc-state=draft
      lc-object=CnV2xNetRxPduId, lc-state=draft
      lc-object=CnV2xNetRxPduRef, lc-state=draft
      lc-object=CnV2xNetTxPdu, lc-state=draft
      lc-object=CnV2xNetTxPduId, lc-state=draft
      lc-object=CnV2xNetTxPduRef, lc-state=draft
      lc-object=CnV2xNetGeneral, lc-state=draft
      lc-object=CnV2xNetDevErrorDetect, lc-state=draft
      lc-object=CnV2xNetMainFunctionPeriod, lc-state=draft
      lc-object=CnV2xNetTxConfirmation, lc-state=draft
      lc-object=CnV2xNetVersionInfoApi, lc-state=draft
      lc-object=CnV2xSec, lc-state=draft
      lc-object=CnV2xSecGeneral, lc-state=draft
      lc-object=CnV2xSecHashConfigRef, lc-state=draft
      lc-object=CnV2xSecNvMBlockDescriptorLongTermCertificateRef, lc-state=draft
      lc-object=CnV2xSecNvMBlockDescriptorPseudonymCertificateRef, lc-state=draft
      lc-object=CnV2xSecNvMBlockDescriptorRef, lc-state=draft
      lc-object=CnV2xSecSignatureGenerationConfigRef, lc-state=draft
      lc-object=CnV2xSecSignatureVerifyConfigRef, lc-state=draft
      lc-object=ComUserModule, lc-state=draft
      lc-object=Crc32P76Mode, lc-state=draft
      lc-object=CRC_32P76_HARDWARE, lc-state=draft
      lc-object=CRC_32P76_RUNTIME, lc-state=draft
      lc-object=CRC_32P76_TABLE, lc-state=draft
      lc-object=USE_DATA_ASYNCH_FNC_PROXY, lc-state=draft
      lc-object=USE_DATA_SYNCH_FNC_PROXY, lc-state=draft
      lc-object=DcmDspRoutineFncSignature, lc-state=draft
      lc-object=ROUTINE_FNC_NORMAL, lc-state=draft
      lc-object=ROUTINE_FNC_PROXY, lc-state=draft
      lc-object=DcmEnableSecurityEventReporting, lc-state=draft
      lc-object=DcmSecurityEventRefs, lc-state=draft
      lc-object=DemEventReportingType, lc-state=draft
      lc-object=STANDARD_REPORTING, lc-state=draft
      lc-object=STANDARD_REPORTING_WITH_MONITOR_DATA, lc-state=draft
      lc-object=DemDataElementFncSignature, lc-state=draft
      lc-object=DATA_FNC_NORMAL, lc-state=draft
      lc-object=DATA_FNC_PROXY, lc-state=draft
      lc-object=DemFreezeFrameRecordTrigger, lc-state=draft
      lc-object=EaDeviceIndex, lc-state=obsolete
      lc-object=EaMemAccAddressArea, lc-state=draft
      lc-object=EaBufferAlignmentValue, lc-state=draft
      lc-object=EaMinimumReadPageSize, lc-state=draft
      lc-object=BROADCAST_8, lc-state=draft
      lc-object=CAN_ID_PROPS_8, lc-state=draft
      lc-object=FILTER_RULE_ID_16, lc-state=draft
      lc-object=IEEE1722TP_COMMON_STREAM_HEADER_PTR, lc-state=draft
      lc-object=IEEE1722TP_RX_AAF_AES3_PTR, lc-state=draft
      lc-object=IEEE1722TP_RX_AAF_PCM_PTR, lc-state=draft
      lc-object=IEEE1722TP_RX_CRF_PTR, lc-state=draft
      lc-object=IEEE1722TP_RX_IEC68133_CIP_NO_SPH_PTR, lc-state=draft
      lc-object=IEEE1722TP_RX_IEC68133_CIP_WITH_SPH_PTR, lc-state=draft
      lc-object=IEEE1722TP_RX_IEC68133_IIDC_PTR, lc-state=draft
      lc-object=IEEE1722TP_RX_IEC68133_PTR, lc-state=draft
      lc-object=IEEE1722TP_RX_RVF_PTR, lc-state=draft
      lc-object=IEEE1722TP_TX_AAF_AES3_PTR, lc-state=draft
      lc-object=IEEE1722TP_TX_AAF_PCM_PTR, lc-state=draft
      lc-object=IEEE1722TP_TX_CRF_PTR, lc-state=draft
      lc-object=IEEE1722TP_TX_IEC68133_CIP_NO_SPH_PTR, lc-state=draft
      lc-object=IEEE1722TP_TX_IEC68133_CIP_WITH_SPH_PTR, lc-state=draft
      lc-object=IEEE1722TP_TX_IEC68133_IIDC_PTR, lc-state=draft
      lc-object=IEEE1722TP_TX_IEC68133_PTR, lc-state=draft
      lc-object=IEEE1722TP_TX_RVF_PTR, lc-state=draft
      lc-object=LISTELEM_PTR, lc-state=draft
      lc-object=MESSAGE_TIMESTAMP_64, lc-state=draft
      lc-object=MESSAGE_TIMESTAMP_VALID_8, lc-state=draft
      lc-object=TIMETUPLE_TYPE_PTR, lc-state=draft
      lc-object=KeepLocalPduBuffer, lc-state=draft
      lc-object=PduBufferAlignment, lc-state=draft
      lc-object=EcucEcuPartitionRef, lc-state=draft
      lc-object=Eep, lc-state=obsolete
      lc-object=EepGeneral, lc-state=obsolete
      lc-object=EepDevErrorDetect, lc-state=obsolete
      lc-object=EepDriverIndex, lc-state=obsolete
      lc-object=EepEcucPartitionRef, lc-state=obsolete
      lc-object=EepMainFunctionPeriod, lc-state=obsolete
      lc-object=EepUseInterrupts, lc-state=obsolete
      lc-object=EepVersionInfoApi, lc-state=obsolete
      lc-object=EepWriteCycleReduction, lc-state=obsolete
      lc-object=EepInitConfiguration, lc-state=obsolete
      lc-object=EepBaseAddress, lc-state=obsolete
      lc-object=EepDefaultMode, lc-state=obsolete
      lc-object=EepDefaultMode/MEMIF_MODE_FAST, lc-state=obsolete
      lc-object=EepDefaultMode/MEMIF_MODE_SLOW, lc-state=obsolete
      lc-object=EepDemEventParameterRefs, lc-state=obsolete
      lc-object=EEP_E_COMPARE_FAILED, lc-state=obsolete
      lc-object=EEP_E_ERASE_FAILED, lc-state=obsolete
      lc-object=EEP_E_READ_FAILED, lc-state=obsolete
      lc-object=EEP_E_WRITE_FAILED, lc-state=obsolete
      lc-object=EepExternalDriver, lc-state=obsolete
      lc-object=EepExternalContainerRef, lc-state=draft
      lc-object=EepFastReadBlockSize, lc-state=obsolete
      lc-object=EepFastWriteBlockSize, lc-state=obsolete
      lc-object=EepJobEndNotification, lc-state=obsolete
      lc-object=EepJobErrorNotification, lc-state=obsolete
      lc-object=EepNormalReadBlockSize, lc-state=obsolete
      lc-object=EepNormalWriteBlockSize, lc-state=obsolete
      lc-object=EepSize, lc-state=obsolete
      lc-object=EepPublishedInformation, lc-state=obsolete
      lc-object=EepAllowedWriteCycles, lc-state=obsolete
      lc-object=EepEraseTime, lc-state=obsolete
      lc-object=EepEraseUnitSize, lc-state=obsolete
      lc-object=EepEraseValue, lc-state=obsolete
      lc-object=EepMinimumAddressType, lc-state=obsolete
      lc-object=EepMinimumLengthType, lc-state=obsolete
      lc-object=EepReadUnitSize, lc-state=obsolete
      lc-object=EepSpecifiedEraseCycles, lc-state=obsolete
      lc-object=EepTotalSize, lc-state=obsolete
      lc-object=EepWriteTime, lc-state=obsolete
      lc-object=EepWriteUnitSize, lc-state=obsolete
      lc-object=EthClkUnit, lc-state=draft
      lc-object=EthClkUnitCrossTimestampingSupport, lc-state=draft
      lc-object=HW_XTIMESTAMPING, lc-state=draft
      lc-object=NO_XTIMESTAMPING, lc-state=draft
      lc-object=SW_XTIMESTAMPING, lc-state=draft
      lc-object=EthClkUnitIdx, lc-state=draft
      lc-object=EthClkUnitTimePhcRef, lc-state=draft
      lc-object=EthClkUnitTimeStampingRef, lc-state=draft
      lc-object=EthCtrEgressHardwareSupportedDataTransferThreshold, lc-state=draft
      lc-object=EthCtrlClk, lc-state=draft
      lc-object=EthCtrlClkAdjustmentEnable, lc-state=draft
      lc-object=EthCtrlClkIdx, lc-state=draft
      lc-object=EthCtrlConfigEgressFifo, lc-state=obsolete
      lc-object=EthCtrlConfigEgressFifoBufLenByte, lc-state=obsolete
      lc-object=EthCtrlConfigEgressFifoBufTotal, lc-state=obsolete
      lc-object=EthCtrlConfigEgressFifoIdx, lc-state=obsolete
      lc-object=EthCtrlConfigEgressFifoPriorityAssignment, lc-state=obsolete
      lc-object=EthCtrlConfigEgressQueue, lc-state=draft
      lc-object=EthCtrlConfigEgressQueueBufLenByte, lc-state=draft
      lc-object=EthCtrlConfigEgressQueueBufTotal, lc-state=draft
      lc-object=EthCtrlConfigEgressQueueIdx, lc-state=draft
      lc-object=EthCtrlConfigEgressQueueSortingType, lc-state=draft
      lc-object=EthCtrlConfigEgressQueueSortingEntry, lc-state=draft
      lc-object=EthCtrlConfigEgressQueueSortingKey, lc-state=draft
      lc-object=EthCtrlConfigEgressQueueSortingMask, lc-state=draft
      lc-object=EthCtrlConfigEgressQueueSortingOffset, lc-state=draft
      lc-object=EthCtrlConfigEgressQueueSortingSize, lc-state=draft
      lc-object=EthCtrlConfigEgressQueueSortingSize/UINT16, lc-state=draft
      lc-object=EthCtrlConfigEgressQueueSortingSize/UINT32, lc-state=draft
      lc-object=EthCtrlConfigEgressQueueSortingSize/UINT64, lc-state=draft
      lc-object=EthCtrlConfigEgressQueueSortingSize/UINT8, lc-state=draft
      lc-object=EthCtrlConfigEgressQueueTransmissionSelection, lc-state=draft
      lc-object=EthCtrlConfigEgressQueueTransmissionSelectionAlgorithm, lc-state=draft
      lc-object=ETH_TRANSMISSION_SELECTION_ATS, lc-state=draft
      lc-object=ETH_TRANSMISSION_SELECTION_CBS, lc-state=draft
      lc-object=ETH_TRANSMISSION_SELECTION_ETS, lc-state=draft
      lc-object=ETH_TRANSMISSION_SELECTION_UNSHAPED, lc-state=draft
      lc-object=EthCtrlConfigEgressQueueTransmissionSelectionCBSConfig, lc-state=draft
      lc-object=EthCtrlConfigEgressQueueCreditBasedShaperMaxCredit, lc-state=draft
      lc-object=EthCtrlConfigEgressQueueCreditBasedShaperMinCredit, lc-state=draft
      lc-object=EthCtrlConfigEgressQueueCreditBasedShaperSendSlope, lc-state=draft
      lc-object=EthCtrlConfigEgressQueueTransmissionSelectionETS, lc-state=draft
      lc-object=EthCtrlETSConfigAvailableBandwidthInPercent, lc-state=draft
      lc-object=EthCtrlETSConfigAvailableBandwidthInWeightValue, lc-state=draft
      lc-object=EthCtrlConfigShaper, lc-state=obsolete
      lc-object=EthCtrlConfigShaperIdleSlope, lc-state=obsolete
      lc-object=EthCtrlConfigShaperMaxCredit, lc-state=obsolete
      lc-object=EthCtrlConfigShaperMinCredit, lc-state=obsolete
      lc-object=EthCtrlConfigShaperPredecessorFifoRef, lc-state=obsolete
      lc-object=EthCtrlConfigIngressFifo, lc-state=obsolete
      lc-object=EthCtrlConfigIngressFifoBufLenByte, lc-state=obsolete
      lc-object=EthCtrlConfigIngressFifoBufTotal, lc-state=obsolete
      lc-object=EthCtrlConfigIngressFifoIdx, lc-state=obsolete
      lc-object=EthCtrlConfigIngressFifoPriorityAssignment, lc-state=obsolete
      lc-object=EthCtrlConfigIngressQueue, lc-state=draft
      lc-object=EthCtrlConfigIngressQueueBufLenByte, lc-state=draft
      lc-object=EthCtrlConfigIngressQueueBufTotal, lc-state=draft
      lc-object=EthCtrlConfigIngressQueueHandlerFunction, lc-state=draft
      lc-object=EthCtrlConfigIngressQueueIdx, lc-state=draft
      lc-object=EthCtrlConfigIngressQueueOverwriteEnabled, lc-state=draft
      lc-object=EthCtrlConfigIngressQueueSortingType, lc-state=draft
      lc-object=EthCtrlIngressQueueSortingEtherTypeAssignment, lc-state=draft
      lc-object=EthCtrlIngressQueueSortingMacDestinationAssignment, lc-state=draft
      lc-object=EthCtrlIngressQueueSortingVlanIdAssignment, lc-state=draft
      lc-object=EthCtrlIngressQueueSortingVlanPriorityAssignment, lc-state=draft
      lc-object=EthCtrlEnableIngressQueueInterrupt, lc-state=draft
      lc-object=EthCtrlConfigIngressQueueSortingPriority, lc-state=draft
      lc-object=SortingPriorityEtherTypeAssignment, lc-state=draft
      lc-object=SortingPriorityMacDestinationAssignment, lc-state=draft
      lc-object=SortingPriorityVlanIdAssignment, lc-state=draft
      lc-object=SortingPriorityVlanPriorityAssignment, lc-state=draft
      lc-object=EthCtrlConfigSpiConfiguration, lc-state=draft
      lc-object=EthCtrlConfigSpiChunkPayloadSize, lc-state=draft
      lc-object=EthCtrlConfigSpiCommRetries, lc-state=draft
      lc-object=EthCtrlConfigSpiCommTimeout, lc-state=draft
      lc-object=EthCtrlConfigSpiEnableControlDataProtection, lc-state=draft
      lc-object=EthCtrlConfigSpiEnableRxCSAlign, lc-state=draft
      lc-object=EthCtrlConfigSpiEnableRxCutThrough, lc-state=draft
      lc-object=EthCtrlConfigSpiEnableRxZeroAlign, lc-state=draft
      lc-object=EthCtrlConfigSpiEnableTransmitDataHdrSequence, lc-state=draft
      lc-object=EthCtrlConfigSpiEnableTxChecksum, lc-state=draft
      lc-object=EthCtrlConfigSpiEnableTxCutThrough, lc-state=draft
      lc-object=EthCtrlConfigSpiSelectTimeStamp, lc-state=draft
      lc-object=EthCtrlConfigSpiSequence, lc-state=draft
      lc-object=EthCtrlConfigSpiAccessSynchronous, lc-state=draft
      lc-object=EthCtrlConfigSpiSequenceName, lc-state=draft
      lc-object=EthCtrlConfigSpiTransmitCreditThreshold, lc-state=draft
      lc-object=EthCtrlEnableEgressHardwareSupportedDataTransfer, lc-state=draft
      lc-object=EthCtrlFramePreemptionEnable, lc-state=draft
      lc-object=EthCtrlPulsePerSecondConfig, lc-state=draft
      lc-object=EthCtrlPulsePerSecondClockRef, lc-state=draft
      lc-object=EthCtrlPulsePerSecondDutyCycle, lc-state=draft
      lc-object=EthCtrlPulsePerSecondFrequency, lc-state=draft
      lc-object=EthCtrlPulsePerSecondStartEnum, lc-state=draft
      lc-object=FALLING_EDGE, lc-state=draft
      lc-object=RISING_EDGE, lc-state=draft
      lc-object=EthPhcSupport, lc-state=draft
      lc-object=EthIfMacSecSupport, lc-state=draft
      lc-object=HW_MACSEC, lc-state=draft
      lc-object=NO_MACSEC, lc-state=draft
      lc-object=SW_MACSEC, lc-state=draft
      lc-object=EthIfPaeInstanceRef, lc-state=draft
      lc-object=EthIfFrameConfig, lc-state=draft
      lc-object=EthIfFrameRxPool, lc-state=draft
      lc-object=EthIfFrameRxControllerRef, lc-state=draft
      lc-object=EthIfFrameRxPdu, lc-state=draft
      lc-object=EthIfFrameRxPduId, lc-state=draft
      lc-object=EthIfFrameRxPduRef, lc-state=draft
      lc-object=EthIfFrameTxPool, lc-state=draft
      lc-object=EthIfFrameTxControllerRef, lc-state=draft
      lc-object=EthIfFrameTxPdu, lc-state=draft
      lc-object=EthIfFrameTxPduId, lc-state=draft
      lc-object=EthIfFrameTxPduRef, lc-state=draft
      lc-object=EthIfFrameTxPriority, lc-state=draft
      lc-object=EthIfFrameType, lc-state=draft
      lc-object=EthIfCV2xCtrlRef, lc-state=draft
      lc-object=EthIfClkUnit, lc-state=draft
      lc-object=EthIfClkUnitIdx, lc-state=draft
      lc-object=EthIfClkUnitRef, lc-state=draft
      lc-object=EthIfPhysCtrlRxMainFunctionIngressQueueProcessing, lc-state=draft
      lc-object=EthIfPhysCtrlRxIngressFifoRef, lc-state=obsolete
      lc-object=EthIfPhysCtrlRxIngressQueueRef, lc-state=draft
      lc-object=EthIfEnableCV2xApi, lc-state=draft
      lc-object=EthIfEnableSecurityEventReporting, lc-state=draft
      lc-object=EthIfFwSupport, lc-state=draft
      lc-object=FIREWALL_WITHOUT_PERSTREAMFILTERING, lc-state=draft
      lc-object=FIREWALL_WITH_PERSTREAMFILTERING, lc-state=draft
      lc-object=NO_FIREWALL, lc-state=draft
      lc-object=EthIfPhcSupport, lc-state=draft
      lc-object=EthIfSecurityEventRefs, lc-state=draft
      lc-object=SEV_ETH_DROP_INV_VLAN, lc-state=draft
      lc-object=SEV_ETH_DROP_MAC_COLLISION, lc-state=draft
      lc-object=SEV_ETH_DROP_UNKNOWN_ETHERTYPE, lc-state=draft
      lc-object=SEV_ETH_DROP_VLAN_DOUBLE_TAG, lc-state=draft
      lc-object=EthSMDataLinkInfoApi, lc-state=draft
      lc-object=EthSwtAtsGroupInstanceTable, lc-state=draft
      lc-object=EthSwtAtsGroupInstanceEntry, lc-state=draft
      lc-object=EthSwtAtsGroupMaximumResidenceTime, lc-state=draft
      lc-object=EthSwtPSCM, lc-state=draft
      lc-object=EthSwtAtsInstanceTable, lc-state=draft
      lc-object=EthSwtAtsInstanceEntry, lc-state=draft
      lc-object=EthSwtPortATSCommitedBurstSize, lc-state=draft
      lc-object=EthSwtPortATSCommitedInformationRate, lc-state=draft
      lc-object=EthSwtPortAtsSchedulerGroupRef, lc-state=draft
      lc-object=EthSwtPSFP, lc-state=draft
      lc-object=EthSwtFilterMaxSduSizeTable, lc-state=draft
      lc-object=EthSwtFilterMaxSduSizeEntry, lc-state=draft
      lc-object=EthSwtFilterMaxSduSize, lc-state=draft
      lc-object=EthSwtFlowMeteringTable, lc-state=draft
      lc-object=EthSwtFlowMeteringEntry, lc-state=draft
      lc-object=EthSwtFlowMeterCF, lc-state=draft
      lc-object=EthSwtFlowMeteringCBS, lc-state=draft
      lc-object=EthSwtFlowMeteringCIR, lc-state=draft
      lc-object=EthSwtFlowMeteringColorMode, lc-state=draft
      lc-object=ETHSWT_COLOR_AWARE, lc-state=draft
      lc-object=ETHSWT_COLOR_BLIND, lc-state=draft
      lc-object=EthSwtFlowMeteringEBS, lc-state=draft
      lc-object=EthSwtFlowMeteringEIR, lc-state=draft
      lc-object=EthSwtStreamFilterTable, lc-state=draft
      lc-object=EthSwtStreamFilterEntry, lc-state=draft
      lc-object=EthSwtAssignedStreamHandle, lc-state=draft
      lc-object=EthSwtStreamHandleId, lc-state=draft
      lc-object=EthSwtStreamHandleIdWildcard, lc-state=draft
      lc-object=EthSwtAtsInstanceEntryRef, lc-state=draft
      lc-object=EthSwtFilterMaxSduSizeRef, lc-state=draft
      lc-object=EthSwtFlowMeteringEntryRef, lc-state=draft
      lc-object=EthSwtStreamFilterEntryPosition, lc-state=draft
      lc-object=EthSwtStreamFilterPriority, lc-state=draft
      lc-object=EthSwtStreamGateEntryRef, lc-state=draft
      lc-object=EthSwtStreamGateTable, lc-state=draft
      lc-object=EthSwtStreamGateEntry, lc-state=draft
      lc-object=EthSwtStreamGateIPV, lc-state=draft
      lc-object=EthSwtFramePreemptionEnable, lc-state=draft
      lc-object=EthSwtPortDefaultTrafficClass, lc-state=draft
      lc-object=EthSwtPortFifo, lc-state=obsolete
      lc-object=EthSwtPortEgressFifoIdx, lc-state=obsolete
      lc-object=EthSwtPortFifoMinimumLength, lc-state=obsolete
      lc-object=EthSwtPortFifoTrafficClassAssignment, lc-state=obsolete
      lc-object=EthSwtPortPriorityToTrafficClassAssignment, lc-state=draft
      lc-object=EthSwtPortPriorityToTrafficClassAssignmentPriority, lc-state=draft
      lc-object=EthSwtPortPriorityToTrafficClassAssignmentTrafficClass, lc-state=draft
      lc-object=EthSwtPortQueue, lc-state=draft
      lc-object=EthSwtPortEgressQueueIdx, lc-state=draft
      lc-object=EthSwtPortEgressQueueTransmissionSelection, lc-state=draft
      lc-object=EthSwtPortEgressQueueTransmissionSelectionAlgorithm, lc-state=draft
      lc-object=ETHSWT_TRANSMISSION_SELECTION_ALGORITHM_ATS, lc-state=draft
      lc-object=ETHSWT_TRANSMISSION_SELECTION_ALGORITHM_CBS, lc-state=draft
      lc-object=ETHSWT_TRANSMISSION_SELECTION_ALGORITHM_ETS, lc-state=draft
      lc-object=ETHSWT_TRANSMISSION_SELECTION_ALGORITHM_UNSHAPED, lc-state=draft
      lc-object=EthSwtPortEgressQueueTransmissionSelectionCBSConfig, lc-state=draft
      lc-object=EthSwtPortEgressQueueCreditBasedShaperIdleSlope, lc-state=draft
      lc-object=EthSwtPortEgressQueueCreditBasedShaperLowerBoundary, lc-state=draft
      lc-object=EthSwtPortEgressQueueCreditBasedShaperUpperBoundary, lc-state=draft
      lc-object=EthSwtPortEgressQueueTransmissionSelectionETSConfig, lc-state=draft
      lc-object=EthSwtETSConfigAvailableBandwidthInPercent, lc-state=draft
      lc-object=EthSwtETSConfigAvailableBandwidthInWeightValue, lc-state=draft
      lc-object=EthSwtPortQueueMinimumLength, lc-state=draft
      lc-object=EthSwtPortQueueTrafficClassAssignment, lc-state=draft
      lc-object=EthSwtTrafficClassToPreemptionStatusAssignment, lc-state=draft
      lc-object=ETHSWT_TRAFFIC_CLASS_EXPRESS, lc-state=draft
      lc-object=ETHSWT_TRAFFIC_CLASS_PREEMPTABLE, lc-state=draft
      lc-object=EthSwtPortShaper, lc-state=obsolete
      lc-object=EthSwtPortEgressPredecessorFifoRef, lc-state=obsolete
      lc-object=EthSwtPortShaperIdleSlope, lc-state=obsolete
      lc-object=EthSwtPortIngressScheduler, lc-state=draft
      lc-object=EthSwtPortPolicer, lc-state=obsolete
      lc-object=EthSwtPortRatePolicedByteCount, lc-state=obsolete
      lc-object=EthSwtPortRatePolicedPriority, lc-state=obsolete
      lc-object=EthSwtPortRatePolicedTimeInterval, lc-state=obsolete
      lc-object=EthSwtPortRateViolationAction, lc-state=obsolete
      lc-object=BLOCK_SOURCE, lc-state=obsolete
      lc-object=DROP_FRAME, lc-state=obsolete
      lc-object=EthSwtRateVlanMembershipRef, lc-state=obsolete
      lc-object=EthSwtStreamIdentificationTable, lc-state=draft
      lc-object=EthSwtStreamIdentificationEntry, lc-state=draft
      lc-object=EthSwtPortEgressStreamIdentificationEgressPortRef, lc-state=draft
      lc-object=EthSwtStreamFilterAction, lc-state=draft
      lc-object=EthSwtStreamFilterActionBlockSource, lc-state=draft
      lc-object=EthSwtStreamFilterActionDestinationPortModification, lc-state=draft
      lc-object=EthSwtStreamFilterActionDestinationPortModificationEgressPortRef, lc-state=draft
      lc-object=EthSwtStreamFilterActionDestinationPortModificationType, lc-state=draft
      lc-object=ETHSWT_STREAM_EGRESS_DESTINATION_EXTEND, lc-state=draft
      lc-object=ETHSWT_STREAM_EGRESS_DESTINATION_LIMIT, lc-state=draft
      lc-object=ETHSWT_STREAM_EGRESS_DESTINATION_OVERWRITE, lc-state=draft
      lc-object=EthSwtStreamFilterActionDropFrame, lc-state=draft
      lc-object=EthSwtStreamFilterActionVlanModification, lc-state=draft
      lc-object=EthSwtStreamFilterActionVlanModificationVlanId, lc-state=draft
      lc-object=EthSwtStreamFilterRule, lc-state=draft
      lc-object=EthSwtStreamFilterEtherType, lc-state=draft
      lc-object=EthSwtStreamFilterIPDestAddress, lc-state=draft
      lc-object=EthSwtStreamFilterIPDestAddress/EthSwtStreamFilterIPAddressKey, lc-state=draft
      lc-object=EthSwtStreamFilterIPDestAddress/EthSwtStreamFilterIPAddressMask, lc-state=draft
      lc-object=EthSwtStreamFilterIPSrcAddress, lc-state=draft
      lc-object=EthSwtStreamFilterIPSrcAddress/EthSwtStreamFilterIPAddressKey, lc-state=draft
      lc-object=EthSwtStreamFilterIPSrcAddress/EthSwtStreamFilterIPAddressMask, lc-state=draft
      lc-object=EthSwtStreamFilterMACDestAddress, lc-state=draft
      lc-object=EthSwtStreamFilterMACDestAddress/EthSwtStreamFilterMACAddressKey, lc-state=draft
      lc-object=EthSwtStreamFilterMACDestAddress/EthSwtStreamFilterMACAddressMask, lc-state=draft
      lc-object=EthSwtStreamFilterMACSrcAddress, lc-state=draft
      lc-object=EthSwtStreamFilterMACSrcAddress/EthSwtStreamFilterMACAddressKey, lc-state=draft
      lc-object=EthSwtStreamFilterMACSrcAddress/EthSwtStreamFilterMACAddressMask, lc-state=draft
      lc-object=EthSwtStreamFilterTcpDestPort, lc-state=draft
      lc-object=EthSwtStreamFilterTcpDestPort/EthSwtStreamFilterPortLowerValue, lc-state=draft
      lc-object=EthSwtStreamFilterTcpDestPort/EthSwtStreamFilterPortUpperValue, lc-state=draft
      lc-object=EthSwtStreamFilterTcpSrcPort, lc-state=draft
      lc-object=EthSwtStreamFilterTcpSrcPort/EthSwtStreamFilterPortLowerValue, lc-state=draft
      lc-object=EthSwtStreamFilterTcpSrcPort/EthSwtStreamFilterPortUpperValue, lc-state=draft
      lc-object=EthSwtStreamFilterUdpDestPort, lc-state=draft
      lc-object=EthSwtStreamFilterUdpDestPort/EthSwtStreamFilterPortLowerValue, lc-state=draft
      lc-object=EthSwtStreamFilterUdpDestPort/EthSwtStreamFilterPortUpperValue, lc-state=draft
      lc-object=EthSwtStreamFilterUdpSrcPort, lc-state=draft
      lc-object=EthSwtStreamFilterUdpSrcPort/EthSwtStreamFilterPortLowerValue, lc-state=draft
      lc-object=EthSwtStreamFilterUdpSrcPort/EthSwtStreamFilterPortUpperValue, lc-state=draft
      lc-object=EthSwtStreamFilterVlanId, lc-state=draft
      lc-object=EthSwtStreamFilterVlanPriority, lc-state=draft
      lc-object=EthSwtStreamHandleAssignment, lc-state=draft
      lc-object=EthSwtStreamIdentificationIngressPortRef, lc-state=draft
      lc-object=EthSwtStreamIdentificationPosition, lc-state=draft
      lc-object=EthSwtUsedInternalPriorityUpperValue, lc-state=draft
      lc-object=EthSwtUsedTrafficClassUpperValue, lc-state=draft
      lc-object=EthTSynEthIfFrameType, lc-state=draft
      lc-object=EthTSynMaxNumberOfTransmitRetries, lc-state=draft
      lc-object=EthTSynClkUnitRef, lc-state=draft
      lc-object=EthTSynRateRatioEnable, lc-state=draft
      lc-object=EthTSynRateRatioMeasurementCount, lc-state=draft
      lc-object=EthTSynRxPdu, lc-state=draft
      lc-object=EthTSynRxPduId, lc-state=draft
      lc-object=EthTSynRxPduRef, lc-state=draft
      lc-object=EthTSynTxPdu, lc-state=draft
      lc-object=EthTSynTxPduId, lc-state=draft
      lc-object=EthTSynTxPduRef, lc-state=draft
      lc-object=EthTrcvActAsSlavePassiveEnabled, lc-state=draft
      lc-object=FeeMemAccAddressArea, lc-state=draft
      lc-object=FeeBufferAlignmentValue, lc-state=draft
      lc-object=FeeMinimumReadPageSize, lc-state=draft
      lc-object=Firewall, lc-state=draft
      lc-object=FirewallConfig, lc-state=draft
      lc-object=FirewallEthernetFrame, lc-state=draft
      lc-object=FirewallLowerLayerPdu, lc-state=draft
      lc-object=FirewallLowerLayerPduId, lc-state=draft
      lc-object=FirewallLowerLayerPduRef, lc-state=draft
      lc-object=FirewallUpperLayerPdu, lc-state=draft
      lc-object=FirewallUpperLayerPduId, lc-state=draft
      lc-object=FirewallUpperLayerPduRef, lc-state=draft
      lc-object=FirewallInitialStateRef, lc-state=draft
      lc-object=FirewallGeneral, lc-state=draft
      lc-object=FirewallDevErrorDetect, lc-state=draft
      lc-object=FirewallMainFunctionPeriod, lc-state=draft
      lc-object=FirewallSecurityEventRefs, lc-state=draft
      lc-object=SEV_FW_PACKET_BLOCKED_BY_PERSTREAMFILTERING, lc-state=draft
      lc-object=SEV_FW_PACKET_BLOCKED_DATALINKLAYER_MISMATCH, lc-state=draft
      lc-object=SEV_FW_PACKET_BLOCKED_DDS_MISMATCH, lc-state=draft
      lc-object=SEV_FW_PACKET_BLOCKED_DOIP_MISMATCH, lc-state=draft
      lc-object=SEV_FW_PACKET_BLOCKED_GENERIC_MISMATCH, lc-state=draft
      lc-object=SEV_FW_PACKET_BLOCKED_ICMP_MISMATCH, lc-state=draft
      lc-object=SEV_FW_PACKET_BLOCKED_IPV4_MISMATCH, lc-state=draft
      lc-object=SEV_FW_PACKET_BLOCKED_IPV6_MISMATCH, lc-state=draft
      lc-object=SEV_FW_PACKET_BLOCKED_RATELIMIT, lc-state=draft
      lc-object=SEV_FW_PACKET_BLOCKED_SOMEIPSD_MISMATCH, lc-state=draft
      lc-object=SEV_FW_PACKET_BLOCKED_SOMEIP_MISMATCH, lc-state=draft
      lc-object=SEV_FW_PACKET_BLOCKED_TCP_MAXCONNECTIONS, lc-state=draft
      lc-object=SEV_FW_PACKET_BLOCKED_TCP_MISMATCH, lc-state=draft
      lc-object=SEV_FW_PACKET_BLOCKED_TCP_STATETRANSITION, lc-state=draft
      lc-object=SEV_FW_PACKET_BLOCKED_TCP_TIMEOUT, lc-state=draft
      lc-object=SEV_FW_PACKET_BLOCKED_UDP_MISMATCH, lc-state=draft
      lc-object=FirewallSwitchRuleMgmtTimeout, lc-state=draft
      lc-object=FirewallVersionInfoApi, lc-state=draft
      lc-object=FirwallEnableSecurityEventReporting, lc-state=draft
      lc-object=FirewallRule, lc-state=draft
      lc-object=FirewallBucketSize, lc-state=draft
      lc-object=FirewallDataLinkFilterConfig, lc-state=draft
      lc-object=FirewallFilterEtherType, lc-state=draft
      lc-object=FirewallFilterMACDestAddress, lc-state=draft
      lc-object=FirewallFilterMACDestAddress/FirewallFilterMACAddressKey, lc-state=draft
      lc-object=FirewallFilterMACDestAddress/FirewallFilterMACAddressMask, lc-state=draft
      lc-object=FirewallFilterMACSrcAddress, lc-state=draft
      lc-object=FirewallFilterMACSrcAddress/FirewallFilterMACAddressKey, lc-state=draft
      lc-object=FirewallFilterMACSrcAddress/FirewallFilterMACAddressMask, lc-state=draft
      lc-object=FirewallFilterVlanId, lc-state=draft
      lc-object=FirewallFilterVlanPriority, lc-state=draft
      lc-object=FirewallDdsFilterConfig, lc-state=draft
      lc-object=FirewallDdsAppId, lc-state=draft
      lc-object=FirewallDdsHostId, lc-state=draft
      lc-object=FirewallDdsInstanceId, lc-state=draft
      lc-object=FirewallDdsMajorProtocolVersion, lc-state=draft
      lc-object=FirewallDdsMinorProtocolVersion, lc-state=draft
      lc-object=FirewallDdsProductId, lc-state=draft
      lc-object=FirewallDdsReaderEntityId, lc-state=draft
      lc-object=FirewallDdsSubmessageType, lc-state=draft
      lc-object=FirewallDdsVendorId, lc-state=draft
      lc-object=FirewallDdsWriterEntityId, lc-state=draft
      lc-object=FirewallDoipFilterConfig, lc-state=draft
      lc-object=FirewallDoipDestAddress, lc-state=draft
      lc-object=FirewallDoipDestAddressLowerValue, lc-state=draft
      lc-object=FirewallDoipDestAddressUpperValue, lc-state=draft
      lc-object=FirewallDoipInverseProtocolVersion, lc-state=draft
      lc-object=FirewallDoipPayloadLength, lc-state=draft
      lc-object=FirewallDoipPayloadType, lc-state=draft
      lc-object=FirewallDoipProtocolVersion, lc-state=draft
      lc-object=FirewallDoipSrcAddress, lc-state=draft
      lc-object=FirewallDoipSrcAddressLowerValue, lc-state=draft
      lc-object=FirewallDoipSrcAddressUpperValue, lc-state=draft
      lc-object=FirewallDoipUdsService, lc-state=draft
      lc-object=FirewallNetworkLayerFilterConfig, lc-state=draft
      lc-object=FirewallNetworkLayerIpv4FilterConfig, lc-state=draft
      lc-object=FirewallNetworkLayerIpv4FilterConfig/FirewallChecksumVerification, lc-state=draft
      lc-object=FirewallDifferentiatedServiceCodePoint, lc-state=draft
      lc-object=FirewallDoNotFragment, lc-state=draft
      lc-object=FirewallExplicitCongestionNotification, lc-state=draft
      lc-object=FirewallNetworkLayerIpv4FilterConfig/FirewallFilterIPDestAddress, lc-state=draft
      lc-object=FirewallFilterIPDestAddress/FirewallFilterIPAddressKey, lc-state=draft
      lc-object=FirewallFilterIPDestAddress/FirewallFilterIPAddressMask, lc-state=draft
      lc-object=FirewallNetworkLayerIpv4FilterConfig/FirewallFilterIPSrcAddress, lc-state=draft
      lc-object=FirewallFilterIPSrcAddress/FirewallFilterIPAddressKey, lc-state=draft
      lc-object=FirewallFilterIPSrcAddress/FirewallFilterIPAddressMask, lc-state=draft
      lc-object=FirewallFilterIPv4Ttl, lc-state=draft
      lc-object=FirewallIpv4TtlMax, lc-state=draft
      lc-object=FirewallIpv4TtlMin, lc-state=draft
      lc-object=FirewallInternetHeaderLength, lc-state=draft
      lc-object=FirewallIpProtocolNumber, lc-state=draft
      lc-object=FirewallMoreFragments, lc-state=draft
      lc-object=FirewallNetworkLayerIpv4FilterConfig/FirewallNetworkLayerIcmpConfig, lc-state=draft
      lc-object=FirewallNetworkLayerIcmpConfig/FirewallChecksumVerification, lc-state=draft
      lc-object=FirewallNetworkLayerIcmpConfig/FirewallIcmpCode, lc-state=draft
      lc-object=FirewallNetworkLayerIcmpConfig/FirewallIcmpType, lc-state=draft
      lc-object=FirewallNetworkLayerIpv6FilterConfig, lc-state=draft
      lc-object=FirewallNetworkLayerIpv6FilterConfig/FirewallFilterIPDestAddress, lc-state=draft
      lc-object=FirewallFilterIPDestAddress/FirewallFilterIPAddressKey, lc-state=draft
      lc-object=FirewallFilterIPDestAddress/FirewallFilterIPAddressMask, lc-state=draft
      lc-object=FirewallNetworkLayerIpv6FilterConfig/FirewallFilterIPSrcAddress, lc-state=draft
      lc-object=FirewallFilterIPSrcAddress/FirewallFilterIPAddressKey, lc-state=draft
      lc-object=FirewallFilterIPSrcAddress/FirewallFilterIPAddressMask, lc-state=draft
      lc-object=FirewallITrafficClass, lc-state=draft
      lc-object=FirewallIpFlowLabel, lc-state=draft
      lc-object=FirewallIpHopLimit, lc-state=draft
      lc-object=FirewallIpNextHeader, lc-state=draft
      lc-object=FirewallNetworkLayerIpv6FilterConfig/FirewallNetworkLayerIcmpConfig, lc-state=draft
      lc-object=FirewallNetworkLayerIcmpConfig/FirewallChecksumVerification, lc-state=draft
      lc-object=FirewallNetworkLayerIcmpConfig/FirewallIcmpCode, lc-state=draft
      lc-object=FirewallNetworkLayerIcmpConfig/FirewallIcmpType, lc-state=draft
      lc-object=FirewallPayloadBytePatternFilterConfig, lc-state=draft
      lc-object=FirewallPayloadByteConfig, lc-state=draft
      lc-object=FirewallPaylodByteOffset, lc-state=draft
      lc-object=FirewallPaylodByteValue, lc-state=draft
      lc-object=FirewallRefillAmount, lc-state=draft
      lc-object=FirewallSomeipProtocolFilterConfig, lc-state=draft
      lc-object=FirewallSomeipClientId, lc-state=draft
      lc-object=FirewallSomeipLengthVerification, lc-state=draft
      lc-object=FirewallSomeipMajorVersion, lc-state=draft
      lc-object=FirewallSomeipMessageType, lc-state=draft
      lc-object=FirewallSomeipMethodId, lc-state=draft
      lc-object=FirewallSomeipProtocolVersion, lc-state=draft
      lc-object=FirewallSomeipReturnCode, lc-state=draft
      lc-object=FirewallSomeipProtocolFilterConfig/FirewallSomeipServiceInterfaceId, lc-state=draft
      lc-object=FirewallSomeipSdFilterConfig, lc-state=draft
      lc-object=FirewallSomeipEntryType, lc-state=draft
      lc-object=FirewallSomeipEventGroupId, lc-state=draft
      lc-object=FirewallSomeipMajorVersion, lc-state=draft
      lc-object=FirewallMajorVersionMaxValue, lc-state=draft
      lc-object=FirewallMajorVersionMinValue, lc-state=draft
      lc-object=FirewallSomeipMinorVersion, lc-state=draft
      lc-object=FirewallMinorVersionMaxValue, lc-state=draft
      lc-object=FirewallMinorVersionMinValue, lc-state=draft
      lc-object=FirewallSomeipServiceInstanceId, lc-state=draft
      lc-object=FirewallSomeipSdFilterConfig/FirewallSomeipServiceInterfaceId, lc-state=draft
      lc-object=FirewallTransportLayerFilterConfig, lc-state=draft
      lc-object=FirewallTransportLayerTcpFilterConfig, lc-state=draft
      lc-object=FirewallTransportLayerTcpFilterConfig/FirewallChecksumVerification, lc-state=draft
      lc-object=FirewallTransportLayerTcpFilterConfig/FirewallFilterDestPort, lc-state=draft
      lc-object=FirewallFilterDestPort/FirewallFilterPortLowerValue, lc-state=draft
      lc-object=FirewallFilterDestPort/FirewallFilterPortUpperValue, lc-state=draft
      lc-object=FirewallTransportLayerTcpFilterConfig/FirewallFilterSrcPort, lc-state=draft
      lc-object=FirewallFilterSrcPort/FirewallFilterPortLowerValue, lc-state=draft
      lc-object=FirewallFilterSrcPort/FirewallFilterPortUpperValue, lc-state=draft
      lc-object=FirewallNumberOfParallelTcpSessions, lc-state=draft
      lc-object=FirewallStateManagementBasedOnTcpFlags, lc-state=draft
      lc-object=FirewallTimeoutCheck, lc-state=draft
      lc-object=FirewallTransportLayerUdpFilterConfig, lc-state=draft
      lc-object=FirewallTransportLayerUdpFilterConfig/FirewallChecksumVerification, lc-state=draft
      lc-object=FirewallTransportLayerUdpFilterConfig/FirewallFilterDestPort, lc-state=draft
      lc-object=FirewallFilterDestPort/FirewallFilterPortLowerValue, lc-state=draft
      lc-object=FirewallFilterDestPort/FirewallFilterPortUpperValue, lc-state=draft
      lc-object=FirewallTransportLayerUdpFilterConfig/FirewallFilterSrcPort, lc-state=draft
      lc-object=FirewallFilterSrcPort/FirewallFilterPortLowerValue, lc-state=draft
      lc-object=FirewallFilterSrcPort/FirewallFilterPortUpperValue, lc-state=draft
      lc-object=FirewallState, lc-state=draft
      lc-object=FirewallStateId, lc-state=draft
      lc-object=FirewallStateDependentRules, lc-state=draft
      lc-object=FirewallActionForMatchingRules, lc-state=draft
      lc-object=FirewallAction, lc-state=draft
      lc-object=FirewallAction/ALLOW, lc-state=draft
      lc-object=FirewallAction/BLOCK, lc-state=draft
      lc-object=FirewallMatchingEgressRule, lc-state=draft
      lc-object=FirewallMatchingIngressRule, lc-state=draft
      lc-object=FirewallDefaultAction, lc-state=draft
      lc-object=FirewallDefaultAction/ALLOW, lc-state=draft
      lc-object=FirewallDefaultAction/BLOCK, lc-state=draft
      lc-object=FirewallStateRef, lc-state=draft
      lc-object=FirewallSwitchBucketCounterStatistics, lc-state=draft
      lc-object=FirewallEthIfSwitchRef, lc-state=draft
      lc-object=FirewallingWithPerStreamFiltering, lc-state=draft
      lc-object=FwSwitchBucketCounterPollingInterval, lc-state=draft
      lc-object=Fls, lc-state=obsolete
      lc-object=FlsConfigSet, lc-state=obsolete
      lc-object=FlsAcErase, lc-state=obsolete
      lc-object=FlsAcWrite, lc-state=obsolete
      lc-object=FlsDefaultMode, lc-state=obsolete
      lc-object=FlsDefaultMode/MEMIF_MODE_FAST, lc-state=obsolete
      lc-object=FlsDefaultMode/MEMIF_MODE_SLOW, lc-state=obsolete
      lc-object=FlsExternalDriver, lc-state=obsolete
      lc-object=FlsSpiReference, lc-state=obsolete
      lc-object=FlsJobEndNotification, lc-state=obsolete
      lc-object=FlsJobErrorNotification, lc-state=obsolete
      lc-object=FlsMaxReadFastMode, lc-state=obsolete
      lc-object=FlsMaxReadNormalMode, lc-state=obsolete
      lc-object=FlsMaxWriteFastMode, lc-state=obsolete
      lc-object=FlsMaxWriteNormalMode, lc-state=obsolete
      lc-object=FlsProtection, lc-state=obsolete
      lc-object=FlsSectorList, lc-state=obsolete
      lc-object=FlsSector, lc-state=obsolete
      lc-object=FlsNumberOfSectors, lc-state=obsolete
      lc-object=FlsPageSize, lc-state=obsolete
      lc-object=FlsSectorSize, lc-state=obsolete
      lc-object=FlsSectorStartaddress, lc-state=obsolete
      lc-object=FlsGeneral, lc-state=obsolete
      lc-object=FlsAcLoadOnJobStart, lc-state=obsolete
      lc-object=FlsBaseAddress, lc-state=obsolete
      lc-object=FlsBlankCheckApi, lc-state=obsolete
      lc-object=FlsCancelApi, lc-state=obsolete
      lc-object=FlsCompareApi, lc-state=obsolete
      lc-object=FlsDevErrorDetect, lc-state=obsolete
      lc-object=FlsDriverIndex, lc-state=obsolete
      lc-object=FlsEcucPartitionRef, lc-state=obsolete
      lc-object=FlsEraseVerificationEnabled, lc-state=obsolete
      lc-object=FlsGetJobResultApi, lc-state=obsolete
      lc-object=FlsGetStatusApi, lc-state=obsolete
      lc-object=FlsMainFunctionPeriod, lc-state=obsolete
      lc-object=FlsSetModeApi, lc-state=obsolete
      lc-object=FlsTimeoutSupervisionEnabled, lc-state=obsolete
      lc-object=FlsTotalSize, lc-state=obsolete
      lc-object=FlsUseInterrupts, lc-state=obsolete
      lc-object=FlsVersionInfoApi, lc-state=obsolete
      lc-object=FlsWriteVerificationEnabled, lc-state=obsolete
      lc-object=FlsPublishedInformation, lc-state=obsolete
      lc-object=FlsAcLocationErase, lc-state=obsolete
      lc-object=FlsAcLocationWrite, lc-state=obsolete
      lc-object=FlsAcSizeErase, lc-state=obsolete
      lc-object=FlsAcSizeWrite, lc-state=obsolete
      lc-object=FlsEraseTime, lc-state=obsolete
      lc-object=FlsErasedValue, lc-state=obsolete
      lc-object=FlsExpectedHwId, lc-state=obsolete
      lc-object=FlsSpecifiedEraseCycles, lc-state=obsolete
      lc-object=FlsWriteTime, lc-state=obsolete
      lc-object=FrNmDynamicPncToChannelMappingEnabled, lc-state=draft
      lc-object=FrNmRepeatMsgIndEnabled, lc-state=draft
      lc-object=I2c, lc-state=draft
      lc-object=I2cConfigSet, lc-state=draft
      lc-object=I2cChannel, lc-state=draft
      lc-object=I2cBaudRate, lc-state=draft
      lc-object=I2cHwUnitBaseAddress, lc-state=draft
      lc-object=I2cHwUnitMode, lc-state=draft
      lc-object=I2C_HW_UNIT_MODE_CONTROLLER, lc-state=draft
      lc-object=I2C_HW_UNIT_MODE_TARGET, lc-state=draft
      lc-object=I2cTargetListening, lc-state=draft
      lc-object=I2cJob, lc-state=draft
      lc-object=I2cDeviceAddress, lc-state=draft
      lc-object=I2cJobId, lc-state=draft
      lc-object=I2cSequence, lc-state=draft
      lc-object=I2cAssignedChannel, lc-state=draft
      lc-object=I2cAssignedJob, lc-state=draft
      lc-object=I2cEndNotification, lc-state=draft
      lc-object=I2cSequenceId, lc-state=draft
      lc-object=I2cGeneral, lc-state=draft
      lc-object=I2cDevErrorDetect, lc-state=draft
      lc-object=I2cVersionInfoApi, lc-state=draft
      lc-object=IEEE1722Tp, lc-state=draft
      lc-object=IEEE1722TpConfig, lc-state=draft
      lc-object=IEEE1722TpLowerLayerPduPool, lc-state=draft
      lc-object=IEEE1722TpLowerLayerRxPduPoolEntry, lc-state=draft
      lc-object=IEEE1722TpLowerLayerRxPduId, lc-state=draft
      lc-object=IEEE1722TpLowerLayerRxPduRef, lc-state=draft
      lc-object=IEEE1722TpLowerLayerTxPduPoolEntry, lc-state=draft
      lc-object=IEEE1722TpLowerLayerTxPduId, lc-state=draft
      lc-object=IEEE1722TpLowerLayerTxPduRef, lc-state=draft
      lc-object=IEEE1722TpStream, lc-state=draft
      lc-object=IEEE1722TpEthIfClkUnitRef, lc-state=draft
      lc-object=IEEE1722TpStbMSynchronizedTimeBaseRef, lc-state=draft
      lc-object=IEEE1722TpStreamDirection, lc-state=draft
      lc-object=IEEE1722TpStreamRx, lc-state=draft
      lc-object=IEEE1722TpStreamRxQueue, lc-state=draft
      lc-object=IEEE1722TpStreamRxQueueSize, lc-state=draft
      lc-object=IEEE1722TpUpperLayerRxPduPoolEntry, lc-state=draft
      lc-object=IEEE1722TpStreamRxPduId, lc-state=draft
      lc-object=IEEE1722TpStreamRxPduRef, lc-state=draft
      lc-object=IEEE1722TpStreamTx, lc-state=draft
      lc-object=IEEE1722TpStreamTxQueue, lc-state=draft
      lc-object=IEEE1722TpStreamTxQueueSize, lc-state=draft
      lc-object=IEEE1722TpUpperLayerTxPduPoolEntry, lc-state=draft
      lc-object=IEEE1722TpStreamTxPduId, lc-state=draft
      lc-object=IEEE1722TpStreamTxPduRef, lc-state=draft
      lc-object=IEEE1722TpStreamIdMacAddress, lc-state=draft
      lc-object=IEEE1722TpStreamIdUniquePart, lc-state=draft
      lc-object=IEEE1722TpStreamIndex, lc-state=draft
      lc-object=IEEE1722TpStreamLowerLayerPduPoolRef, lc-state=draft
      lc-object=IEEE1722TpStreamMaxTransitTime, lc-state=draft
      lc-object=IEEE1722TpStreamSubtype, lc-state=draft
      lc-object=IEEE1722TpStreamAAF, lc-state=draft
      lc-object=IEEE1722TpStreamAafAes3DataTypeH, lc-state=draft
      lc-object=IEEE1722TpStreamAafAes3DataTypeL, lc-state=draft
      lc-object=IEEE1722TpStreamAafAes3DataTypeRef, lc-state=draft
      lc-object=IEC61937, lc-state=draft
      lc-object=PCM, lc-state=draft
      lc-object=SMPTE338, lc-state=draft
      lc-object=UNSPECIFIED, lc-state=draft
      lc-object=VENDOR, lc-state=draft
      lc-object=IEEE1722TpStreamAafAes3NominalFrameRate, lc-state=draft
      lc-object=IEEE1722TpStreamAafAes3NominalFrameRate/R_16kHz, lc-state=draft
      lc-object=IEEE1722TpStreamAafAes3NominalFrameRate/R_176_4kHz, lc-state=draft
      lc-object=IEEE1722TpStreamAafAes3NominalFrameRate/R_192kHz, lc-state=draft
      lc-object=IEEE1722TpStreamAafAes3NominalFrameRate/R_24kHz, lc-state=draft
      lc-object=IEEE1722TpStreamAafAes3NominalFrameRate/R_32kHz, lc-state=draft
      lc-object=IEEE1722TpStreamAafAes3NominalFrameRate/R_44_1kHz, lc-state=draft
      lc-object=IEEE1722TpStreamAafAes3NominalFrameRate/R_48kHz, lc-state=draft
      lc-object=IEEE1722TpStreamAafAes3NominalFrameRate/R_88_2kHz, lc-state=draft
      lc-object=IEEE1722TpStreamAafAes3NominalFrameRate/R_8kHz, lc-state=draft
      lc-object=IEEE1722TpStreamAafAes3NominalFrameRate/R_96kHz, lc-state=draft
      lc-object=IEEE1722TpStreamAafAes3NominalFrameRate/R_USER, lc-state=draft
      lc-object=IEEE1722TpStreamAafAes3StreamsPerFrame, lc-state=draft
      lc-object=IEEE1722TpStreamAafEventDefault, lc-state=draft
      lc-object=IEEE1722TpStreamAafFormat, lc-state=draft
      lc-object=AES3_32BIT, lc-state=draft
      lc-object=FLOAT_32BIT, lc-state=draft
      lc-object=INT_16BIT, lc-state=draft
      lc-object=INT_24BIT, lc-state=draft
      lc-object=INT_32BIT, lc-state=draft
      lc-object=IEEE1722TpStreamAafFormat/USER, lc-state=draft
      lc-object=IEEE1722TpStreamAafPcmBitDepth, lc-state=draft
      lc-object=IEEE1722TpStreamAafPcmChannelsPerFrame, lc-state=draft
      lc-object=IEEE1722TpStreamAafPcmNominalSampleRate, lc-state=draft
      lc-object=IEEE1722TpStreamAafPcmNominalSampleRate/R_16kHz, lc-state=draft
      lc-object=IEEE1722TpStreamAafPcmNominalSampleRate/R_176_4kHz, lc-state=draft
      lc-object=IEEE1722TpStreamAafPcmNominalSampleRate/R_192kHz, lc-state=draft
      lc-object=IEEE1722TpStreamAafPcmNominalSampleRate/R_24kHz, lc-state=draft
      lc-object=IEEE1722TpStreamAafPcmNominalSampleRate/R_32kHz, lc-state=draft
      lc-object=IEEE1722TpStreamAafPcmNominalSampleRate/R_44_1kHz, lc-state=draft
      lc-object=IEEE1722TpStreamAafPcmNominalSampleRate/R_48kHz, lc-state=draft
      lc-object=IEEE1722TpStreamAafPcmNominalSampleRate/R_88_2kHz, lc-state=draft
      lc-object=IEEE1722TpStreamAafPcmNominalSampleRate/R_8kHz, lc-state=draft
      lc-object=IEEE1722TpStreamAafPcmNominalSampleRate/R_96kHz, lc-state=draft
      lc-object=IEEE1722TpStreamAafPcmNominalSampleRate/R_USER, lc-state=draft
      lc-object=IEEE1722TpStreamAafSparseTimestamp, lc-state=draft
      lc-object=IEEE1722TpStreamACF, lc-state=draft
      lc-object=IEEE1722TpAcfCollectionThreshold, lc-state=draft
      lc-object=IEEE1722TpAcfCollectionTimeout, lc-state=draft
      lc-object=IEEE1722TpStreamAcfHeaderType, lc-state=draft
      lc-object=NON_TIME_SYNCHRONOUS, lc-state=draft
      lc-object=TIME_SYNCHRONOUS, lc-state=draft
      lc-object=IEEE1722TpStreamAcfMixedBusTypeCollection, lc-state=draft
      lc-object=IEEE1722TpStreamAcfPayload, lc-state=draft
      lc-object=IEEE1722TpStreamAcfCan, lc-state=draft
      lc-object=IEEE1722TpStreamAcfCan/IEEE1722TpStreamAcfBusId, lc-state=draft
      lc-object=IEEE1722TpStreamAcfCanMessageType, lc-state=draft
      lc-object=CAN, lc-state=draft
      lc-object=CAN_BRIEF, lc-state=draft
      lc-object=IEEE1722TpStreamAcfCanPdu, lc-state=draft
      lc-object=IEEE1722TpStreamAcfCanExtendedFrameFormat, lc-state=draft
      lc-object=IEEE1722TpStreamAcfCanFDBitDataRateFormat, lc-state=draft
      lc-object=IEEE1722TpStreamAcfCanFDBitRateSwitch, lc-state=draft
      lc-object=IEEE1722TpStreamAcfCanId, lc-state=draft
      lc-object=IEEE1722TpStreamAcfCanPduFilter, lc-state=draft
      lc-object=IEEE1722TpStreamAcfCanIdMask, lc-state=draft
      lc-object=IEEE1722TpStreamAcfCanPdu/IEEE1722TpStreamAcfRxPdu, lc-state=draft
      lc-object=IEEE1722TpStreamAcfRxPdu/IEEE1722TpStreamAcfPduId, lc-state=draft
      lc-object=IEEE1722TpStreamAcfRxPdu/IEEE1722TpStreamAcfPduRef, lc-state=draft
      lc-object=IEEE1722TpStreamAcfCanPdu/IEEE1722TpStreamAcfTriggerMode, lc-state=draft
      lc-object=IEEE1722TpStreamAcfTriggerMode/TRIGGER_ALWAYS, lc-state=draft
      lc-object=IEEE1722TpStreamAcfTriggerMode/TRIGGER_NEVER, lc-state=draft
      lc-object=IEEE1722TpStreamAcfCanPdu/IEEE1722TpStreamAcfTxPdu, lc-state=draft
      lc-object=IEEE1722TpStreamAcfTxPdu/IEEE1722TpStreamAcfPduId, lc-state=draft
      lc-object=IEEE1722TpStreamAcfTxPdu/IEEE1722TpStreamAcfPduRef, lc-state=draft
      lc-object=IEEE1722TpStreamAcfLin, lc-state=draft
      lc-object=IEEE1722TpStreamAcfLin/IEEE1722TpStreamAcfBusId, lc-state=draft
      lc-object=IEEE1722TpStreamAcfLinPdu, lc-state=draft
      lc-object=IEEE1722TpStreamAcfLinId, lc-state=draft
      lc-object=IEEE1722TpStreamAcfLinPdu/IEEE1722TpStreamAcfRxPdu, lc-state=draft
      lc-object=IEEE1722TpStreamAcfRxPdu/IEEE1722TpStreamAcfPduId, lc-state=draft
      lc-object=IEEE1722TpStreamAcfRxPdu/IEEE1722TpStreamAcfPduRef, lc-state=draft
      lc-object=IEEE1722TpStreamAcfLinPdu/IEEE1722TpStreamAcfTriggerMode, lc-state=draft
      lc-object=IEEE1722TpStreamAcfTriggerMode/TRIGGER_ALWAYS, lc-state=draft
      lc-object=IEEE1722TpStreamAcfTriggerMode/TRIGGER_NEVER, lc-state=draft
      lc-object=IEEE1722TpStreamAcfLinPdu/IEEE1722TpStreamAcfTxPdu, lc-state=draft
      lc-object=IEEE1722TpStreamAcfTxPdu/IEEE1722TpStreamAcfPduId, lc-state=draft
      lc-object=IEEE1722TpStreamAcfTxPdu/IEEE1722TpStreamAcfPduRef, lc-state=draft
      lc-object=IEEE1722TpStreamCRF, lc-state=draft
      lc-object=IEEE1722TpStreamCrfBaseFrequency, lc-state=draft
      lc-object=IEEE1722TpStreamCrfFrameSync, lc-state=draft
      lc-object=IEEE1722TpStreamCrfPull, lc-state=draft
      lc-object=PULL_1_0, lc-state=draft
      lc-object=PULL_1_001, lc-state=draft
      lc-object=PULL_1_1_001, lc-state=draft
      lc-object=PULL_1_8, lc-state=draft
      lc-object=PULL_24_25, lc-state=draft
      lc-object=PULL_25_24, lc-state=draft
      lc-object=IEEE1722TpStreamCrfTimestampInterval, lc-state=draft
      lc-object=IEEE1722TpStreamCrfType, lc-state=draft
      lc-object=AUDIO_SAMPLE, lc-state=draft
      lc-object=MACHINE_CYCLE, lc-state=draft
      lc-object=IEEE1722TpStreamCrfType/USER, lc-state=draft
      lc-object=VIDEO_FRAME, lc-state=draft
      lc-object=VIDEO_LINE, lc-state=draft
      lc-object=IEEE1722TpStreamIIDC, lc-state=draft
      lc-object=IEEE1722TpStreamIidcChannel, lc-state=draft
      lc-object=IEEE1722TpStreamIidcDataBlockSize, lc-state=draft
      lc-object=IEEE1722TpStreamIidcFractionNumber, lc-state=draft
      lc-object=IEEE1722TpStreamIidcSourcePacketHeader, lc-state=draft
      lc-object=IEEE1722TpStreamIidcStreamFormat, lc-state=draft
      lc-object=IEEE1722TpStreamIidcSy, lc-state=draft
      lc-object=IEEE1722TpStreamIidcTCode, lc-state=draft
      lc-object=IEEE1722TpStreamIidcTag, lc-state=draft
      lc-object=IEEE1722TpStreamRVF, lc-state=draft
      lc-object=IEEE1722TpStreamRvfActivePixels, lc-state=draft
      lc-object=IEEE1722TpStreamRvfColorSpace, lc-state=draft
      lc-object=BT_Rec_601, lc-state=draft
      lc-object=BT_Rec_709, lc-state=draft
      lc-object=Grayscale, lc-state=draft
      lc-object=ITU_BT_2020, lc-state=draft
      lc-object=IEEE1722TpStreamRvfColorSpace/User, lc-state=draft
      lc-object=XYZ, lc-state=draft
      lc-object=YCM, lc-state=draft
      lc-object=YCbCr, lc-state=draft
      lc-object=YCgCo, lc-state=draft
      lc-object=sRGB, lc-state=draft
      lc-object=IEEE1722TpStreamRvfEventDefault, lc-state=draft
      lc-object=IEEE1722TpStreamRvfFrameRate, lc-state=draft
      lc-object=FR_1, lc-state=draft
      lc-object=FR_10, lc-state=draft
      lc-object=FR_100, lc-state=draft
      lc-object=FR_120, lc-state=draft
      lc-object=FR_15, lc-state=draft
      lc-object=FR_150, lc-state=draft
      lc-object=FR_2, lc-state=draft
      lc-object=FR_20, lc-state=draft
      lc-object=FR_200, lc-state=draft
      lc-object=FR_24, lc-state=draft
      lc-object=FR_240, lc-state=draft
      lc-object=FR_25, lc-state=draft
      lc-object=FR_30, lc-state=draft
      lc-object=FR_300, lc-state=draft
      lc-object=FR_48, lc-state=draft
      lc-object=FR_5, lc-state=draft
      lc-object=FR_50, lc-state=draft
      lc-object=FR_60, lc-state=draft
      lc-object=FR_72, lc-state=draft
      lc-object=FR_85, lc-state=draft
      lc-object=FR_User, lc-state=draft
      lc-object=IEEE1722TpStreamRvfInterlaced, lc-state=draft
      lc-object=IEEE1722TpStreamRvfPixelDepth, lc-state=draft
      lc-object=PD_10, lc-state=draft
      lc-object=PD_12, lc-state=draft
      lc-object=PD_16, lc-state=draft
      lc-object=PD_8, lc-state=draft
      lc-object=IEEE1722TpStreamRvfPixelDepth/User, lc-state=draft
      lc-object=IEEE1722TpStreamRvfPixelFormat, lc-state=draft
      lc-object=PF_4_1_1, lc-state=draft
      lc-object=PF_4_2_0, lc-state=draft
      lc-object=PF_4_2_2, lc-state=draft
      lc-object=PF_4_2_2_4, lc-state=draft
      lc-object=PF_4_4_4, lc-state=draft
      lc-object=PF_4_4_4_4, lc-state=draft
      lc-object=PF_Bayer_bggr, lc-state=draft
      lc-object=PF_Bayer_gbrg, lc-state=draft
      lc-object=PF_Bayer_grbg, lc-state=draft
      lc-object=PF_Bayer_rggb, lc-state=draft
      lc-object=PF_Monochrome, lc-state=draft
      lc-object=PF_User, lc-state=draft
      lc-object=IEEE1722TpStreamRvfTotalLines, lc-state=draft
      lc-object=IEEE1722TpStreamVersion, lc-state=draft
      lc-object=IEEE1722TpGeneral, lc-state=draft
      lc-object=IEEE1722TpDevErrorDetect, lc-state=draft
      lc-object=IEEE1722TpMainFunctionRx, lc-state=draft
      lc-object=IEEE1722TpMainFunctionRxPartitionRef, lc-state=draft
      lc-object=IEEE1722TpMainFunctionRxPeriod, lc-state=draft
      lc-object=IEEE1722TpMainFunctionTx, lc-state=draft
      lc-object=IEEE1722TpMainFunctionTxPartitionRef, lc-state=draft
      lc-object=IEEE1722TpMainFunctionTxPeriod, lc-state=draft
      lc-object=IEEE1722TpVersionInfoApi, lc-state=draft
      lc-object=ISO15118Chrg, lc-state=draft
      lc-object=ISO15118ChrgGeneral, lc-state=draft
      lc-object=ISO15118ChrgDevErrorDetect, lc-state=draft
      lc-object=ISO15118ChrgMainFunctionCycleTime, lc-state=draft
      lc-object=ISO15118ChrgVersionInfoApi, lc-state=draft
      lc-object=ISO15118ChrgService, lc-state=draft
      lc-object=ISO15118ChrgSoAdSocketConnectionRef, lc-state=draft
      lc-object=ISO15118ChrgTimer, lc-state=draft
      lc-object=ISO15118ChrgV2gEvccMsgTimeout, lc-state=draft
      lc-object=ISO15118ChrgV2GTP, lc-state=draft
      lc-object=ISO15118ChrgV2GSrcTcpDataRef, lc-state=draft
      lc-object=ISO15118ChrgV2GTPPdu, lc-state=draft
      lc-object=ISO15118ChrgV2GTPPduHandleId, lc-state=draft
      lc-object=ISO15118ChrgV2GTPPduPayloadType, lc-state=draft
      lc-object=ISO15118ChrgV2GTPPduProtocolVersion, lc-state=draft
      lc-object=ISO15118ChrgV2GTPPduRef, lc-state=draft
      lc-object=ISO15118ChrgV2GUdpSdpClientRef, lc-state=draft
      lc-object=IdsM, lc-state=draft
      lc-object=IdsMConfiguration, lc-state=draft
      lc-object=IdsMBlockState, lc-state=draft
      lc-object=IdsMBlockStateID, lc-state=draft
      lc-object=IdsMBufferConfiguration, lc-state=draft
      lc-object=IdsMContextDataBuffer, lc-state=draft
      lc-object=IdsMContextDataBufferSize, lc-state=draft
      lc-object=IdsMNumberOfContextDataBuffers, lc-state=draft
      lc-object=IdsMEventBuffers, lc-state=draft
      lc-object=IdsMNumberOfEventBuffers, lc-state=draft
      lc-object=IdsMNumberOfQualifiedEventBuffers, lc-state=draft
      lc-object=IdsMExternalEventId, lc-state=draft
      lc-object=IdsMFilterChainRef, lc-state=draft
      lc-object=IdsMInternalEventId, lc-state=draft
      lc-object=IdsMReportingModeFilter, lc-state=draft
      lc-object=BRIEF, lc-state=draft
      lc-object=BRIEF_BYPASSING_FILTERS, lc-state=draft
      lc-object=DETAILED, lc-state=draft
      lc-object=DETAILED_BYPASSING_FILTERS, lc-state=draft
      lc-object=IdsMReportingModeFilter/OFF, lc-state=draft
      lc-object=IdsMSensorInstanceId, lc-state=draft
      lc-object=IdsMServiceInterfaceOptions, lc-state=draft
      lc-object=IdsMEventMaxContextDataSize, lc-state=draft
      lc-object=IdsMSinkDem, lc-state=draft
      lc-object=IdsMSinkIdsR, lc-state=draft
      lc-object=IdsMFilterChain, lc-state=draft
      lc-object=IdsMBlockStateFilter, lc-state=draft
      lc-object=IdsMBlockStateReference, lc-state=draft
      lc-object=IdsMEventAggregationFilter, lc-state=draft
      lc-object=IdsMContextDataSourceSelector, lc-state=draft
      lc-object=IDSM_FILTERS_CTX_USE_FIRST, lc-state=draft
      lc-object=IDSM_FILTERS_CTX_USE_LAST, lc-state=draft
      lc-object=IdsMEventAggregationTimeInterval, lc-state=draft
      lc-object=IdsMEventThresholdFilter, lc-state=draft
      lc-object=IdsMEventThresholdNumber, lc-state=draft
      lc-object=IdsMEventThresholdTimeInterval, lc-state=draft
      lc-object=IdsMForwardEveryNthFilter, lc-state=draft
      lc-object=IdsMNthParameter, lc-state=draft
      lc-object=IdsMPdus, lc-state=draft
      lc-object=IdsMIfTxPdu, lc-state=draft
      lc-object=IdsMIfTxPduHandleId, lc-state=draft
      lc-object=IdsMIfTxPduRef, lc-state=draft
      lc-object=IdsMTpTxPdu, lc-state=draft
      lc-object=IdsMTpTxPduHandleId, lc-state=draft
      lc-object=IdsMTpTxPduRef, lc-state=draft
      lc-object=IdsMGeneral, lc-state=draft
      lc-object=IdsMDevErrorDetect, lc-state=draft
      lc-object=IdsMDiagnosticSupport, lc-state=draft
      lc-object=IdsMEnableSecurityEventReporting, lc-state=draft
      lc-object=IdsMGlobalRateLimitationFilters, lc-state=draft
      lc-object=IdsMFilterEventRateLimitation, lc-state=draft
      lc-object=IdsMRateLimitationMaximumEvents, lc-state=draft
      lc-object=IdsMRateLimitationTimeInterval, lc-state=draft
      lc-object=IdsMFilterTrafficLimitation, lc-state=draft
      lc-object=IdsMTrafficLimitationMaximumBytes, lc-state=draft
      lc-object=IdsMTrafficLimitationTimeInterval, lc-state=draft
      lc-object=IdsMInstanceId, lc-state=draft
      lc-object=IdsMMainFunctionPeriod, lc-state=draft
      lc-object=IdsMNvmBlockDescriptor, lc-state=draft
      lc-object=IdsMSecurityEventRefs, lc-state=draft
      lc-object=SEV_IDSM_COMMUNICATION_ERROR, lc-state=draft
      lc-object=SEV_IDSM_NO_CONTEXT_DATA_BUFFER_AVAILABLE, lc-state=draft
      lc-object=SEV_IDSM_NO_EVENT_BUFFER_AVAILABLE, lc-state=draft
      lc-object=SEV_IDSM_NO_QUALIFIED_EVENT_BUFFER_AVAILABLE, lc-state=draft
      lc-object=SEV_IDSM_TRAFFIC_LIMITATION_EXCEEDED, lc-state=draft
      lc-object=IdsMSignature, lc-state=draft
      lc-object=IdsMCsmJobReference, lc-state=draft
      lc-object=IdsMSignatureLength, lc-state=draft
      lc-object=IdsMSignatureSupport, lc-state=draft
      lc-object=IdsMTimestamp, lc-state=draft
      lc-object=IdsMStbmTimeBaseReference, lc-state=draft
      lc-object=IdsMTimestampOption, lc-state=draft
      lc-object=AUTOSAR, lc-state=draft
      lc-object=Custom, lc-state=draft
      lc-object=IdsMTimestampSupport, lc-state=draft
      lc-object=IdsMVersionInfoApi, lc-state=draft
      lc-object=IpduMContainedRxPdu/IpduMContainedPduOffset, lc-state=draft
      lc-object=IpduMContainedRxPdu/IpduMPduUpdateBitPosition, lc-state=draft
      lc-object=IpduMContainedTxPdu/IpduMContainedPduOffset, lc-state=draft
      lc-object=IpduMContainedTxPdu/IpduMPduUpdateBitPosition, lc-state=draft
      lc-object=IpduMContainerHeaderSize/IPDUM_HEADERTYPE_NONE, lc-state=draft
      lc-object=IpduMContainerHeaderSize/IPDUM_HEADERTYPE_NONE, lc-state=draft
      lc-object=IpduMUnusedAreasDefault, lc-state=draft
      lc-object=J1939Fscp, lc-state=draft
      lc-object=J1939FscpConfigSet, lc-state=draft
      lc-object=J1939FscpRxChannel, lc-state=draft
      lc-object=J1939FscpRxChannelComMNetworkHandleRef, lc-state=draft
      lc-object=J1939FscpRxPg, lc-state=draft
      lc-object=J1939FscpRxInstances, lc-state=draft
      lc-object=J1939FscpRxSrvt, lc-state=draft
      lc-object=J1939FscpSdgRxPdu, lc-state=draft
      lc-object=J1939FscpSdgRxPduId, lc-state=draft
      lc-object=J1939FscpSdgRxPduRef, lc-state=draft
      lc-object=J1939FscpSdmRxPdu, lc-state=draft
      lc-object=J1939FscpSdmRxPduId, lc-state=draft
      lc-object=J1939FscpSdmRxPduRef, lc-state=draft
      lc-object=J1939FscpShmRxPdu, lc-state=draft
      lc-object=J1939FscpShmRxPduId, lc-state=draft
      lc-object=J1939FscpShmRxPduRef, lc-state=draft
      lc-object=J1939FscpTxChannel, lc-state=draft
      lc-object=J1939FscpShmTxPdu, lc-state=draft
      lc-object=J1939FscpShmTxPduId, lc-state=draft
      lc-object=J1939FscpShmTxPduRef, lc-state=draft
      lc-object=J1939FscpTxChannelComMNetworkHandleRef, lc-state=draft
      lc-object=J1939FscpTxPg, lc-state=draft
      lc-object=J1939FscpSdgTxPdu, lc-state=draft
      lc-object=J1939FscpSdgTxPduId, lc-state=draft
      lc-object=J1939FscpSdgTxPduRef, lc-state=draft
      lc-object=J1939FscpSdmTxPdu, lc-state=draft
      lc-object=J1939FscpSdmTxPduId, lc-state=draft
      lc-object=J1939FscpSdmTxPduRef, lc-state=draft
      lc-object=J1939FscpShmTxPriority, lc-state=draft
      lc-object=J1939FscpTxSrvt, lc-state=draft
      lc-object=J1939FscpGeneral, lc-state=draft
      lc-object=J1939FscpDevErrorDetect, lc-state=draft
      lc-object=J1939FscpMainFunctionPeriod, lc-state=draft
      lc-object=J1939FscpVersionInfoApi, lc-state=draft
      lc-object=KeyMEnableSecurityEventReporting, lc-state=draft
      lc-object=KeyMSecurityEventRefs, lc-state=draft
      lc-object=SEV_CERT_INTERMEDIATE_INST_REQ, lc-state=draft
      lc-object=SEV_CERT_INTERMEDIATE_UPD_REQ, lc-state=draft
      lc-object=SEV_CERT_ROOT_INST_REQ, lc-state=draft
      lc-object=SEV_CERT_ROOT_UPD_REQ, lc-state=draft
      lc-object=SEV_CERT_VERIF_FAILED, lc-state=draft
      lc-object=LSduR, lc-state=draft
      lc-object=LSduRBswModules, lc-state=draft
      lc-object=LSduRBswModuleRef, lc-state=draft
      lc-object=LSduRLowerModule, lc-state=draft
      lc-object=LSduRProvideTxBuffer, lc-state=draft
      lc-object=LSduRReleaseRxBuffer, lc-state=draft
      lc-object=LSduRRxIndication, lc-state=draft
      lc-object=LSduRTransmit, lc-state=draft
      lc-object=LSduRTxConfirmation, lc-state=draft
      lc-object=LSduRUpperModule, lc-state=draft
      lc-object=LSduRConfig, lc-state=draft
      lc-object=LSduRPath, lc-state=draft
      lc-object=LSduRPathDestinationPdu, lc-state=draft
      lc-object=LSduRPathDestinationPduId, lc-state=draft
      lc-object=LSduRPathDestinationPduRef, lc-state=draft
      lc-object=LSduRPathSourcePdu, lc-state=draft
      lc-object=LSduRPathSourcePduId, lc-state=draft
      lc-object=LSduRPathSourcePduRef, lc-state=draft
      lc-object=LSduRGeneral, lc-state=draft
      lc-object=LSduRDevErrorDetect, lc-state=draft
      lc-object=LSduRMetaDataSupport, lc-state=draft
      lc-object=LSduRVersionInfoApi, lc-state=draft
      lc-object=LSduRZeroCostOperation, lc-state=draft
      lc-object=LdComUserModule, lc-state=draft
      lc-object=LdComUserModuleCnfRef, lc-state=draft
      lc-object=Mka, lc-state=draft
      lc-object=MkaCryptoAlgoConfig, lc-state=draft
      lc-object=MkaMacSecCipherSuite, lc-state=draft
      lc-object=GCM_AES_128, lc-state=draft
      lc-object=GCM_AES_256, lc-state=draft
      lc-object=GCM_AES_XPN_128, lc-state=draft
      lc-object=GCM_AES_XPN_256, lc-state=draft
      lc-object=MkaMacSecCipherSuitePrio, lc-state=draft
      lc-object=MkaCryptoAlgoConfigIdx, lc-state=draft
      lc-object=MkaMacSecCapability, lc-state=draft
      lc-object=INTEGRITY_AND_CONFIDENTIALITY, lc-state=draft
      lc-object=INTEGRITY_WITHOUT_CONFIDENTIALITY, lc-state=draft
      lc-object=MkaMacSecConfidentialityOffset, lc-state=draft
      lc-object=CONFIDENTIALITY_OFFSET_0, lc-state=draft
      lc-object=CONFIDENTIALITY_OFFSET_30, lc-state=draft
      lc-object=CONFIDENTIALITY_OFFSET_50, lc-state=draft
      lc-object=MkaMacSecReplayProtection, lc-state=draft
      lc-object=MkaMacSecReplayProtectionWindow, lc-state=draft
      lc-object=MkaGeneral, lc-state=draft
      lc-object=MkaDevErrorDetect, lc-state=draft
      lc-object=MkaEnableSecurityEventReporting, lc-state=draft
      lc-object=MkaHelloTime, lc-state=draft
      lc-object=MkaLifeTime, lc-state=draft
      lc-object=MkaMainFunctionPeriod, lc-state=draft
      lc-object=MkaSakRetireTime, lc-state=draft
      lc-object=MkaSecurityEventRefs, lc-state=draft
      lc-object=SEV_MKA_AUTHENTICATION_FAILURE, lc-state=draft
      lc-object=SEV_MKA_CIPHER_SUITE_NOT_SUPPORTED, lc-state=draft
      lc-object=SEV_MKA_PORT_NOT_ENABLED, lc-state=draft
      lc-object=SEV_MKA_PORT_NUMBER_CHANGE, lc-state=draft
      lc-object=SEV_MKA_TIMEOUT, lc-state=draft
      lc-object=MkaVersionInfoApi, lc-state=draft
      lc-object=MkaPaeConfiguration, lc-state=draft
      lc-object=MkaAutoStart, lc-state=draft
      lc-object=MkaPaeConfigurationIdx, lc-state=draft
      lc-object=MkaRetryBaseDelay, lc-state=draft
      lc-object=MkaRetryCyclicDelay, lc-state=draft
      lc-object=MkaSakRekeyTimeSpan, lc-state=draft
      lc-object=MkaPaeInstance, lc-state=draft
      lc-object=MkaEthIfControllerRef, lc-state=draft
      lc-object=MkaKay, lc-state=draft
      lc-object=MkaBypassEtherType, lc-state=draft
      lc-object=MkaBypassVlan, lc-state=draft
      lc-object=MkaDstMacAddress, lc-state=draft
      lc-object=MkaKayDemEventParameterRefs, lc-state=draft
      lc-object=MKA_E_ALGO_MISMATCH_INSTANCE, lc-state=draft
      lc-object=MKA_E_KEY_MISMATCH_INSTANCE, lc-state=draft
      lc-object=MKA_E_KEY_NOT_PRESENT_INSTANCE, lc-state=draft
      lc-object=MKA_E_TIMEOUT_INSTANCE, lc-state=draft
      lc-object=MkaKayParticipant, lc-state=draft
      lc-object=MkaCryptoAlgoRef, lc-state=draft
      lc-object=MkaCryptoCknCakKeyRef, lc-state=draft
      lc-object=MkaCryptoHashKey128DerivationJobRef, lc-state=draft
      lc-object=MkaCryptoHashKey256DerivationJobRef, lc-state=draft
      lc-object=MkaCryptoIckDeriveJobRef, lc-state=draft
      lc-object=MkaCryptoIcvGenerateJobRef, lc-state=draft
      lc-object=MkaCryptoIcvVerifyJobRef, lc-state=draft
      lc-object=MkaCryptoKekDeriveJobRef, lc-state=draft
      lc-object=MkaCryptoKeyUnwrapJobRef, lc-state=draft
      lc-object=MkaCryptoKeyWrapJobRef, lc-state=draft
      lc-object=MkaCryptoRandomJobRef, lc-state=draft
      lc-object=MkaCryptoSakKeyRef, lc-state=draft
      lc-object=MkaParticipantActivate, lc-state=draft
      lc-object=MkaKeyServerPriority, lc-state=draft
      lc-object=MkaRole, lc-state=draft
      lc-object=MKA_KEY_SERVER, lc-state=draft
      lc-object=MKA_PEER, lc-state=draft
      lc-object=MkaSrcMacAddress, lc-state=draft
      lc-object=MkaOnFailPermissiveMode, lc-state=draft
      lc-object=MKA_PERMISSIVE_MODE_NEVER, lc-state=draft
      lc-object=MKA_PERMISSIVE_MODE_TIMEOUT, lc-state=draft
      lc-object=MkaOnFailPermissiveModeTimeout, lc-state=draft
      lc-object=MkaPaeConfRef, lc-state=draft
      lc-object=MkaPaeIdx, lc-state=draft
      lc-object=MkaPaeRxPdu, lc-state=draft
      lc-object=MkaPaeRxPduId, lc-state=draft
      lc-object=MkaPaeRxPduRef, lc-state=draft
      lc-object=MkaPaeTxPdu, lc-state=draft
      lc-object=MkaPaeTxPduId, lc-state=draft
      lc-object=MkaPaeTxPduRef, lc-state=draft
      lc-object=MkaSwitchPortRef, lc-state=draft
      lc-object=NmDynamicPncToChannelMappingEnabled, lc-state=draft
      lc-object=NmDynamicPncToChannelMappingSupport, lc-state=draft
      lc-object=NvMBlockCiphering, lc-state=draft
      lc-object=NvMCsmDecryptionJobReference, lc-state=draft
      lc-object=NvMCsmEncryptionJobReference, lc-state=draft
      lc-object=NvMNvBlockNVRAMDataLength, lc-state=draft
      lc-object=NvMBlockCipheringRef, lc-state=draft
      lc-object=NvMBlockUseCompression, lc-state=draft
      lc-object=NvMBufferAlignmentValue, lc-state=draft
      lc-object=NvMCsmRetryCounter, lc-state=draft
      lc-object=PduRReleaseRxBuffer, lc-state=draft
      lc-object=RteComUser, lc-state=draft
      lc-object=RteComUserEcucPartitionRef, lc-state=draft
      lc-object=RteLdComUser, lc-state=draft
      lc-object=RteLdComUserEcucPartitionRef, lc-state=draft
      lc-object=SdAclCheckBlockDescriptorRef, lc-state=draft
      lc-object=SdBlocklistedVersions, lc-state=draft
      lc-object=SdBlocklistedMinorVersions, lc-state=draft
      lc-object=SdClientServiceAllowedProvider, lc-state=draft
      lc-object=SdClientServiceAllowedProvider/SdIpAddress, lc-state=draft
      lc-object=SdClientServiceAllowedProvider/SdIpAddressType, lc-state=draft
      lc-object=SdIpAddressType/SD_AF_INET, lc-state=draft
      lc-object=SdIpAddressType/SD_AF_INET6, lc-state=draft
      lc-object=SdVersionDrivenFindBehavior, lc-state=draft
      lc-object=SdServerServiceAllowedConsumers, lc-state=draft
      lc-object=SdServerServiceAllowedConsumers/SdIpAddress, lc-state=draft
      lc-object=SdServerServiceAllowedConsumers/SdIpAddressType, lc-state=draft
      lc-object=SdIpAddressType/SD_AF_INET, lc-state=draft
      lc-object=SdIpAddressType/SD_AF_INET6, lc-state=draft
      lc-object=SdEnableAclPolicyCheck, lc-state=draft
      lc-object=SEV_SOME_IP_ACL_CHECK_FAILED_EVENT_SUBSCRIPTION, lc-state=draft
      lc-object=SEV_SOME_IP_ACL_CHECK_FAILED_METHOD_REQUEST, lc-state=draft
      lc-object=SEV_SOME_IP_ACL_CHECK_FAILED_OFFER, lc-state=draft
      lc-object=SEV_SOME_IP_SD_DUPLICATE_OFFER, lc-state=draft
      lc-object=SecOCEnableSecurityEventReporting, lc-state=draft
      lc-object=SecOCSecurityEventRefs, lc-state=draft
      lc-object=SEV_SECOC_FRESHNESS_NOT_AVAILABLE, lc-state=draft
      lc-object=SEV_SECOC_MAC_VERIFICATION_FAILED, lc-state=draft
      lc-object=SoAdSocketIpAddrAssignmentChgNotifUpperLayerRef, lc-state=draft
      lc-object=SoAdEnableSecurityEventReporting, lc-state=draft
      lc-object=SoAdSecurityEventRefs, lc-state=draft
      lc-object=SEV_DROP_MSG_RX_UDP_LENGTH, lc-state=draft
      lc-object=SEV_DROP_MSG_RX_UDP_SOCKET, lc-state=draft
      lc-object=SEV_DROP_PDU_RX_TCP, lc-state=draft
      lc-object=SEV_DROP_PDU_RX_UDP, lc-state=draft
      lc-object=SEV_REJECTED_TCP_CONNECTION, lc-state=draft
      lc-object=StbMDisciplinedClock, lc-state=draft
      lc-object=StbMDisciplinedClockHardwareRef, lc-state=draft
      lc-object=StbMFallbackTimeClock, lc-state=draft
      lc-object=StbMFallbackTimeClockFrequency, lc-state=draft
      lc-object=StbMFallbackTimeClockPrescaler, lc-state=draft
      lc-object=StbMFallbackTimeHardware, lc-state=draft
      lc-object=StbMMaxProgressionMismatchThreshold, lc-state=draft
      lc-object=StbMSynchronizedTimeBaseType, lc-state=draft
      lc-object=TBTYPE_PURELOCAL, lc-state=draft
      lc-object=TBTYPE_SYNCHRONIZED, lc-state=draft
      lc-object=StbMRateSource, lc-state=draft
      lc-object=RteRipsPluginProps/RteRipsPluginCommunicationTypeSupport, lc-state=draft
      lc-object=RteRipsPluginCommunicationTypeSupport/RteRipsPluginCommunicationType, lc-state=draft
      lc-object=RteRipsPluginCommunicationType/INTER_ECU, lc-state=draft
      lc-object=RteRipsPluginCommunicationType/INTER_PARTITION, lc-state=draft
      lc-object=RteRipsPluginCommunicationType/INTRA_PARTITION, lc-state=draft
      lc-object=TcpIpCtrlRxPdu, lc-state=draft
      lc-object=TcpIpCtrlRxPduId, lc-state=draft
      lc-object=TcpIpCtrlRxPduRef, lc-state=draft
      lc-object=TcpIpCtrlTxPdu, lc-state=draft
      lc-object=TcpIpCtrlTxPduId, lc-state=draft
      lc-object=TcpIpCtrlTxPduRef, lc-state=draft
      lc-object=TcpIpTcpSackEnabled, lc-state=draft
      lc-object=TcpIpTcpWindowScale, lc-state=draft
      lc-object=TcpIpTcpWindowScaleOptionEnabled, lc-state=draft
      lc-object=TcpIpTlsTrustedCAList, lc-state=draft
      lc-object=TcpIpTlsTrustedCAListEntry, lc-state=draft
      lc-object=TcpIpTlsRootCertUpdateCalloutFunction, lc-state=draft
      lc-object=TcpIpTlsRootCertUpdateCalloutHeaderFile, lc-state=draft
      lc-object=TcpIpTlsUseExtensionCertificateStatusRequest, lc-state=draft
      lc-object=TcpIpTlsUseExtensionMaxFragmentLength, lc-state=draft
      lc-object=TcpIpTlsUseExtensionTrustedCAKeys, lc-state=draft
      lc-object=TcpIpEnableSecurityEventReporting, lc-state=draft
      lc-object=TcpIpSecurityEventRefs, lc-state=draft
      lc-object=SEV_ARP_IP_ADDR_CONFLICT, lc-state=draft
      lc-object=SEV_IPV4_DROP_INV_ADDR, lc-state=draft
      lc-object=SEV_IPV6_DROP_INV_ADDR, lc-state=draft
      lc-object=SEV_TCP_DROP_INV_PORT, lc-state=draft
      lc-object=SEV_TLS_CONNECTION_CLOSED, lc-state=draft
      lc-object=SEV_TLS_CONNECTION_ESTABLISHED, lc-state=draft
      lc-object=SEV_TLS_ERROR, lc-state=draft
      lc-object=SEV_UDP_DROP_INV_PORT, lc-state=draft
      lc-object=UdpNmDynamicPncToChannelMappingEnabled, lc-state=draft
      lc-object=UdpNmDynamicPncToChannelMappingSupport, lc-state=draft
      lc-object=V2xGnConfig, lc-state=draft
      lc-object=V2xGnRxPdu, lc-state=draft
      lc-object=V2xGnRxPduId, lc-state=draft
      lc-object=V2xGnRxPduRef, lc-state=draft
      lc-object=V2xGnTxPdu, lc-state=draft
      lc-object=V2xGnTxPduId, lc-state=draft
      lc-object=V2xGnTxPduRef, lc-state=draft
      lc-object=WEthCtrEgressHardwareSupportedDataTransferThreshold, lc-state=draft
      lc-object=WEthCtrlEnableEgressHardwareSupportedDataTransfer, lc-state=draft
      lc-object=WdgMCrossClusterTransition, lc-state=draft
      lc-object=WdgMCrossClusterTransitionDestRef, lc-state=draft
      lc-object=WdgMCrossClusterTransitionSourceRef, lc-state=draft
      lc-object=WdgMTransitionProxy, lc-state=draft
      lc-object=WdgMTransitionProxy/WdgMResourceRef, lc-state=draft
      lc-object=WdgMMainFunctionModeProps, lc-state=draft
      lc-object=WdgMMainFunctionModePropsMainFunctionRef, lc-state=draft
      lc-object=WdgMMainFunctionModePropsTimePeriod, lc-state=draft
      lc-object=WdgMBaseSocket, lc-state=draft
      lc-object=WdgMBaseSocket/WdgMResourceRef, lc-state=draft
      lc-object=WdgMSocketEcucPartitionRef, lc-state=draft
      lc-object=WdgMMainFunction, lc-state=draft
      lc-object=WdgMMainFunctionPartitionRef, lc-state=draft
      lc-object=WdgMMainFunctionRef, lc-state=draft
      lc-object=WdgMSwClusterSupport, lc-state=draft
      lc-object=DISABLE_SW_CLUSTER_SUPPORT, lc-state=draft
      lc-object=ENABLE_SW_CLUSTER_SUPPORT, lc-state=draft
