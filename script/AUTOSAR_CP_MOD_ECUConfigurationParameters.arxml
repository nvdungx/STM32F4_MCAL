[part 7 of 14: package /AUTOSAR/EcucDefs]
AUTOSAR XML (schema 00053)
package /AUTOSAR/EcucDefs  (continued)
  module definition EthSwt [0..*]: post-build-variant-support=true, variants link-time/post-build/pre-compile  # Configuration of the EthSwt (Ethernet Switch Driver) module.
    container EthSwtConfig [1..*]: multiplicity set at link in variant link-time / post-build in variant post-build / pre-compile in variant pre-compile, post-build-variant-multiplicity=true  # Configuration of one Ethernet Switch.
      float EthSwtArlTableEntryTimeout [0..1]: 1..65535, multiplicity set at pre-compile, set at pre-compile, default-value=300  # If present, this parameter specifies the timeout in seconds for removing unused entries from the ARL table of the Ethernet switch. If the parameter is not configured, entries are not removed automatically.
      boolean EthSwtClockSynchronizationSupport: post-build-variant-value=true, set at link in variant link-time / post-build in variant post-build / pre-compile in variant pre-compile, default-value=false  # This parameter defines, if a Ethernet switch shall enable clock synchronization with another Ethernet switch to which it is connected via uplink port. | If this parameter is set to TRUE the clock synchronization between connected Ethernet switches is activated and the clocks of the Ethernet switches are synchronized. If this parameter is set to FALSE the clock synchronization between connected Ethernet switches is deactivated. This parameter shall only be set to TRUE if the Ethernet switch hardware supports clock synchronization.
      boolean EthSwtDropDoubleTagged: post-build-variant-value=true, set at link in variant link-time / post-build in variant post-build / pre-compile in variant pre-compile, default-value=false  # This parameter defines if a switch shall drop double tagged (Q in Q) frames. | If this parameter is set to TRUE double tagged frames are dropped at all ports. If this parameter is set to FALSE, then double tagged frames are forwarded. If double tagging is used as a feature, this parameter must be set to FALSE. This parameter shall only be set to TRUE when Switch-HW supports the filtering of double tagged frames as filtering by SW is NOT possible!
      integer EthSwtIdx: 0..255, scope=ECU, set at pre-compile, symbolic-name-value=true, with-auto=true  # Specifies the instance ID of the configured Ethernet Switch.
      enumeration EthSwtMacAddressLearningMode: {IVL, SVL}, set at pre-compile, default-value=SVL  # Defines the MAC address learning mode specified by [7, IEEE802.1Q] either shared VLAN learning (SVL) or independent VLAN learning (IVL).
      integer EthSwtUsedInternalPriorityUpperValue: 0..4294967295, set at pre-compile, default-value=7  # Configure the upper value of the used internal priority range in the Ethernet switch. Tags: atp.Status=draft | The range of used internal priority values is defined from 0 to EthSwtUsedInternalPriorityUpperValue, where zero is the lowest and EthSwtUsedInternalPriorityUpperValue the highest internal priority value. Each priority is mapped to at least one traffic class.
      integer EthSwtUsedTrafficClassUpperValue: 0..65535, set at pre-compile, default-value=7  # Configure the upper value of the used traffic class range in the Ethernet switch. Tags: atp.Status=draft | The range of used traffic classes is defined from 0 to EthSwtUsedTrafficClassUpperValue. A traffic class is associated with exactly one egress queue at an egress port.
      reference EthSwtConfigEcucPartitionRef [0..1]: scope=ECU, multiplicity set at pre-compile, post-build-variant-multiplicity=true, post-build-variant-value=true, set at pre-compile, destination=EcucPartition  # Maps the configuration of one single Ethernet switch to zero or one ECUC partitions. The ECUC partition referenced is a subset of the ECUC partitions where the Ethernet switch driver is mapped to.
      reference EthSwtManagementEthCtrlRef [0..1]: multiplicity set at pre-compile, set at pre-compile, requires-symbolic-name-value=true, destination=EthCtrlConfig  # Reference to the Ethernet controller connected to the management port where the management frames will be transmitted/received.
      reference EthSwtManagementPortRef [0..1]: multiplicity set at pre-compile, set at pre-compile, destination=EthSwtPort  # Reference to the port where the management CPU is connected to.
      container EthSwtAtsGroupInstanceTable [0..1]: multiplicity set at link in variant link-time / post-build in variant post-build / pre-compile in variant pre-compile, post-build-variant-multiplicity=true  # Collection of AtsGroupInstanceEntrys. Tags: atp.Status=draft
        container EthSwtAtsGroupInstanceEntry [0..*]: multiplicity set at link in variant link-time / post-build in variant post-build / pre-compile in variant pre-compile, post-build-variant-multiplicity=true  # AtsGroupInstanceEntry. Tags: atp.Status=draft
          float EthSwtAtsGroupMaximumResidenceTime: 0..INF, post-build-variant-value=true, set at link in variant link-time / post-build in variant post-build / pre-compile in variant pre-compile  # The parameter defines the maximum duration limit for which frames can reside in a bridge in seconds. Tags: atp.Status=draft
      container EthSwtDemEventParameterRefs [0..1]: multiplicity set at pre-compile, post-build-variant-multiplicity=true  # Container for the references to DemEventParameter elements which shall be invoked using the API Dem_SetEventStatus in case the corresponding error occurs. The EventId is taken from the referenced DemEventParameter's DemEventId symbolic value. The standardized errors are provided in this container and can be extended by vendor-specific error references.
        reference ETHSWT_E_ACCESS [0..1]: multiplicity set at link in variant link-time / post-build in variant post-build / pre-compile in variant pre-compile, post-build-variant-multiplicity=true, post-build-variant-value=true, set at link in variant link-time / post-build in variant post-build / pre-compile in variant pre-compile, requires-symbolic-name-value=true, destination=DemEventParameter  # Reference to the DemEventParameter which shall be issued when the error "Ethernet Switch Access Failure" has occurred.
        reference ETHSWT_E_SYNCPORT2PHY [0..1]: multiplicity set at link in variant link-time / post-build in variant post-build / pre-compile in variant pre-compile, post-build-variant-multiplicity=true, post-build-variant-value=true, set at link in variant link-time / post-build in variant post-build / pre-compile in variant pre-compile, requires-symbolic-name-value=true, destination=DemEventParameter  # Reference to the DemEventParameter which shall be issued when the error "Ethernet switch port and the referenced Ethernet transceiver are in contradicting modes" has occurred.
      container EthSwtMacForwardingTable [0..*]: multiplicity set at link in variant link-time / post-build in variant post-build / pre-compile in variant pre-compile, post-build-variant-multiplicity=true  # Represents a MAC forwarding table.
        string EthSwtPredefinedMacAddress: scope=ECU, post-build-variant-value=true, set at link in variant link-time / post-build in variant post-build / pre-compile in variant pre-compile, max-length=17, min-length=17, regular-expression=([0-9a-fA-F]\{2}:)\{5}[0-9a-fA-F]\{2}  # Specifies a 48-bit physical addresses (MAC addresses) network byte order, which can be reached via the referenced port and if available via the referenced VLAN . Note that further addresses can be learned during runtime.
        reference EthSwtMacForwardingTablePortRef [1..255]: scope=ECU, multiplicity set at link in variant link-time / post-build in variant post-build / pre-compile in variant pre-compile, post-build-variant-multiplicity=true, post-build-variant-value=true, set at link in variant link-time / post-build in variant post-build / pre-compile in variant pre-compile, destination=EthSwtPort  # References the ports the MAC shall be assigned to.
        reference EthSwtVlanMembershipRef [0..4095]: multiplicity set at link in variant link-time / post-build in variant post-build / pre-compile in variant pre-compile, post-build-variant-multiplicity=true, post-build-variant-value=true, set at link in variant link-time / post-build in variant post-build / pre-compile in variant pre-compile, destination=EthSwtVlanMembership  # References the VLAN-IDs the MAC address shall be assigned to. Please note, this reference is used if EthSwtMacAddressLearningMode is set to IVL (independent VLAN learning).
      container EthSwtNvm [0..1]: multiplicity set at pre-compile, post-build-variant-multiplicity=true  # Configuration of one Ethernet Switch Nvm usage in case the module requires non volatile memory in the Ecu to store switch configuration.
        reference EthSwtConfigurationNvmBlockDescriptorRef: set at pre-compile, requires-symbolic-name-value=true, destination=NvMBlockDescriptor  # Reference to the Nvm block description in the Nvm module configuration to store e.g. the port mirror configurations
        reference EthSwtTableNvmBlockDescriptorRef: scope=ECU, post-build-variant-value=true, set at pre-compile, requires-symbolic-name-value=true, destination=NvMBlockDescriptor  # Reference to the Nvm block description in the Nvm module configuration to store e.g. the learned ARL table
      container EthSwtPSCM [0..1]: multiplicity set at link in variant link-time / post-build in variant post-build / pre-compile in variant pre-compile, post-build-variant-multiplicity=true  # Per stream classification and metering. Tags: atp.Status=draft
        container EthSwtAtsInstanceTable [0..1]: multiplicity set at pre-compile  # EthSwtAtsInstanceTable Tags: atp.Status=draft
          container EthSwtAtsInstanceEntry [0..*]: multiplicity set at link in variant link-time / post-build in variant post-build / pre-compile in variant pre-compile, post-build-variant-multiplicity=true  # Configuration of an Asynchronous Traffic Scheduler configuration in the scope of the PSFP. Tags: atp.Status=draft
            integer EthSwtPortATSCommitedBurstSize: 0..18446744073709551615, post-build-variant-value=true, set at link in variant link-time / post-build in variant post-build / pre-compile in variant pre-compile  # Maximum token capacity of the token bucket. Tags: atp.Status=draft
            integer EthSwtPortATSCommitedInformationRate: 0..18446744073709551615, post-build-variant-value=true, set at link in variant link-time / post-build in variant post-build / pre-compile in variant pre-compile  # Defines the rate at which the token bucket is refilled with tokens. Tags: atp.Status=draft
            reference EthSwtPortAtsSchedulerGroupRef: post-build-variant-value=true, set at link in variant link-time / post-build in variant post-build / pre-compile in variant pre-compile, destination=EthSwtAtsGroupInstanceEntry  # Defines to which ATS scheduler group this ATS scheduler belongs to. Tags: atp.Status=draft
        container EthSwtPSFP [0..1]: multiplicity set at pre-compile  # Configuration of Per-stream Filtering and Policing (PSFP). Tags: atp.Status=draft
          container EthSwtFilterMaxSduSizeTable [0..1]: multiplicity set at pre-compile  # EthSwtFilterMaxSduSizeTable represents a table of sdu size values, where each value (table entry) could be referenced by a EthSwtStreamFilterEntry. Tags: atp.Status=draft
            container EthSwtFilterMaxSduSizeEntry [1..*]: multiplicity set at link in variant link-time / post-build in variant post-build / pre-compile in variant pre-compile, post-build-variant-multiplicity=true  # EthSwtFilterMaxSduSizeEntry defines the maximum SDU size (size of an Ethernet packet) which is acceptable to be processed by the Ethernet switch. Tags: atp.Status=draft | The value of EthSwtFilterMaxSduSizeEntry consider the size of the following parts of an Ethernet packet: * Preamble (7 byte) * SFD (start of frame delimiter) (1 byte) * Ethernet frame (Dst MAC,Src MAC, VLAN-tag, TypeField, Payload, CRC Checksum) * Minimum IPG (inter package gap) (12 byte times).
              integer EthSwtFilterMaxSduSize: 84..2020, post-build-variant-value=true, set at link in variant link-time / post-build in variant post-build / pre-compile in variant pre-compile  # Max Sdu size. Tags: atp.Status=draft
          container EthSwtFlowMeteringTable [0..1]: multiplicity set at pre-compile  # EthSwtFlowMeteringTable represents a table of flowmeter configurations, where each flowmeter configuration (table entry) could be referenced by a EthSwtStreamFilterEntry. Tags: atp.Status=draft
            container EthSwtFlowMeteringEntry [1..*]: multiplicity set at link in variant link-time / post-build in variant post-build / pre-compile in variant pre-compile, post-build-variant-multiplicity=true  # Configuration of a flow metering. Tags: atp.Status=draft
              boolean EthSwtFlowMeterCF: post-build-variant-value=true, set at link in variant link-time / post-build in variant post-build / pre-compile in variant pre-compile  # Coupling Flag that defines if unused "green" tokens in the first bucket are transferred to the second bucket as "yellow" tokens. Tags: atp.Status=draft | Note: this parameter maps to IEEE802.1Q parameter "ieee8021PSFPFlowMeterCF".
              integer EthSwtFlowMeteringCBS: 0..255, post-build-variant-value=true, set at link in variant link-time / post-build in variant post-build / pre-compile in variant pre-compile  # Committed Burst Size (accepted burst size in green token bucket). Tags: atp.Status=draft | Note: this parameter maps to IEEE802.1Q parameter "ieee8021PSFPFlowMeterCBS".
              integer EthSwtFlowMeteringCIR: 0..4294967295, post-build-variant-value=true, set at link in variant link-time / post-build in variant post-build / pre-compile in variant pre-compile  # Committed Information Rate (accepted rate in green token bucket) in bits per second. Tags: atp.Status=draft | Note: this parameter maps to IEEE802.1Q parameter "ieee8021PSFPFlowMeterCIR".
              enumeration EthSwtFlowMeteringColorMode: post-build-variant-value=true, set at link in variant link-time / post-build in variant post-build / pre-compile in variant pre-compile  # Parameter that defines if color-aware or color-blind mode is used. The mode indicates if a color that might be assigned at ingress is used to chose the bucket from which to take tokens; only green and yellow can be assigned; basically, in color-blind mode, all frames are treated like green frames. Tags: atp.Status=draft | Note: this parameter maps to IEEE802.1Q parameter "ieee8021PSFPFlowMeterCM".
                ETHSWT_COLOR_AWARE  # Tags: atp.Status=draft
                ETHSWT_COLOR_BLIND  # Tags: atp.Status=draft
              integer EthSwtFlowMeteringEBS: 0..255, post-build-variant-value=true, set at link in variant link-time / post-build in variant post-build / pre-compile in variant pre-compile  # Excess burst size (accepted burst size in yellow token bucket). Tags: atp.Status=draft | Note: this parameter maps to IEEE802.1Q parameter "ieee8021PSFPFlowMeterEBS".
              integer EthSwtFlowMeteringEIR: 0..4294967295, post-build-variant-value=true, set at link in variant link-time / post-build in variant post-build / pre-compile in variant pre-compile  # Excess Information Rate (accepted rate in yellow token bucket) in bits per second. Tags: atp.Status=draft | Note: this parameter maps to IEEE802.1Q parameter "ieee8021PSFPFlowMeterEIR".
          container EthSwtStreamFilterTable [0..1]: multiplicity set at pre-compile  # EthSwtStreamFilterTable represents a table of stream filter configurations, where each stream filter configuration (table entry) could reference a EthSwtFilterMaxSduSizeEntry, EthSwtFlowMeteringEntry and EthSwtStreamGateEntry. Tags: atp.Status=draft
            container EthSwtStreamFilterEntry [1..*]: multiplicity set at link in variant link-time / post-build in variant post-build / pre-compile in variant pre-compile, post-build-variant-multiplicity=true  # This container represents a stream filter, where EthSwtStreamFilterPriority and EthSwtAssignedStreamHandle are used to detect a matching Ethernet frame. Tags: atp.Status=draft
              integer EthSwtStreamFilterEntryPosition: 0..65535, scope=ECU, post-build-variant-value=true, set at link in variant link-time / post-build in variant post-build / pre-compile in variant pre-compile  # Specifies the position as unique ID within an ordered list of EthSwtStreamFilterEntrys. The ordered list shall start with 0 and continue as linear list with no gaps. Tags: atp.Status=draft | Note: The list is processed in ascending order. The instance of EthSwtStreamFilterEntry with position 0 is processed first.
              integer EthSwtStreamFilterPriority: 0..7, post-build-variant-value=true, set at link in variant link-time / post-build in variant post-build / pre-compile in variant pre-compile  # This parameter represents an assigned priority of this stream filter, which is used to detect a matching Ethernet frame. Tags: atp.Status=draft
              reference EthSwtAtsInstanceEntryRef [0..1]: multiplicity set at link in variant link-time / post-build in variant post-build / pre-compile in variant pre-compile, post-build-variant-multiplicity=true, post-build-variant-value=true, set at link in variant link-time / post-build in variant post-build / pre-compile in variant pre-compile, destination=EthSwtAtsInstanceEntry  # Reference to an entry of an ATS table, where the entry represents a configuration for asynchronous traffic shaping. Tags: atp.Status=draft
              reference EthSwtFilterMaxSduSizeRef [0..1]: multiplicity set at link in variant link-time / post-build in variant post-build / pre-compile in variant pre-compile, post-build-variant-multiplicity=true, post-build-variant-value=true, set at link in variant link-time / post-build in variant post-build / pre-compile in variant pre-compile, destination=EthSwtFilterMaxSduSizeEntry  # Reference to an entry of a max-sdu-size table, where the entry represents a particular value. Tags: atp.Status=draft
              reference EthSwtFlowMeteringEntryRef [0..1]: multiplicity set at link in variant link-time / post-build in variant post-build / pre-compile in variant pre-compile, post-build-variant-multiplicity=true, post-build-variant-value=true, set at link in variant link-time / post-build in variant post-build / pre-compile in variant pre-compile, destination=EthSwtFlowMeteringEntry  # Reference to an entry of a flow metering table, where the entry represents a configuration for flow metering. Tags: atp.Status=draft
              reference EthSwtStreamGateEntryRef [0..1]: multiplicity set at pre-compile, post-build-variant-value=true, set at link in variant link-time / post-build in variant post-build / pre-compile in variant pre-compile, destination=EthSwtStreamGateEntry  # Reference to an entry of a gate table, where the entry represents a configuration for a gate. Tags: atp.Status=draft
              container EthSwtAssignedStreamHandle  # This container represents an assigned stream handle id of this stream filter, which is used to detect a matching Ethernet frame. The EthSwtAssignedStreamHandle could represent a list of assigned stream handle ids. Tags: atp.Status=draft | Additionally it could set a wildcard flag (EthSwtStreamHandleIdWildcard), where any assigned stream handle id carried by an Ethernet frame would match to this stream filter.
                integer EthSwtStreamHandleId [0..*]: 0..65535, multiplicity set at link in variant link-time / post-build in variant post-build / pre-compile in variant pre-compile, post-build-variant-multiplicity=true, post-build-variant-value=true, set at link in variant link-time / post-build in variant post-build / pre-compile in variant pre-compile  # Assigned stream handle id of this stream filter, which is used for evaluation of a matching Ethernet frame. Tags: atp.Status=draft
                boolean EthSwtStreamHandleIdWildcard: post-build-variant-value=true, set at link in variant link-time / post-build in variant post-build / pre-compile in variant pre-compile  # Defines whether this EthSwtAssignedStreamHandle includes the wildcard. Tags: atp.Status=draft
          container EthSwtStreamGateTable [0..1]: multiplicity set at pre-compile  # EthSwtStreamGateTable represents a table of stream gate configurations, where each stream gate configuration (table entry) could be referenced by a EthSwtStreamFilterEntry. Tags: atp.Status=draft
            container EthSwtStreamGateEntry [1..*]: multiplicity set at link in variant link-time / post-build in variant post-build / pre-compile in variant pre-compile, post-build-variant-multiplicity=true  # Configuration of a stream gate. Tags: atp.Status=draft
              integer EthSwtStreamGateIPV: 0..4294967295, post-build-variant-value=true, set at link in variant link-time / post-build in variant post-build / pre-compile in variant pre-compile  # Internal Priority Value (IPV), a priority value that determines the assigned traffic class. Tags: atp.Status=draft | Note: The upper value is limited by the configured used internal priority value of the this Ethernet switch (EthSwtUsedInternalPriorityUpperValue). The remaining value range shall be ignored.
      container EthSwtPort [1..*]: multiplicity set at link in variant link-time / post-build in variant post-build / pre-compile in variant pre-compile, post-build-variant-multiplicity=true  # Configuration of one Ethernet Switch Port.
        boolean EthSwtFramePreemptionEnable: post-build-variant-value=true, set at link in variant link-time / post-build in variant post-build / pre-compile in variant pre-compile, default-value=false  # Configures whether frame preemption for this EthSwtPort is enabled. Tags: atp.Status=draft | If the Ethernet switch hardware supports frame preemption and this parameter is set TRUE, then frame preemption for the corresponding EthSwtPort is enabled. If for some traffic class(es) EthSwtTrafficClassToPreemptionStatusAssignment at the egress port queue is additionally configured to ETHSWT_TRAFFIC_CLASS_PREEMPTABLE, then frame preemption for the respective traffic class(es) at the correponding EthSwtEgressPort is possible.
        integer EthSwtPortIdx: 0..255, scope=ECU, set at pre-compile, symbolic-name-value=true, with-auto=true  # Specifies the instance ID of the configured Ethernet Switch Port.
        integer EthSwtPortInterPacketGap [0..1]: 0..10000, multiplicity set at link in variant link-time+post-build / pre-compile in variant pre-compile, set at link in variant link-time+post-build / pre-compile in variant pre-compile, default-value=12  # This parameter defines the transmit Inter-Packet Gap (IPG) (also called interframe gap (IFG)) between transmitted Ethernet packets in "byte times". This parameter can only exist if the hardware and driver support setting the IPG.
        enumeration EthSwtPortMacLayerSpeed [0..1]: {ETH_MAC_LAYER_SPEED_100M, ETH_MAC_LAYER_SPEED_10G, ETH_MAC_LAYER_SPEED_10M, ETH_MAC_LAYER_SPEED_1G, ETH_MAC_LAYER_SPEED_2500M, ETH_MAC_LAYER_SPEED_5G}, scope=ECU, multiplicity set at link in variant link-time+post-build / pre-compile in variant pre-compile, post-build-variant-multiplicity=true, post-build-variant-value=true, set at link in variant link-time+post-build / pre-compile in variant pre-compile  # Defines the baud rate of the MAC layer.
        enumeration EthSwtPortMacLayerSubType [0..1]: {REDUCED, REVERSED, SERIAL, STANDARD, UNIVERSAL_SERIAL}, scope=ECU, multiplicity set at link in variant link-time+post-build / pre-compile in variant pre-compile, post-build-variant-multiplicity=true, post-build-variant-value=true, set at link in variant link-time+post-build / pre-compile in variant pre-compile  # Defines the MAC layer subtype of this EthSwtPort.
        enumeration EthSwtPortMacLayerType [0..1]: {ETHSWT_PORT_MAC_LAYER_TYPE_XGMII, ETHSWT_PORT_MAC_LAYER_TYPE_XMII, ETHSWT_PORT_MAC_LAYER_TYPE_XXGMII}, scope=ECU, multiplicity set at link in variant link-time+post-build / pre-compile in variant pre-compile, post-build-variant-multiplicity=true, post-build-variant-value=true, set at link in variant link-time+post-build / pre-compile in variant pre-compile  # Defines the MAC layer type of this EthSwtPort.
        enumeration EthSwtPortPhysicalLayerType [0..1]: {ETHSWT_PORT_10000BASE_T1, ETHSWT_PORT_1000BASE_T, ETHSWT_PORT_1000BASE_T1, ETHSWT_PORT_100BASE_T1, ETHSWT_PORT_100BASE_TX, ETHSWT_PORT_10BASE_T1S, ETHSWT_PORT_2500BASE_T1, ETHSWT_PORT_5000BASE_T1}, scope=ECU, multiplicity set at link in variant link-time+post-build / pre-compile in variant pre-compile, post-build-variant-multiplicity=true, post-build-variant-value=true, set at link in variant link-time+post-build / pre-compile in variant pre-compile  # Defines the physical layer type of this EthSwtPort.
        enumeration EthSwtPortRole [0..1]: {ETHSWT_HOST_PORT, ETHSWT_UP_LINK_PORT}, multiplicity set at link in variant link-time / post-build in variant post-build / pre-compile in variant pre-compile, post-build-variant-multiplicity=true, post-build-variant-value=true, set at link in variant link-time / post-build in variant post-build / pre-compile in variant pre-compile  # Set a special role of the Ethernet switch port. It is either a host port or a up link port. If not configured it is a standard port.
        boolean EthSwtPortTimeStampSupport: post-build-variant-value=true, set at link in variant link-time / post-build in variant post-build / pre-compile in variant pre-compile  # Enables/Disables the Switch-port specific timestamping.
        reference EthSwtPortTrcvRef [0..1]: scope=ECU, multiplicity set at link in variant link-time+post-build / pre-compile in variant pre-compile, post-build-variant-multiplicity=true, post-build-variant-value=true, set at link in variant link-time / post-build in variant post-build / pre-compile in variant pre-compile, requires-symbolic-name-value=true, destination=EthTrcvConfig  # Reference to the Ethernet transceiver driver this EthSwtPort is connected with.
        container EthSwtPortEgress  # Configuration of one Ethernet Switch Port Egress behavior.
          integer EthSwtPortDefaultTrafficClass: 0..65535, post-build-variant-value=true, set at link in variant link-time / post-build in variant post-build / pre-compile in variant pre-compile, default-value=1  # Represents the default traffic class assignment. All Ethernet frames, where the priority associated with this Ethernet frame is not available in a EthSwtPortTrafficClassAssignment of this egress port, are assigned to the default traffic class. Tags: atp.Status=draft
          reference EthSwtPortEgressLastSchedulerRef: post-build-variant-value=true, set at link in variant link-time / post-build in variant post-build / pre-compile in variant pre-compile, destination=EthSwtPortEgressScheduler  # Reference to the port scheduler which is the last in the egress port structure.
          container EthSwtPortEgressScheduler [1..*]: multiplicity set at link in variant link-time / post-build in variant post-build / pre-compile in variant pre-compile, post-build-variant-multiplicity=true  # Represents a Scheduler in the egress port.
            enumeration EthSwtPortSchedulerAlgorithm: {ETHSWT_SCHEDULER_ENHANCED_TRAFFIC_SHAPER, ETHSWT_SCHEDULER_STRICT_PRIORITY}, post-build-variant-value=true, set at link in variant link-time / post-build in variant post-build / pre-compile in variant pre-compile  # Defines the scheduler algorithm.
            container EthSwtPortEgressSchedulerPredecessor [1..*]: multiplicity set at link in variant link-time / post-build in variant post-build / pre-compile in variant pre-compile, post-build-variant-multiplicity=true  # Defines an ordered list of predecessors for this scheduler.
              integer EthSwtPortSchedulerPredecessorOrder: 0..18446744073709551615, scope=ECU, post-build-variant-value=true, set at link in variant link-time / post-build in variant post-build / pre-compile in variant pre-compile  # Defines the order of the scheduler predecessors. | This value has to be understood as a relative value, i.e. the value shows only the relative ordering of the elements. The highest value has the highest priority and gaps are allowed (not dense based). The values need to be unique within one EthSwtPortScheduler.
              choice reference EthSwtPortEgressPredecessorRef: post-build-variant-value=true, set at link in variant link-time / post-build in variant post-build / pre-compile in variant pre-compile, destination=[EthSwtPortEgressScheduler, EthSwtPortFifo, EthSwtPortQueue, EthSwtPortShaper]  # Choice reference to the scheduler predecessor.
          container EthSwtPortFifo [1..*]: multiplicity set at link in variant link-time / post-build in variant post-build / pre-compile in variant pre-compile, post-build-variant-multiplicity=true  # Represents a Fifo in the egress port. Tags: atp.Status=obsolete
            integer EthSwtPortEgressFifoIdx: 0..18446744073709551615, scope=ECU, post-build-variant-value=true, set at pre-compile  # Specifies the instance ID of the fifo of the configured Ethernet switch egress port Tags: atp.Status=obsolete
            integer EthSwtPortFifoMinimumLength [0..1]: 0..18446744073709551615, scope=ECU, multiplicity set at link in variant link-time / post-build in variant post-build / pre-compile in variant pre-compile, post-build-variant-multiplicity=true, post-build-variant-value=true, set at link in variant link-time / post-build in variant post-build / pre-compile in variant pre-compile  # FIFO minimum length in Byte. This assignment is used to configure a guaranteed size of a configured FIFO. Tags: atp.Status=obsolete
            integer EthSwtPortFifoTrafficClassAssignment [0..8]: 0..7, scope=ECU, post-build-variant-value=true, set at link in variant link-time / post-build in variant post-build / pre-compile in variant pre-compile  # Defines which traffic classes are assigned to this Fifo. Tags: atp.Status=obsolete
          container EthSwtPortPriorityToTrafficClassAssignment [1..65535]: multiplicity set at pre-compile  # Defines a priority based traffic class assignment. All Ethernet frames with a specific priority (EthSwtPortPriorityToTrafficClassAssignmentPriority) arriving at the egress side within the forwarding process, shall be assigned to the corresponding traffic class (EthSwtPortPriorityToTrafficClassAssignmentTrafficClass). Tags: atp.Status=draft
            integer EthSwtPortPriorityToTrafficClassAssignmentPriority: 0..4294967295, set at pre-compile  # Defines the priority derived from the Ethernet frame, which is used to determine the corresponding traffic class, where this Ethernet frame shall be assigned to. The upper value range is restricted to the configured value of EthSwtUsedInternalPriorityUpperValue. Tags: atp.Status=draft
            integer EthSwtPortPriorityToTrafficClassAssignmentTrafficClass: 0..65535, set at pre-compile  # Defines the traffic class value where an Ethernet frame, with the corresponding priority, is assigned to. The upper value range is restricted to the configured value of EthSwtUsedTrafficClassUpperValue. Tags: atp.Status=draft
          container EthSwtPortQueue [1..65535]: multiplicity set at link in variant link-time / post-build in variant post-build / pre-compile in variant pre-compile, post-build-variant-multiplicity=true  # Represents a Queue at the egress port. Tags: atp.Status=draft
            integer EthSwtPortEgressQueueIdx: 0..7, post-build-variant-value=true, set at link in variant link-time / post-build in variant post-build / pre-compile in variant pre-compile  # Specifies the instance ID of the queue of the configured Ethernet switch egress port. Tags: atp.Status=draft
            integer EthSwtPortQueueMinimumLength [0..1]: 0..18446744073709551615, multiplicity set at link in variant link-time / post-build in variant post-build / pre-compile in variant pre-compile, post-build-variant-multiplicity=true, post-build-variant-value=true, set at link in variant link-time / post-build in variant post-build / pre-compile in variant pre-compile  # Queue minimum length in Byte. This assignment is used to configure a guaranteed size Tags: atp.Status=draft | of a configured Queue.
            integer EthSwtPortQueueTrafficClassAssignment: 0..65535, post-build-variant-value=true, set at link in variant link-time / post-build in variant post-build / pre-compile in variant pre-compile  # Defines the traffic class where this egress port queue is assigned to. All Ethernet frames which arrive at the corresponding egress port are considered to be enqueued in this egress port queue, where the assigned traffic class of the Ethernet frame match to the assigned traffic class of this egress port queue. Tags: atp.Status=draft
            enumeration EthSwtTrafficClassToPreemptionStatusAssignment: post-build-variant-value=true, set at link in variant link-time / post-build in variant post-build / pre-compile in variant pre-compile, default-value=ETHSWT_TRAFFIC_CLASS_EXPRESS  # Defines the preemption status for the traffic class which is derived from the priority via EthSwtPortPriorityToTrafficClassAssignment. Tags: atp.Status=draft | If this parameter is set to ETHSWT_TRAFFIC_CLASS_PREEMPTABLE, then the Ethernet frames assigned to the corresponding traffic class could be preempted within the transmission process. If set to ETHSWT_TRAFFIC_CLASS_EXPRESS, then the Ethernet frames assigned to the corresponding traffic class will never be preempted.
              ETHSWT_TRAFFIC_CLASS_EXPRESS  # Tags: atp.Status=draft
              ETHSWT_TRAFFIC_CLASS_PREEMPTABLE  # Tags: atp.Status=draft
            container EthSwtPortEgressQueueTransmissionSelection  # Represents the transmission selection of an egress port queue. Tags: atp.Status=draft
              enumeration EthSwtPortEgressQueueTransmissionSelectionAlgorithm: post-build-variant-value=true, set at link in variant link-time / post-build in variant post-build / pre-compile in variant pre-compile, default-value=ETHSWT_TRANSMISSION_SELECTION_ALGORITHM_UNSHAPED  # Represents the transmission selection algorithm of an egress port queue. Tags: atp.Status=draft
                ETHSWT_TRANSMISSION_SELECTION_ALGORITHM_ATS  # Tags: atp.Status=draft
                ETHSWT_TRANSMISSION_SELECTION_ALGORITHM_CBS  # Tags: atp.Status=draft
                ETHSWT_TRANSMISSION_SELECTION_ALGORITHM_ETS  # Tags: atp.Status=draft
                ETHSWT_TRANSMISSION_SELECTION_ALGORITHM_UNSHAPED  # Tags: atp.Status=draft
              container EthSwtPortEgressQueueTransmissionSelectionCBSConfig [0..1]: multiplicity set at link in variant link-time / post-build in variant post-build / pre-compile in variant pre-compile, post-build-variant-multiplicity=true  # Represents the configuration of a credit based shaper transmission selection algorithm of an egress port queue. Tags: atp.Status=draft | This configuration is used if the EthSwtPortEgressQueueTransmissionSelectionAlgorithm is set to ETHSWT_TRANSMISSION_SELECTION_ALGORITHM_CBS.
                integer EthSwtPortEgressQueueCreditBasedShaperIdleSlope: 0..18446744073709551615, post-build-variant-value=true, set at link in variant link-time / post-build in variant post-build / pre-compile in variant pre-compile  # Defines the increase of credit in bits per second for the AVB shaper. Tags: atp.Status=draft | Note: this parameter maps to IEEE802.1Q parameter "ieee8021FqtssAdminIdleSlopeMs" and "ieee8021FqtssAdminIdleSlopeLs". Note: If the value exceeds the available bandwidth according the configured EthSwtPortPhysicalLayerType, the CBS becomes ineffective.
                integer EthSwtPortEgressQueueCreditBasedShaperLowerBoundary [0..1]: 0..18446744073709551615, multiplicity set at pre-compile, post-build-variant-value=true, set at link in variant link-time / post-build in variant post-build / pre-compile in variant pre-compile  # Defines the lower credit boundary for the Credit Based Shaper. Tags: atp.Status=draft
                integer EthSwtPortEgressQueueCreditBasedShaperUpperBoundary [0..1]: 0..18446744073709551615, multiplicity set at pre-compile, post-build-variant-value=true, set at link in variant link-time / post-build in variant post-build / pre-compile in variant pre-compile  # Defines the upper credit boundary for the Credit Based Shaper. Tags: atp.Status=draft
              container EthSwtPortEgressQueueTransmissionSelectionETSConfig [0..1]: multiplicity set at pre-compile  # Represents the configuration of an enhanced transmission selection algorithm of an egress port queue. This configuration is used if the EthSwtPortEgressQueueTransmissionSelectionAlgorithm is set to ETHSWT_SCHEDULER_ENHANCED_TRAFFIC_SHAPER. The subordinated configuration parameters allow to configure the ETS in different variants to support commonly used scheduler algorithms (e.g. weighted round robin). Tags: atp.Status=draft
                integer EthSwtETSConfigAvailableBandwidthInPercent [0..1]: 0..100, multiplicity set at pre-compile, set at pre-compile, default-value=30  # Represents the configuration of an enhanced transmission selection algorithm for one egress port queue, where the available bandwidth is configured in percent. The percent value represents the available bandwidth for emission opportunities to transmit Ethernet frames calculated in bits. Tags: atp.Status=draft | The resolution is 1%.
                integer EthSwtETSConfigAvailableBandwidthInWeightValue [0..1]: 1..255, multiplicity set at pre-compile, set at pre-compile, default-value=1  # Represents the configuration of an enhanced transmission selection algorithm of an egress port queue, where the available bandwidth is configured as weight value. The weight value represents the number of emission opportunities to transmit Ethernet frames. Tags: atp.Status=draft
          container EthSwtPortShaper [0..*]: multiplicity set at link in variant link-time / post-build in variant post-build / pre-compile in variant pre-compile, post-build-variant-multiplicity=true  # Represents a Shaper in the egress port. Tags: atp.Status=obsolete
            integer EthSwtPortShaperIdleSlope [0..1]: 0..18446744073709551615, post-build-variant-value=true, set at link in variant link-time / post-build in variant post-build / pre-compile in variant pre-compile  # Defines the increase of credit in bits per second for the AVB shaper. Tags: atp.Status=obsolete
            reference EthSwtPortEgressPredecessorFifoRef: post-build-variant-value=true, set at link in variant link-time / post-build in variant post-build / pre-compile in variant pre-compile, destination=EthSwtPortFifo  # Reference to the fifo which is the predecessor for this shaper. Tags: atp.Status=obsolete
        container EthSwtPortIngress  # Configuration of one Ethernet Switch Port ingress behavior.
          integer EthSwtPortIngressDefaultPriority [0..1]: 0..7, multiplicity set at link in variant link-time / post-build in variant post-build / pre-compile in variant pre-compile, post-build-variant-multiplicity=true, post-build-variant-value=true, set at link in variant link-time / post-build in variant post-build / pre-compile in variant pre-compile, default-value=0  # Default priority for ingress.
          integer EthSwtPortIngressDefaultVlan [0..1]: 0..4094, multiplicity set at link in variant link-time / post-build in variant post-build / pre-compile in variant pre-compile, post-build-variant-multiplicity=true, post-build-variant-value=true, set at link in variant link-time / post-build in variant post-build / pre-compile in variant pre-compile, default-value=1  # Default VLAN for ingress.
          boolean EthSwtPortIngressDropUntagged: post-build-variant-value=true, set at link in variant link-time / post-build in variant post-build / pre-compile in variant pre-compile, default-value=false  # Defines the ingress behavior for untagged frames.
          container EthSwtPortIngressScheduler [0..*]: multiplicity set at link in variant link-time / post-build in variant post-build / pre-compile in variant pre-compile, post-build-variant-multiplicity=true  # Represents a Scheduler configuration at an ingress port. Tags: atp.Status=draft
          container EthSwtPortIngressVlanTranslationTable  # This container defines 0..* entries of the form (IngressVlanID, TranslatedVlanID) that define the ingress Vlan translation. The IngressVlanID is the VlanID read from the incoming frame upon reception (ingress), which is replaced by the corresponding TranslatedVlanID upon ingress Vlan translation.
            container EthSwtPortIngressVlanTranslationTableEntry [0..*]: multiplicity set at link in variant link-time / post-build in variant post-build / pre-compile in variant pre-compile, post-build-variant-multiplicity=true  # This container defines the mapping between the IngressVlanID (VlanID read from the received frame upon ingress) and the corresponding TranslatedVlanID upon ingress Vlan translation.
              integer EthSwtIngressVlanId [0..1]: 0..4095, scope=ECU, multiplicity set at link in variant link-time / post-build in variant post-build / pre-compile in variant pre-compile, post-build-variant-multiplicity=true, post-build-variant-value=true, set at link in variant link-time / post-build in variant post-build / pre-compile in variant pre-compile  # Incoming VlanID from received frame.
              integer EthSwtTranslatedVlanId [0..1]: 0..4095, scope=ECU, multiplicity set at link in variant link-time / post-build in variant post-build / pre-compile in variant pre-compile, post-build-variant-multiplicity=true, post-build-variant-value=true, set at link in variant link-time / post-build in variant post-build / pre-compile in variant pre-compile  # Mapped VlanID after ingress Vlan translation.
          container EthSwtPortPolicer [0..32760]: multiplicity set at link in variant link-time / post-build in variant post-build / pre-compile in variant pre-compile, post-build-variant-multiplicity=true  # Definition of Rate Policing parameters. Tags: atp.Status=obsolete
            integer EthSwtPortRatePolicedByteCount: 1..18446744073709551615, post-build-variant-value=true, set at link in variant link-time / post-build in variant post-build / pre-compile in variant pre-compile  # Amount of Byte Counts (excluding Header information) which can be received in a configured EthSwtPortRatePolicedTimeInterval. Tags: atp.Status=obsolete
            integer EthSwtPortRatePolicedPriority [0..1]: 0..7, multiplicity set at link in variant link-time / post-build in variant post-build / pre-compile in variant pre-compile, post-build-variant-multiplicity=true, post-build-variant-value=true, set at link in variant link-time / post-build in variant post-build / pre-compile in variant pre-compile  # Defines the priority which this rate policy shall be limited on. If no priority is given this rate policy is not considering priority. Tags: atp.Status=obsolete
            float EthSwtPortRatePolicedTimeInterval: 0..INF, post-build-variant-value=true, set at link in variant link-time / post-build in variant post-build / pre-compile in variant pre-compile  # Time interval in seconds where a configured EthSwtPortRatePolicedByteCount can be received without a rate limitation. Tags: atp.Status=obsolete
            enumeration EthSwtPortRateViolationAction: post-build-variant-value=true, set at link in variant link-time / post-build in variant post-build / pre-compile in variant pre-compile  # Action to be taken when the rate policy criteria defined for this EthSwtPortPolicer are met. Tags: atp.Status=obsolete
              BLOCK_SOURCE  # Tags: atp.Status=obsolete
              DROP_FRAME  # Tags: atp.Status=obsolete
            reference EthSwtRateVlanMembershipRef [0..4095]: multiplicity set at link in variant link-time / post-build in variant post-build / pre-compile in variant pre-compile, post-build-variant-multiplicity=true, post-build-variant-value=true, set at link in variant link-time / post-build in variant post-build / pre-compile in variant pre-compile, destination=EthSwtVlanMembership  # References the Vlans this rate policy shall apply to. Tags: atp.Status=obsolete | If no EthSwtRateVlanMembershipRef is configured the rate policing applies only on the configured EthSwtPortRatePolicedPriority. This element is obsolete and will be removed in a future revision.
          container EthSwtPortPriorityRegeneration [8..8]: multiplicity set at pre-compile  # Defines a priority regeneration where the EthSwtPortPriorityRegenerationIngressPCP is replaced by EthSwtPortPriorityRegenerationRegeneratedPriority. | The EthSwtPortPriorityRegeneration is mandatory and shall always be available. An EthSwtPortPriorityRegeneration shall have 8 mappings, one for each priority. Rational: an Ethernet switch always performs a priority regeneration.
            integer EthSwtPortPriorityRegenerationIngressPCP: 0..7, scope=ECU, post-build-variant-value=true, set at link in variant link-time / post-build in variant post-build / pre-compile in variant pre-compile  # PCP (VLAN-priority) in the incoming message.
            integer EthSwtPortPriorityRegenerationRegeneratedPriority: 0..7, scope=ECU, post-build-variant-value=true, set at link in variant link-time / post-build in variant post-build / pre-compile in variant pre-compile  # Message priority the incoming message will be tagged with.
      container EthSwtSpi [0..1]: multiplicity set at pre-compile, post-build-variant-multiplicity=true  # Configuration of one Ethernet Switch SPI access (if SPI is used).
        container EthSwtSpiSequence [1..*]: multiplicity set at pre-compile, post-build-variant-multiplicity=true  # Container gives EthSwt driver information about one SPI sequence. | One SPI sequence used by EthSwt driver is in exclusive use for it. No other driver is allowed to access this sequence. EthSwt driver may use one sequence to access n EthSwt hardware chips of the same type or n sequences are used to access one single EthSwt hardware chip. If a EthSwt hardware has no SPI interface, there is no instance of this container.
          boolean EthSwtSpiAccessSynchronous [0..1]: scope=ECU, multiplicity set at pre-compile, post-build-variant-multiplicity=true, post-build-variant-value=true, set at pre-compile  # This parameter is used to define whether the access to the Spi sequence is synchronous or asynchronous. | true: SPI access is synchronous. false: SPI access is asynchronous.
          reference EthSwtSpiSequenceName [0..*]: scope=ECU, multiplicity set at pre-compile, post-build-variant-multiplicity=true, post-build-variant-value=true, set at pre-compile, requires-symbolic-name-value=true, destination=SpiSequence  # Reference to a Spi sequence configuration container.
      container EthSwtStreamIdentificationTable [0..1]: multiplicity set at link in variant link-time / post-build in variant post-build / pre-compile in variant pre-compile, post-build-variant-multiplicity=true  # Configuration of a stream identification table. Tags: atp.Status=draft
        container EthSwtStreamIdentificationEntry [0..*]: multiplicity set at link in variant link-time / post-build in variant post-build / pre-compile in variant pre-compile, post-build-variant-multiplicity=true  # Configuration of a stream identification. Tags: atp.Status=draft
          integer EthSwtStreamHandleAssignment: 0..65535, post-build-variant-value=true, set at link in variant link-time / post-build in variant post-build / pre-compile in variant pre-compile  # Assigment of this stream identification to an stream filter entry. Tags: atp.Status=draft
          integer EthSwtStreamIdentificationPosition: 0..65535, scope=ECU, post-build-variant-value=true, set at link in variant link-time / post-build in variant post-build / pre-compile in variant pre-compile  # Specifies the position as unique ID within an ordered list of EthSwtStreamIdentificationEntrys. The ordered list shall start with 0 and continue as linear list with no gaps. Tags: atp.Status=draft | Note: The list is processed in ascending order. The instance of EthSwtStreamIdentificationEntry with position 0 is processed first.
          reference EthSwtPortEgressStreamIdentificationEgressPortRef [0..*]: multiplicity set at link in variant link-time / post-build in variant post-build / pre-compile in variant pre-compile, post-build-variant-multiplicity=true, post-build-variant-value=true, set at link in variant link-time / post-build in variant post-build / pre-compile in variant pre-compile, destination=EthSwtPortEgress  # Reference to the egress ports this stream identification applies to. Tags: atp.Status=draft
          reference EthSwtStreamIdentificationIngressPortRef [0..*]: multiplicity set at link in variant link-time / post-build in variant post-build / pre-compile in variant pre-compile, post-build-variant-multiplicity=true, post-build-variant-value=true, set at link in variant link-time / post-build in variant post-build / pre-compile in variant pre-compile, destination=EthSwtPortIngress  # Reference to the ingress ports this stream identification applies to. Tags: atp.Status=draft
          container EthSwtStreamFilterAction [0..1]: multiplicity set at link in variant link-time / post-build in variant post-build / pre-compile in variant pre-compile, post-build-variant-multiplicity=true  # Configuration of a stream filter action. Tags: atp.Status=draft
            boolean EthSwtStreamFilterActionBlockSource: post-build-variant-value=true, set at link in variant link-time / post-build in variant post-build / pre-compile in variant pre-compile  # Enables Blocking all frames from the MAC address. Tags: atp.Status=draft
            boolean EthSwtStreamFilterActionDropFrame: post-build-variant-value=true, set at link in variant link-time / post-build in variant post-build / pre-compile in variant pre-compile  # Enables Drop Frame action. Tags: atp.Status=draft
            container EthSwtStreamFilterActionDestinationPortModification [0..1]: multiplicity set at link in variant link-time / post-build in variant post-build / pre-compile in variant pre-compile, post-build-variant-multiplicity=true  # Defines the action to modify the destination port(s) determined by the frame forwarding process for an particular Ethernet frame. Either the egress destination of an Ethernet frame is extended or overwritten. Tags: atp.Status=draft
              enumeration EthSwtStreamFilterActionDestinationPortModificationType: post-build-variant-value=true, set at link in variant link-time / post-build in variant post-build / pre-compile in variant pre-compile  # Defines the method to modify the egress destination. Either overwrite or extend the egress destination. Tags: atp.Status=draft
                ETHSWT_STREAM_EGRESS_DESTINATION_EXTEND  # Tags: atp.Status=draft
                ETHSWT_STREAM_EGRESS_DESTINATION_LIMIT  # Tags: atp.Status=draft
                ETHSWT_STREAM_EGRESS_DESTINATION_OVERWRITE  # Tags: atp.Status=draft
              reference EthSwtStreamFilterActionDestinationPortModificationEgressPortRef [1..*]: multiplicity set at link in variant link-time / post-build in variant post-build / pre-compile in variant pre-compile, post-build-variant-multiplicity=true, post-build-variant-value=true, set at link in variant link-time / post-build in variant post-build / pre-compile in variant pre-compile, destination=EthSwtPortEgress  # Defines a set of destination ports (egress ports) used for the modification of the egress destination of an Ethernet frame. Tags: atp.Status=draft
            container EthSwtStreamFilterActionVlanModification [0..1]: multiplicity set at link in variant link-time / post-build in variant post-build / pre-compile in variant pre-compile, post-build-variant-multiplicity=true  # Defines the action to modify the VLAN-ID within a VLAN-tag of an Ethernet frame. Tags: atp.Status=draft
              integer EthSwtStreamFilterActionVlanModificationVlanId: 0..4094, post-build-variant-value=true, set at link in variant link-time / post-build in variant post-build / pre-compile in variant pre-compile  # Defines the VLAN-ID to modify the existing VLAN-ID within the VLAN-tag of an Ethernet frame. Tags: atp.Status=draft
          container EthSwtStreamFilterRule  # Configuration of a filter rule. Tags: atp.Status=draft
            integer EthSwtStreamFilterEtherType [0..*]: 0..65535, multiplicity set at pre-compile, set at pre-compile  # Definition of the filter Ether Type. Tags: atp.Status=draft
            integer EthSwtStreamFilterVlanId [0..*]: 0..4094, multiplicity set at pre-compile, set at pre-compile  # Definition of the filter VLAN-ID. Tags: atp.Status=draft
            integer EthSwtStreamFilterVlanPriority [0..*]: 0..7, multiplicity set at pre-compile, set at pre-compile  # Definition of the filter VLAN Priority. Tags: atp.Status=draft
            container EthSwtStreamFilterIEEE1722StreamId [0..1]: post-build-variant-multiplicity=true  # Definition of the filter IEEE1722 Stream Id. Specifies a 64 bit Stream Id. Please note: According to IEEE802.1Q specification, the 48 most significant bits represents a source MAC address and the 16 least significant bits a unique id. AUTOSAR deviates from this definition and allow to have any kind of MAC address (e.g. source or destination or MAC multicast address)
              string EthSwtStreamFilterStreamMacId: post-build-variant-value=true, set at link in variant link-time / post-build in variant post-build / pre-compile in variant pre-compile, max-length=17, min-length=17, regular-expression=([0-9a-fA-F]{2}:){5}[0-9a-fA-F]{2}  # Specifies the 48-bit physical address (MAC address) part of the IEEE1722 Stream Id.
              integer EthSwtStreamFilterStreamUniqueId: 0..65535, multiplicity set at pre-compile, post-build-variant-value=true, set at link in variant link-time / post-build in variant post-build / pre-compile in variant pre-compile, default-value=0  # Specifies the 16-bit unique part of the IEEE1722 Stream Id.
            container EthSwtStreamFilterIPDestAddress [0..*]: multiplicity set at link in variant link-time / post-build in variant post-build / pre-compile in variant pre-compile, post-build-variant-multiplicity=true  # Configuration of one IP destination filter. Tags: atp.Status=draft
              string EthSwtStreamFilterIPAddressKey: post-build-variant-value=true, set at link in variant link-time / post-build in variant post-build / pre-compile in variant pre-compile  # IP address key pattern. Tags: atp.Status=draft
              string EthSwtStreamFilterIPAddressMask: post-build-variant-value=true, set at link in variant link-time / post-build in variant post-build / pre-compile in variant pre-compile  # IP address mask pattern. Tags: atp.Status=draft
            container EthSwtStreamFilterIPSrcAddress [0..*]: multiplicity set at link in variant link-time / post-build in variant post-build / pre-compile in variant pre-compile, post-build-variant-multiplicity=true  # Configuration of one IP source filter. Tags: atp.Status=draft
              string EthSwtStreamFilterIPAddressKey: post-build-variant-value=true, set at link in variant link-time / post-build in variant post-build / pre-compile in variant pre-compile  # IP address key pattern. Tags: atp.Status=draft
              string EthSwtStreamFilterIPAddressMask: post-build-variant-value=true, set at link in variant link-time / post-build in variant post-build / pre-compile in variant pre-compile  # IP address mask pattern. Tags: atp.Status=draft
            container EthSwtStreamFilterMACDestAddress [0..*]: multiplicity set at link in variant link-time / post-build in variant post-build / pre-compile in variant pre-compile, post-build-variant-multiplicity=true  # Configuration of one MAC destination filter. Tags: atp.Status=draft
              string EthSwtStreamFilterMACAddressKey: post-build-variant-value=true, set at link in variant link-time / post-build in variant post-build / pre-compile in variant pre-compile, max-length=17, min-length=17, regular-expression=([0-9a-fA-F]\{2}:)\{5}[0-9a-fA-F]\{2}  # Specifies the 48-bit physical address (MAC address) key value. Tags: atp.Status=draft
              string EthSwtStreamFilterMACAddressMask: post-build-variant-value=true, set at link in variant link-time / post-build in variant post-build / pre-compile in variant pre-compile, max-length=17, min-length=17, regular-expression=([0-9a-fA-F]\{2}:)\{5}[0-9a-fA-F]\{2}  # Specifies the 48-bit physical address (MAC address) mask value. Tags: atp.Status=draft
            container EthSwtStreamFilterMACSrcAddress [0..*]: multiplicity set at link in variant link-time / post-build in variant post-build / pre-compile in variant pre-compile, post-build-variant-multiplicity=true  # Configuration of one MAC source filter. Tags: atp.Status=draft
              string EthSwtStreamFilterMACAddressKey: post-build-variant-value=true, set at link in variant link-time / post-build in variant post-build / pre-compile in variant pre-compile, max-length=17, min-length=17, regular-expression=([0-9a-fA-F]\{2}:)\{5}[0-9a-fA-F]\{2}  # Specifies the 48-bit physical address (MAC address) key value. Tags: atp.Status=draft
              string EthSwtStreamFilterMACAddressMask: post-build-variant-value=true, set at link in variant link-time / post-build in variant post-build / pre-compile in variant pre-compile, max-length=17, min-length=17, regular-expression=([0-9a-fA-F]\{2}:)\{5}[0-9a-fA-F]\{2}  # Specifies the 48-bit physical address (MAC address) mask value. Tags: atp.Status=draft
            container EthSwtStreamFilterTcpDestPort [0..*]: multiplicity set at link in variant link-time / post-build in variant post-build / pre-compile in variant pre-compile, post-build-variant-multiplicity=true  # Configuration of a TCP destination port filter. Tags: atp.Status=draft
              integer EthSwtStreamFilterPortLowerValue: 0..65535, set at pre-compile  # Definition of the filter port lower value. Tags: atp.Status=draft
              integer EthSwtStreamFilterPortUpperValue: 0..65535, set at pre-compile  # Definition of the filter port upper value. Tags: atp.Status=draft
            container EthSwtStreamFilterTcpSrcPort [0..*]: multiplicity set at link in variant link-time / post-build in variant post-build / pre-compile in variant pre-compile, post-build-variant-multiplicity=true  # Configuration of a TCP source port filter. Tags: atp.Status=draft
              integer EthSwtStreamFilterPortLowerValue: 0..65535, set at pre-compile  # Definition of the filter port lower value. Tags: atp.Status=draft
              integer EthSwtStreamFilterPortUpperValue: 0..65535, set at pre-compile  # Definition of the filter port upper value. Tags: atp.Status=draft
            container EthSwtStreamFilterUdpDestPort [0..*]: multiplicity set at link in variant link-time / post-build in variant post-build / pre-compile in variant pre-compile, post-build-variant-multiplicity=true  # Configuration of a UDP destination port filter. Tags: atp.Status=draft
              integer EthSwtStreamFilterPortLowerValue: 0..65535, set at pre-compile  # Definition of the filter port lower value. Tags: atp.Status=draft
              integer EthSwtStreamFilterPortUpperValue: 0..65535, set at pre-compile  # Definition of the filter port upper value. Tags: atp.Status=draft
            container EthSwtStreamFilterUdpSrcPort [0..*]: multiplicity set at link in variant link-time / post-build in variant post-build / pre-compile in variant pre-compile, post-build-variant-multiplicity=true  # Configuration of a UDP source port filter. Tags: atp.Status=draft
              integer EthSwtStreamFilterPortLowerValue: 0..65535, set at pre-compile  # Definition of the filter port lower value. Tags: atp.Status=draft
              integer EthSwtStreamFilterPortUpperValue: 0..65535, set at pre-compile  # Definition of the filter port upper value. Tags: atp.Status=draft
      container EthSwtUnknownMacDestAddressConfig [1..*]: multiplicity set at link in variant link-time / post-build in variant post-build / pre-compile in variant pre-compile, post-build-variant-multiplicity=true  # Definition to which EthSwtPorts an Ethernet frame shall be forwarded if the destination MAC address is not present in the address resolution lookup (ARL) table.
        reference EthSwtDestPortsForUnknownMulticastMacDestAddressRef [0..255]: scope=ECU, multiplicity set at link in variant link-time / post-build in variant post-build / pre-compile in variant pre-compile, post-build-variant-multiplicity=true, post-build-variant-value=true, set at link in variant link-time / post-build in variant post-build / pre-compile in variant pre-compile, destination=EthSwtPort  # This parameter specifies the egress ports frames with unknown multicast MAC destination addresses (without a matching ARL entry) are forwarded on. | Note that "Drop Unknown Multicast" behavior can be achieved by not referencing any EthSwtPort.
        reference EthSwtDestPortsForUnknownUnicastMacDestAddressRef [0..255]: scope=ECU, multiplicity set at link in variant link-time / post-build in variant post-build / pre-compile in variant pre-compile, post-build-variant-multiplicity=true, post-build-variant-value=true, set at link in variant link-time / post-build in variant post-build / pre-compile in variant pre-compile, destination=EthSwtPort  # This parameter specifies the egress ports frames with unknown unicast MAC destination addresses (without a matching ARL entry) are forwarded on. | Note that "Flooding" can be achieved by referencing all EthSwtPorts.
        reference EthSwtDestVlanForUnknownMacDestAddressRef [0..4095]: scope=ECU, multiplicity set at link in variant link-time / post-build in variant post-build / pre-compile in variant pre-compile, post-build-variant-multiplicity=true, post-build-variant-value=true, set at link in variant link-time / post-build in variant post-build / pre-compile in variant pre-compile, destination=EthSwtVlanMembership  # Optional reference to a set of VLANs to define that the owning EthSwtUnknownMacDestAddressConfig is applicable for these VLANs only.
      container EthSwtVlanMembership [0..4095]: multiplicity set at link in variant link-time / post-build in variant post-build / pre-compile in variant pre-compile, post-build-variant-multiplicity=true  # Determines the membership of this Ethernet switch and the referenced ports to the virtual network, i.e. frames with this VID can be received and transmitted via the referenced ports.
        integer EthSwtVlanMembershipId: 0..4094, scope=ECU, post-build-variant-value=true, set at link in variant link-time / post-build in variant post-build / pre-compile in variant pre-compile  # Determines the VID of the virtual network this port belongs to.
        container EthSwtVlanMembershipPortRefEntry [0..255]: multiplicity set at link in variant link-time / post-build in variant post-build / pre-compile in variant pre-compile, post-build-variant-multiplicity=true  # Determines the VLAN membership of one referenced ports to the virtual network and the according forwarding type (NOT_SENT, SENT_UNTAGGED, SENT_TAGGED).
          enumeration EthSwtVlanForwardingType: {ETHSWT_NOT_SENT, ETHSWT_SENT_TAGGED, ETHSWT_SENT_UNTAGGED}, scope=ECU, post-build-variant-value=true, set at link in variant link-time / post-build in variant post-build / pre-compile in variant pre-compile  # Defines how the message with a specific VLAN-ID at the referenced port shall be handled.
          reference EthSwtVlanMembershipPortRef: scope=ECU, post-build-variant-value=true, set at link in variant link-time / post-build in variant post-build / pre-compile in variant pre-compile, destination=EthSwtPort  # Reference to one port the VLAN shall be assigned to.
    container EthSwtGeneral  # General configuration of Ethernet Switch Driver module.
      boolean EthSwtCheckWakeupApi: set at pre-compile  # Enables / Disables EthSwt_CheckWakeup API.
      boolean EthSwtDeletePortMirrorConfigurationApi: set at pre-compile  # Enables / Disables EthSwt_DeletePortMirrorConfiguration API
      boolean EthSwtDevErrorDetect: set at pre-compile, default-value=false  # Switches the development error detection and notification on or off. | * true: detection and notification is enabled. * false: detection and notification is disabled.
      boolean EthSwtEnableCableDiagnosticApi: set at pre-compile  # Enable/disable the APIs for cable diagnostic: EthSwt_RunPortCableDiagnostic, EthSwt_GetPortCableDiagnosticsResult
      boolean EthSwtEnableVlanApi: set at pre-compile  # Enables / Disables EthSwt_EnableVLAN API.
      boolean EthSwtGetArlTableApi: set at pre-compile  # Enables / Disables EthSwt_GetArlTable API.
      boolean EthSwtGetBaudRateApi: set at pre-compile  # Enables / Disables EthSwt_GetBaudRate API
      function name EthSwtGetCfgDataRawDone [0..1]: multiplicity set at pre-compile, set at pre-compile  # Defines the function name for <GetCfgDataRawDone>
      boolean EthSwtGetCfgRaw: set at pre-compile  # Disable /Enable support of reading raw data from switch memory
      boolean EthSwtGetCounterValuesApi: set at pre-compile  # Enables / Disables EthSwt_GetCounterValues API
      boolean EthSwtGetDuplexModeApi: set at pre-compile  # Enables / Disables EthSwt_GetDuplexMode API
      boolean EthSwtGetLinkStateApi: set at pre-compile  # Enables / Disables EthSwt_GetLinkState API
      boolean EthSwtGetMacLearningModeApi: set at pre-compile  # Enables / Disables EthSwt_GetMacLearningMode API.
      boolean EthSwtGetMaxQueueBufferFillLevelApi: set at pre-compile  # Enables / Disables EthSwt_GetMaxQueueBufferFillLevel API.
      boolean EthSwtGetPortCableDiagnosticsResultApi: set at pre-compile  # Enables / Disables EthSwt_GetPortCableDiagnosticsResult API
      boolean EthSwtGetPortIdentifierApi: set at pre-compile  # Enables / Disables EthSwt_GetPortIdentifier API
      boolean EthSwtGetPortMacAddrApi: set at pre-compile  # Enables / Disables EthSwt_GetPortMacAddr API.
      boolean EthSwtGetPortMacAddrVlanApi [0..1]: multiplicity set at pre-compile, set at pre-compile  # Enables / Disables EthSwt_GetPortMacAddrVlan API.
      boolean EthSwtGetPortMirrorStateApi: set at pre-compile  # Enables / Disables EthSwt_GetPortMirrorState API
      boolean EthSwtGetPortSignalQualityApi: set at pre-compile  # Enables / Disables EthSwt_GetPortSignalQuality API
      boolean EthSwtGetRxStatsApi: set at pre-compile  # Enables / Disables EthSwt_GetRxStats API.
      boolean EthSwtGetSwitchIdentifierApi: set at pre-compile  # Enables / Disables EthSwt_GetSwitchIdentifier API
      boolean EthSwtGetSwitchPortModeApi: set at pre-compile  # Enables / Disables EthSwt_GetSwitchPortMode API
      boolean EthSwtGetSwitchPortWakeupReasonApi: set at pre-compile  # Enables / Disables EthSwt_GetSwitchPortWakeupReason API.
      boolean EthSwtGetSwitchRegApi: set at pre-compile  # Enables / Disables EthSwt_GetSwitchReg API.
      boolean EthSwtGetTxErrorCounterValuesApi: set at pre-compile, default-value=false  # Enables/Disables Eth_GetTxErrorCounterValues API.
      boolean EthSwtGetTxStatsApi: set at pre-compile, default-value=false  # Enables/Disables Eth_GetTxStats API.
      boolean EthSwtGlobalTimeSupportApi: set at pre-compile  # Enables/Disables the Global Time APIs used amongst others by Global Time Synchronization over Ethernet.
      integer EthSwtIndex: 0..255, set at pre-compile  # Specifies the InstanceId of this module instance. If only one instance is present it shall have the Id 0.
      function name EthSwtLinkDownCallout [0..1]: multiplicity set at pre-compile, set at pre-compile  # Defines the function name for the <EthSwtLinkDownCallout> callout.
      function name EthSwtLinkUpCallout [0..1]: multiplicity set at pre-compile, set at pre-compile  # Defines the function name for the <EthSwtLinkUpCallout> callout.
      boolean EthSwtLowPowerModeSupport [0..1]: multiplicity set at pre-compile, set at pre-compile, default-value=false  # Disable / Enable support of low power mode.
      float EthSwtMainFunctionPeriod: 0..INF, set at pre-compile  # The cycle time of the periodic main function of EthSwt. Defined in seconds .
      boolean EthSwtManagementSupportApi: set at pre-compile  # Enables/Disables the Switch management APIs to support a Switch-port specific communication attribute access.
      boolean EthSwtPersistentConfigurationResult: set at pre-compile  # Enables / Disables the callback API <User>_PersistentConfigurationResult.
      function name EthSwtPersistentConfigurationResultCallback [0..1]: multiplicity set at pre-compile, set at pre-compile  # Defines the function name for <EthSwtPersistentConfigurationResultCallback>.
      string EthSwtPublicCddHeaderFile [0..*]: multiplicity set at pre-compile, set at pre-compile, max-length=32, min-length=1  # Defines header files for callback functions which shall be included in case of CDDs.
      boolean EthSwtReadMmdApi: set at pre-compile, default-value=false  # Enables/Disables EthSwt_ReadMmd
      boolean EthSwtReadPortMirrorConfigurationApi: set at pre-compile  # Enables / Disables EthSwt_ReadPortMirrorConfiguration API
      boolean EthSwtReadTrcvRegisterApi: set at pre-compile  # Enables / Disables EthSwt_ReadTrcvRegister API.
      boolean EthSwtResetConfigurationApi: set at pre-compile  # Enables / Disables EthSwt_ResetConfiguration API.
      boolean EthSwtSetForwardingModeApi: set at pre-compile, default-value=false  # Enables /disables EthSwt_SetForwardingMode API.
      boolean EthSwtSetMacLearningModeApi: set at pre-compile  # Enables / Disables EthSwt_SetMacLearningMode API.
      boolean EthSwtSetPortLoopbackModeApi: set at pre-compile  # Enables / Disables EthSwt_SetPortLoopbackModeApi API
      boolean EthSwtSetPortMirrorStateApi: set at pre-compile  # Enables / Disables EthSwt_SetPortMirrorState API
      boolean EthSwtSetPortTestModeApi: set at pre-compile  # Enables / Disables EthSwt_SetPortTestMode API
      boolean EthSwtSetPortTxModeApi: set at pre-compile  # Enables / Disables EthSwt_SetPortTxModeApi API
      boolean EthSwtSetSwitchPortModeApi: set at pre-compile  # Enables / Disables EthSwt_SetSwitchPortMode API
      boolean EthSwtSetSwitchRegApi: set at pre-compile  # Enables / Disables EthSwt_SetSwitchReg API.
      boolean EthSwtStartSwitchPortAutoNegotiationApi: set at pre-compile  # Enables / Disables EthSwt_StartSwitchPortAutoNegotiation API
      boolean EthSwtStoreConfigurationApi: set at pre-compile  # Enables / Disables EthSwt_StoreConfiguration API.
      boolean EthSwtVerifyConfigApi: set at pre-compile, default-value=false  # Enables /disables EthSwt_VerifyConfig API.
      boolean EthSwtVersionInfoApi: set at pre-compile, default-value=false  # Enables / Disables version info API.
      boolean EthSwtWriteMmdApi: set at pre-compile, default-value=false  # Enables/Disables EthSwt_WriteMmd
      boolean EthSwtWritePortMirrorConfigurationApi: set at pre-compile  # Enables / Disables EthSwt_WritePortMirrorConfiguration API
      boolean EthSwtWriteTrcvRegisterApi: set at pre-compile  # Enables / Disables EthSwt_WriteTrcvRegister API.
      reference EthSwtEcucPartitionRef [0..*]: scope=ECU, multiplicity set at pre-compile, post-build-variant-multiplicity=true, post-build-variant-value=true, set at pre-compile, destination=EcucPartition  # Maps the Ethernet switch driver to zero or multiple ECUC partitions to make the modules API available in this partition.
  module definition EthTSyn [0..1]: post-build-variant-support=true, variants pre-compile  # Configuration of the Synchronized Time-base Manager (StbM) module with respect to global time handling on Ethernet.
    container EthTSynGeneral  # This container holds the general parameters of the Ethernet-specific Synchronized Time-base Manager
      string EthTSynDestPhyAddr: set at pre-compile, default-value=01:80:C2:00:00:0E  # Destination Physical Address (MAC-Address). | Destination Physical Hardware Address (MAC-Address) of EthTSyn-gPTP Frames. Input format has to match xx:xx:xx:xx:xx:xx, where x stands for a hex value between 0 and F.
      boolean EthTSynDevErrorDetect: set at pre-compile, default-value=false  # Switches the development error detection and notification on or off. | * true: detection and notification is enabled. * false: detection and notification is disabled.
      boolean EthTSynEnableSecurityEventReporting: set at pre-compile, default-value=false  # Switches the reporting of security events to the IdsM: | - true: reporting is enabled. - false: reporting is disabled.
      float EthTSynGlobalTimeRxToUplinkSwitchResidenceTime [0..1]: 0..4, multiplicity set at pre-compile, set at pre-compile, default-value=0  # This parameter is specifying the default value used for the residence time of the Ethernet Switch [Ingress to Uplink]. | This value is used by the EthTSyn if the calculation of the residence time failed. Unit: seconds
      float EthTSynGlobalTimeUplinkToTxSwitchResidenceTime [0..1]: 0..4, multiplicity set at pre-compile, set at pre-compile, default-value=0  # This parameter is specifying the default value used for the residence time of the Ethernet Switch [Uplink to Egress]. | This value is used by the EthTSyn if the calculation of the residence time failed. Unit: seconds
      boolean EthTSynHardwareTimestampSupport: set at pre-compile  # Activate/Deactivate the hardware time stamping functionality of the Ethernet hardware. | True: Timestamp is retrieved from the Ethernet hardware False: Timestamp is retrieved from the StbM
      float EthTSynMainFunctionPeriod: 0..INF, set at pre-compile  # Schedule period of the main function EthTSyn_MainFunction. | Unit: seconds.
      boolean EthTSynMasterSlaveConflictDetection: set at pre-compile, default-value=false  # Enables master / slave conflict detection and notification. | * true: detection and notification is enabled. * false: detection and notification is disabled.
      integer EthTSynMaxNumberOfTransmitRetries: 0..20, set at pre-compile, default-value=0  # Provide the max number of re-transmission of frames in case of transmission failure(i.e., no buffer available or driver busy). A value of 0 will disable the retry mechanism. Tags: atp.Status=draft
      boolean EthTSynMessageCompliance: set at pre-compile  # * true: IEEE 802.1AS compliant message format will be used. | * false: IEEE 802.1AS message format with AUTOSAR extension will be used.
      integer EthTSynSwitchMgmtRxMessageBufferCount [0..1]: 1..254, multiplicity set at pre-compile, set at pre-compile, default-value=10  # This parameter is used to determine the amount of Rx message buffers available in the EthTSyn when EthTSyn is used in a Bridge configuration.
      boolean EthTSynTimeValidationSupport: set at pre-compile, default-value=false  # Switches support for time validation on or off. | * true: time validation is enabled. * false: time validation is disabled.
      boolean EthTSynVersionInfoApi: set at pre-compile, default-value=false  # Activate/Deactivate the version information API (EthTSyn_GetVersionInfo). True: version information API activated False: version information API deactivated.
      reference EthTSynEthIfFrameType: set at pre-compile, destination=EthIfFrameConfig  # The chosen frame owner determines which frames (in respect to ethertype) are received. Tags: atp.Status=draft
      container EthTSynSecurityEventRefs [0..1]: multiplicity set at pre-compile  # Container for the references to IdsMEvent elements representing the security events that the EthTSyn | module shall report to the IdsM in case the coresponding security related event occurs (and if EthTSynEnableSecurityEventReportings set to "true"). The standardized security events in this container can be extended by vendor-specific security events.
        reference SEV_TSYN_ETH_FRESHNESS_NOT_AVAILABLE [0..1]: multiplicity set at pre-compile, set at pre-compile, requires-symbolic-name-value=true, destination=IdsMEvent  # FV not available from FVM. Context data provides the respective domain ID.
        reference SEV_TSYN_ETH_ICV_GENERATION_FAILED [0..1]: multiplicity set at pre-compile, set at pre-compile, requires-symbolic-name-value=true, destination=IdsMEvent  # ICV generation for Follow_Up message failed. Context data provides the respective domain ID
        reference SEV_TSYN_ETH_ICV_VERIFICATION_FAILED [0..1]: multiplicity set at pre-compile, set at pre-compile, requires-symbolic-name-value=true, destination=IdsMEvent  # ICV verification for Follow_Up message failed. Context data provides the respective domain ID.
        reference SEV_TSYN_ETH_SYNC_FUP_SEQUENCE_ERROR [0..1]: multiplicity set at pre-compile, set at pre-compile, requires-symbolic-name-value=true, destination=IdsMEvent  # Failed to receive correct sequence of SYNC and Follow_Up from the TimeMaster within (EthTSynGlobalTimeFollowUpTimeout).
    container EthTSynGlobalTimeDomain [1..*]  # This represents the existence of a global time domain on Ethernet. The EthTSyn module can administrate several global time domains at the same time that in itself form a hierarchy of domains and sub-domains. | If the EthTSyn exists it is assumed that at least one global time domain exists.
      integer EthTSynFramePrio [0..1]: 0..7, multiplicity set at pre-compile, post-build-variant-multiplicity=true, post-build-variant-value=true, set at pre-compile  # This optional parameter, if present, indicates the priority of outgoing EthTSyn message (i.e., it equals the 3-bit PCP field of a tagged VLAN message). If a VLAN is not configured, this parameter is also not configured
      float EthTSynGlobalTimeDebounceTime [0..1]: 0..4, post-build-variant-value=true, set at pre-compile  # This represents the configuration of a TX debounce time for Sync, Follow_Up, and pDelay messages compared to a message before with the same PDU. Unit: seconds
      integer EthTSynGlobalTimeDomainId: 0..127, set at pre-compile  # The global time domain ID.
      float EthTSynGlobalTimeRxDebounceTime [0..1]: 0..4, multiplicity set at pre-compile, post-build-variant-value=true, set at pre-compile  # This represents the configuration of a RX debounce time for Sync and Follow_Up. Unit: seconds
      reference EthTSynClkUnitRef [0..1]: scope=ECU, multiplicity set at pre-compile, set at pre-compile, requires-symbolic-name-value=true, destination=EthIfClkUnit  # Reference to a HW clock unit in the Ethernet controller. Tags: atp.Status=draft
      reference EthTSynGlobalTimeEthIfRef [0..*]: set at pre-compile, requires-symbolic-name-value=true, destination=EthIfController  # This represents the reference to the Ethernet interface taken to fetch the global time information.
      reference EthTSynSynchronizedTimeBaseRef: set at pre-compile, requires-symbolic-name-value=true, destination=StbMSynchronizedTimeBase  # Mandatory reference to the required synchronized time-base.
      container EthTSynGlobalTimeFollowUpDataIDList [0..1]: multiplicity set at pre-compile, post-build-variant-multiplicity=true  # The DataIDList for Follow_Up message ensures the identification of data elements due to CRC calculation and message authentication process.
        container EthTSynGlobalTimeFollowUpDataIDListElement [16..16]  # Element of the DataIDList for Follow_Up message ensures the identification of data elements due to CRC calculation and message authentication process.
          integer EthTSynGlobalTimeFollowUpDataIDListIndex: 0..15, post-build-variant-value=true, set at pre-compile  # Index of the DataIDList for Follow_Up message ensures the identification of data elements due to CRC calculation and message authentication process.
          integer EthTSynGlobalTimeFollowUpDataIDListValue: 0..255, post-build-variant-value=true, set at pre-compile  # Value of the DataIDList for Follow_Up message ensures the identification of data elements due to CRC calculation and message authentication process.
      container EthTSynPortConfig [0..*]: multiplicity set at pre-compile, post-build-variant-multiplicity=true  # Configuration of the EthTSyn-Ports within the TimeDomain.
        boolean EthTSynEnableTimeValidation: set at pre-compile, default-value=false  # Enables/disables time recording for time validation for a specific Time Domain.
        enumeration EthTSynGlobalTimePortRole [0..1]: {DYNAMIC, TIME_MASTER, TIME_SLAVE}, post-build-variant-value=true, set at pre-compile, default-value=DYNAMIC  # Parameter to set the port behavior to Time Slave, Time Master or Dynamic (Time Slave or Time Master at runtime).
        float EthTSynGlobalTimeTxPeriod [0..1]: 0..INF, post-build-variant-value=true, set at pre-compile  # This represents configuration of the TX period. Unit: seconds
        reference EthTSynSwitchManagementEthSwitchPortRef [0..1]: multiplicity set at pre-compile, set at pre-compile, requires-symbolic-name-value=true, destination=EthSwtPort  # In an AVB-Bridge config, this reference is used to assign the EthTSyn-Port to an Ethernet Switch-Port.
        container EthTSynGlobalTimeRxIcvVerification [0..1]: multiplicity set at pre-compile  # This container collects configuration that shall be used for ICV verification.
          integer EthTSynIcvRxLength: 0..1061, set at pre-compile  # Length of ICV to be transmitted within Follow_Up Message on the bus (in bytes).
          integer EthTSynIcvVerificationAttempts: 0..65535, set at pre-compile, default-value=0  # This parameter specifies the number of ICV verification attempts that are to be carried out when the verification of the ICV failed for a given secured Follow_Up message. If zero is set, then only one ICV verification attempt is done.
          enumeration EthTSynIcvVerificationBase: {ICV_MAC, ICV_SIGNATURE}, set at pre-compile  # Symmetric or asymmetric cryptography selection for the ICV generation
          float EthTSynIcvVerificationTimeout: 0..INF, set at pre-compile  # Timeout of ICV verification (respective CSM job completion in asynchronous behavior). A value of 0 disables the ICV timeout monitoring. Unit: Seconds
          integer EthTSynRxAuthenticationBuildAttempts: 0..65535, set at pre-compile, default-value=0  # This parameter specifies the number of authentication build attempts that are to be carried out when the verification of the ICV failed for a given Follow_Up message. If zero is set, then only one ICV verification attempt is done.
          reference EthTSynIcvVerificationFvIdRef [0..1]: multiplicity set at pre-compile, set at pre-compile, requires-symbolic-name-value=true, destination=StbMFreshnessValue  # This represents the reference to the FV taken to verify the ICV.
          reference EthTSynIcvVerificationJobRef: set at pre-compile, requires-symbolic-name-value=true, destination=CsmJob  # This represents the reference to the CSM job to fetch the CSM job ID.
        container EthTSynGlobalTimeTxIcvGeneration [0..1]: multiplicity set at pre-compile  # This container collects configuration that shall be used for ICV generation.
          enumeration EthTSynIcvGenerationBase: {ICV_MAC, ICV_SIGNATURE}, set at pre-compile  # Symmetric or asymmetric cryptography selection for the ICV generation
          float EthTSynIcvGenerationTimeout: 0..INF, set at pre-compile  # Timeout of ICV generation (respective CSM job completion in asynchronous behaviour). A value of 0 disables the ICV timeout monitoring. Unit: Seconds
          integer EthTSynIcvTxLength: 0..1061, set at pre-compile  # Length of ICV to be transmitted within Follow_Up Message on the bus (in bytes).
          integer EthTSynTxAuthenticationBuildAttempts: 0..65535, set at pre-compile, default-value=0  # This parameter specifies the number of authentication build attempts that are to be carried out when the generation of the ICV failed for a given Follow_Up message. If zero is set, then only one ICV generation attempt is done.
          reference EthTSynIcvGenerationFvIdRef [0..1]: multiplicity set at pre-compile, set at pre-compile, requires-symbolic-name-value=true, destination=StbMFreshnessValue  # This represents the reference to the FV taken to generate the ICV generation.
          reference EthTSynIcvGenerationJobRef: set at pre-compile, requires-symbolic-name-value=true, destination=CsmJob  # This represents the reference to the CSM job to fetch the CSM job ID.
        container EthTSynPdelayConfig: multiplicity set at pre-compile, post-build-variant-multiplicity=true  # Configuration of cyclic propagation delay measurement.
          boolean EthTSynGlobalTimePdelayRespEnable: post-build-variant-value=true, set at pre-compile, default-value=true  # This parameter allows disabling Pdelay_Resp / Pdelay_Resp_Follow_Up transmission, if no Pdelay_Req messages are expected. | FALSE: No Pdelay requests expected. Pdelay_Resp / Pdelay_Resp_Follow_Up transmission is disabled. TRUE: Pdelay requests expected. Pdelay_Resp / Pdelay_Resp_Follow_Up transmission is enabled.
          float EthTSynGlobalTimePropagationDelay: 0..4, post-build-variant-value=true, set at pre-compile, default-value=0  # If cyclic propagation delay measurement is enabled, this parameter represents the default value of the propagation delay until the first actually measured propagation delay is available. | If cyclic propagation delay measurement is disabled, this parameter replaces a measured propagation delay by a fixed value. Unit: seconds
          float EthTSynGlobalTimeTxPdelayReqPeriod: 0..4, post-build-variant-value=true, set at pre-compile, default-value=0  # This represents configuration of the TX period for Pdelay_Req messages. | A value of 0 disables the cyclic Pdelay measurement. Unit: seconds
          float EthTSynPdelayLatencyThreshold [0..1]: 0..INF, post-build-variant-value=true, set at pre-compile, default-value=1E-5  # Threshold for calculated Pdelay. If a measured Pdelay exceeds EthTSynPdelayLatencyThreshold, this value is discarded. | Unit: seconds
          float EthTSynPdelayRespAndRespFollowUpTimeout: 0..4, post-build-variant-value=true, set at pre-compile  # Timeout value for Pdelay_Resp and Pdelay_Resp_Follow_Up after a Pdelay_Req has been transmitted resp. a Pdelay_Resp has been received. | A value of 0 deactivates this timeout observation. Unit: seconds
          boolean EthTSynRateRatioEnable: scope=ECU, post-build-variant-value=true, set at pre-compile  # Enables/disables neighbor rate ratio calculation according to IEEE 802.1AS. Tags: atp.Status=draft
          integer EthTSynRateRatioMeasurementCount: 1..255, post-build-variant-value=true, set at pre-compile  # This parameter defines the number of successful pDelay measurements used to calculate the neighbor rate ratio according to IEEE 802.1AS. Tags: atp.Status=draft
        container EthTSynRxPdu [0..1]: multiplicity set at pre-compile  # PDU used for reception. Tags: atp.Status=draft | Supported MetaData entry: TIMETUPLE_TYPE_PTR
          integer EthTSynRxPduId: 0..65535, scope=ECU, set at pre-compile, symbolic-name-value=true, with-auto=true  # PDU identifier used for RxIndication from LSduR. Tags: atp.Status=draft
          reference EthTSynRxPduRef: scope=ECU, set at pre-compile, destination=Pdu  # Reference to the Pdu object representing the PDU. Tags: atp.Status=draft
        container EthTSynTxPdu [0..1]: multiplicity set at pre-compile  # PDU used for transmission. Tags: atp.Status=draft
          integer EthTSynTxPduId: 0..65535, scope=ECU, set at pre-compile, symbolic-name-value=true, with-auto=true  # PDU identifier used for TxConfirmation from LSduR. Tags: atp.Status=draft
          reference EthTSynTxPduRef: scope=ECU, set at pre-compile, destination=Pdu  # Reference to the Pdu object representing the PDU. Tags: atp.Status=draft
      choice container EthTSynPortRole [0..1]: multiplicity set at pre-compile, post-build-variant-multiplicity=true  # Specifying the Role of the EthTSyn-Port (Master or Slave).
        container EthTSynGlobalTimeMaster [0..1]: multiplicity set at pre-compile, post-build-variant-multiplicity=true  # Configuration of a (global) time master. Each time domain is required to have exactly one global time master, but may have multiple ports acting as time (sub-) master (see Time Gateway) to relay global time from the global time master to the time slaves. The global time master may or may not exist on the configured ECU. The exact role of the port is derived implicitly.
          float EthTSynCyclicMsgResumeTime: 0..INF, post-build-variant-value=true, set at pre-compile  # Defines the time where the 1st regular cycle time based message transmission takes place, after an immediate transmission before. Unit: seconds
          enumeration EthTSynGlobalTimeTxCrcSecured: {CRC_NOT_SUPPORTED, CRC_SUPPORTED}, post-build-variant-value=true, set at pre-compile  # This represents the configuration of whether or not CRC is supported.
          float EthTSynHoldOverTime [0..1]: 0..INF, multiplicity set at pre-compile, post-build-variant-multiplicity=true, post-build-variant-value=true, set at pre-compile, default-value=3  # Parameter to define timeout for transmission of Sync and Follow_Up messages on Master ports in absence of reception of Sync and Follow_Up messages on Slave port.Unit: seconds
          boolean EthTSynImmediateTimeSync: post-build-variant-value=true, set at pre-compile  # Enables/Disables the cyclic polling of StbM_GetTimeBaseUpdateCounter() within EthTSyn_MainFunction().
          boolean EthTSynTLVFollowUpICVSubTLV: set at pre-compile  # This represents the configuration of whether an AUTOSAR Follow_Up ICV Sub-TLV is used or not. | - true: This represents a configuration where an AUTOSAR Follow_Up ICV Sub-TLV is used. - false: This represents a configuration where an AUTOSAR Follow_Up ICV Sub-TLV is not used.
          boolean EthTSynTxSubTLVStatus: post-build-variant-value=true, set at pre-compile  # Definition of whether (true) or not (false) a Sub-TLV:Status Secured or Sub-TLV:Status Not Secured shall be sent in the AUTOSAR TLV of a Follow_Up message.
          boolean EthTSynTxSubTLVTime: post-build-variant-value=true, set at pre-compile  # Definition of whether (true) or not (false) a Sub-TLV:Time Secured shall be sent in the AUTOSAR TLV of a Follow_Up message.
          boolean EthTSynTxSubTLVUserData: post-build-variant-value=true, set at pre-compile  # Definition of whether (true) or not (false) a Sub-TLV:UserData Secured or Sub-TLV:UserData Not Secured shall be sent in the AUTOSAR TLV of a Follow_Up message.
          container EthTSynCrcTimeFlagsTxSecured [0..1]: multiplicity set at pre-compile, post-build-variant-multiplicity=true  # This container collects definitions which parts of the Follow_Up message elements shall be used for CRC calculation.
            boolean EthTSynCrcCorrectionField: post-build-variant-value=true, set at pre-compile, default-value=false  # correctionField from the Follow_Up Message Header shall be included in CRC calculation.
            boolean EthTSynCrcDomainNumber: post-build-variant-value=true, set at pre-compile, default-value=false  # domainNumber from the Follow_Up Message Header shall be included in CRC calculation.
            boolean EthTSynCrcMessageLength: post-build-variant-value=true, set at pre-compile, default-value=false  # messageLength from the Follow_Up Message Header shall be included in CRC calculation.
            boolean EthTSynCrcPreciseOriginTimestamp: post-build-variant-value=true, set at pre-compile, default-value=true  # preciseOriginTimestamp from the Follow_Up Message Field shall be included in CRC calculation.
            boolean EthTSynCrcSequenceId: post-build-variant-value=true, set at pre-compile, default-value=false  # sequenceId from the Follow_Up Message Header shall be included in CRC calculation.
            boolean EthTSynCrcSourcePortIdentity: post-build-variant-value=true, set at pre-compile, default-value=false  # sourcePortIdentity from the Follow_Up Message Header shall be included in CRC calculation.
        container EthTSynGlobalTimeSlave [0..1]: multiplicity set at pre-compile, post-build-variant-multiplicity=true  # Configuration of a time slave. Each global time domain is required to have at least one time slave. The configured ECU may or may not represent a time slave.
          float EthTSynGlobalTimeFollowUpTimeout: 0..4, post-build-variant-value=true, set at pre-compile  # Timeout value of the Follow_Up message (of the subsequent Sync message). | A value of 0 deactivates this timeout observation. Unit: seconds
          integer EthTSynGlobalTimeSequenceCounterHysteresis: 0..15, post-build-variant-value=true, set at pre-compile, default-value=0  # EthTSynGlobalTimeSequenceCounterHysteresis specifies the number of consecutive valid message pairs that are required by the Time Slave while being in Timeout state until a Time Tuple is forwarded to the StbM.
          integer EthTSynGlobalTimeSequenceCounterJumpWidth: 0..65535, post-build-variant-value=true, set at pre-compile, default-value=0  # The SequenceCounterJumpWidth specifies the maximum allowed jump of the Sequence Counter between two consecutive Sync messages.
          enumeration EthTSynRxCrcValidated: {CRC_IGNORED, CRC_NOT_VALIDATED, CRC_OPTIONAL, CRC_VALIDATED}, post-build-variant-value=true, set at pre-compile  # Definition of whether or not validation of the CRC takes place.
          enumeration EthTSynRxIcvVerificationType: {ICV_IGNORED, ICV_NOT_VERIFIED, ICV_OPTIONAL, ICV_VERIFIED}, set at pre-compile  # This parameter controls whether or not ICV verification shall be supported.
          boolean EthTSynRxSubTLVStatus: multiplicity set at pre-compile, set at pre-compile, default-value=false  # Definition of whether or not a Sub-TLV:Status Secured or Sub-TLV:Status Not Secured shall be present and shall be evaluated when processing a received Follow_Up message.
          boolean EthTSynRxSubTLVTime: multiplicity set at pre-compile, set at pre-compile, default-value=false  # Definition of whether or not a Sub-TLV:Time Secured shall be present and shall be evaluated when processing a received Follow_Up message
          boolean EthTSynRxSubTLVUserData: multiplicity set at pre-compile, set at pre-compile, default-value=false  # Definition of whether or not a Sub-TLV:UserData Secured or Sub-TLV:UserData Not Secured shall be present and shall be evaluated when processing a received Follow_Up message
          container EthTSynCrcFlagsRxValidated [0..1]: multiplicity set at pre-compile, post-build-variant-multiplicity=true  # This container collects definitions which parts of the Follow_Up message elements shall be included in CRC validation.
            boolean EthTSynCrcCorrectionField: post-build-variant-value=true, set at pre-compile, default-value=false  # correctionField from the Follow_Up Message Header shall be included in CRC calculation.
            boolean EthTSynCrcDomainNumber: post-build-variant-value=true, set at pre-compile, default-value=false  # domainNumber from the Follow_Up Message Header shall be included in CRC calculation.
            boolean EthTSynCrcMessageLength: post-build-variant-value=true, set at pre-compile, default-value=false  # messageLength from the Follow_Up Message Header shall be included in CRC calculation.
            boolean EthTSynCrcPreciseOriginTimestamp: post-build-variant-value=true, set at pre-compile, default-value=true  # preciseOriginTimestamp from the Follow_Up Message Field shall be included in CRC calculation.
            boolean EthTSynCrcSequenceId: post-build-variant-value=true, set at pre-compile, default-value=false  # sequenceId from the Follow_Up Message Header shall be included in CRC calculation.
            boolean EthTSynCrcSourcePortIdentity: post-build-variant-value=true, set at pre-compile, default-value=false  # sourcePortIdentity from the Follow_Up Message Header shall be included in CRC calculation.
  module definition EthTrcv [0..*]: post-build-variant-support=true, variants link-time/post-build/pre-compile  # Configuration of Ethernet Transceiver Driver module
    container EthTrcvConfigSet  # This container contains the configuration parameters and sub containers of the AUTOSAR EthTrcv module.
      container EthTrcvConfig [1..*]  # Configuration of the individual transceiver
        boolean EthTrcvActAsSlavePassiveEnabled [0..1]: multiplicity set at pre-compile, set at pre-compile  # Specifies if the ECU is acting as a passive communication slave on the corresponding ComM channel (corresponding ComM channel has ComMNMVariant set to SLAVE_PASSIVE). Tags: atp.Status=draft | If the parameter is set to TRUE, the Ethernet transceiver driver shall poll the maintained Ethernet hardware for a signaled Sleep.Indication (according to OA TC10) in the context of the EthTrcv_MainFunction.
        enumeration EthTrcvConnNeg: {TRCV_CONN_NEG_AUTO, TRCV_CONN_NEG_MASTER, TRCV_CONN_NEG_NONE, TRCV_CONN_NEG_SLAVE}, post-build-variant-value=true, set at link in variant link-time / post-build in variant post-build / pre-compile in variant pre-compile  # Specifies the connection negotiation of the Ethernet transceiver link.
        enumeration EthTrcvDuplexMode: {ETHTRCV_DUPLEX_MODE_FULL, ETHTRCV_DUPLEX_MODE_HALF}, post-build-variant-value=true, set at link in variant link-time / post-build in variant post-build / pre-compile in variant pre-compile  # Specifies the duplex mode of the Ethernet transceiver link if Auto-Negotiation is disabled. This parameter is ignored if Auto-Negotiation is enabled (EthTrcvConnNeg=TRCV_CONN_NEG_AUTO).
        boolean EthTrcvEnablePLCA: set at pre-compile, default-value=false  # Enables the transmission with PLCA (Physical Layer Collision Avoidance) | TRUE: PLCA enabled FALSE: PLCA disabled
        boolean EthTrcvForceSleepEnabled: set at pre-compile  # Specifies if the Ethernet hardware (PHY) support to go to sleep without the confirmation of the Ethernet hardware (PHY) of the linked Ethernet communication partner according to the OA TC10. | If the parameter is set to TRUE, the Ethernet hardware (PHY) support to force its hardware state to the sleep state. This is used, if the Ethernet communication partner do not accept the Sleep.Request after the specified repetitions on Sleep.Request (see EthTrcvSleepRequestNumberOfRepetitions). If EthTrcvSleepRequestNumberOfRepetitions is not available, the EthTransceiver driver shall force the Ethernet hardware (PHY) to sleep state after the first unsuccessful Sleep.Request.
        integer EthTrcvIdx: 0..255, scope=ECU, set at pre-compile, symbolic-name-value=true, with-auto=true  # Specifies the instance ID of the configured transceiver.
        enumeration EthTrcvMacLayerSpeed [0..1]: {ETH_MAC_LAYER_SPEED_100M, ETH_MAC_LAYER_SPEED_10G, ETH_MAC_LAYER_SPEED_10M, ETH_MAC_LAYER_SPEED_1G, ETH_MAC_LAYER_SPEED_2500M, ETH_MAC_LAYER_SPEED_5G}, scope=ECU, multiplicity set at link in variant link-time+post-build / pre-compile in variant pre-compile, post-build-variant-multiplicity=true, post-build-variant-value=true, set at link in variant link-time+post-build / pre-compile in variant pre-compile  # Defines the baud rate of the MAC layer.
        enumeration EthTrcvMacLayerSubType [0..1]: {LIGHT, REDUCED, REVERSED, SERIAL, STANDARD, UNIVERSAL_SERIAL}, scope=ECU, multiplicity set at link in variant link-time+post-build / pre-compile in variant pre-compile, post-build-variant-multiplicity=true, post-build-variant-value=true, set at link in variant link-time+post-build / pre-compile in variant pre-compile  # Defines the MAC layer subtype of a switch port
        enumeration EthTrcvMacLayerType [0..1]: {TRCV_MAC_LAYER_TYPE_XGMII, TRCV_MAC_LAYER_TYPE_XMII, TRCV_MAC_LAYER_TYPE_XXGMII}, scope=ECU, multiplicity set at link in variant link-time / post-build in variant post-build / pre-compile in variant pre-compile, post-build-variant-multiplicity=true, post-build-variant-value=true, set at link in variant link-time / post-build in variant post-build / pre-compile in variant pre-compile  # Defines the MAC layer type of the ethernet transceiver.
        integer EthTrcvPhysLayerPlcaLocalNodeId [0..1]: 0..255, multiplicity set at pre-compile, set at pre-compile, default-value=255  # Configuration parameter for the transceiver node ID when the PLCA mode for 10BASE-T1S is used.
        integer EthTrcvPhysLayerPlcaMaxBurstCount [0..1]: 0..255, set at pre-compile  # Defines maximum packets allowed to be transmitted within a TO. The maximum burst count could differ per ECU within a PLCA mixed segment.
        integer EthTrcvPhysLayerPlcaMaxBurstTimer [0..1]: 0..255, set at pre-compile, default-value=128  # Limits the burst frames in bit time. The maximum burst time could differ per ECU within a PLCA mixed segment.
        integer EthTrcvPhysLayerPlcaNodeCount [0..1]: 0..255, multiplicity set at pre-compile, set at pre-compile, default-value=8  # Defines the number of communication participants on the mixed segment. This value is relevant for the head-node transceiver (EthTrcvPhysLayerNodeID = 0) in order to know when the BEACON has to be transmitted.
        integer EthTrcvPhysLayerPlcaTransmitOpportunityTimer [0..1]: 1..255, multiplicity set at pre-compile, set at pre-compile, default-value=32  # Timer for the transmission in bit time to evaluate if a Transmission Opportunity is yield or not.
        enumeration EthTrcvPhysLayerType [0..1]: {TRCV_PHYS_LAYER_TYPE_10000BASE_T1, TRCV_PHYS_LAYER_TYPE_1000BASE_T, TRCV_PHYS_LAYER_TYPE_1000BASE_T1, TRCV_PHYS_LAYER_TYPE_100BASE_T1, TRCV_PHYS_LAYER_TYPE_100BASE_TX, TRCV_PHYS_LAYER_TYPE_10BASE_T1S, TRCV_PHYS_LAYER_TYPE_2500BASE_T1, TRCV_PHYS_LAYER_TYPE_5000BASE_T1}, multiplicity set at link in variant link-time / post-build in variant post-build / pre-compile in variant pre-compile, post-build-variant-multiplicity=true, post-build-variant-value=true, set at link in variant link-time / post-build in variant post-build / pre-compile in variant pre-compile  # Specifies the physical layer type of the Ethernet transceiver link.
        float EthTrcvSleepModeExecutionDelay [0..1]: 0..INF, multiplicity set at pre-compile, set at pre-compile  # Specifies the time delay in seconds to execute a sleep (see OA TC10) for a Ethernet hardware (PHY), if a pending wake-up was detected while a ETH_MODE_DOWN was requested. | The value shall be an integral multiple of EthTrcvMainFunctionPeriod.
        integer EthTrcvSleepRequestNumberOfRepetitions: 0..255, set at pre-compile, default-value=0  # Specifies the repetitions to trigger a Sleep.Request (according to OA TC10) if a release of the communication channel was triggered by the upper layer (ETH_MODE_DOWN) and a SleepFail.Indication was signaled. Thus, the Ethernet hardware (PHY) of the connected communication partner did not accept the Sleep.Request.
        float EthTrcvSleepRequestRepetitionPeriod: 0..INF, set at pre-compile  # Specifies the repetition period in seconds of repetitions for a Sleep Request (according to OA TC10). | The value shall be a integral multiple of EthTrcvMainFunctionPeriod.
        enumeration EthTrcvSpeed: {TRCV_SPEED_10, TRCV_SPEED_100, TRCV_SPEED_1000, TRCV_SPEED_10000, TRCV_SPEED_2500, TRCV_SPEED_5000}, post-build-variant-value=true, set at link in variant link-time / post-build in variant post-build / pre-compile in variant pre-compile  # Specifies the speed of the Ethernet transceiver link in [MBit/s]. If AutoNegotiation is enabled (EthTrcvConnNeg=TRCV_CONN_NEG_AUTO) this is the maximum speed advertised for Auto-Negotiation.
        function name EthTrcvWakeUpCallout [0..1]: multiplicity set at pre-compile, set at pre-compile  # Configuration of the call-out name.
        boolean EthTrcvWakeupForwardLocalEnabled: set at pre-compile  # Specifies if remote wake up forwarding is enabled (TRUE) or disabled (FALSE) for OA TC10 compliant Ethernet Transceiver. | If the parameter is set to TRUE, the Ethernet hardware (PHY) activate a local wake up (e.g. via I/O pin), if a remote wake-up on data line (e.g. 100Base-T1) was received (either WUP or WUR).
        boolean EthTrcvWakeupForwardRemoteEnabled: set at pre-compile  # Specifies if local wake up forwarding is enabled (TRUE) or disabled (FALSE) for OA TC10 compliant Ethernet Transceiver. | If the parameter is set to TRUE, the Ethernet hardware (PHY) transmit a wake-up (WUP or WUR on the data line (e.g. 100Base-T1), when a local wake-up occurred (e.g. via I/O pin), which was triggered by neighboring Ethernet hardware (PHY).
        float EthTrcvWakeupLocalDetectionTime [0..1]: 1E-5..0.1, multiplicity set at link in variant link-time+post-build / pre-compile in variant pre-compile, set at link in variant link-time+post-build / pre-compile in variant pre-compile  # Defines the time in seconds when a local wake-up (e.g. via I/O pin) triggered by a neighboring PHY is evalutated as a valid wake-up.
        float EthTrcvWakeupLocalDurationTime [0..1]: 4E-5..0.1, multiplicity set at link in variant link-time+post-build / pre-compile in variant pre-compile, set at link in variant link-time+post-build / pre-compile in variant pre-compile  # Defines the duration time in seconds how long a local wake-up should be present on the local wake-up connection (e.g. via I/O pin) to indicate the neighboring PHYs about a wake-up.
        boolean EthTrcvWakeupLocalEnabled: set at pre-compile  # Specifies if local wake-up is enabled (TRUE) or disabled (FALSE) for OA TC10 compliant Ethernet hardware (PHY). | If the parameter is set to TRUE, the Ethernet hardware (PHY) is able to detect and react on a wake-up received by a neighboring PHY (e.g. via I/O pin).
        boolean EthTrcvWakeupRemoteEnabled: set at pre-compile  # Specifies if remote wake-up is enabled (TRUE) or disabled (FALSE) for OA TC10 compliant Ethernet hardware (PHY). | If the parameter is set to TRUE, the Ethernet hardware (PHY) wake up when receiving a remote wake-up (e.g. via 100Base-T1 data line) triggered by the connected communication partner.
        integer EthTrcvWakeupRequestNumberOfRepetitions: 0..255, set at pre-compile, default-value=0  # Specifies the repetitions to trigger a wake-up request (according to OA TC10), if an active communication request (ETH_MODE_ACTIVE_WITH_WAKEUP_REQUEST) was triggered by the upperlayer.
        float EthTrcvWakeUpRequestRepetitionPeriod [0..1]: 0..INF, multiplicity set at pre-compile, set at pre-compile  # Specifies the repetition period in seconds of a wake-up request, if an active communication request (ETH_MODE_ACTIVE_WITH_WAKEUP_REQUEST) was triggered by the upperlayer. | The value shall be an integral multiple of EthTrcvMainFunctionPeriod.
        boolean EthTrcvWakeupSleepOnDatalineEnabled [0..1]: multiplicity set at pre-compile, set at pre-compile  # Specifies if wake-up on data line according to OA TC10 is supported by the used Ethernet hardware (PHY) and if the functionality (wake-up and sleep on dataline) is enabled. | If the parameter is configured, wake-up and sleep on data line is supported according to OA TC10 by the used Ethernet hardware (PHY). If the parameter is set to TRUE, the wake-up and sleep on data line functionality according to OA TC10 is enabled. If the parameter is set to FALSE, the wake-up and sleep on data line functionality according to OA TC10 is disabled. Note: Disabling of the wake-up and sleep functionality is used if Ethernet hardware (PHY) parts are connected, where one PHY do not support the OA TC10 wake-up and sleep on dataline functionality. This may needed for legacy scenarios, where ECUs are taken over from previous car lines and no OA TC10 Ethernet hardware (PHY) were used.
        reference EthTrcvConfigEcucPartitionRef [0..1]: scope=ECU, multiplicity set at pre-compile, post-build-variant-multiplicity=true, post-build-variant-value=true, set at pre-compile, destination=EcucPartition  # Maps the Ethernet transceiver configuration to zero or one ECUC partitions. The ECUC partition referenced is a subset of the ECUC partitions where the Ethernet transceiver driver is mapped to.
        reference EthTrcvIcuChannelRef [0..1]: multiplicity set at pre-compile, set at pre-compile, requires-symbolic-name-value=true, destination=IcuChannel  # Reference to the IcuChannel to enable/disable the interrupts for wakeups.
        container EthTrcvDemEventParameterRefs [0..1]  # Container for the references to DemEventParameter elements which shall be invoked using the API Dem_SetEventStatus in case the corresponding error occurs. The EventId is taken from the referenced DemEventParameter's DemEventId symbolic value. The standardized errors are provided in this container and can be extended by vendor-specific error references.
          reference ETHTRCV_E_ACCESS [0..1]: multiplicity set at link in variant link-time / post-build in variant post-build / pre-compile in variant pre-compile, post-build-variant-multiplicity=true, post-build-variant-value=true, set at link in variant link-time / post-build in variant post-build / pre-compile in variant pre-compile, requires-symbolic-name-value=true, destination=DemEventParameter  # Reference to the DemEventParameter which shall be issued when the error "Transceiver access failed" has occurred.
        choice container EthTrcvMgmtInterface [0..1]: multiplicity set at pre-compile  # The choice container allow to configure either the EthTrcv is accessed by a MII interface or Switch interface.
          container EthTrcvMiiInterface [0..1]: multiplicity set at pre-compile  # This container includes the MII interface configuration between an Ethernet Controller and the Ethernet Transceiver. If this container is configured the EthTrcv shall call Eth_WriteMii / Eth_ReadMii API to access the hardware ethernet tranceiver. | Note: In case of external MACPHY use this parameter may be enabled.
            integer EthTrcvCtrlIdx: 0..255, post-build-variant-value=true, set at link in variant link-time / post-build in variant post-build / pre-compile in variant pre-compile  # Specifies the controller used for MII access to the transceiver
            integer EthTrcvMiiIdx: 0..255, set at pre-compile  # Specifies the transceiver index used for MII access to the transceiver.
          container EthTrcvSwitchInterface [0..1]: multiplicity set at pre-compile  # This container includes the Switch interface configuration between an Ethernet Switch and an Ethernet Transceiver. If this container is configured the EthTrcv shall call EthSwt_WriteTrcvRegister / EthSwt_WriteTrcvRegister API to access the hardware ethernet transceiver.
            reference EthTrcvSwitchPortRef: set at pre-compile, requires-symbolic-name-value=true, destination=EthSwtPort  # Reference to a switch port.
            reference EthTrcvSwitchRef: set at pre-compile, requires-symbolic-name-value=true, destination=EthSwtConfig  # Reference to a switch configuration container.
        container EthTrcvWakeupMap [0..7]  # Container for the mapping of wake up reasons to wake up sources. At least one container is needed if EthTrcvWakeUpSupport is not ETHTRCV_WAKEUP_NOT_SUPPORTED.
          enumeration EthTrcvWakeupReason: {ETHTRCV_WUR_BUS, ETHTRCV_WUR_GENERAL, ETHTRCV_WUR_INTERNAL, ETHTRCV_WUR_PIN, ETHTRCV_WUR_POWER_ON, ETHTRCV_WUR_RESET, ETHTRCV_WUR_SYSERR}, post-build-variant-value=true, set at link in variant link-time / post-build in variant post-build / pre-compile in variant pre-compile  # This parameter defines the transceiver wake up reasons.
          reference EthTrcvWakeupSourceRef: set at pre-compile, requires-symbolic-name-value=true, destination=EcuMWakeupSource  # Configures the wake-up source defined in EcuM.
    container EthTrcvGeneral  # General configuration of Ethernet Transceiver Driver module
      boolean EthTrcvDevErrorDetect: set at pre-compile, default-value=false  # Switches the development error detection and notification on or off. | * true: detection and notification is enabled. * false: detection and notification is disabled.
      boolean EthTrcvEnableCableDiagnosticApi: set at pre-compile  # Enable/disable the APIs for cable diagnostic: EthTrcv_RunCableDiagnostic, EthTrcv_GetCableDiagnosticsResult
      boolean EthTrcvGetBaudRateApi: set at pre-compile  # Enables / Disables EthTrcv_GetBaudRate API
      boolean EthTrcvGetBusWuReasonApi: set at pre-compile, default-value=false  # Enables / Disables API to obtain the recent wake-up reason detected by the used Ethernet hardware (e.g. PHY).
      boolean EthTrcvGetDuplexModeApi: set at pre-compile  # Enables / Disables EthTrcv_GetDuplexMode API
      boolean EthTrcvGetLinkStateApi: set at pre-compile  # Enables / Disables EthTrcv_GetLinkState API
      boolean EthTrcvGetPhyIdentifierApi: multiplicity set at pre-compile, set at pre-compile  # Enables / Disables EthTrcv_GetPhyIdentifier API.
      boolean EthTrcvGetTransceiverWakeupModeApi [0..1]: multiplicity set at pre-compile, set at pre-compile  # Enables / Disables EthTrcv_GetTransceiverWakeupMode API
      integer EthTrcvIndex: 0..255, set at pre-compile  # Specifies the InstanceId of this module instance. If only one instance is present it shall have the Id 0.
      float EthTrcvMainFunctionPeriod [0..1]: 0..INF, multiplicity set at pre-compile, set at pre-compile  # Specifies the period of main function EthTrcv_MainFunction in seconds.
      integer EthTrcvMaxTrcvsSupported: 0..255, set at pre-compile, default-value=1
      boolean EthTrcvSetPhyTestModeApi: multiplicity set at pre-compile, set at pre-compile  # Enables / Disables EthTrcv_SetPhyTestMode API.
      boolean EthTrcvStartAutoNegotiationApi: set at pre-compile  # Enables / Disables EthTrcv_StartAutoNegotiation API
      boolean EthTrcvVersionInfoApi: set at pre-compile, default-value=false  # Enables / Disables version info API
      boolean EthTrcvVersionInfoApiMacro: set at pre-compile, default-value=false  # Enables / Disables version info API macro implementation
      enumeration EthTrcvWakeUpSupport: {ETHTRCV_WAKEUP_BY_ASYNCHRONOUS_CHECK, ETHTRCV_WAKEUP_BY_INTERRUPT, ETHTRCV_WAKEUP_BY_POLLING, ETHTRCV_WAKEUP_NOT_SUPPORTED}, set at pre-compile  # Configures how to detect a signaled wake-up by hardware: polling, asychronous check via signal, interrupt or to not used/not supported. In case detection of a wake-up is not support (e.g. wake-up detection not needed or Ethernet hardware does not support wake-up detection), the BSWMD pre-configuration shall be set to ETHTRCV_WAKEUP_NOT_SUPPORTED.
      reference EthTrcvEcucPartitionRef [0..*]: scope=ECU, multiplicity set at pre-compile, post-build-variant-multiplicity=true, post-build-variant-value=true, set at pre-compile, destination=EcucPartition  # Maps the Ethernet transceiver driver to zero or multiple ECUC partitions to make the modules API available in this partition.
  module definition Fee [0..1]: variants pre-compile  # Configuration of the Fee (Flash EEPROM Emulation) module.
    container FeeBlockConfiguration [1..*]  # Configuration of block specific parameters for the Flash EEPROM Emulation module.
      integer FeeBlockNumber: 1..65534, scope=ECU, set at pre-compile, symbolic-name-value=true  # Block identifier (handle). | 0x0000 and 0xFFFF shall not be used for block numbers (see FEE006). Range: min = 2^NVM_DATASET_SELECTION_BITS max = 0xFFFF -2^NVM_DATASET_SELECTION_BITS Note: Depending on the number of bits set aside for dataset selection several other block numbers shall also be left out to ease implementation.
      integer FeeBlockSize: 1..65535, scope=ECU, set at pre-compile  # Size of a logical block in bytes.
      boolean FeeImmediateData: scope=ECU, set at pre-compile  # Marker for high priority data. | true: Block contains immediate data. false: Block does not contain immediate data.
      integer FeeNumberOfWriteCycles: 0..4294967295, set at pre-compile  # Number of write cycles required for this block.
      reference FeeMemAccAddressArea [0..1]: multiplicity set at pre-compile, set at pre-compile, requires-symbolic-name-value=true, destination=MemAccAddressAreaConfiguration  # Reference to the MemAccAddressAreaConfiguration. Tags: atp.Status=draft
    container FeeGeneral  # Container for general parameters. These parameters are not specific to a block.
      boolean FeeDevErrorDetect: set at pre-compile, default-value=false  # Switches the development error detection and notification on or off. | * true: detection and notification is enabled. * false: detection and notification is disabled.
      float FeeMainFunctionPeriod: 0..INF, scope=ECU, set at pre-compile  # The period between successive calls to the main function in seconds.
      integer FeeMinimumReadPageSize: 0..65535, set at pre-compile  # Minimum Page size will be a multiple of the minimum page size. Fee shall align read requests to this size. Tags: atp.Status=draft
      function name FeeNvmJobEndNotification [0..1]: multiplicity set at pre-compile, set at pre-compile  # Mapped to the job end notification routine provided by the upper layer module (NvM_JobEndNotification).
      function name FeeNvmJobErrorNotification [0..1]: multiplicity set at pre-compile, set at pre-compile  # Mapped to the job error notification routine provided by the upper layer module (NvM_JobErrorNotification).
      boolean FeePollingMode: set at pre-compile  # Pre-processor switch to enable and disable the polling mode for this module. | true: Polling mode enabled, callback functions (provided to MemAcc module) disabled. false: Polling mode disabled, callback functions (provided to MemAcc module) enabled.
      boolean FeeVersionInfoApi: set at pre-compile, default-value=false  # Pre-processor switch to enable / disable the API to read out the modules version information. | true: Version info API enabled. false: Version info API disabled.
      integer FeeVirtualPageSize: 0..65535, set at pre-compile  # The size in bytes to which logical blocks shall be aligned.
      reference FeeBufferAlignmentValue: set at pre-compile, requires-symbolic-name-value=true, destination=MemAccAddressAreaConfiguration  # Parameter determines the alignment of the start address that Fee buffers need to have. Tags: atp.Status=draft | Value shall be inherited from MemAccBufferAlignmentValue.
    container FeePublishedInformation  # Additional published parameters not covered by CommonPublishedInformation container. | Note that these parameters do not have any configuration class setting, since they are published information.
      integer FeeBlockOverhead: 0..65535, set at published-information  # Management overhead per logical block in bytes. | Note: If the management overhead depends on the block size or block location a formula has to be provided that allows the configurator to calculate the management overhead correctly.
      integer FeePageOverhead: 0..65535, set at published-information  # Management overhead per page in bytes. | Note: If the management overhead depends on the block size or block location a formula has to be provided that allows the configurator to calculate the management overhead correctly.
  module definition FiM [0..1]: post-build-variant-support=true, variants post-build/pre-compile  # Configuration of the FiM (Function Inhibition Manager) module.
    container FiMConfigSet  # This container contains the configuration parameters and sub containers of the FiM module supporting multiple configuration sets.
      container FiMFID [1..*]  # This container includes symbolic names of all FIDs.
        integer FiMFunctionId: 0..65535, scope=ECU, set at pre-compile, symbolic-name-value=true  # Unique identifier of a FimFunctionId. This parameter should not be changeable by user, because the Id should be generated by Fim itself to prevent gaps and multiple use of an Id. | Note: The implementer can add the attribute 'withAuto' to the parameter definition which indicates that the value can be calculated by the generator automatically. When 'withAuto' is set to 'true' for this parameter definition the 'isAutoValue' can be set to 'true'. If 'isAutoValue' is set to 'true' the actual value will not be considered during ECU Configuration but will be (re-)calculated by the code generator and stored in the value attribute afterwards.
        container FiMCallbackFIDStatusChanged [0..1]: multiplicity set at pre-compile  # The presence of this container sets up the callout function FIDStatusChanged for this FID.
          function name FiMCallbackFIDStatusChangedFnc [0..1]: multiplicity set at pre-compile, set at pre-compile  # If this parameter is configured, it defines the c callout function name that is called when the FID state changes. If this parameter is not configured, the operation CBFidStatusChanged on the C/S interface FiM_FunctionInhibition is called.
      container FiMInhibitionConfiguration [1..*]: multiplicity set at post-build in variant post-build / pre-compile in variant pre-compile, post-build-variant-multiplicity=true  # This container includes all configuration parameters concerning the relationship between event and FID.
        enumeration FiMInhInhibitionMask: {FIM_LAST_FAILED, FIM_NOT_TESTED, FIM_TESTED, FIM_TESTED_AND_FAILED}, post-build-variant-value=true, set at post-build in variant post-build / pre-compile in variant pre-compile  # The configuration parameter is used to specify the inhibition mask for an event - FID relation.
        reference FiMInhComponentRef [0..*]: multiplicity set at post-build in variant post-build / pre-compile in variant pre-compile, post-build-variant-multiplicity=true, post-build-variant-value=true, set at post-build in variant post-build / pre-compile in variant pre-compile, destination=DemComponent  # Reference to a DemComponent which is necessary for function permission.
        reference FiMInhEventRef [0..*]: multiplicity set at post-build in variant post-build / pre-compile in variant pre-compile, post-build-variant-multiplicity=true, post-build-variant-value=true, set at post-build in variant post-build / pre-compile in variant pre-compile, requires-symbolic-name-value=true, destination=DemEventParameter  # Selection of an single DEM Event.
        reference FiMInhFunctionIdRef: post-build-variant-value=true, set at post-build in variant post-build / pre-compile in variant pre-compile, destination=FiMFID
        reference FiMInhSumRef [0..*]: multiplicity set at post-build in variant post-build / pre-compile in variant pre-compile, post-build-variant-multiplicity=true, post-build-variant-value=true, set at post-build in variant post-build / pre-compile in variant pre-compile, destination=FiMSummaryEvent  # Selection of a summarized Event.
      container FiMSummaryEvent [0..*]: multiplicity set at post-build in variant post-build / pre-compile in variant pre-compile, post-build-variant-multiplicity=true  # The summarized EventId definition record consists of a summarized event ID and specific Dem Events. | This record means that a particular FID that has to be disabled in case of summarized event (defined above) is to be disabled in any of the specific events. A possible solution could be assigning events as summarized events along with a list of specific events. During the configuration process the summarized event substitutes the referenced single events. However, it is not outlined how this requirement is solved - whether by configuration process or by implementation within the FiM. The FiM configuration tool could also build up a suitable data structure for summarized events and deal with it in the FiM implementation.
        reference FiMInputEventRef [1..*]: multiplicity set at post-build in variant post-build / pre-compile in variant pre-compile, post-build-variant-multiplicity=true, post-build-variant-value=true, set at post-build in variant post-build / pre-compile in variant pre-compile, requires-symbolic-name-value=true, destination=DemEventParameter  # Reference to DemEventParameters combined to this summarized event.
    container FiMGeneral
      boolean FiMAvailabilitySupport: set at pre-compile, default-value=false  # This configuration parameter specifies, if the Fim shall support the service to set the Availabity of a Funtionality. | true: Service is supported. false: Service is not supported
      boolean FiMDevErrorDetect: set at pre-compile, default-value=false  # Switches the development error detection and notification on or off. | * true: detection and notification is enabled. * false: detection and notification is disabled.
      boolean FiMEventUpdateTriggeredByDem: set at pre-compile  # This configuration parameter specifies the way FIM obtains status of EventIds. | TRUE: the DEM informs FIM about changes of monitor status, FALSE: the FIM polls monitor status from the DEM module either cyclically or on demand.
      float FiMMainFunctionPeriod: 0..INF, set at pre-compile  # Allow to configure the time for the periodic cyclic task. | Please note: This configuration value shall be equal to the value in the Basic Software Scheduler configuration of the RTE module. The AUTOSAR configuration standard is to use SI units, so this parameter is defined as float value in seconds. FiM configuration tools shall convert this float value to the appropriate value format for the use in the software implementation of FiM.
      integer FiMMaxEventsPerFidInhibitionConfiguration [0..1]: 1..65535, set at pre-compile  # This configuration parameter specifies the total maximum number of inhibiting events in a FiMInhibitionConfiguration. | Its applicable for post build configuration versions only and may be used to allocate the maximum size of memory to store and execute the configuration.
      integer FiMMaxFiMInhibitionConfigurations [0..1]: 1..65535, set at pre-compile  # This configuration parameter specifies the total maximum number of FiMInhibitionConfigurations. | Its applicable for post build configuration versions only and may be used to allocate the maximum size of memory to store and execute the configuration.
      integer FiMMaxInputEventsPerSummaryEvents [0..1]: 1..65535, set at pre-compile  # This configuration parameter specifies the total maximum number of input events per summary event. | Its applicable for post build configuration versions only and may be used to allocate the maximum size of memory to store and execute the configuration.
      integer FiMMaxSumEventsPerFidInhibitionConfiguration [0..1]: 1..65535, set at pre-compile  # This configuration parameter specifies the total maximum number of inhibiting summary events in a FiMInhibitionConfiguration. | Its applicable for post build configuration versions only and may be used to allocate the maximum size of memory to store and execute the configuration.
      integer FiMMaxSummaryEvents: 0..65535, set at pre-compile  # This configuration parameter specifies the maximum number of summarized events that can be configured.
      boolean FiMVersionInfoApi: set at pre-compile, default-value=false  # This configuration parameter is used to switch on or to switch off the API to get the version information.
  module definition Firewall [0..1]: post-build-variant-support=true, variants link-time/post-build/pre-compile  # Configuration of the Firewall module. Tags: atp.Status=draft
    container FirewallConfig  # This container contains the configuration parameters and sub containers of the Firewall module. Tags: atp.Status=draft
      reference FirewallInitialStateRef: multiplicity set at link in variant link-time / post-build in variant post-build / pre-compile in variant pre-compile, post-build-variant-multiplicity=true, post-build-variant-value=true, set at link in variant link-time / post-build in variant post-build / pre-compile in variant pre-compile, destination=FirewallState  # Reference to the Firewall State that is defined as the default state. Tags: atp.Status=draft
      container FirewallEthernetFrame [1..*]: multiplicity set at link in variant link-time / post-build in variant post-build / pre-compile in variant pre-compile, post-build-variant-multiplicity=true  # An ethernet frame to be filtered. Tags: atp.Status=draft
        container FirewallLowerLayerPdu  # Represents the lower layer PDU associated with an EthernetFrame. This PDU is usually linked to the EthIf via LSduR. It may accept any meta data item types for forwarding to the upper layer, but may consume meta data items of the types BROADCAST_8 and FILTER_RULE_ID_16. Tags: atp.Status=draft
          integer FirewallLowerLayerPduId: 0..65535, scope=ECU, set at pre-compile, symbolic-name-value=true, with-auto=true  # PDU identifier used for RxIndication from LSduR. Tags: atp.Status=draft
          reference FirewallLowerLayerPduRef: scope=ECU, post-build-variant-value=true, set at link in variant link-time / post-build in variant post-build / pre-compile in variant pre-compile, destination=Pdu  # Reference to the global PDU. Tags: atp.Status=draft
        container FirewallUpperLayerPdu  # Represents the upper layer PDU associated with an EthernetFrame. This PDU is linked to the LSduR and its upper layer modules, e.g. the TcpIp. It may provide any meta data item types forwarded from the lower layer. Tags: atp.Status=draft
          integer FirewallUpperLayerPduId: 0..65535, scope=ECU, set at pre-compile, symbolic-name-value=true, with-auto=true  # PDU identifier used for ReleaseRxBuffer from LSduR. Tags: atp.Status=draft
          reference FirewallUpperLayerPduRef: scope=ECU, post-build-variant-value=true, set at link in variant link-time / post-build in variant post-build / pre-compile in variant pre-compile, destination=Pdu  # Reference to the global PDU. Tags: atp.Status=draft
    container FirewallGeneral  # Contains the general configuration parameters of the module. Tags: atp.Status=draft
      boolean FirewallDevErrorDetect: set at pre-compile, default-value=false  # Switches the development error detection and notification on or off. Tags: atp.Status=draft | * true: detection and notification is enabled. * false: detection and notification is disabled.
      float FirewallMainFunctionPeriod: 0..INF, set at pre-compile, default-value=0.05  # Execution cycle of the respective Firewall_MainFunction instance in seconds. Tags: atp.Status=draft
      float FirewallSwitchRuleMgmtTimeout [0..1]: 0..INF, multiplicity set at pre-compile, set at pre-compile  # Timeout to wait for a confirmation of a switch core configuration request. Tags: atp.Status=draft
      boolean FirewallVersionInfoApi: set at pre-compile, default-value=false  # Pre-processor switch for enabling version info API support. Tags: atp.Status=draft
      boolean FirwallEnableSecurityEventReporting: scope=ECU, set at pre-compile, default-value=false  # Switches the reporting of security events to the IdsM: Tags: atp.Status=draft | - true: reporting is enabled. - false: reporting is disabled.
      container FirewallSecurityEventRefs [0..1]: multiplicity set at pre-compile  # Container for the references to IdsMEvent elements representing the security events that the Firwall module shall report to the IdsM in case the coresponding security related event occurs (and if FirewallEnableSecurityEventReporting is set to "true"). The standardized security events in this container can be extended by vendor-specific security events. Tags: atp.Status=draft
        reference SEV_FW_PACKET_BLOCKED_BY_PERSTREAMFILTERING [0..1]: multiplicity set at pre-compile, set at pre-compile, requires-symbolic-name-value=true, destination=IdsMEvent  # A network packet was blocked due to per-stream filtering in the switch Tags: atp.Status=draft
        reference SEV_FW_PACKET_BLOCKED_DATALINKLAYER_MISMATCH [0..1]: multiplicity set at pre-compile, set at pre-compile, requires-symbolic-name-value=true, destination=IdsMEvent  # A network packet was blocked due to a rule mismatch on data link layer Tags: atp.Status=draft
        reference SEV_FW_PACKET_BLOCKED_DDS_MISMATCH [0..1]: multiplicity set at pre-compile, set at pre-compile, requires-symbolic-name-value=true, destination=IdsMEvent  # A network packet was blocked due to a rule mismatch in the DDS-RTPS protocol Tags: atp.Status=draft
        reference SEV_FW_PACKET_BLOCKED_DOIP_MISMATCH [0..1]: multiplicity set at pre-compile, set at pre-compile, requires-symbolic-name-value=true, destination=IdsMEvent  # A network packet was blocked due to a rule mismatch in the DoIP protocol Tags: atp.Status=draft
        reference SEV_FW_PACKET_BLOCKED_GENERIC_MISMATCH [0..1]: multiplicity set at pre-compile, set at pre-compile, requires-symbolic-name-value=true, destination=IdsMEvent  # A network packet was blocked due to a rule mismatch on generic inspection level Tags: atp.Status=draft
        reference SEV_FW_PACKET_BLOCKED_ICMP_MISMATCH [0..1]: multiplicity set at pre-compile, set at pre-compile, requires-symbolic-name-value=true, destination=IdsMEvent  # A network packet was blocked due to a rule mismatch within the ICMP protocol Tags: atp.Status=draft
        reference SEV_FW_PACKET_BLOCKED_IPV4_MISMATCH [0..1]: multiplicity set at pre-compile, set at pre-compile, requires-symbolic-name-value=true, destination=IdsMEvent  # A network packet was blocked due to a rule mismatch on IPv4 layer Tags: atp.Status=draft
        reference SEV_FW_PACKET_BLOCKED_IPV6_MISMATCH [0..1]: multiplicity set at pre-compile, set at pre-compile, requires-symbolic-name-value=true, destination=IdsMEvent  # A network packet was blocked due to a rule mismatch on IPv6 layer Tags: atp.Status=draft
        reference SEV_FW_PACKET_BLOCKED_RATELIMIT [0..1]: multiplicity set at pre-compile, set at pre-compile, requires-symbolic-name-value=true, destination=IdsMEvent  # A network packet was blocked due to the rate limit was reached Tags: atp.Status=draft
        reference SEV_FW_PACKET_BLOCKED_SOMEIP_MISMATCH [0..1]: multiplicity set at pre-compile, set at pre-compile, requires-symbolic-name-value=true, destination=IdsMEvent  # A network packet was blocked due to a rule mismatch in the SOME/IP protocol Tags: atp.Status=draft
        reference SEV_FW_PACKET_BLOCKED_SOMEIPSD_MISMATCH [0..1]: multiplicity set at pre-compile, set at pre-compile, requires-symbolic-name-value=true, destination=IdsMEvent  # A network packet was blocked due to a rule mismatch in the SOME/IP SD protocol Tags: atp.Status=draft
        reference SEV_FW_PACKET_BLOCKED_TCP_MAXCONNECTIONS [0..1]: multiplicity set at pre-compile, set at pre-compile, requires-symbolic-name-value=true, destination=IdsMEvent  # A network packet was blocked due to the maximal number of open Tags: atp.Status=draft | TCP connections was reached
        reference SEV_FW_PACKET_BLOCKED_TCP_MISMATCH [0..1]: multiplicity set at pre-compile, set at pre-compile, requires-symbolic-name-value=true, destination=IdsMEvent  # A network packet was blocked due to a rule mismatch on TCP layer Tags: atp.Status=draft
        reference SEV_FW_PACKET_BLOCKED_TCP_STATETRANSITION [0..1]: multiplicity set at pre-compile, set at pre-compile, requires-symbolic-name-value=true, destination=IdsMEvent  # A network packet was blocked due to an invalid TCP state transition Tags: atp.Status=draft
        reference SEV_FW_PACKET_BLOCKED_TCP_TIMEOUT [0..1]: multiplicity set at pre-compile, set at pre-compile, requires-symbolic-name-value=true, destination=IdsMEvent  # A network packet was blocked due to TCP timeout Tags: atp.Status=draft
        reference SEV_FW_PACKET_BLOCKED_UDP_MISMATCH [0..1]: multiplicity set at pre-compile, set at pre-compile, requires-symbolic-name-value=true, destination=IdsMEvent  # A network packet was blocked due to a rule mismatch on UDP layer Tags: atp.Status=draft
    container FirewallRule [1..*]: multiplicity set at link in variant link-time / post-build in variant post-build / pre-compile in variant pre-compile, post-build-variant-multiplicity=true  # Firewall Rule that defines the control information in individual packets. Tags: atp.Status=draft
      integer FirewallBucketSize [0..1]: 0..65535, multiplicity set at link in variant link-time / post-build in variant post-build / pre-compile in variant pre-compile, post-build-variant-multiplicity=true, post-build-variant-value=true, set at pre-compile  # This attribute defines the capacity of the queue for rate limitation (leaky-bucket Algorithm). Tags: atp.Status=draft
      integer FirewallRefillAmount [0..1]: 0..65535, multiplicity set at link in variant link-time / post-build in variant post-build / pre-compile in variant pre-compile, post-build-variant-multiplicity=true, post-build-variant-value=true, set at link in variant link-time / post-build in variant post-build / pre-compile in variant pre-compile  # This attribute defines the output rate that describes how many packets leave the queue per second (leaky-bucket Algorithm). Tags: atp.Status=draft
      container FirewallDataLinkFilterConfig [0..1]: multiplicity set at link in variant link-time / post-build in variant post-build / pre-compile in variant pre-compile, post-build-variant-multiplicity=true  # Configuration of filter rules on the DataLink layer Tags: atp.Status=draft
        integer FirewallFilterEtherType [0..1]: 0..65535, multiplicity set at pre-compile, set at pre-compile  # Definition of the filter Ether Type. Tags: atp.Status=draft
        integer FirewallFilterVlanId [0..1]: 0..4094, multiplicity set at pre-compile, set at pre-compile  # Definition of the filter VLAN ID. Tags: atp.Status=draft
        integer FirewallFilterVlanPriority [0..1]: 0..7, multiplicity set at pre-compile, set at pre-compile  # Definition of the filter VLAN Priority. Tags: atp.Status=draft
        container FirewallFilterMACDestAddress [0..1]: multiplicity set at link in variant link-time / post-build in variant post-build / pre-compile in variant pre-compile, post-build-variant-multiplicity=true  # Configuration of one MAC destination filter. Tags: atp.Status=draft
          string FirewallFilterMACAddressKey: post-build-variant-value=true, set at link in variant link-time / post-build in variant post-build / pre-compile in variant pre-compile, max-length=17, min-length=17, regular-expression=([0-9a-fA-F]\{2}:)\{5}[0-9a-fA-F]\{2}  # Specifies the 48-bit physical address (MAC address) key value. Tags: atp.Status=draft
          string FirewallFilterMACAddressMask: post-build-variant-value=true, set at link in variant link-time / post-build in variant post-build / pre-compile in variant pre-compile, max-length=17, min-length=17, regular-expression=([0-9a-fA-F]\{2}:)\{5}[0-9a-fA-F]\{2}  # Specifies the 48-bit physical address (MAC address) mask value. Tags: atp.Status=draft
        container FirewallFilterMACSrcAddress [0..1]: multiplicity set at link in variant link-time / post-build in variant post-build / pre-compile in variant pre-compile, post-build-variant-multiplicity=true  # Configuration of one MAC source filter. Tags: atp.Status=draft
          string FirewallFilterMACAddressKey: post-build-variant-value=true, set at link in variant link-time / post-build in variant post-build / pre-compile in variant pre-compile, max-length=17, min-length=17, regular-expression=([0-9a-fA-F]\{2}:)\{5}[0-9a-fA-F]\{2}  # Specifies the 48-bit physical address (MAC address) key value. Tags: atp.Status=draft
          string FirewallFilterMACAddressMask: post-build-variant-value=true, set at link in variant link-time / post-build in variant post-build / pre-compile in variant pre-compile, max-length=17, min-length=17, regular-expression=([0-9a-fA-F]\{2}:)\{5}[0-9a-fA-F]\{2}  # Specifies the 48-bit physical address (MAC address) mask value. Tags: atp.Status=draft
      container FirewallDdsFilterConfig [0..1]: multiplicity set at link in variant link-time / post-build in variant post-build / pre-compile in variant pre-compile, post-build-variant-multiplicity=true  # Configuration of filter rules for Dds Tags: atp.Status=draft
        integer FirewallDdsAppId [0..1]: 0..4294967295, multiplicity set at link in variant link-time / post-build in variant post-build / pre-compile in variant pre-compile, post-build-variant-multiplicity=true, post-build-variant-value=true, set at link in variant link-time / post-build in variant post-build / pre-compile in variant pre-compile  # Filter for DDSI-RTPS messages in which the appId in the DDSI-RTPS header and the INFO_DST (0x0E) submessage matches. Tags: atp.Status=draft
        integer FirewallDdsHostId [0..1]: 0..4294967295, multiplicity set at link in variant link-time / post-build in variant post-build / pre-compile in variant pre-compile, post-build-variant-multiplicity=true, post-build-variant-value=true, set at link in variant link-time / post-build in variant post-build / pre-compile in variant pre-compile  # Filter for DDSI-RTPS messages in which the hostId in the DDSI-RTPS header and the INFO_DST (0x0E) submessage matches. Tags: atp.Status=draft
        integer FirewallDdsInstanceId [0..1]: 0..4294967295, multiplicity set at link in variant link-time / post-build in variant post-build / pre-compile in variant pre-compile, post-build-variant-multiplicity=true, post-build-variant-value=true, set at link in variant link-time / post-build in variant post-build / pre-compile in variant pre-compile  # Filter for DDSI-RTPS messages in which the instanceId in the DDSI-RTPS header and the INFO_DST (0x0E) submessage matches. Tags: atp.Status=draft
        integer FirewallDdsMajorProtocolVersion [0..1]: 0..255, multiplicity set at link in variant link-time / post-build in variant post-build / pre-compile in variant pre-compile, post-build-variant-multiplicity=true, post-build-variant-value=true, set at link in variant link-time / post-build in variant post-build / pre-compile in variant pre-compile  # Filter for DDSI-RTPS messages in which the majorProtocolVersion in the DDSI-RTPS header matches. Tags: atp.Status=draft
        integer FirewallDdsMinorProtocolVersion [0..1]: 0..255, multiplicity set at link in variant link-time / post-build in variant post-build / pre-compile in variant pre-compile, post-build-variant-multiplicity=true, post-build-variant-value=true, set at link in variant link-time / post-build in variant post-build / pre-compile in variant pre-compile  # Filter for DDSI-RTPS messages in which the minorProtocolVersion in the DDSI-RTPS header matches. Tags: atp.Status=draft
        integer FirewallDdsProductId [0..1]: 0..255, multiplicity set at link in variant link-time / post-build in variant post-build / pre-compile in variant pre-compile, post-build-variant-multiplicity=true, post-build-variant-value=true, set at link in variant link-time / post-build in variant post-build / pre-compile in variant pre-compile  # Filter for DDSI-RTPS messages in which the productId in the DDSI-RTPS header matches. Tags: atp.Status=draft
        integer FirewallDdsReaderEntityId [0..1]: 0..255, multiplicity set at link in variant link-time / post-build in variant post-build / pre-compile in variant pre-compile, post-build-variant-multiplicity=true, post-build-variant-value=true, set at link in variant link-time / post-build in variant post-build / pre-compile in variant pre-compile  # Filter for DDSI-RTPS messages in which the readerEntityID in a DDSI-RTPS submessage matches Tags: atp.Status=draft
        integer FirewallDdsSubmessageType [0..1]: 0..255, multiplicity set at link in variant link-time / post-build in variant post-build / pre-compile in variant pre-compile, post-build-variant-multiplicity=true, post-build-variant-value=true, set at link in variant link-time / post-build in variant post-build / pre-compile in variant pre-compile  # Defines the allowed submessage type in the DDSI-RTPS message Tags: atp.Status=draft
        integer FirewallDdsVendorId [0..1]: 0..255, multiplicity set at link in variant link-time / post-build in variant post-build / pre-compile in variant pre-compile, post-build-variant-multiplicity=true, post-build-variant-value=true, set at link in variant link-time / post-build in variant post-build / pre-compile in variant pre-compile  # Filter for DDSI-RTPS messages in which the vendorId in the DDSI-RTPS header matches. Tags: atp.Status=draft
        integer FirewallDdsWriterEntityId [0..1]: 0..255, multiplicity set at link in variant link-time / post-build in variant post-build / pre-compile in variant pre-compile, post-build-variant-multiplicity=true, post-build-variant-value=true, set at link in variant link-time / post-build in variant post-build / pre-compile in variant pre-compile  # Filter for DDSI-RTPS messages in which the writerEntityID in a DDSI-RTPS submessage matches Tags: atp.Status=draft
      container FirewallDoipFilterConfig [0..1]: multiplicity set at link in variant link-time / post-build in variant post-build / pre-compile in variant pre-compile, post-build-variant-multiplicity=true  # Configuration of filter rules for DoIP Tags: atp.Status=draft
        integer FirewallDoipInverseProtocolVersion [0..1]: 2..255, multiplicity set at link in variant link-time / post-build in variant post-build / pre-compile in variant pre-compile, post-build-variant-multiplicity=true, post-build-variant-value=true, set at link in variant link-time / post-build in variant post-build / pre-compile in variant pre-compile  # Filter to match DoIP messages in which the inverseprotocolVersion in the DoIP header matches. Tags: atp.Status=draft
        integer FirewallDoipPayloadLength [0..1]: 0..4294967295, multiplicity set at link in variant link-time / post-build in variant post-build / pre-compile in variant pre-compile, post-build-variant-multiplicity=true, post-build-variant-value=true, set at link in variant link-time / post-build in variant post-build / pre-compile in variant pre-compile  # Filter to match DoIP messages in which the payloadLength in the DoIP header matches. Tags: atp.Status=draft
        integer FirewallDoipPayloadType [0..1]: 0..65535, multiplicity set at link in variant link-time / post-build in variant post-build / pre-compile in variant pre-compile, post-build-variant-multiplicity=true, post-build-variant-value=true, set at link in variant link-time / post-build in variant post-build / pre-compile in variant pre-compile  # Filter to match DoIP messages in which the payloadType in the DoIP header matches. Tags: atp.Status=draft
        integer FirewallDoipProtocolVersion [0..1]: 2..255, multiplicity set at link in variant link-time / post-build in variant post-build / pre-compile in variant pre-compile, post-build-variant-multiplicity=true, post-build-variant-value=true, set at link in variant link-time / post-build in variant post-build / pre-compile in variant pre-compile  # Filter to match DoIP messages in which the protocolVersion in the DoIP header matches. Tags: atp.Status=draft
        integer FirewallDoipUdsService [0..1]: 0..4294967295, multiplicity set at link in variant link-time / post-build in variant post-build / pre-compile in variant pre-compile, post-build-variant-multiplicity=true, post-build-variant-value=true, set at link in variant link-time / post-build in variant post-build / pre-compile in variant pre-compile  # Filter to match DoIP messages that contain the udsService. Tags: atp.Status=draft
        container FirewallDoipDestAddress [0..1]: multiplicity set at link in variant link-time / post-build in variant post-build / pre-compile in variant pre-compile, post-build-variant-multiplicity=true  # Configuration of a source port filter. Tags: atp.Status=draft
          integer FirewallDoipDestAddressLowerValue [0..1]: 0..65535, multiplicity set at link in variant link-time / post-build in variant post-build / pre-compile in variant pre-compile, post-build-variant-multiplicity=true, post-build-variant-value=true, set at link in variant link-time / post-build in variant post-build / pre-compile in variant pre-compile  # Filter to match DoIP messages in which the destinationAddress is greater or equal than FirwallDoipDestAddressLowerValue Tags: atp.Status=draft
          integer FirewallDoipDestAddressUpperValue [0..1]: 0..65535, multiplicity set at link in variant link-time / post-build in variant post-build / pre-compile in variant pre-compile, post-build-variant-multiplicity=true, post-build-variant-value=true, set at link in variant link-time / post-build in variant post-build / pre-compile in variant pre-compile  # Filter to match DoIP messages in which the destinationAddress is smaller or equal than FirewallDoipDestAddressUpperValue Tags: atp.Status=draft
        container FirewallDoipSrcAddress [0..1]: multiplicity set at link in variant link-time / post-build in variant post-build / pre-compile in variant pre-compile, post-build-variant-multiplicity=true  # Configuration of a source port filter. Tags: atp.Status=draft
          integer FirewallDoipSrcAddressLowerValue [0..1]: 0..65535, multiplicity set at link in variant link-time / post-build in variant post-build / pre-compile in variant pre-compile, post-build-variant-multiplicity=true, post-build-variant-value=true, set at link in variant link-time / post-build in variant post-build / pre-compile in variant pre-compile  # Filter to match DoIP messages in which the sourceAddress is greater or equal than FirwallDoipDestAddressLowerValue Tags: atp.Status=draft
          integer FirewallDoipSrcAddressUpperValue [0..1]: 0..65535, multiplicity set at link in variant link-time / post-build in variant post-build / pre-compile in variant pre-compile, post-build-variant-multiplicity=true, post-build-variant-value=true, set at link in variant link-time / post-build in variant post-build / pre-compile in variant pre-compile  # Definition of the filter port upper value. Tags: atp.Status=draft
      container FirewallNetworkLayerFilterConfig [0..1]: multiplicity set at link in variant link-time / post-build in variant post-build / pre-compile in variant pre-compile, post-build-variant-multiplicity=true  # Configuration of filter rules on the Network layer Tags: atp.Status=draft
        container FirewallNetworkLayerIpv4FilterConfig [0..1]: multiplicity set at link in variant link-time / post-build in variant post-build / pre-compile in variant pre-compile, post-build-variant-multiplicity=true  # Configuration of filter rules for IPv6 on the Network layer Tags: atp.Status=draft
          boolean FirewallChecksumVerification [0..1]: multiplicity set at link in variant link-time / post-build in variant post-build / pre-compile in variant pre-compile, post-build-variant-multiplicity=true, post-build-variant-value=true, set at link in variant link-time / post-build in variant post-build / pre-compile in variant pre-compile  # Defines whether checksum verification is performed or not. Tags: atp.Status=draft
          integer FirewallDifferentiatedServiceCodePoint [0..1]: 0..65535, multiplicity set at link in variant link-time / post-build in variant post-build / pre-compile in variant pre-compile, post-build-variant-multiplicity=true, post-build-variant-value=true, set at link in variant link-time / post-build in variant post-build / pre-compile in variant pre-compile  # Filter to match packets with a DSCP value. Tags: atp.Status=draft
          boolean FirewallDoNotFragment [0..1]: multiplicity set at link in variant link-time / post-build in variant post-build / pre-compile in variant pre-compile, post-build-variant-multiplicity=true, post-build-variant-value=true, set at link in variant link-time / post-build in variant post-build / pre-compile in variant pre-compile  # Filter to match packets that have the doNotFragment bit in the Header set. Tags: atp.Status=draft
          integer FirewallExplicitCongestionNotification [0..1]: 0..65535, multiplicity set at link in variant link-time / post-build in variant post-build / pre-compile in variant pre-compile, post-build-variant-multiplicity=true, post-build-variant-value=true, set at link in variant link-time / post-build in variant post-build / pre-compile in variant pre-compile  # Filter to match packets with a ECN code point. Tags: atp.Status=draft
          integer FirewallInternetHeaderLength [0..1]: 0..65535, multiplicity set at link in variant link-time / post-build in variant post-build / pre-compile in variant pre-compile, post-build-variant-multiplicity=true, post-build-variant-value=true, set at link in variant link-time / post-build in variant post-build / pre-compile in variant pre-compile  # Filter to match packets with a minimum ipv4 header length. Tags: atp.Status=draft
          integer FirewallIpProtocolNumber [0..1]: 0..255, multiplicity set at link in variant link-time / post-build in variant post-build / pre-compile in variant pre-compile, post-build-variant-multiplicity=true, post-build-variant-value=true, set at link in variant link-time / post-build in variant post-build / pre-compile in variant pre-compile  # Filter to match packets with a IP protocol number . Tags: atp.Status=draft
          boolean FirewallMoreFragments [0..1]: multiplicity set at link in variant link-time / post-build in variant post-build / pre-compile in variant pre-compile, post-build-variant-multiplicity=true, post-build-variant-value=true, set at link in variant link-time / post-build in variant post-build / pre-compile in variant pre-compile  # Filter to match packets that have the moreFragments flag in the Header set. Tags: atp.Status=draft
          container FirewallFilterIPDestAddress [0..1]: multiplicity set at link in variant link-time / post-build in variant post-build / pre-compile in variant pre-compile, post-build-variant-multiplicity=true  # Configuration of one IP destination filter. Tags: atp.Status=draft
            string FirewallFilterIPAddressKey: post-build-variant-value=true, set at link in variant link-time / post-build in variant post-build / pre-compile in variant pre-compile  # IP address key pattern. Tags: atp.Status=draft
            string FirewallFilterIPAddressMask: post-build-variant-value=true, set at link in variant link-time / post-build in variant post-build / pre-compile in variant pre-compile  # IP address mask pattern. Tags: atp.Status=draft
          container FirewallFilterIPSrcAddress [0..1]: multiplicity set at link in variant link-time / post-build in variant post-build / pre-compile in variant pre-compile, post-build-variant-multiplicity=true  # Configuration of one IP source filter. Tags: atp.Status=draft
            string FirewallFilterIPAddressKey: post-build-variant-value=true, set at link in variant link-time / post-build in variant post-build / pre-compile in variant pre-compile  # IP address key pattern. Tags: atp.Status=draft
            string FirewallFilterIPAddressMask: post-build-variant-value=true, set at link in variant link-time / post-build in variant post-build / pre-compile in variant pre-compile  # IP address mask pattern. Tags: atp.Status=draft
          container FirewallFilterIPv4Ttl [0..1]: multiplicity set at link in variant link-time / post-build in variant post-build / pre-compile in variant pre-compile, post-build-variant-multiplicity=true  # Filter to match packets with a ttl value (TimeToLive defines the lifetime of data on the network). Tags: atp.Status=draft
            integer FirewallIpv4TtlMax: 0..255, multiplicity set at link in variant link-time / post-build in variant post-build / pre-compile in variant pre-compile, post-build-variant-multiplicity=true, post-build-variant-value=true, set at link in variant link-time / post-build in variant post-build / pre-compile in variant pre-compile  # Filter to match packets with a max ttl value. Tags: atp.Status=draft
            integer FirewallIpv4TtlMin: 0..255, multiplicity set at link in variant link-time / post-build in variant post-build / pre-compile in variant pre-compile, post-build-variant-multiplicity=true, post-build-variant-value=true, set at link in variant link-time / post-build in variant post-build / pre-compile in variant pre-compile  # Filter to match packets with a min ttl value. Tags: atp.Status=draft
          container FirewallNetworkLayerIcmpConfig [0..1]: multiplicity set at link in variant link-time / post-build in variant post-build / pre-compile in variant pre-compile, post-build-variant-multiplicity=true  # Configuration of filter rules for ICMP (Internet Control Message Protocol). Tags: atp.Status=draft
            boolean FirewallChecksumVerification [0..1]: multiplicity set at link in variant link-time / post-build in variant post-build / pre-compile in variant pre-compile, post-build-variant-multiplicity=true, post-build-variant-value=true, set at link in variant link-time / post-build in variant post-build / pre-compile in variant pre-compile  # Defines whether checksum verification is performed or not. Tags: atp.Status=draft
            integer FirewallIcmpCode: 0..65535, post-build-variant-value=true, set at link in variant link-time / post-build in variant post-build / pre-compile in variant pre-compile  # Filter to match packets with the Icmp code. Tags: atp.Status=draft
            integer FirewallIcmpType: 0..65535, post-build-variant-value=true, set at link in variant link-time / post-build in variant post-build / pre-compile in variant pre-compile  # Filter to match packets with the Icmp type. Tags: atp.Status=draft
        container FirewallNetworkLayerIpv6FilterConfig [0..1]: multiplicity set at link in variant link-time / post-build in variant post-build / pre-compile in variant pre-compile, post-build-variant-multiplicity=true  # Configuration of filter rules on the Network layer Tags: atp.Status=draft
          integer FirewallIpFlowLabel [0..1]: 1..1048575, multiplicity set at link in variant link-time / post-build in variant post-build / pre-compile in variant pre-compile, post-build-variant-multiplicity=true, post-build-variant-value=true, set at link in variant link-time / post-build in variant post-build / pre-compile in variant pre-compile  # Filter to match packets with a defined flow label. Tags: atp.Status=draft
          integer FirewallIpHopLimit [0..1]: 0..255, multiplicity set at link in variant link-time / post-build in variant post-build / pre-compile in variant pre-compile, post-build-variant-multiplicity=true, post-build-variant-value=true, set at link in variant link-time / post-build in variant post-build / pre-compile in variant pre-compile  # Filter to match packets with a minimum hop limit. Tags: atp.Status=draft
          integer FirewallIpNextHeader [0..1]: 0..255, multiplicity set at link in variant link-time / post-build in variant post-build / pre-compile in variant pre-compile, post-build-variant-multiplicity=true, post-build-variant-value=true, set at link in variant link-time / post-build in variant post-build / pre-compile in variant pre-compile  # Filter to match packets with a defined type of an extension header. Tags: atp.Status=draft
          integer FirewallITrafficClass [0..1]: 0..255, multiplicity set at link in variant link-time / post-build in variant post-build / pre-compile in variant pre-compile, post-build-variant-multiplicity=true, post-build-variant-value=true, set at link in variant link-time / post-build in variant post-build / pre-compile in variant pre-compile  # Filter to match packets with a defined traffic class or priority. Tags: atp.Status=draft
          container FirewallFilterIPDestAddress [0..1]: multiplicity set at link in variant link-time / post-build in variant post-build / pre-compile in variant pre-compile, post-build-variant-multiplicity=true  # Configuration of one IP destination filter. Tags: atp.Status=draft
            string FirewallFilterIPAddressKey: post-build-variant-value=true, set at link in variant link-time / post-build in variant post-build / pre-compile in variant pre-compile  # IP address key pattern. Tags: atp.Status=draft
            string FirewallFilterIPAddressMask: post-build-variant-value=true, set at link in variant link-time / post-build in variant post-build / pre-compile in variant pre-compile  # IP address mask pattern. Tags: atp.Status=draft
          container FirewallFilterIPSrcAddress [0..1]: multiplicity set at link in variant link-time / post-build in variant post-build / pre-compile in variant pre-compile, post-build-variant-multiplicity=true  # Configuration of one IP source filter. Tags: atp.Status=draft
            string FirewallFilterIPAddressKey: post-build-variant-value=true, set at link in variant link-time / post-build in variant post-build / pre-compile in variant pre-compile  # IP address key pattern. Tags: atp.Status=draft
            string FirewallFilterIPAddressMask: post-build-variant-value=true, set at link in variant link-time / post-build in variant post-build / pre-compile in variant pre-compile  # IP address mask pattern. Tags: atp.Status=draft
          container FirewallNetworkLayerIcmpConfig [0..1]: multiplicity set at link in variant link-time / post-build in variant post-build / pre-compile in variant pre-compile, post-build-variant-multiplicity=true  # Configuration of filter rules for ICMP (Internet Control Message Protocol). Tags: atp.Status=draft
            boolean FirewallChecksumVerification [0..1]: multiplicity set at link in variant link-time / post-build in variant post-build / pre-compile in variant pre-compile, post-build-variant-multiplicity=true, post-build-variant-value=true, set at link in variant link-time / post-build in variant post-build / pre-compile in variant pre-compile  # Defines whether checksum verification is performed or not. Tags: atp.Status=draft
            integer FirewallIcmpCode: 0..65535, post-build-variant-value=true, set at link in variant link-time / post-build in variant post-build / pre-compile in variant pre-compile  # Filter to match packets with the Icmp code. Tags: atp.Status=draft
            integer FirewallIcmpType: 0..65535, post-build-variant-value=true, set at link in variant link-time / post-build in variant post-build / pre-compile in variant pre-compile  # Filter to match packets with the Icmp type. Tags: atp.Status=draft
      container FirewallPayloadBytePatternFilterConfig [0..1]: multiplicity set at link in variant link-time / post-build in variant post-build / pre-compile in variant pre-compile, post-build-variant-multiplicity=true  # Configuration of a generic firewall rule that defines the individual bytes of a message that shall match. Tags: atp.Status=draft
        container FirewallPayloadByteConfig [0..*]: multiplicity set at link in variant link-time / post-build in variant post-build / pre-compile in variant pre-compile, post-build-variant-multiplicity=true  # Configuration of a single byte in the datagram. Tags: atp.Status=draft
          integer FirewallPaylodByteOffset: 0..18446744073709551615, multiplicity set at pre-compile, set at pre-compile  # This parameter defines the byte offset in the datagram (start byte of the Ethernet frame, i.e. offset 0 corresponds to the first byte of the destination MAC address). Tags: atp.Status=draft
          integer FirewallPaylodByteValue: 0..255, multiplicity set at pre-compile, set at pre-compile  # This attribute defines the byteValue in the datagram. Tags: atp.Status=draft
      container FirewallSomeipProtocolFilterConfig [0..1]: multiplicity set at link in variant link-time / post-build in variant post-build / pre-compile in variant pre-compile, post-build-variant-multiplicity=true  # Configuration of SOME/IP Protocol firewall rules Tags: atp.Status=draft
        integer FirewallSomeipClientId [0..1]: 0..65535, multiplicity set at link in variant link-time / post-build in variant post-build / pre-compile in variant pre-compile, post-build-variant-multiplicity=true, post-build-variant-value=true, set at link in variant link-time / post-build in variant post-build / pre-compile in variant pre-compile  # Filter for SOME/IP messages in which the clientId in the SOME/IP header matches. Tags: atp.Status=draft
        boolean FirewallSomeipLengthVerification [0..1]: multiplicity set at link in variant link-time / post-build in variant post-build / pre-compile in variant pre-compile, post-build-variant-multiplicity=true, post-build-variant-value=true, set at link in variant link-time / post-build in variant post-build / pre-compile in variant pre-compile  # Defines whether length verification is performed or not. Tags: atp.Status=draft
        integer FirewallSomeipMajorVersion [0..1]: 0..255, multiplicity set at link in variant link-time / post-build in variant post-build / pre-compile in variant pre-compile, post-build-variant-multiplicity=true, post-build-variant-value=true, set at link in variant link-time / post-build in variant post-build / pre-compile in variant pre-compile  # Filter for SOME/IP messages in which the majorVersion in the SOME/IP header matches. Tags: atp.Status=draft
        integer FirewallSomeipMessageType [0..1]: 0..255, multiplicity set at link in variant link-time / post-build in variant post-build / pre-compile in variant pre-compile, post-build-variant-multiplicity=true, post-build-variant-value=true, set at link in variant link-time / post-build in variant post-build / pre-compile in variant pre-compile  # Filter for SOME/IP messages in which the message type in the SOME/IP header matches. Tags: atp.Status=draft
        integer FirewallSomeipMethodId [0..1]: 0..65535, multiplicity set at link in variant link-time / post-build in variant post-build / pre-compile in variant pre-compile, post-build-variant-multiplicity=true, post-build-variant-value=true, set at link in variant link-time / post-build in variant post-build / pre-compile in variant pre-compile  # Filter for SOME/IP messages in which the methodId in the SOME/IP header matches. Tags: atp.Status=draft
        integer FirewallSomeipProtocolVersion [0..1]: 0..255, multiplicity set at link in variant link-time / post-build in variant post-build / pre-compile in variant pre-compile, post-build-variant-multiplicity=true, post-build-variant-value=true, set at link in variant link-time / post-build in variant post-build / pre-compile in variant pre-compile  # Filter for SOME/IP messages in which the protocol version in the SOME/IP header matches. Tags: atp.Status=draft
        integer FirewallSomeipReturnCode [0..1]: 0..255, multiplicity set at link in variant link-time / post-build in variant post-build / pre-compile in variant pre-compile, post-build-variant-multiplicity=true, post-build-variant-value=true, set at link in variant link-time / post-build in variant post-build / pre-compile in variant pre-compile  # Filter for SOME/IP messages in which the return code in the SOME/IP header matches. Tags: atp.Status=draft
        integer FirewallSomeipServiceInterfaceId [0..1]: 0..65535, multiplicity set at link in variant link-time / post-build in variant post-build / pre-compile in variant pre-compile, post-build-variant-multiplicity=true, post-build-variant-value=true, set at link in variant link-time / post-build in variant post-build / pre-compile in variant pre-compile  # Filter for SOME/IP messages in which the serviceInterfaceId in the SOME/IP header matches. Tags: atp.Status=draft
      container FirewallSomeipSdFilterConfig [0..1]: multiplicity set at link in variant link-time / post-build in variant post-build / pre-compile in variant pre-compile, post-build-variant-multiplicity=true  # Configuration of SOME/IP Service Discovery firewall rules Tags: atp.Status=draft
        integer FirewallSomeipEntryType [0..1]: 0..18446744073709551615, multiplicity set at link in variant link-time / post-build in variant post-build / pre-compile in variant pre-compile, post-build-variant-multiplicity=true, post-build-variant-value=true, set at link in variant link-time / post-build in variant post-build / pre-compile in variant pre-compile  # Filter for SOME/IP SD messages in which the entryType in the SOME/IP header matches. Tags: atp.Status=draft
        integer FirewallSomeipEventGroupId [0..1]: 0..65535, multiplicity set at link in variant link-time / post-build in variant post-build / pre-compile in variant pre-compile, post-build-variant-multiplicity=true, post-build-variant-value=true, set at link in variant link-time / post-build in variant post-build / pre-compile in variant pre-compile  # Filter for SOME/IP SD messages in which the eventGroupId in the SOME/IP header matches. Tags: atp.Status=draft
        integer FirewallSomeipServiceInstanceId [0..1]: 0..65535, multiplicity set at link in variant link-time / post-build in variant post-build / pre-compile in variant pre-compile, post-build-variant-multiplicity=true, post-build-variant-value=true, set at link in variant link-time / post-build in variant post-build / pre-compile in variant pre-compile  # Filter for SOME/IP SD messages in which the serviceInstanceId in the SOME/IP header matches. Tags: atp.Status=draft
        integer FirewallSomeipServiceInterfaceId [0..1]: 0..65535, multiplicity set at link in variant link-time / post-build in variant post-build / pre-compile in variant pre-compile, post-build-variant-multiplicity=true, post-build-variant-value=true, set at link in variant link-time / post-build in variant post-build / pre-compile in variant pre-compile  # Filter for SOME/IP messages in which the serviceInterfaceId in the SOME/IP header matches. Tags: atp.Status=draft
        container FirewallSomeipMajorVersion [0..1]: multiplicity set at link in variant link-time / post-build in variant post-build / pre-compile in variant pre-compile, post-build-variant-multiplicity=true  # Filter for SOME/IP SD messages in which the MajorVersion in the SOME/IP header is in the configured max and min value. Tags: atp.Status=draft
          integer FirewallMajorVersionMaxValue [0..1]: 0..255, multiplicity set at link in variant link-time / post-build in variant post-build / pre-compile in variant pre-compile, post-build-variant-multiplicity=true, post-build-variant-value=true, set at link in variant link-time / post-build in variant post-build / pre-compile in variant pre-compile  # Filter for SOME/IP SD messages in which the MajorVersion in the SOME/IP header is smaller or equal than this value. Tags: atp.Status=draft
          integer FirewallMajorVersionMinValue [0..1]: 0..255, multiplicity set at link in variant link-time / post-build in variant post-build / pre-compile in variant pre-compile, post-build-variant-multiplicity=true, post-build-variant-value=true, set at link in variant link-time / post-build in variant post-build / pre-compile in variant pre-compile  # Filter for SOME/IP SD messages in which the MajorVersion in the SOME/IP header is greater or equal than this value. Tags: atp.Status=draft
        container FirewallSomeipMinorVersion [0..1]: multiplicity set at link in variant link-time / post-build in variant post-build / pre-compile in variant pre-compile, post-build-variant-multiplicity=true  # Filter for SOME/IP SD messages in which the MinorVersion in the SOME/IP header is in the configured max and min value. Tags: atp.Status=draft
          integer FirewallMinorVersionMaxValue [0..1]: 0..4294967294, multiplicity set at link in variant link-time / post-build in variant post-build / pre-compile in variant pre-compile, post-build-variant-multiplicity=true, post-build-variant-value=true, set at link in variant link-time / post-build in variant post-build / pre-compile in variant pre-compile  # Filter for SOME/IP SD messages in which the MinorVersion in the SOME/IP header is smaller or equal than than this value. Tags: atp.Status=draft
          integer FirewallMinorVersionMinValue [0..1]: 0..4294967294, multiplicity set at link in variant link-time / post-build in variant post-build / pre-compile in variant pre-compile, post-build-variant-multiplicity=true, post-build-variant-value=true, set at link in variant link-time / post-build in variant post-build / pre-compile in variant pre-compile  # Filter for SOME/IP SD messages in which the MinorVersion in the SOME/IP header is greater or equal than this value. Tags: atp.Status=draft
      container FirewallTransportLayerFilterConfig [0..1]: multiplicity set at link in variant link-time / post-build in variant post-build / pre-compile in variant pre-compile, post-build-variant-multiplicity=true  # Configuration of filter rules on Transport Layer level. Tags: atp.Status=draft
        container FirewallTransportLayerTcpFilterConfig [0..1]: multiplicity set at link in variant link-time / post-build in variant post-build / pre-compile in variant pre-compile, post-build-variant-multiplicity=true  # Configuration of filter rules for TCP on Transport Layer level. Tags: atp.Status=draft
          boolean FirewallChecksumVerification [0..1]: multiplicity set at link in variant link-time / post-build in variant post-build / pre-compile in variant pre-compile, post-build-variant-multiplicity=true, post-build-variant-value=true, set at link in variant link-time / post-build in variant post-build / pre-compile in variant pre-compile  # Defines whether checksum verification is performed or not. Tags: atp.Status=draft
          integer FirewallNumberOfParallelTcpSessions [0..1]: 0..65535, multiplicity set at link in variant link-time / post-build in variant post-build / pre-compile in variant pre-compile, post-build-variant-multiplicity=true, post-build-variant-value=true, set at link in variant link-time / post-build in variant post-build / pre-compile in variant pre-compile  # This parameter defines the maximal number of TCP Sessions that are allowed to be established. Tags: atp.Status=draft
          boolean FirewallStateManagementBasedOnTcpFlags [0..1]: multiplicity set at link in variant link-time / post-build in variant post-build / pre-compile in variant pre-compile, post-build-variant-multiplicity=true, post-build-variant-value=true, set at link in variant link-time / post-build in variant post-build / pre-compile in variant pre-compile  # This attribute defines whether the StateManagement is based on TCP flags or not. Tags: atp.Status=draft
          integer FirewallTimeoutCheck [0..1]: 0..65535, multiplicity set at link in variant link-time / post-build in variant post-build / pre-compile in variant pre-compile, post-build-variant-multiplicity=true, post-build-variant-value=true, set at link in variant link-time / post-build in variant post-build / pre-compile in variant pre-compile  # This parameter defines the TCP Session timeout in seconds Tags: atp.Status=draft
          container FirewallFilterDestPort [0..1]: multiplicity set at link in variant link-time / post-build in variant post-build / pre-compile in variant pre-compile, post-build-variant-multiplicity=true  # Configuration of a destination port filter. Tags: atp.Status=draft
            integer FirewallFilterPortLowerValue: 0..65535, post-build-variant-value=true, set at link in variant link-time / post-build in variant post-build / pre-compile in variant pre-compile  # Definition of the filter port lower value. Tags: atp.Status=draft
            integer FirewallFilterPortUpperValue: 0..65535, post-build-variant-value=true, set at link in variant link-time / post-build in variant post-build / pre-compile in variant pre-compile  # Definition of the filter port upper value. Tags: atp.Status=draft
          container FirewallFilterSrcPort [0..1]: multiplicity set at link in variant link-time / post-build in variant post-build / pre-compile in variant pre-compile, post-build-variant-multiplicity=true  # Configuration of a source port filter. Tags: atp.Status=draft
            integer FirewallFilterPortLowerValue: 0..65535, post-build-variant-value=true, set at link in variant link-time / post-build in variant post-build / pre-compile in variant pre-compile  # Definition of the filter port lower value. Tags: atp.Status=draft
            integer FirewallFilterPortUpperValue: 0..65535, post-build-variant-value=true, set at link in variant link-time / post-build in variant post-build / pre-compile in variant pre-compile  # Definition of the filter port upper value. Tags: atp.Status=draft
        container FirewallTransportLayerUdpFilterConfig [0..1]: multiplicity set at link in variant link-time / post-build in variant post-build / pre-compile in variant pre-compile, post-build-variant-multiplicity=true  # Configuration of filter rules for UDP on Transport Layer level. Tags: atp.Status=draft
          boolean FirewallChecksumVerification [0..1]: multiplicity set at link in variant link-time / post-build in variant post-build / pre-compile in variant pre-compile, post-build-variant-multiplicity=true, post-build-variant-value=true, set at link in variant link-time / post-build in variant post-build / pre-compile in variant pre-compile  # Defines whether checksum verification is performed or not. Tags: atp.Status=draft
          container FirewallFilterDestPort [0..1]: multiplicity set at link in variant link-time / post-build in variant post-build / pre-compile in variant pre-compile, post-build-variant-multiplicity=true  # Configuration of a destination port filter. Tags: atp.Status=draft
            integer FirewallFilterPortLowerValue: 0..65535, post-build-variant-value=true, set at link in variant link-time / post-build in variant post-build / pre-compile in variant pre-compile  # Definition of the filter port lower value. Tags: atp.Status=draft
            integer FirewallFilterPortUpperValue: 0..65535, post-build-variant-value=true, set at link in variant link-time / post-build in variant post-build / pre-compile in variant pre-compile  # Definition of the filter port upper value. Tags: atp.Status=draft
          container FirewallFilterSrcPort [0..1]: multiplicity set at link in variant link-time / post-build in variant post-build / pre-compile in variant pre-compile, post-build-variant-multiplicity=true  # Configuration of a source port filter. Tags: atp.Status=draft
            integer FirewallFilterPortLowerValue: 0..65535, post-build-variant-value=true, set at link in variant link-time / post-build in variant post-build / pre-compile in variant pre-compile  # Definition of the filter port lower value. Tags: atp.Status=draft
            integer FirewallFilterPortUpperValue: 0..65535, post-build-variant-value=true, set at link in variant link-time / post-build in variant post-build / pre-compile in variant pre-compile  # Definition of the filter port upper value. Tags: atp.Status=draft
    container FirewallState [1..*]: multiplicity set at link in variant link-time / post-build in variant post-build / pre-compile in variant pre-compile, post-build-variant-multiplicity=true  # Collection of Firewall states in which the Firewall may be activated (via the FirewallStateRef). Tags: atp.Status=draft
      integer FirewallStateId: 0..65535, set at pre-compile, symbolic-name-value=true  # Parameter that identifies the Firewall State. Tags: atp.Status=draft
    container FirewallStateDependentRules [1..*]: multiplicity set at link in variant link-time / post-build in variant post-build / pre-compile in variant pre-compile, post-build-variant-multiplicity=true  # Firewall rules that are defined in a firewall state Tags: atp.Status=draft
      enumeration FirewallDefaultAction [0..1]: multiplicity set at link in variant link-time / post-build in variant post-build / pre-compile in variant pre-compile, post-build-variant-multiplicity=true, post-build-variant-value=true, set at link in variant link-time / post-build in variant post-build / pre-compile in variant pre-compile  # This attribute defines a defaultAction. Tags: atp.Status=draft
        ALLOW  # Tags: atp.Status=draft
        BLOCK  # Tags: atp.Status=draft
      reference FirewallStateRef [1..*]: multiplicity set at link in variant link-time / post-build in variant post-build / pre-compile in variant pre-compile, post-build-variant-multiplicity=true, post-build-variant-value=true, set at link in variant link-time / post-build in variant post-build / pre-compile in variant pre-compile, destination=FirewallState  # Reference to firewall states in which the Firewall is active. If one of the referenced Firewall States is active then the firewall rule shall be considered active as well. Tags: atp.Status=draft
      container FirewallActionForMatchingRules [1..*]: multiplicity set at link in variant link-time / post-build in variant post-build / pre-compile in variant pre-compile, post-build-variant-multiplicity=true  # Firewall action that is performed if the referenced pattern matches. Tags: atp.Status=draft
        enumeration FirewallAction [0..1]: multiplicity set at link in variant link-time / post-build in variant post-build / pre-compile in variant pre-compile, post-build-variant-multiplicity=true, post-build-variant-value=true, set at link in variant link-time / post-build in variant post-build / pre-compile in variant pre-compile  # Action that is performed by the firewall if the matchingRule is fulfilled. Tags: atp.Status=draft
          ALLOW  # Tags: atp.Status=draft
          BLOCK  # Tags: atp.Status=draft
        reference FirewallMatchingEgressRule [0..*]: multiplicity set at link in variant link-time / post-build in variant post-build / pre-compile in variant pre-compile, post-build-variant-multiplicity=true, post-build-variant-value=true, set at link in variant link-time / post-build in variant post-build / pre-compile in variant pre-compile, destination=FirewallRule  # Firewall rule expression against which the egress network traffic is matched. Tags: atp.Status=draft
        reference FirewallMatchingIngressRule [0..*]: multiplicity set at link in variant link-time / post-build in variant post-build / pre-compile in variant pre-compile, post-build-variant-multiplicity=true, post-build-variant-value=true, set at link in variant link-time / post-build in variant post-build / pre-compile in variant pre-compile, destination=FirewallRule  # Firewall rule expression against which the ingress network traffic is matched. Tags: atp.Status=draft
    container FirewallSwitchBucketCounterStatistics [0..*]: multiplicity set at link in variant link-time / post-build in variant post-build / pre-compile in variant pre-compile, post-build-variant-multiplicity=true  # Polling of switch bucket counter statistics Tags: atp.Status=draft
      float FwSwitchBucketCounterPollingInterval: multiplicity set at pre-compile, set at pre-compile  # Length of the switch bucket counter polling time interval (in seconds). Note: Shall be configured as a multiple of the IdsM main function period. Tags: atp.Status=draft
      reference FirewallEthIfSwitchRef [1..*]: multiplicity set at link in variant link-time / post-build in variant post-build / pre-compile in variant pre-compile, post-build-variant-multiplicity=true, post-build-variant-value=true, set at link in variant link-time / post-build in variant post-build / pre-compile in variant pre-compile, destination=EthIfSwitch  # Reference to EthIfSwitch for which the bucket counter statistics applies. Tags: atp.Status=draft
      reference FirewallingWithPerStreamFiltering [0..1]: multiplicity set at link in variant link-time / post-build in variant post-build / pre-compile in variant pre-compile, post-build-variant-multiplicity=true, post-build-variant-value=true, set at link in variant link-time / post-build in variant post-build / pre-compile in variant pre-compile, destination=EthIfPhysController  # Reference to EthIfSwitch for which the bucket counter statistics applies. Tags: atp.Status=draft
