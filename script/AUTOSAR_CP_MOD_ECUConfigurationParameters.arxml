[part 5 of 14: package /AUTOSAR/EcucDefs]
AUTOSAR XML (schema 00053)
package /AUTOSAR/EcucDefs  (continued)
  module definition Dcm [0..1]: post-build-variant-support=true, variants link-time/post-build/pre-compile  (continued)
    container DcmGeneral  # Contains general configuration parameters valid for the entire Dcm module.
      boolean DcmDDDIDStorage [0..1]: multiplicity set at pre-compile, set at pre-compile, default-value=false  # This configuration switch defines, whether DDDID definition is stored non-volatile or not. | true: DDDID are stored non-volatile false: DDDID are only maintained volatile
      boolean DcmDevErrorDetect: set at pre-compile, default-value=false  # Switches the development error detection and notification on or off. | * true: detection and notification is enabled. * false: detection and notification is disabled.
      boolean DcmEnableSecurityEventReporting: scope=ECU, set at pre-compile, default-value=false  # Switches the reporting of security events to the IdsM: Tags: atp.Status=draft | - true: reporting is enabled. - false: reporting is disabled.
      string DcmHeaderFileInclusion [0..*]: scope=ECU, multiplicity set at pre-compile, set at pre-compile, regular-expression=[a-zA-Z0-9_]([a-zA-Z0-9\._])*  # Name of the header file(s) to be included by the Dcm module containing the used C-callback declarations.
      boolean DcmRespondAllRequest: scope=ECU, set at pre-compile  # If set to FALSE the Dcm will not respond to diagnostic request that contains a service ID which is in the range from 0x40 to 0x7F or in the range from 0xC0 to 0xFF (Response IDs).
      float DcmS3ServerTimeoutOverwrite [0..1]: 5..INF, scope=ECU, multiplicity set at pre-compile, set at pre-compile  # Time for the server to keep a diagnostic session other than the defaultSession active while not receiving any diagnostic request message. This parameter overwrites the 5s recommend value of the S3server timeout in ISO 14229-2. | The parameter value is defined in seconds.
      float DcmTaskTime: 0..INF, set at link in variant link-time / pre-compile in variant post-build+pre-compile  # Allow to configure the time for the periodic cyclic task. Please note: This configuration value shall be equal to the value in the RTE module. | The AUTOSAR configuration standard is to use SI units, so this parameter is defined as float value in seconds. Dcm configuration tools must convert this float value to the appropriate value format for the use in the software implementation of Dcm. min: A negative value and zero is not allowed. upperMultiplicity: Exactly one TaskTime must be specified per configuration. lowerMultiplicity: Exactly one TaskTime must be specified per configuration.
      boolean DcmVersionInfoApi: set at pre-compile, default-value=false  # Preprocessor switch to enable or disable the output Version info of the functionality.
      reference DcmVinRef [0..1]: multiplicity set at pre-compile, set at pre-compile, destination=DcmDspDid  # Reference to the Did containing the VIN Information. | This parameter is needed for function Dcm_GetVin
      container DcmSecureCoding [0..1]: multiplicity set at pre-compile  # Contains references to diagnostic elements that are used for the secure coding process.
        integer DcmSecureCodingDataBufferSize: 0..4294967295, scope=ECU, set at pre-compile  # Provides the size of the Dcm internal buffer to store data during the secure coding sequence.
        reference DcmSecureCodingAuthenticationJobRef: set at pre-compile, requires-symbolic-name-value=true, destination=CsmJob  # Reference to a CsmJob used to verify the authentication of the secure coding data in the Csm.
        reference DcmSecureCodingDataIdentifier [1..*]: multiplicity set at pre-compile, set at pre-compile, destination=DcmDspDid  # Refers to a writeable data identifier that requires the secure coding process to write the data.
        reference DcmSecureCodingValidationRoutine: set at pre-compile, destination=DcmDspRoutine  # Refers to a routine control that triggers the secure coding validation and data update process.
      container DcmSecurityEventRefs [0..1]: multiplicity set at pre-compile  # Container for the references to IdsMEvent elements representing the security events that the Dcm module shall report to the IdsM in case the coresponding security related event occurs (and if DcmEnableSecurityEventReporting is set to "true"). The standardized security events in this container can be extended by vendor-specific security events. Tags: atp.Status=draft
        reference SEV_UDS_AUTHENTICATION_FAILED [0..1]: multiplicity set at pre-compile, set at pre-compile, requires-symbolic-name-value=true, destination=IdsMEvent  # Authentication (via Authentication SID 0x29) failed
        reference SEV_UDS_AUTHENTICATION_NEEDED [0..1]: multiplicity set at pre-compile, set at pre-compile, requires-symbolic-name-value=true, destination=IdsMEvent  # A diagnostic request was received while the required authentication to execute this service is not given. NRC 0x34 (authenticationRequired) was returned.
        reference SEV_UDS_AUTHENTICATION_SUCCESSFUL [0..1]: multiplicity set at pre-compile, set at pre-compile, requires-symbolic-name-value=true, destination=IdsMEvent  # Succesfully authenticated (via Authentication SID 0x29)
        reference SEV_UDS_CLEAR_DTC_FAILED [0..1]: multiplicity set at pre-compile, set at pre-compile, requires-symbolic-name-value=true, destination=IdsMEvent  # Clearing DTC information has been requested by SID 0x14 ClearDiagnosticInformation, but failed
        reference SEV_UDS_CLEAR_DTC_SUCCESSFUL [0..1]: multiplicity set at pre-compile, set at pre-compile, requires-symbolic-name-value=true, destination=IdsMEvent  # DTC information has been cleared by SID 0x14 ClearDiagnosticInformation
        reference SEV_UDS_COMMUNICATION_CONTROL_FAILED [0..1]: multiplicity set at pre-compile, set at pre-compile, requires-symbolic-name-value=true, destination=IdsMEvent  # The control of a communication has been requested by service SID 0x28 CommunicationControl, but failed
        reference SEV_UDS_COMMUNICATION_CONTROL_SUCCESSFUL [0..1]: multiplicity set at pre-compile, set at pre-compile, requires-symbolic-name-value=true, destination=IdsMEvent  # The control of a communication has been requested by service SID 0x28 CommunicationControl successfully
        reference SEV_UDS_CONTROL_DTC_SETTING_FAILED [0..1]: multiplicity set at pre-compile, set at pre-compile, requires-symbolic-name-value=true, destination=IdsMEvent  # Control of DTC setting has been requested by service SID 0x85 ControlDTCSetting, but failed
        reference SEV_UDS_CONTROL_DTC_SETTING_SUCCESSFUL [0..1]: multiplicity set at pre-compile, set at pre-compile, requires-symbolic-name-value=true, destination=IdsMEvent  # The control of a DTC setting has been requested by service SID 0x85 ControlDTCSetting successfully
        reference SEV_UDS_ECU_RESET_FAILED [0..1]: multiplicity set at pre-compile, set at pre-compile, requires-symbolic-name-value=true, destination=IdsMEvent  # ECU Reset has been requested by SID 0x11 ECUReset, but failed
        reference SEV_UDS_ECU_RESET_SUCCESSFUL [0..1]: multiplicity set at pre-compile, set at pre-compile, requires-symbolic-name-value=true, destination=IdsMEvent  # ECU has been reset by SID 0x11 ECUReset
        reference SEV_UDS_IO_CONTROL_FAILED [0..1]: multiplicity set at pre-compile, set at pre-compile, requires-symbolic-name-value=true, destination=IdsMEvent  # IOControl operation has been requested by service SID 0x2F InputOutputControlByIdentifier, but failed
        reference SEV_UDS_IO_CONTROL_SUCCESSFUL [0..1]: multiplicity set at pre-compile, set at pre-compile, requires-symbolic-name-value=true, destination=IdsMEvent  # IOControl operation has been requested by service SID 0x2F InputOutputControlByIdentifier successfully
        reference SEV_UDS_REQUEST_FILE_TRANSFER_FAILED [0..1]: multiplicity set at pre-compile, set at pre-compile, requires-symbolic-name-value=true, destination=IdsMEvent  # A file transfer sequence has been requested with SID 0x38, but failed
        reference SEV_UDS_REQUEST_FILE_TRANSFER_SUCCESSFUL [0..1]: multiplicity set at pre-compile, set at pre-compile, requires-symbolic-name-value=true, destination=IdsMEvent  # A file transfer sequence has been requested successfully with SID 0x38
        reference SEV_UDS_REQUEST_UP_DOWNLOAD_FAILED [0..1]: multiplicity set at pre-compile, set at pre-compile, requires-symbolic-name-value=true, destination=IdsMEvent  # An upload / download sequence has been requested with SID 0x34 or SID 0x35, but failed
        reference SEV_UDS_REQUEST_UP_DOWNLOAD_SUCCESSFUL [0..1]: multiplicity set at pre-compile, set at pre-compile, requires-symbolic-name-value=true, destination=IdsMEvent  # An upload / download sequence has been requested successfully with SID 0x34 or SID 0x35
        reference SEV_UDS_ROUTINE_CONTROL_FAILED [0..1]: multiplicity set at pre-compile, set at pre-compile, requires-symbolic-name-value=true, destination=IdsMEvent  # The control of a routine has been requested by service SID 0x31 RoutineControl, but failed
        reference SEV_UDS_ROUTINE_CONTROL_SUCCESSFUL [0..1]: multiplicity set at pre-compile, set at pre-compile, requires-symbolic-name-value=true, destination=IdsMEvent  # The control of a routine has been requested by service SID 0x31 RoutineControl successfully
        reference SEV_UDS_SECURITY_ACCESS_FAILED [0..1]: multiplicity set at pre-compile, set at pre-compile, requires-symbolic-name-value=true, destination=IdsMEvent  # Unlocking of the ECU (via Security Access SID 0x27) failed
        reference SEV_UDS_SECURITY_ACCESS_NEEDED [0..1]: multiplicity set at pre-compile, set at pre-compile, requires-symbolic-name-value=true, destination=IdsMEvent  # Tester has sent a diagnostic request without meeting the server's security level requirements for that service. NRC 0x33 (securityAccessDenied) was returned.
        reference SEV_UDS_SECURITY_ACCESS_SUCCESSFUL [0..1]: multiplicity set at pre-compile, set at pre-compile, requires-symbolic-name-value=true, destination=IdsMEvent  # Successful unlocked the ECU (via Security Access SID 0x27)
        reference SEV_UDS_WRITE_DATA_FAILED [0..1]: multiplicity set at pre-compile, set at pre-compile, requires-symbolic-name-value=true, destination=IdsMEvent  # Change of Diagnostic data identifier has been requested by SID 0x2E WriteDataByIdentifier, but failed
        reference SEV_UDS_WRITE_DATA_SUCCESSFUL [0..1]: multiplicity set at pre-compile, set at pre-compile, requires-symbolic-name-value=true, destination=IdsMEvent  # Diagnostic data identifier has been written by SID 0x2E WriteDataByIdentifier
        reference SEV_UDS_WRITE_MEMORY_FAILED [0..1]: multiplicity set at pre-compile, set at pre-compile, requires-symbolic-name-value=true, destination=IdsMEvent  # Writting of Data into memory has been requested by SID 0x3D WriteMemoryByAddress, but failed
        reference SEV_UDS_WRITE_MEMORY_SUCCESSFUL [0..1]: multiplicity set at pre-compile, set at pre-compile, requires-symbolic-name-value=true, destination=IdsMEvent  # Data has been written into memory by SID 0x3D WriteMemoryByAddress
  module definition Dds [0..1]: post-build-variant-support=true, variants post-build/pre-compile  # Configuration of the Dds module.
    container DdsConfig  # This container contains the configuration parameters and sub containers of the AUTOSAR Dds module.
      container DdsAppDataRxPduCollection [0..1]: multiplicity set at pre-compile  # Collection of upper layer Rx PDUs towards the application layer.
        container DdsAppDataRxPdu [0..65535]: multiplicity set at post-build in variant post-build / pre-compile in variant pre-compile, post-build-variant-multiplicity=true  # The upper layer PDU used to send received data from DDS to Application.
          integer DdsAppDataRxPduId: 0..65535, scope=ECU, set at pre-compile, symbolic-name-value=true  # The current pdu local id.
          reference DdsAppDataRxPduRef: scope=ECU, set at pre-compile, destination=Pdu  # The reference to a PDU in the global PDU structure described in the AUTOSAR ECU Configuration Specification. | This reference will be used by the Dds module to derive the PDU Id.
      container DdsAppDataTxPduCollection [0..1]: multiplicity set at pre-compile  # Collection of upper layer Tx PDUs towards the application layer.
        container DdsAppDataTxPdu [0..65535]: multiplicity set at post-build in variant post-build / pre-compile in variant pre-compile, post-build-variant-multiplicity=true  # The upper layer PDU used to transmit data from Application to DDS itself.
          integer DdsAppDataTxPduId: 0..65535, scope=ECU, set at pre-compile, symbolic-name-value=true  # The current pdu local id.
          reference DdsAppDataTxPduRef: scope=ECU, set at pre-compile, destination=Pdu  # The reference to a PDU in the global PDU structure described in the AUTOSAR ECU Configuration Specification. | This reference will be used by the Dds module to derive the PDU Id.
      container DdsDomainParticipantCollection [0..1]: multiplicity set at pre-compile  # Collection of DDS Domain Participants.
        container DdsDomainParticipant [1..65535]: multiplicity set at pre-compile  # This container represents the configuration of one single Domain Participant hosted within the current node. One node can contain more than one Domain Participant.
          integer DdsDomainId: 0..65535, scope=ECU, set at pre-compile  # The ID of the Domain to which this DDS node belongs. It unambiguously identifies the DDS Domain to which the DomainParticipant belongs. | Note: Only entities that belong to the same DDS Domain can communicate with each other.
          integer DdsDomainParticipantId: 0..65535, scope=ECU, set at pre-compile  # Identifier of a Dds Domain Participant.
          container DdsDataReceiver [0..65535]: multiplicity set at pre-compile  # Container useful to usability: it defines a DDS DataReader linked to a Sender/ReceiverInterface.
            reference DdsReceiverDataReaderRef: scope=ECU, set at pre-compile, destination=DdsDataReader  # Reference to the dataReader used by the receiver
          container DdsDataSender [0..65535]: multiplicity set at pre-compile  # Container useful to usability: it defines a DDS DataWriter linked to a Sender/ReceiverInterface.
            reference DdsSenderDataWriterRef: scope=ECU, set at pre-compile, destination=DdsDataWriter  # Reference to the dataWriter used by the sender
          container DdsDomainParticipantCryptoInfo [0..1]: multiplicity set at pre-compile  # This container contains the configuration of the Crypto service to be used by Entities belonging to this DomainParticipant. | If it is not present, it means that not security mechanism is supported.
            reference DdsDomainParticipantCsmAuthenticateJob: scope=ECU, set at pre-compile, destination=CsmJob  # The reference to the CSM job to be used to authenticate data.
            reference DdsDomainParticipantCsmVerifyJob: scope=ECU, set at pre-compile, destination=CsmJob  # The reference to the CSM job to be used to verify data.
          container DdsDomainParticipantMulticastRtpsPduCollection [0..1]: multiplicity set at pre-compile  # The pool of multicast lower layer PDUs towards lower network layers.
            container DdsRtpsMulticastDataRxPdu [0..1]: multiplicity set at post-build in variant post-build / pre-compile in variant pre-compile, post-build-variant-multiplicity=true  # The multicast reception lower layer pdu used to send data from the lower network layer to DDS itself.
              integer DdsRtpsMulticastDataRxPduId: 0..65535, scope=ECU, set at pre-compile, symbolic-name-value=true  # The current pdu local id.
              reference DdsRtpsMulticastDataRxPduRef: scope=ECU, set at pre-compile, destination=Pdu  # The reference to a PDU in the global PDU structure described in the AUTOSAR ECU Configuration Specification. | This reference will be used by the Dds module to derive the PDU Id.
            container DdsRtpsMulticastDataTxPdu [0..1]: multiplicity set at post-build in variant post-build / pre-compile in variant pre-compile, post-build-variant-multiplicity=true  # The multicast lower layer transmission PDU used to transmit data from DDS to lower network layer.
              integer DdsRtpsMulticastDataTxPduId: 0..65535, scope=ECU, set at pre-compile, symbolic-name-value=true  # The current pdu local id
              reference DdsRtpsMulticastDataTxPduRef: scope=ECU, set at pre-compile, destination=Pdu  # The reference to a PDU in the global PDU structure described in the AUTOSAR ECU Configuration Specification. | This reference will be used by the Dds module to derive the PDU Id.
          container DdsDomainParticipantQoS [0..1]: multiplicity set at pre-compile  # This container represents the configuration of QoS supported by the Dds DomainParticipant.
            container DdsEntityFactory [0..1]: multiplicity set at pre-compile  # Describes the DDS [cite{DDS}] ENTITY_FACTORY QoS policy.
              boolean DdsEntityFactoryAutoenableCreatedEntities: set at pre-compile, default-value=true  # See "ENTITY_FACTORY" chapter of DDS [cite{DDS}].
            container DdsUserData [0..1]: multiplicity set at pre-compile  # Describes the DDS [cite{DDS}] USER_DATA QoS policy.
              string DdsUserDataValue: scope=ECU, set at pre-compile  # See "USER_DATA" chapter of DDS [cite{DDS}].
          container DdsDomainParticipantUnicastRtpsPduCollection [0..1]: multiplicity set at pre-compile  # Collection of unicast lower layer PDUs towards lower network layers.
            container DdsRtpsDataRxPdu [0..1]: multiplicity set at post-build in variant post-build / pre-compile in variant pre-compile, post-build-variant-multiplicity=true  # The unicast reception lower layer pdu used to send data from the lower network layer to DDS itself.
              integer DdsRtpsDataRxPduId: 0..65535, scope=ECU, set at pre-compile, symbolic-name-value=true  # The current pdu local id.
              reference DdsRtpsDataRxPduRef: scope=ECU, set at pre-compile, destination=Pdu  # The reference to a PDU in the global PDU structure described in the AUTOSAR ECU Configuration Specification. | This reference will be used by the Dds module to derive the PDU Id.
            container DdsRtpsDataTxPdu [0..65535]: multiplicity set at post-build in variant post-build / pre-compile in variant pre-compile, post-build-variant-multiplicity=true  # The unicast transmission lower layer pdu used to transmit data from DDS to lower network layer.
              integer DdsRtpsDataTxPduId: 0..65535, scope=ECU, set at pre-compile, symbolic-name-value=true  # The current pdu local id
              reference DdsRtpsDataTxPduRef: scope=ECU, set at pre-compile, destination=Pdu  # The reference to a PDU in the global PDU structure described in the AUTOSAR ECU Configuration Specification. | This reference will be used by the Dds module to derive the PDU Id.
          container DdsPublisher [0..65535]: multiplicity set at pre-compile  # This container represents the configuration of one Publisher.
            container DdsDataWriter [1..65535]: multiplicity set at pre-compile  # This container represents the configuration of one data writer. One publisher can refer to one or more writer, but a writer can belong to one single publisher.
              reference DdsDataWriterAppDataTxPduRef [1..65535]: scope=ECU, multiplicity set at pre-compile, set at pre-compile, destination=DdsAppDataTxPdu  # This reference refers to the DdsAppDataTxPdu which is used by the upper layer of the Dds module to transfer data which is requested to be transmitted on the network as DDS serialized data.
              reference DdsDataWriterRemoteDataReaders [0..65535]: scope=ECU, multiplicity set at pre-compile, set at pre-compile, destination=DdsRemoteDataReader  # Reference to the remote DdsDataReaders that the current DdsDataWriters has to send data to. | For each remote DdsDataReader configured, the local DdsDataWriter shall send data by using the DdsDataReaderRemotePdu configured for the given remote DataReader.
              reference DdsDataWriterTopicRef: scope=ECU, set at pre-compile, destination=DdsTopic  # This reference selects the Topic on which the current Dds Writer wants to publish.
              container DdsDataWriterQoS [0..1]  # This container represents the configuration of QoS Profiles related to the current DdsDataWriter.
                container DdsDeadline [0..1]: multiplicity set at pre-compile  # Describes the DDS [cite{DDS}] DEADLINE QoS policy.
                  float DdsDeadlinePeriod: 0..65.534, scope=ECU, set at pre-compile  # See "DEADLINE" chapter of DDS [cite{DDS}]. | Time given in seconds.
                container DdsDestinationOrder [0..1]: multiplicity set at pre-compile  # Describes the DDS [cite{DDS}] DESTINATION_ORDER QoS policy.
                  enumeration DdsDestinationOrderKind: {BY_RECEPTION_TIMESTAMP, BY_SOURCE_TIMESTAMP}, scope=ECU, set at pre-compile, default-value=BY_RECEPTION_TIMESTAMP  # See "DESTINATION_ORDER" chapter of DDS [cite{DDS}].
                container DdsDurability [0..1]: multiplicity set at pre-compile  # Describes the DDS [cite{DDS}] DURABILITY QoS policy.
                  enumeration DdsDurabilityKind: {PERSISTENT, TRANSIENT, TRANSIENT_LOCAL, VOLATILE}, scope=ECU, set at pre-compile, default-value=VOLATILE  # See "DURABILITY" chapter of DDS [cite{DDS}].
                container DdsDurabilityService [0..1]: multiplicity set at pre-compile  # Describes the DDS [cite{DDS}] DURABILITY_SERVICE QoS policy.
                  float DdsDurabilityServiceCleanupDelay: 0..65.534, scope=ECU, set at pre-compile  # See "DURABILITY_SERVICE" chapter of DDS [cite{DDS}]. | Time given in seconds.
                  integer DdsDurabilityServiceHistoryDepth: 0..65534, scope=ECU, set at pre-compile, default-value=1  # See "DURABILITY_SERVICE" chapter of DDS [cite{DDS}].
                  enumeration DdsDurabilityServiceHistoryKind: {KEEP_ALL, KEEP_LAST}, scope=ECU, set at pre-compile, default-value=KEEP_LAST  # See "DURABILITY_SERVICE" chapter of DDS [cite{DDS}].
                  integer DdsDurabilityServiceMaxInstances: 0..65534, scope=ECU, set at pre-compile  # See "DURABILITY_SERVICE" chapter of DDS [cite{DDS}].
                  integer DdsDurabilityServiceMaxSamples: 0..65534, scope=ECU, set at pre-compile  # See "DURABILITY_SERVICE" chapter of DDS [cite{DDS}].
                  integer DdsDurabilityServiceMaxSamplesPerInstance: 0..65534, scope=ECU, set at pre-compile  # See "DURABILITY_SERVICE" chapter of DDS [cite{DDS}].
                container DdsHistory [0..1]: multiplicity set at pre-compile  # Describes the DDS [cite{DDS}] HISTORY QoS policy.
                  enumeration DdsHistoryKind: {KEEP_ALL, KEEP_LAST}, scope=ECU, set at pre-compile, default-value=KEEP_LAST  # See "HISTORY" chapter of DDS [cite{DDS}].
                  integer DdsHistoryOrderDepth: 0..65534, scope=ECU, set at pre-compile, default-value=1  # See "HISTORY" chapter of DDS [cite{DDS}].
                container DdsLatencyBudget [0..1]: multiplicity set at pre-compile  # Describes the DDS [cite{DDS}] LATENCY_BUDGET QoS policy.
                  float DdsLatencyBudgetDuration: 0..65.534, scope=ECU, set at pre-compile  # See "LATENCY_BUDGET" chapter of DDS [cite{DDS}]. | Time given in seconds.
                container DdsLifespan [0..1]: multiplicity set at pre-compile  # Describes the DDS [cite{DDS}] LIFESPAN QoS policy.
                  float DdsLifespanDuration: 0..65.534, scope=ECU, set at pre-compile  # See "LIFESPAN" chapter of DDS [cite{DDS}]. | Time given in seconds.
                container DdsLiveliness [0..1]: multiplicity set at pre-compile  # Describes the DDS [cite{DDS}] LIVELINESS QoS policy.
                  float DdsLivelinessLeaseDuration: 0..65.534, scope=ECU, set at pre-compile  # See "LIVELINESS" chapter of DDS [cite{DDS}]. | Time given in seconds.
                  enumeration DdsLivenessKind: {AUTOMATIC, MANUAL_BY_PARTICIPANT, MANUAL_BY_TOPIC}, scope=ECU, set at pre-compile, default-value=AUTOMATIC  # See "LIVELINESS" chapter of DDS [cite{DDS}].
                container DdsOwnership [0..1]: multiplicity set at pre-compile  # Describes the DDS [cite{DDS}] OWNERSHIP QoS policy.
                  enumeration DdsOwnershipKind: {EXCLUSIVE, SHARED}, scope=ECU, set at pre-compile, default-value=SHARED  # See "OWNERSHIP" chapter of DDS [cite{DDS}].
                container DdsOwnershipStrength [0..1]: multiplicity set at pre-compile  # Describes the DDS [cite{DDS}] OWNERSHIP_STRENGTH QoS policy.
                  integer DdsOwnershipStrengthValue: 0..65534, scope=ECU, set at pre-compile, default-value=0  # See "OWNERSHIP_STRENGTH" chapter of DDS [cite{DDS}].
                container DdsReliability [0..1]: multiplicity set at pre-compile  # Describes the DDS [cite{DDS}] RELIABILITY QoS policy.
                  enumeration DdsReliabilityKind: {BEST_EFFORT, RELIABLE}, scope=ECU, set at pre-compile  # See "RELIABILITY" chapter of DDS [cite{DDS}].
                  float DdsReliabilityMaxBlockingTime: 0..65.534, scope=ECU, set at pre-compile, default-value=0.1  # See "RELIABILITY" chapter of DDS [cite{DDS}]. | Time given in seconds.
                container DdsResourceLimits [0..1]: multiplicity set at pre-compile  # Describes the DDS [cite{DDS}] RESOURCE_LIMITS QoS policy.
                  integer DdsResouceLimitsMaxInstances: 0..65534, scope=ECU, set at pre-compile, default-value=65534  # See "RESOURCE_LIMITS" chapter of DDS [cite{DDS}].
                  integer DdsResouceLimitsMaxSamples: 0..65534, scope=ECU, set at pre-compile, default-value=65534  # See "RESOURCE_LIMITS" chapter of DDS [cite{DDS}].
                  integer DdsResouceLimitsMaxSamplesPerInstance: 0..65534, scope=ECU, set at pre-compile, default-value=65534  # See "RESOURCE_LIMITS" chapter of DDS [cite{DDS}].
                container DdsTransportPriority [0..1]: multiplicity set at pre-compile  # Describes the DDS [cite{DDS}] TRANSPORT_PRIORITY QoS policy.
                  integer DdsTransportPriorityValue: 0..65534, scope=ECU, set at pre-compile, default-value=0  # See "TRANSPORT_PRIORITY" chapter of DDS [cite{DDS}].
                container DdsUserData [0..1]: multiplicity set at pre-compile  # Describes the DDS [cite{DDS}] USER_DATA QoS policy.
                  string DdsUserDataValue: scope=ECU, set at pre-compile  # See "USER_DATA" chapter of DDS [cite{DDS}].
                container DdsWriterDataLifecycle [0..1]: multiplicity set at pre-compile  # Describes the DDS [cite{DDS}] WRITER_DATA_LIFECYCLE QoS policy.
                  boolean DdsAutodisposeUnregisteredInstances: set at pre-compile, default-value=true  # See "WRITER_DATA_LIFECYCLE" chapter of DDS [cite{DDS}].
            container DdsPublisherQoS [0..1]: multiplicity set at pre-compile  # This container represents the configuration of QoS Profiles related to the current Dds Publisher.
              container DdsEntityFactory [0..1]: multiplicity set at pre-compile  # Describes the DDS [cite{DDS}] ENTITY_FACTORY QoS policy.
                boolean DdsEntityFactoryAutoenableCreatedEntities: set at pre-compile, default-value=true  # See "ENTITY_FACTORY" chapter of DDS [cite{DDS}].
              container DdsGroupData [0..1]: multiplicity set at pre-compile  # Describes the DDS [cite{DDS}] GROUP_DATA QoS policy.
                string DdsGroupDataValue: scope=ECU, set at pre-compile  # See "GROUP_DATA" chapter of DDS [cite{DDS}].
              container DdsPartition [0..1]: multiplicity set at pre-compile  # Describes the DDS [cite{DDS}] PARTITION QoS policy.
                string DdsPartitionName [1..65534]: scope=ECU, multiplicity set at pre-compile, set at pre-compile  # See "PARTITION" chapter of DDS [cite{DDS}].
              container DdsPresentation [0..1]: multiplicity set at pre-compile  # Describes the DDS [cite{DDS}] PRESENTATION QoS policy.
                enumeration DdsPresentationAccessScope: {GROUP, INSTANCE, TOPIC}, scope=ECU, set at pre-compile  # See "PRESENTATION" chapter of DDS [cite{DDS}].
                boolean DdsPresentationCoherentAccess: set at pre-compile  # See "PRESENTATION" chapter of DDS [cite{DDS}].
                boolean DdsPresentationOrderedAccess: set at pre-compile  # See "PRESENTATION" chapter of DDS [cite{DDS}].
          container DdsRemoteDomainParticipantCollection [0..65535]: multiplicity set at pre-compile  # Collection of Remote Domain Participants.
            container DdsRemoteDomainParticipant [0..65535]: multiplicity set at pre-compile  # Static configuration of remote endpoints. This container contains information about reachability and QoS parameters of remote endpoints.
              integer DdsRtpsRemoteDomainParticipantId: 0..65535, scope=ECU, set at pre-compile  # The DomainParticipant ID of the remote DDS node. | Note: please refer to chapter "User Traffic" of Data Distribution Service (DDS), Version 1.4 for details on its usage.
              container DdsRemoteDataReader [0..65535]: multiplicity set at pre-compile  # The configuration of a specific remote DataReader.
                choice reference DdsRemoteDataReaderPdu: scope=ECU, set at pre-compile, destination=[DdsRtpsDataTxPdu, DdsRtpsMulticastDataTxPdu]  # The Pdu used to transmit data to the given remote DataReader. It could refer both a unicast and a multicast Pdu
                container DdsDataReaderQoS [0..1]  # This container represents the configuration of QoS Profiles related to the current DdsDataReader.
                  container DdsDeadline [0..1]: multiplicity set at pre-compile  # Describes the DDS [cite{DDS}] DEADLINE QoS policy.
                    float DdsDeadlinePeriod: 0..65.534, scope=ECU, set at pre-compile  # See "DEADLINE" chapter of DDS [cite{DDS}]. | Time given in seconds.
                  container DdsDestinationOrder [0..1]: multiplicity set at pre-compile  # Describes the DDS [cite{DDS}] DESTINATION_ORDER QoS policy.
                    enumeration DdsDestinationOrderKind: {BY_RECEPTION_TIMESTAMP, BY_SOURCE_TIMESTAMP}, scope=ECU, set at pre-compile, default-value=BY_RECEPTION_TIMESTAMP  # See "DESTINATION_ORDER" chapter of DDS [cite{DDS}].
                  container DdsHistory [0..1]: multiplicity set at pre-compile  # Describes the DDS [cite{DDS}] HISTORY QoS policy.
                    enumeration DdsHistoryKind: {KEEP_ALL, KEEP_LAST}, scope=ECU, set at pre-compile, default-value=KEEP_LAST  # See "HISTORY" chapter of DDS [cite{DDS}].
                    integer DdsHistoryOrderDepth: 0..65534, scope=ECU, set at pre-compile, default-value=1  # See "HISTORY" chapter of DDS [cite{DDS}].
                  container DdsLatencyBudget [0..1]: multiplicity set at pre-compile  # Describes the DDS [cite{DDS}] LATENCY_BUDGET QoS policy.
                    float DdsLatencyBudgetDuration: 0..65.534, scope=ECU, set at pre-compile  # See "LATENCY_BUDGET" chapter of DDS [cite{DDS}]. | Time given in seconds.
                  container DdsLiveliness [0..1]: multiplicity set at pre-compile  # Describes the DDS [cite{DDS}] LIVELINESS QoS policy.
                    float DdsLivelinessLeaseDuration: 0..65.534, scope=ECU, set at pre-compile  # See "LIVELINESS" chapter of DDS [cite{DDS}]. | Time given in seconds.
                    enumeration DdsLivenessKind: {AUTOMATIC, MANUAL_BY_PARTICIPANT, MANUAL_BY_TOPIC}, scope=ECU, set at pre-compile, default-value=AUTOMATIC  # See "LIVELINESS" chapter of DDS [cite{DDS}].
                  container DdsOwnership [0..1]: multiplicity set at pre-compile  # Describes the DDS [cite{DDS}] OWNERSHIP QoS policy.
                    enumeration DdsOwnershipKind: {EXCLUSIVE, SHARED}, scope=ECU, set at pre-compile, default-value=SHARED  # See "OWNERSHIP" chapter of DDS [cite{DDS}].
                  container DdsReaderDataLifecycle [0..1]: multiplicity set at pre-compile  # Describes the DDS [cite{DDS}] READER_DATA_LIFECYCLE QoS policy.
                    integer DdsAutopurgeDisposedSamplesDelay: 0..65534, scope=ECU, set at pre-compile, default-value=65534  # See "READER_DATA_LIFECYCLE" chapter of DDS [cite{DDS}].
                    integer DdsAutopurgeNowriterSamplesDelay: 0..65534, scope=ECU, set at pre-compile, default-value=65534  # See "READER_DATA_LIFECYCLE" chapter of DDS [cite{DDS}].
                  container DdsReliability [0..1]: multiplicity set at pre-compile  # Describes the DDS [cite{DDS}] RELIABILITY QoS policy.
                    enumeration DdsReliabilityKind: {BEST_EFFORT, RELIABLE}, scope=ECU, set at pre-compile  # See "RELIABILITY" chapter of DDS [cite{DDS}].
                    float DdsReliabilityMaxBlockingTime: 0..65.534, scope=ECU, set at pre-compile, default-value=0.1  # See "RELIABILITY" chapter of DDS [cite{DDS}]. | Time given in seconds.
                  container DdsResourceLimits [0..1]: multiplicity set at pre-compile  # Describes the DDS [cite{DDS}] RESOURCE_LIMITS QoS policy.
                    integer DdsResouceLimitsMaxInstances: 0..65534, scope=ECU, set at pre-compile, default-value=65534  # See "RESOURCE_LIMITS" chapter of DDS [cite{DDS}].
                    integer DdsResouceLimitsMaxSamples: 0..65534, scope=ECU, set at pre-compile, default-value=65534  # See "RESOURCE_LIMITS" chapter of DDS [cite{DDS}].
                    integer DdsResouceLimitsMaxSamplesPerInstance: 0..65534, scope=ECU, set at pre-compile, default-value=65534  # See "RESOURCE_LIMITS" chapter of DDS [cite{DDS}].
                  container DdsTimeBasedFilter [0..1]: multiplicity set at pre-compile  # Describes the DDS [cite{DDS}] TIME_BASED_FILTER QoS policy.
                    float DdsTimeBasedFilterMinimumSeparation: 0..65.534, scope=ECU, set at pre-compile  # See "TIME_BASED_FILTER" chapter of DDS [cite{DDS}]. | Time given in seconds.
                  container DdsUserData [0..1]: multiplicity set at pre-compile  # Describes the DDS [cite{DDS}] USER_DATA QoS policy.
                    string DdsUserDataValue: scope=ECU, set at pre-compile  # See "USER_DATA" chapter of DDS [cite{DDS}].
              container DdsRemoteDataWriter [0..65535]: multiplicity set at pre-compile  # The configuration of a specific remote DataWriter.
                choice reference DdsRemoteDataWriterPdu: scope=ECU, set at pre-compile, destination=[DdsRtpsDataRxPdu, DdsRtpsMulticastDataRxPdu]  # The Pdu used to receive data from the given remote DataWriter. It could refer both a unicast and a multicast Pdu
                container DdsDataWriterQoS [0..1]  # This container represents the configuration of QoS Profiles related to the current DdsDataWriter.
                  container DdsDeadline [0..1]: multiplicity set at pre-compile  # Describes the DDS [cite{DDS}] DEADLINE QoS policy.
                    float DdsDeadlinePeriod: 0..65.534, scope=ECU, set at pre-compile  # See "DEADLINE" chapter of DDS [cite{DDS}]. | Time given in seconds.
                  container DdsDestinationOrder [0..1]: multiplicity set at pre-compile  # Describes the DDS [cite{DDS}] DESTINATION_ORDER QoS policy.
                    enumeration DdsDestinationOrderKind: {BY_RECEPTION_TIMESTAMP, BY_SOURCE_TIMESTAMP}, scope=ECU, set at pre-compile, default-value=BY_RECEPTION_TIMESTAMP  # See "DESTINATION_ORDER" chapter of DDS [cite{DDS}].
                  container DdsDurability [0..1]: multiplicity set at pre-compile  # Describes the DDS [cite{DDS}] DURABILITY QoS policy.
                    enumeration DdsDurabilityKind: {PERSISTENT, TRANSIENT, TRANSIENT_LOCAL, VOLATILE}, scope=ECU, set at pre-compile, default-value=VOLATILE  # See "DURABILITY" chapter of DDS [cite{DDS}].
                  container DdsDurabilityService [0..1]: multiplicity set at pre-compile  # Describes the DDS [cite{DDS}] DURABILITY_SERVICE QoS policy.
                    float DdsDurabilityServiceCleanupDelay: 0..65.534, scope=ECU, set at pre-compile  # See "DURABILITY_SERVICE" chapter of DDS [cite{DDS}]. | Time given in seconds.
                    integer DdsDurabilityServiceHistoryDepth: 0..65534, scope=ECU, set at pre-compile, default-value=1  # See "DURABILITY_SERVICE" chapter of DDS [cite{DDS}].
                    enumeration DdsDurabilityServiceHistoryKind: {KEEP_ALL, KEEP_LAST}, scope=ECU, set at pre-compile, default-value=KEEP_LAST  # See "DURABILITY_SERVICE" chapter of DDS [cite{DDS}].
                    integer DdsDurabilityServiceMaxInstances: 0..65534, scope=ECU, set at pre-compile  # See "DURABILITY_SERVICE" chapter of DDS [cite{DDS}].
                    integer DdsDurabilityServiceMaxSamples: 0..65534, scope=ECU, set at pre-compile  # See "DURABILITY_SERVICE" chapter of DDS [cite{DDS}].
                    integer DdsDurabilityServiceMaxSamplesPerInstance: 0..65534, scope=ECU, set at pre-compile  # See "DURABILITY_SERVICE" chapter of DDS [cite{DDS}].
                  container DdsHistory [0..1]: multiplicity set at pre-compile  # Describes the DDS [cite{DDS}] HISTORY QoS policy.
                    enumeration DdsHistoryKind: {KEEP_ALL, KEEP_LAST}, scope=ECU, set at pre-compile, default-value=KEEP_LAST  # See "HISTORY" chapter of DDS [cite{DDS}].
                    integer DdsHistoryOrderDepth: 0..65534, scope=ECU, set at pre-compile, default-value=1  # See "HISTORY" chapter of DDS [cite{DDS}].
                  container DdsLatencyBudget [0..1]: multiplicity set at pre-compile  # Describes the DDS [cite{DDS}] LATENCY_BUDGET QoS policy.
                    float DdsLatencyBudgetDuration: 0..65.534, scope=ECU, set at pre-compile  # See "LATENCY_BUDGET" chapter of DDS [cite{DDS}]. | Time given in seconds.
                  container DdsLifespan [0..1]: multiplicity set at pre-compile  # Describes the DDS [cite{DDS}] LIFESPAN QoS policy.
                    float DdsLifespanDuration: 0..65.534, scope=ECU, set at pre-compile  # See "LIFESPAN" chapter of DDS [cite{DDS}]. | Time given in seconds.
                  container DdsLiveliness [0..1]: multiplicity set at pre-compile  # Describes the DDS [cite{DDS}] LIVELINESS QoS policy.
                    float DdsLivelinessLeaseDuration: 0..65.534, scope=ECU, set at pre-compile  # See "LIVELINESS" chapter of DDS [cite{DDS}]. | Time given in seconds.
                    enumeration DdsLivenessKind: {AUTOMATIC, MANUAL_BY_PARTICIPANT, MANUAL_BY_TOPIC}, scope=ECU, set at pre-compile, default-value=AUTOMATIC  # See "LIVELINESS" chapter of DDS [cite{DDS}].
                  container DdsOwnership [0..1]: multiplicity set at pre-compile  # Describes the DDS [cite{DDS}] OWNERSHIP QoS policy.
                    enumeration DdsOwnershipKind: {EXCLUSIVE, SHARED}, scope=ECU, set at pre-compile, default-value=SHARED  # See "OWNERSHIP" chapter of DDS [cite{DDS}].
                  container DdsOwnershipStrength [0..1]: multiplicity set at pre-compile  # Describes the DDS [cite{DDS}] OWNERSHIP_STRENGTH QoS policy.
                    integer DdsOwnershipStrengthValue: 0..65534, scope=ECU, set at pre-compile, default-value=0  # See "OWNERSHIP_STRENGTH" chapter of DDS [cite{DDS}].
                  container DdsReliability [0..1]: multiplicity set at pre-compile  # Describes the DDS [cite{DDS}] RELIABILITY QoS policy.
                    enumeration DdsReliabilityKind: {BEST_EFFORT, RELIABLE}, scope=ECU, set at pre-compile  # See "RELIABILITY" chapter of DDS [cite{DDS}].
                    float DdsReliabilityMaxBlockingTime: 0..65.534, scope=ECU, set at pre-compile, default-value=0.1  # See "RELIABILITY" chapter of DDS [cite{DDS}]. | Time given in seconds.
                  container DdsResourceLimits [0..1]: multiplicity set at pre-compile  # Describes the DDS [cite{DDS}] RESOURCE_LIMITS QoS policy.
                    integer DdsResouceLimitsMaxInstances: 0..65534, scope=ECU, set at pre-compile, default-value=65534  # See "RESOURCE_LIMITS" chapter of DDS [cite{DDS}].
                    integer DdsResouceLimitsMaxSamples: 0..65534, scope=ECU, set at pre-compile, default-value=65534  # See "RESOURCE_LIMITS" chapter of DDS [cite{DDS}].
                    integer DdsResouceLimitsMaxSamplesPerInstance: 0..65534, scope=ECU, set at pre-compile, default-value=65534  # See "RESOURCE_LIMITS" chapter of DDS [cite{DDS}].
                  container DdsTransportPriority [0..1]: multiplicity set at pre-compile  # Describes the DDS [cite{DDS}] TRANSPORT_PRIORITY QoS policy.
                    integer DdsTransportPriorityValue: 0..65534, scope=ECU, set at pre-compile, default-value=0  # See "TRANSPORT_PRIORITY" chapter of DDS [cite{DDS}].
                  container DdsUserData [0..1]: multiplicity set at pre-compile  # Describes the DDS [cite{DDS}] USER_DATA QoS policy.
                    string DdsUserDataValue: scope=ECU, set at pre-compile  # See "USER_DATA" chapter of DDS [cite{DDS}].
                  container DdsWriterDataLifecycle [0..1]: multiplicity set at pre-compile  # Describes the DDS [cite{DDS}] WRITER_DATA_LIFECYCLE QoS policy.
                    boolean DdsAutodisposeUnregisteredInstances: set at pre-compile, default-value=true  # See "WRITER_DATA_LIFECYCLE" chapter of DDS [cite{DDS}].
          container DdsSubscriber [0..65535]: multiplicity set at pre-compile  # This container represents the configuration of a Subscriber.
            container DdsDataReader [1..65535]: multiplicity set at pre-compile  # This container represents the configuration of one data reader. One subscriber can refer to one or more readers, but a reader can belong to one single subscriber.
              reference DdsDataReaderAppDataRxPduRef [1..65535]: scope=ECU, multiplicity set at pre-compile, set at pre-compile, destination=DdsAppDataRxPdu  # This reference refers to the DdsAppDataRxPdu which is used by Dds module to forward de-serialized DDS data to the upper layer of the DDS module.
              reference DdsDataReaderRemoteDataWriters [0..65535]: scope=ECU, multiplicity set at pre-compile, set at pre-compile, destination=DdsRemoteDataWriter  # Reference to the remote DdsDataWriters from which the current DdsDataReaders would like to receive data. | Data from a remote writer is received by using the DdsRemoteDataWriterPdu referred by the given DdsRemoteDataWriter.
              reference DdsDataReaderTopicRef: scope=ECU, set at pre-compile, destination=DdsTopic  # This reference selects the Topic on which the current Dds Reader wants to receive.
              container DdsDataReaderQoS [0..1]  # This container represents the configuration of QoS Profiles related to the current DdsDataReader.
                container DdsDeadline [0..1]: multiplicity set at pre-compile  # Describes the DDS [cite{DDS}] DEADLINE QoS policy.
                  float DdsDeadlinePeriod: 0..65.534, scope=ECU, set at pre-compile  # See "DEADLINE" chapter of DDS [cite{DDS}]. | Time given in seconds.
                container DdsDestinationOrder [0..1]: multiplicity set at pre-compile  # Describes the DDS [cite{DDS}] DESTINATION_ORDER QoS policy.
                  enumeration DdsDestinationOrderKind: {BY_RECEPTION_TIMESTAMP, BY_SOURCE_TIMESTAMP}, scope=ECU, set at pre-compile, default-value=BY_RECEPTION_TIMESTAMP  # See "DESTINATION_ORDER" chapter of DDS [cite{DDS}].
                container DdsHistory [0..1]: multiplicity set at pre-compile  # Describes the DDS [cite{DDS}] HISTORY QoS policy.
                  enumeration DdsHistoryKind: {KEEP_ALL, KEEP_LAST}, scope=ECU, set at pre-compile, default-value=KEEP_LAST  # See "HISTORY" chapter of DDS [cite{DDS}].
                  integer DdsHistoryOrderDepth: 0..65534, scope=ECU, set at pre-compile, default-value=1  # See "HISTORY" chapter of DDS [cite{DDS}].
                container DdsLatencyBudget [0..1]: multiplicity set at pre-compile  # Describes the DDS [cite{DDS}] LATENCY_BUDGET QoS policy.
                  float DdsLatencyBudgetDuration: 0..65.534, scope=ECU, set at pre-compile  # See "LATENCY_BUDGET" chapter of DDS [cite{DDS}]. | Time given in seconds.
                container DdsLiveliness [0..1]: multiplicity set at pre-compile  # Describes the DDS [cite{DDS}] LIVELINESS QoS policy.
                  float DdsLivelinessLeaseDuration: 0..65.534, scope=ECU, set at pre-compile  # See "LIVELINESS" chapter of DDS [cite{DDS}]. | Time given in seconds.
                  enumeration DdsLivenessKind: {AUTOMATIC, MANUAL_BY_PARTICIPANT, MANUAL_BY_TOPIC}, scope=ECU, set at pre-compile, default-value=AUTOMATIC  # See "LIVELINESS" chapter of DDS [cite{DDS}].
                container DdsOwnership [0..1]: multiplicity set at pre-compile  # Describes the DDS [cite{DDS}] OWNERSHIP QoS policy.
                  enumeration DdsOwnershipKind: {EXCLUSIVE, SHARED}, scope=ECU, set at pre-compile, default-value=SHARED  # See "OWNERSHIP" chapter of DDS [cite{DDS}].
                container DdsReaderDataLifecycle [0..1]: multiplicity set at pre-compile  # Describes the DDS [cite{DDS}] READER_DATA_LIFECYCLE QoS policy.
                  integer DdsAutopurgeDisposedSamplesDelay: 0..65534, scope=ECU, set at pre-compile, default-value=65534  # See "READER_DATA_LIFECYCLE" chapter of DDS [cite{DDS}].
                  integer DdsAutopurgeNowriterSamplesDelay: 0..65534, scope=ECU, set at pre-compile, default-value=65534  # See "READER_DATA_LIFECYCLE" chapter of DDS [cite{DDS}].
                container DdsReliability [0..1]: multiplicity set at pre-compile  # Describes the DDS [cite{DDS}] RELIABILITY QoS policy.
                  enumeration DdsReliabilityKind: {BEST_EFFORT, RELIABLE}, scope=ECU, set at pre-compile  # See "RELIABILITY" chapter of DDS [cite{DDS}].
                  float DdsReliabilityMaxBlockingTime: 0..65.534, scope=ECU, set at pre-compile, default-value=0.1  # See "RELIABILITY" chapter of DDS [cite{DDS}]. | Time given in seconds.
                container DdsResourceLimits [0..1]: multiplicity set at pre-compile  # Describes the DDS [cite{DDS}] RESOURCE_LIMITS QoS policy.
                  integer DdsResouceLimitsMaxInstances: 0..65534, scope=ECU, set at pre-compile, default-value=65534  # See "RESOURCE_LIMITS" chapter of DDS [cite{DDS}].
                  integer DdsResouceLimitsMaxSamples: 0..65534, scope=ECU, set at pre-compile, default-value=65534  # See "RESOURCE_LIMITS" chapter of DDS [cite{DDS}].
                  integer DdsResouceLimitsMaxSamplesPerInstance: 0..65534, scope=ECU, set at pre-compile, default-value=65534  # See "RESOURCE_LIMITS" chapter of DDS [cite{DDS}].
                container DdsTimeBasedFilter [0..1]: multiplicity set at pre-compile  # Describes the DDS [cite{DDS}] TIME_BASED_FILTER QoS policy.
                  float DdsTimeBasedFilterMinimumSeparation: 0..65.534, scope=ECU, set at pre-compile  # See "TIME_BASED_FILTER" chapter of DDS [cite{DDS}]. | Time given in seconds.
                container DdsUserData [0..1]: multiplicity set at pre-compile  # Describes the DDS [cite{DDS}] USER_DATA QoS policy.
                  string DdsUserDataValue: scope=ECU, set at pre-compile  # See "USER_DATA" chapter of DDS [cite{DDS}].
            container DdsSubscriberQoS [0..1]: multiplicity set at pre-compile  # This container represents the configuration of QoS Profiles related to the current Dds Subscriber.
              container DdsEntityFactory [0..1]: multiplicity set at pre-compile  # Describes the DDS [cite{DDS}] ENTITY_FACTORY QoS policy.
                boolean DdsEntityFactoryAutoenableCreatedEntities: set at pre-compile, default-value=true  # See "ENTITY_FACTORY" chapter of DDS [cite{DDS}].
              container DdsGroupData [0..1]: multiplicity set at pre-compile  # Describes the DDS [cite{DDS}] GROUP_DATA QoS policy.
                string DdsGroupDataValue: scope=ECU, set at pre-compile  # See "GROUP_DATA" chapter of DDS [cite{DDS}].
              container DdsPartition [0..1]: multiplicity set at pre-compile  # Describes the DDS [cite{DDS}] PARTITION QoS policy.
                string DdsPartitionName [1..65534]: scope=ECU, multiplicity set at pre-compile, set at pre-compile  # See "PARTITION" chapter of DDS [cite{DDS}].
              container DdsPresentation [0..1]: multiplicity set at pre-compile  # Describes the DDS [cite{DDS}] PRESENTATION QoS policy.
                enumeration DdsPresentationAccessScope: {GROUP, INSTANCE, TOPIC}, scope=ECU, set at pre-compile  # See "PRESENTATION" chapter of DDS [cite{DDS}].
                boolean DdsPresentationCoherentAccess: set at pre-compile  # See "PRESENTATION" chapter of DDS [cite{DDS}].
                boolean DdsPresentationOrderedAccess: set at pre-compile  # See "PRESENTATION" chapter of DDS [cite{DDS}].
          container DdsTopic [0..65535]: multiplicity set at pre-compile  # This container represents the configuration of one Topic.
            string DdsTopicName: scope=ECU, multiplicity set at pre-compile, set at pre-compile  # Identifies name of the Topic. Communication between publishers and subscribers is based on the topic name.
            foreign reference DdsTopicImplementationType [0..1]: scope=ECU, multiplicity set at pre-compile, set at pre-compile, destination-type=IMPLEMENTATION-DATA-TYPE  # This reference selects the ImplementationDataType the topic is related. A Topic is used to publish a well-defined data type, described by the referenced ImplementationDataType. | Note: if the Topic is related to a SenderReceiver communication, the reference to the ImplementationDataType shall exist
            container DdsTopicQoS [0..1]  # This container contains the configuration of the QoS supported by the DdsTopic
              container DdsDeadline [0..1]: multiplicity set at pre-compile  # Describes the DDS [cite{DDS}] DEADLINE QoS policy.
                float DdsDeadlinePeriod: 0..65.534, scope=ECU, set at pre-compile  # See "DEADLINE" chapter of DDS [cite{DDS}]. | Time given in seconds.
              container DdsDestinationOrder [0..1]: multiplicity set at pre-compile  # Describes the DDS [cite{DDS}] DESTINATION_ORDER QoS policy.
                enumeration DdsDestinationOrderKind: {BY_RECEPTION_TIMESTAMP, BY_SOURCE_TIMESTAMP}, scope=ECU, set at pre-compile, default-value=BY_RECEPTION_TIMESTAMP  # See "DESTINATION_ORDER" chapter of DDS [cite{DDS}].
              container DdsDurability [0..1]: multiplicity set at pre-compile  # Describes the DDS [cite{DDS}] DURABILITY QoS policy.
                enumeration DdsDurabilityKind: {PERSISTENT, TRANSIENT, TRANSIENT_LOCAL, VOLATILE}, scope=ECU, set at pre-compile, default-value=VOLATILE  # See "DURABILITY" chapter of DDS [cite{DDS}].
              container DdsDurabilityService [0..1]: multiplicity set at pre-compile  # Describes the DDS [cite{DDS}] DURABILITY_SERVICE QoS policy.
                float DdsDurabilityServiceCleanupDelay: 0..65.534, scope=ECU, set at pre-compile  # See "DURABILITY_SERVICE" chapter of DDS [cite{DDS}]. | Time given in seconds.
                integer DdsDurabilityServiceHistoryDepth: 0..65534, scope=ECU, set at pre-compile, default-value=1  # See "DURABILITY_SERVICE" chapter of DDS [cite{DDS}].
                enumeration DdsDurabilityServiceHistoryKind: {KEEP_ALL, KEEP_LAST}, scope=ECU, set at pre-compile, default-value=KEEP_LAST  # See "DURABILITY_SERVICE" chapter of DDS [cite{DDS}].
                integer DdsDurabilityServiceMaxInstances: 0..65534, scope=ECU, set at pre-compile  # See "DURABILITY_SERVICE" chapter of DDS [cite{DDS}].
                integer DdsDurabilityServiceMaxSamples: 0..65534, scope=ECU, set at pre-compile  # See "DURABILITY_SERVICE" chapter of DDS [cite{DDS}].
                integer DdsDurabilityServiceMaxSamplesPerInstance: 0..65534, scope=ECU, set at pre-compile  # See "DURABILITY_SERVICE" chapter of DDS [cite{DDS}].
              container DdsHistory [0..1]: multiplicity set at pre-compile  # Describes the DDS [cite{DDS}] HISTORY QoS policy.
                enumeration DdsHistoryKind: {KEEP_ALL, KEEP_LAST}, scope=ECU, set at pre-compile, default-value=KEEP_LAST  # See "HISTORY" chapter of DDS [cite{DDS}].
                integer DdsHistoryOrderDepth: 0..65534, scope=ECU, set at pre-compile, default-value=1  # See "HISTORY" chapter of DDS [cite{DDS}].
              container DdsLatencyBudget [0..1]: multiplicity set at pre-compile  # Describes the DDS [cite{DDS}] LATENCY_BUDGET QoS policy.
                float DdsLatencyBudgetDuration: 0..65.534, scope=ECU, set at pre-compile  # See "LATENCY_BUDGET" chapter of DDS [cite{DDS}]. | Time given in seconds.
              container DdsLifespan [0..1]: multiplicity set at pre-compile  # Describes the DDS [cite{DDS}] LIFESPAN QoS policy.
                float DdsLifespanDuration: 0..65.534, scope=ECU, set at pre-compile  # See "LIFESPAN" chapter of DDS [cite{DDS}]. | Time given in seconds.
              container DdsLiveliness [0..1]: multiplicity set at pre-compile  # Describes the DDS [cite{DDS}] LIVELINESS QoS policy.
                float DdsLivelinessLeaseDuration: 0..65.534, scope=ECU, set at pre-compile  # See "LIVELINESS" chapter of DDS [cite{DDS}]. | Time given in seconds.
                enumeration DdsLivenessKind: {AUTOMATIC, MANUAL_BY_PARTICIPANT, MANUAL_BY_TOPIC}, scope=ECU, set at pre-compile, default-value=AUTOMATIC  # See "LIVELINESS" chapter of DDS [cite{DDS}].
              container DdsOwnership [0..1]: multiplicity set at pre-compile  # Describes the DDS [cite{DDS}] OWNERSHIP QoS policy.
                enumeration DdsOwnershipKind: {EXCLUSIVE, SHARED}, scope=ECU, set at pre-compile, default-value=SHARED  # See "OWNERSHIP" chapter of DDS [cite{DDS}].
              container DdsReliability [0..1]: multiplicity set at pre-compile  # Describes the DDS [cite{DDS}] RELIABILITY QoS policy.
                enumeration DdsReliabilityKind: {BEST_EFFORT, RELIABLE}, scope=ECU, set at pre-compile  # See "RELIABILITY" chapter of DDS [cite{DDS}].
                float DdsReliabilityMaxBlockingTime: 0..65.534, scope=ECU, set at pre-compile, default-value=0.1  # See "RELIABILITY" chapter of DDS [cite{DDS}]. | Time given in seconds.
              container DdsResourceLimits [0..1]: multiplicity set at pre-compile  # Describes the DDS [cite{DDS}] RESOURCE_LIMITS QoS policy.
                integer DdsResouceLimitsMaxInstances: 0..65534, scope=ECU, set at pre-compile, default-value=65534  # See "RESOURCE_LIMITS" chapter of DDS [cite{DDS}].
                integer DdsResouceLimitsMaxSamples: 0..65534, scope=ECU, set at pre-compile, default-value=65534  # See "RESOURCE_LIMITS" chapter of DDS [cite{DDS}].
                integer DdsResouceLimitsMaxSamplesPerInstance: 0..65534, scope=ECU, set at pre-compile, default-value=65534  # See "RESOURCE_LIMITS" chapter of DDS [cite{DDS}].
              container DdsTopicData [0..1]: multiplicity set at pre-compile  # Describes the DDS [cite{DDS}] TOPIC_DATA QoS policy.
                string DdsTopicDataValue: scope=ECU, set at pre-compile  # See "TOPIC_DATA" chapter of DDS [cite{DDS}].
              container DdsTransportPriority [0..1]: multiplicity set at pre-compile  # Describes the DDS [cite{DDS}] TRANSPORT_PRIORITY QoS policy.
                integer DdsTransportPriorityValue: 0..65534, scope=ECU, set at pre-compile, default-value=0  # See "TRANSPORT_PRIORITY" chapter of DDS [cite{DDS}].
      container DdsRxQueueCollection [0..1]: multiplicity set at pre-compile  # Collection of Rx queues.
        container DdsRxQueue [1..65535]: multiplicity set at pre-compile  # The queue used to save DdsRtpsDataRxPdus from PduR (as lower) to DDS. | One single queue can be used to save one or more DdsRtpsDataRxPdus.
          enumeration DdsQueueAlgorithm: {FIFO, LIFO, VENDOR_SPECIFIC}, scope=ECU, set at pre-compile  # Single queue scheduling algorithm
          float DdsRxQueuePeriod: 0..65.534, scope=ECU, set at pre-compile  # Scheduling period of the single queue. | Time given in seconds.
          integer DdsRxQueueSize: 0..65535, scope=ECU, set at pre-compile  # Queue size in bytes
          reference DdsRxQueueMulticastPduRef [0..65535]: scope=ECU, multiplicity set at pre-compile, set at pre-compile, destination=DdsRtpsMulticastDataRxPdu  # Reference to a reception multicast lower layer PDU to be stored in the given queue.
          reference DdsRxQueueUnicastPduRef [0..65535]: scope=ECU, multiplicity set at pre-compile, set at pre-compile, destination=DdsRtpsDataRxPdu  # Reference to a reception unicast lower layer Pdu to be stored in the given queue.
      container DdsTxQueueCollection [0..1]: multiplicity set at pre-compile  # Collection of Tx queues.
        container DdsTxQueue [1..65535]: multiplicity set at pre-compile  # The queue used to save DdsAppDataTxPdus from PduR (as upper) to DDS. | One single queue can be used to save one or more DdsAppDataTxPdus.
          enumeration DdsQueueAlgorithm: {FIFO, LIFO, VENDOR_SPECIFIC}, scope=ECU, set at pre-compile  # Single queue scheduling algorithm
          float DdsTxQueuePeriod: 0..65.534, scope=ECU, set at pre-compile  # Scheduling period of the single queue. | Time given in seconds.
          integer DdsTxQueueSize: 0..65535, scope=ECU, set at pre-compile  # Queue size in bytes
          reference DdsTxQueuePduRef [1..65535]: scope=ECU, multiplicity set at pre-compile, set at pre-compile, destination=DdsAppDataTxPdu  # Reference to a transmission upper layer PDU to be stored in the given queue.
    container DdsGeneral  # This container lists the general configuration parameters for the Dds module.
      boolean DdsDevErrorDetect: set at pre-compile, default-value=false  # Switches the development error detection and notification on or off. | * true: detection and notification is enabled. * false: detection and notification is disabled.
      float DdsMainRxFunctionPeriod: 0..INF, set at pre-compile  # This parameter defines the cycle time in seconds of the periodic call of the Dds_MainFunction_Rx.
      float DdsMainTxFunctionPeriod: 0..INF, set at pre-compile  # This parameter defines the cycle time in seconds of the periodic call of the Dds_MainFunction_Tx.
      reference DdsSynchronizedTimeBaseRef [0..1]: scope=ECU, multiplicity set at pre-compile, set at pre-compile, requires-symbolic-name-value=true, destination=StbMSynchronizedTimeBase  # Reference to a StbM Synchronized Time Base.
  module definition Dem [0..1]: post-build-variant-support=true, variants post-build/pre-compile  # Configuration of the Dem (Diagnostic Event Manager) module.
    container DemConfigSet  # This container contains the configuration parameters and sub containers of the Dem module supporting multiple configuration sets.
      container DemComponent [0..*]  # This container configures the monitored components and system dependencies.
        function name DemComponentFailedCallbackFnc [0..1]: multiplicity set at pre-compile, set at pre-compile  # Specifies the function to be called on component failed status changes.
        function name DemComponentFailedCallbackUsePort [0..1]: multiplicity set at pre-compile, set at pre-compile, default-value=false  # Specifies whether CBStatusComp_{ComponentName} for component change notifications shall be provided.
        integer DemComponentId: 1..65535, scope=ECU, set at pre-compile, symbolic-name-value=true  # Unique identifier of a DemComponent. | Component Id should be configured in sequential order beginning with 1 and no gaps in between. This parameter should not be changeable by user, because the Id should be generated by Dem itself to prevent gaps and multiple use of an Id
        boolean DemComponentIgnoresPriority [0..1]: multiplicity set at pre-compile, set at pre-compile, default-value=false  # This configuration switch defines, whether the priority of events at this component shall be ignored.
        reference DemImmediateChildComponentRef [0..*]: multiplicity set at pre-compile, set at pre-compile, destination=DemComponent  # Reference to all immediate children of the current component.
      container DemDTC [0..65535]  # This container contains the configuration (parameters) for DemUdsDTC.
        integer DemDTCFunctionalUnit [0..1]: 0..255, scope=ECU, multiplicity set at pre-compile, set at pre-compile  # DTCFuncitonalUnit is a 1-byte value which identifies the corresponding basic vehicle / system function which reports the DTC. This parameter is necessary for the report of severity information. | If this parameter is configured for no DTC, the Dem provides no DTC functional unit information.
        boolean DemDtcOBDRelevance [0..1]: multiplicity set at post-build in variant post-build / pre-compile in variant pre-compile, post-build-variant-multiplicity=true, post-build-variant-value=true, set at post-build in variant post-build / pre-compile in variant pre-compile  # Defines is this DTC is relevant for OBD. OBD relevant DTCs are reported in the OBD related APIs and it is possible to configure the calculation of further OBD related data such as readiness groups, IUMPR, etc. | If set to false, the DTC is not OBD relevant If set to true, the DTC is OBD relevant.
        enumeration DemDTCSeverity [0..1]: {DEM_SEVERITY_CHECK_AT_NEXT_HALT, DEM_SEVERITY_CHECK_IMMEDIATELY, DEM_SEVERITY_MAINTENANCE_ONLY, DEM_SEVERITY_NO_SEVERITY}, scope=ECU, multiplicity set at post-build in variant post-build / pre-compile in variant pre-compile, post-build-variant-multiplicity=true, post-build-variant-value=true, set at post-build in variant post-build / pre-compile in variant pre-compile, default-value=DEM_SEVERITY_NO_SEVERITY  # DTC severity according to ISO 14229-1. This parameter depends on the automotive manufacturer. | If it is not configured, the value is counted as 'no severity'. If this parameter is configured for no DTC, the Dem provides no DTC severity information.
        integer DemDtcValue [0..1]: 256..16777214, scope=ECU, multiplicity set at post-build in variant post-build / pre-compile in variant pre-compile, post-build-variant-multiplicity=true, post-build-variant-value=true, set at post-build in variant post-build / pre-compile in variant pre-compile  # 3 Byte value of the UDS Diagnostic Trouble Code (DTC). The value is unique within a fault memory. | The ranges: 0x000000-0x0000FF and 0xFFFFFF are reserved by ISO 14229-1.
        enumeration DemNvStorageStrategy [0..1]: {DURING_SHUTDOWN, IMMEDIATE_AT_FIRST_OCCURRENCE}, scope=ECU, multiplicity set at pre-compile, set at pre-compile, default-value=DURING_SHUTDOWN  # This parameter defines when the event related data of the DTC is stored in the NVRAM.
        enumeration DemWWHOBDDTCClass [0..1]: {DEM_DTC_WWHOBD_CLASS_A, DEM_DTC_WWHOBD_CLASS_B1, DEM_DTC_WWHOBD_CLASS_B2, DEM_DTC_WWHOBD_CLASS_C, DEM_DTC_WWHOBD_CLASS_NOCLASS}, scope=ECU, multiplicity set at pre-compile, set at pre-compile  # DTC Class according to ISO 14229-1 [2013 version]. This parameter depends on the automotive manufacturer. | If it is not configured, the value is marked as 'unclassified'. If this parameter is configured for no DTC, the Dem provides no DTC WWHOBD class information.
        reference DemDTCAttributesRef: set at pre-compile, destination=DemDTCAttributes  # This parameter defines the DTC Attributes associated with the DemDTC.
        reference DemObdDTCRef [0..1]: multiplicity set at pre-compile, set at pre-compile, destination=DemObdDTC  # This parameter defines the OBD DTC configuration associated with the DemDTC. | It is allowed to have events without a OBD DTC.
      container DemDTCAttributes [0..65535]  # This container contains the configuration (parameters) for DemDTCAttributes.
        integer DemAgingCycleCounterThreshold [0..1]: 1..255, scope=ECU, multiplicity set at pre-compile, set at pre-compile  # Number of aging cycles needed to unlearn/delete the event.
        integer DemAgingCycleCounterThresholdForTFSLC [0..1]: 1..255, scope=ECU, multiplicity set at pre-compile, set at pre-compile  # Number of aging cycles needed to reset the testFailedSinceLastClear Bit.
        integer DemDTCPriority: 1..255, scope=ECU, set at pre-compile  # Priority of the event/dtc, in view of full event memory. A lower value means higher priority.
        enumeration DemDTCSignificance [0..1]: {DEM_EVENT_SIGNIFICANCE_FAULT, DEM_EVENT_SIGNIFICANCE_OCCURRENCE}, scope=ECU, multiplicity set at pre-compile, set at pre-compile  # Significance of the event, which indicates additional information concerning fault classification and resolution. | It can be mapped as Dem-internal data element. It shall be configured, if it is a part of event related data.
        integer DemMaxNumberFreezeFrameRecords [0..1]: 0..255, scope=ECU, multiplicity set at pre-compile, set at pre-compile  # This parameter defines the number of according freeze frame records, which can maximal be stored for this event. Therefore all these freeze frame records have the same freeze frame class. | This parameter is only required for calculated record numeration (refer to DemTypeOfFreezeFrameRecordNumeration).
        reference DemAgingCycleRef [0..1]: scope=ECU, multiplicity set at pre-compile, set at pre-compile, destination=DemOperationCycle  # Reference to the cycle which is triggering the aging of the event.
        reference DemExtendedDataClassRef [0..1]: multiplicity set at pre-compile, set at pre-compile, destination=DemExtendedDataClass  # This reference defines the link to an extended data class sampler.
        reference DemFreezeFrameClassRef [0..1]: multiplicity set at pre-compile, set at pre-compile, destination=DemFreezeFrameClass  # These references define the links to a freeze frame class sampler.
        reference DemFreezeFrameRecNumClassRef [0..1]: scope=ECU, multiplicity set at pre-compile, set at pre-compile, destination=DemFreezeFrameRecNumClass  # This parameter defines the list of dedicated freeze frame record numbers associated with the diagnostic event. These record numbers are assigned to the freeze frame records (instead of calculated record numbers). | This parameter is only required for configured record numeration (refer to DemTypeOfFreezeFrameRecordNumeration).
        reference DemJ1939ExpandedFreezeFrameClassRef [0..1]: multiplicity set at pre-compile, set at pre-compile, destination=DemJ1939FreezeFrameClass  # These references define the links to a J1939 freeze frame class sampler.
        reference DemJ1939FreezeFrameClassRef [0..1]: multiplicity set at pre-compile, set at pre-compile, destination=DemJ1939FreezeFrameClass  # These references define the links to a J1939 freeze frame class sampler.
        choice reference DemMemoryDestinationRef: scope=ECU, multiplicity set at pre-compile, set at pre-compile, destination=[DemPrimaryMemory, DemUserDefinedMemory]  # The memory destination assigns DTCs to one memory destination.
        reference DemUDSOBDFreezeFrameClassRef [0..1]: multiplicity set at post-build in variant post-build / pre-compile in variant pre-compile, post-build-variant-multiplicity=true, set at pre-compile, destination=DemFreezeFrameClass  # This reference defines the link to the freeze frame for emission related diagnostics over UDS.
      container DemDebounceCounterBasedClass [0..65535]  # This container contains the configuration of Debounce Counter Based Class
        integer DemCounterBasedFdcThresholdStorageValue [0..1]: 1..32767, multiplicity set at post-build in variant post-build / pre-compile in variant pre-compile, post-build-variant-multiplicity=true, post-build-variant-value=true, set at post-build in variant post-build / pre-compile in variant pre-compile  # Threshold to allocate an event memory entry and to capture the Freeze Frame.
        enumeration DemDebounceBehavior: {DEM_DEBOUNCE_FREEZE, DEM_DEBOUNCE_RESET}, set at pre-compile, default-value=DEM_DEBOUNCE_RESET  # This parameter defines how the event debounce algorithm will behave, if a related enable condition is not fulfilled or ControlDTCSetting of the related event is disabled.
        integer DemDebounceCounterDecrementStepSize: 1..32768, scope=ECU, post-build-variant-value=true, set at post-build in variant post-build / pre-compile in variant pre-compile  # Defines the step size for decrementation of the internal debounce counter (PREPASSED).
        integer DemDebounceCounterFailedThreshold: 1..32767, scope=ECU, post-build-variant-value=true, set at post-build in variant post-build / pre-compile in variant pre-compile  # Defines the value of the internal debounce counter, which indicates the failed status.
        integer DemDebounceCounterIncrementStepSize: 1..32767, scope=ECU, post-build-variant-value=true, set at post-build in variant post-build / pre-compile in variant pre-compile  # Defines the step size for incrementation of the internal debounce counter (PREFAILED).
        boolean DemDebounceCounterJumpDown: scope=ECU, post-build-variant-value=true, set at post-build in variant post-build / pre-compile in variant pre-compile  # Switch for the activation of Jump-Down. | true: Jump-Down activated false: Jump-Down deactivated
        integer DemDebounceCounterJumpDownValue: -32768..32767, scope=ECU, post-build-variant-value=true, set at post-build in variant post-build / pre-compile in variant pre-compile, default-value=0  # Jump-Down value of the internal debounce counter which is taken as initialization value for the counter when the respective step-down occurs.
        boolean DemDebounceCounterJumpUp: scope=ECU, post-build-variant-value=true, set at post-build in variant post-build / pre-compile in variant pre-compile  # Switch for the activation of Jump-Up. | true: Jump-Up activated false: Jump-Up deactivated
        integer DemDebounceCounterJumpUpValue: -32768..32767, scope=ECU, post-build-variant-value=true, set at post-build in variant post-build / pre-compile in variant pre-compile, default-value=0  # Jump-Up value of the internal debounce counter which is taken as initialization value for the counter when the respective step-up occurs.
        integer DemDebounceCounterPassedThreshold: -32768..-1, scope=ECU, post-build-variant-value=true, set at post-build in variant post-build / pre-compile in variant pre-compile  # Defines the value of the internal debounce counter, which indicates the passed status.
        boolean DemDebounceCounterStorage: set at pre-compile, default-value=false  # Switch to store the debounce counter value non-volatile or not. | true: debounce counter value shall be stored non-volatile false: debounce counter value is volatile
      container DemDebounceTimeBasedClass [0..65535]  # This container contains the configuration of Debounce Time Based Class.
        enumeration DemDebounceBehavior: {DEM_DEBOUNCE_FREEZE, DEM_DEBOUNCE_RESET}, set at pre-compile, default-value=DEM_DEBOUNCE_RESET  # This parameter defines how the event debounce algorithm will | behave, if a related enable condition is not fulfilled or ControlDTCSetting of the related event is disabled.
        float DemDebounceTimeFailedThreshold: 0.001..3600, scope=ECU, post-build-variant-value=true, set at post-build in variant post-build / pre-compile in variant pre-compile  # Defines the time out duration for "Event Failed" qualification. | The AUTOSAR configuration standard is to use SI units, so this parameter is defined as float value in seconds. Dem configuration tools must convert this float value to the appropriate value format for the use in the software implementation of Dem.
        float DemDebounceTimePassedThreshold: 0.001..3600, scope=ECU, post-build-variant-value=true, set at post-build in variant post-build / pre-compile in variant pre-compile  # Defines the time out duration for "Event Passed" qualification. | The AUTOSAR configuration standard is to use SI units, so this parameter is defined as float value in seconds. Dem configuration tools must convert this float value to the appropriate value format for the use in the software implementation of Dem.
        float DemTimeBasedFdcThresholdStorageValue [0..1]: 0.001..3600, multiplicity set at post-build in variant post-build / pre-compile in variant pre-compile, post-build-variant-multiplicity=true, post-build-variant-value=true, set at post-build in variant post-build / pre-compile in variant pre-compile  # Threshold to allocate an event memory entry and to capture the Freeze Frame.
      container DemDtrs [0..1]  # This container holds the configuration of DTRs collection.
        container DemDtr [0..65535]  # This container holds the configuration of one individual DTR.
          float DemDtrCompuDenominator0: scope=ECU, set at pre-compile  # Part of the conversion between the binary representation and the physical meaning analogous to the SW-C Template conversion CompuRationalCoeffs with 2 numerator coefficients and 1 denominator coefficient in the direction compuInternalToPhys. | This is the only one supported denominator value, a constant divisor. The value 0 is not allowed.
          float DemDtrCompuNumerator0: scope=ECU, set at pre-compile  # Part of the conversion between the binary representation and the physical meaning analogous to the SW-C Template conversion CompuRationalCoeffs with 2 numerator coefficients and 1 denominator coefficient in the direction compuInternalToPhys. | This is the first numerator value, which is multiplied with x^0, i.e., the offset.
          float DemDtrCompuNumerator1: scope=ECU, set at pre-compile  # Part of the conversion between the binary representation and the physical meaning analogous to the SW-C Template conversion CompuRationalCoeffs with 2 numerator coefficients and 1 denominator coefficient in the direction compuInternalToPhys. | This is the second numerator value, which is multiplied with x^1, i.e., the factor.
          integer DemDtrId: 0..65535, scope=ECU, set at pre-compile, symbolic-name-value=true  # The index identifier value assigned to this DTR. The value is generated during the Dem configuration process.
          integer DemDtrMid: 0..255, scope=ECU, multiplicity set at post-build in variant post-build / pre-compile in variant pre-compile, post-build-variant-multiplicity=true, post-build-variant-value=true, set at post-build in variant post-build / pre-compile in variant pre-compile  # The OBDMID of the DTR. | The values 0x00, 0x20, 0x40, 0x60, 0x80, 0xA0, 0xC0, 0xE0 are reserved.
          integer DemDtrTid: 0..255, scope=ECU, multiplicity set at post-build in variant post-build / pre-compile in variant pre-compile, post-build-variant-multiplicity=true, post-build-variant-value=true, set at post-build in variant post-build / pre-compile in variant pre-compile  # The OBDTID of the DTR.
          integer DemDtrUasid: 0..255, scope=ECU, multiplicity set at post-build in variant post-build / pre-compile in variant pre-compile, post-build-variant-multiplicity=true, post-build-variant-value=true, set at post-build in variant post-build / pre-compile in variant pre-compile  # The UaSId the DTR data shall be scaled to, and reported together with the rescaled DTR data.
          enumeration DemDtrUpdateKind: {DEM_DTR_UPDATE_ALWAYS, DEM_DTR_UPDATE_STEADY}, multiplicity set at pre-compile, set at pre-compile, default-value=DEM_DTR_UPDATE_ALWAYS  # Update conditions applied by the Dem to reports of DTR values. Only supported if a related Event is configured
          reference DemDtrEventRef [0..1]: scope=ECU, multiplicity set at pre-compile, set at pre-compile, destination=DemEventParameter  # Reference to the DemEventParameter this DTR is related to. If the related event is not configured, the Dem cannot ensure consistency between the DTR and the event.
      container DemEventParameter [1..65535]  # This container contains the configuration (parameters) for events.
        float DemCausalityDelayTime [0..1]: 0..2.5, multiplicity set at pre-compile, set at pre-compile, default-value=0  # Time to wait until the event is considered as causal. | The parameter is specified in seconds.
        integer DemComponentPriority [0..1]: 0..255, multiplicity set at pre-compile, set at pre-compile  # Specifies the priority within the component. A lower value means higher priority.
        integer DemEventAssociatedIdentification [0..1]: 0..65535, scope=ECU, post-build-variant-value=true, set at post-build in variant post-build / pre-compile in variant pre-compile  # Event associated identifier that allows to identify an event. This value can be reported as internal data element in snapshot records or extended data records.
        boolean DemEventAvailable: scope=ECU, post-build-variant-value=true, set at post-build in variant post-build / pre-compile in variant pre-compile  # This parameter configures an Event as unavailable. | It is treated by Dem as if it does not exist. true = Event is available false = Event is not available
        boolean DemEventAvailableInVariant [0..1]: scope=ECU, multiplicity set at pre-compile, post-build-variant-value=true, set at post-build in variant post-build / pre-compile in variant pre-compile, default-value=true  # This parameter defines the enabled or disabled status of an event. If set to FALSE, the Event is generally disabled, even though the SW-C is integrated and the Event is described in the ECUC. The Dem shall ignore all calls from the SW-C. If set to TRUE, the availability of the event depends on other availability sources.
        integer DemEventConfirmationThreshold: 1..255, scope=ECU, post-build-variant-value=true, set at post-build in variant post-build / pre-compile in variant pre-compile, default-value=1  # Defines the operation cycle threshold of the DTC confirmation status according "Confirmation Threshold" of ISO 14229-1.
        boolean DemEventConfirmationThresholdCounterAdaptable [0..1]: scope=ECU, set at pre-compile, default-value=false  # Indicates whether the events confirmation Cycle threshold can be adapted by Dem_SetEventConfirmationThresholdCounter.
        integer DemEventId: 1..65535, scope=ECU, set at pre-compile, symbolic-name-value=true  # Unique identifier of a diagnostic event. | This parameter should not be changeable by user, because the Id should be generated by Dem itself to prevent gaps and multiple use of an Id. The events should be sequentially ordered beginning with 1 and no gaps in between.
        enumeration DemEventKind: {DEM_EVENT_KIND_BSW, DEM_EVENT_KIND_SWC}, set at pre-compile, default-value=DEM_EVENT_KIND_SWC  # This parameter is used to distinguish between SW-C and BSW events.
        boolean DemEventRecoverableInSameOperationCycle [0..1]: scope=ECU, post-build-variant-value=true, set at pre-compile, default-value=true  # If parameter is configured to FALSE, reporting of PASSED will be ignored if the event is already "testfailed this operation cycle".
        enumeration DemEventReportingType: set at pre-compile, default-value=STANDARD_REPORTING  # This parameter defines the way a monitor can report an event to the Dem. There are various ways to report an event and the Dem provides different APIs for it. Tags: atp.Status=draft
          STANDARD_REPORTING  # Tags: atp.Status=draft
          STANDARD_REPORTING_WITH_MONITOR_DATA  # Tags: atp.Status=draft
        boolean DemFFPrestorageInNvm [0..1]: set at pre-compile  # If the event uses a pre-stored freeze-frame this attribute indicates if the event requires the pre-stored data to be stored in non-volatile memory. | TRUE = store the pre-stored data in non-volatile memory, FALSE = pre-stored data is not stored in non-volatile memory.
        boolean DemFFPrestorageSupported: scope=ECU, set at pre-compile, default-value=false  # If this parameter is set to true, then the Prestorage of FreezeFrames is supported by the assigned event. This parameter is useful to calculate the buffer size.
        enumeration DemReportBehavior [0..1]: {REPORT_AFTER_INIT, REPORT_BEFORE_INIT}, multiplicity set at pre-compile, set at pre-compile, default-value=REPORT_BEFORE_INIT  # Indicates the reporting behavior of the BSW Module (DemEventKind == DEM_EVENT_KIND_BSW) in order to determine the size of the reporting queue. | If the parameter is not defined it means REPORT_BEFORE_INIT.
        reference DemComponentClassRef [0..1]: multiplicity set at pre-compile, set at pre-compile, destination=DemComponent  # Reference to the monitored component.
        reference DemDTCRef [0..1]: multiplicity set at pre-compile, set at pre-compile, destination=DemDTC  # This parameter defines the DTC configuration (typically Uds) associated with the diagnostic event. | It is allowed to have events without a DTC (e.g. for ECU-internal events triggering safety reactions without being reported via diagnostic communication). The same DemDTCAttributes can be used from several events, to combine these (refer to chapter "Combination of diagnostic event").
        reference DemEnableConditionGroupRef [0..1]: scope=ECU, multiplicity set at pre-compile, set at pre-compile, destination=DemEnableConditionGroup  # References an enable condition group.
        reference DemOBDGroupingAssociativeEventsRef [0..1]: scope=ECU, multiplicity set at pre-compile, set at pre-compile, destination=DemEventParameter  # This parameter defines a reference which points to a representative event of one group of associate events. | The "reverence event" must refer to it self. Note: One event is only allowed to be reverenced to only one group of associate events.
        reference DemOperationCycleRef: scope=ECU, set at pre-compile, destination=DemOperationCycle  # Kind of operation cycle for the event (e.g. power cycle, driving cycle, ...)
        reference DemStorageConditionGroupRef [0..1]: scope=ECU, multiplicity set at pre-compile, set at pre-compile, destination=DemStorageConditionGroup  # References a storage condition group.
        container DemCallbackClearEventAllowed [0..1]  # The presence of this container indicates that the Dem has access to a "ClearEventAllowed" callback. | In case there is a DemCallbackClearEventAllowedFnc, this parameter defines the name of the function that the Dem will call. In case there is no DemCallbackClearEventAllowedFnc, the Dem will have an R-Port requiring the interface CallbackClearEventAllowed whose name is generated by using the unique callback-prefix followed by the event name.
          function name DemCallbackClearEventAllowedFnc [0..1]: scope=ECU, multiplicity set at pre-compile, set at pre-compile  # Function name of prototype "ClearEventAllowed".
          enumeration DemClearEventAllowedBehavior: {DEM_NO_STATUS_BYTE_CHANGE, DEM_ONLY_THIS_CYCLE_AND_READINESS}, set at pre-compile, default-value=DEM_NO_STATUS_BYTE_CHANGE  # Defines the resulting UDS status byte for the related event, which must not be cleared according to the ClearEventAllowed callback.
        container DemCallbackEventDataChanged [0..1]  # The presence of this container indicates that the Dem has access to an "EventDataChanged" callback. | In case there is a DemCallbackEventDataChangedFnc, this parameter defines the name of the function that the Dem will call. In case there is no DemCallbackEventDataChangedFnc, the Dem will have an R-Port requiring the interface CallbackEventDataChanged whose name is generated by using the unique callback-prefix followed by the event name.
          function name DemCallbackEventDataChangedFnc [0..1]: scope=ECU, multiplicity set at pre-compile, set at pre-compile  # Function name of prototype "EventDataChanged"
        container DemCallbackEventUdsStatusChanged [0..*]  # The presence of this container indicates, that the Dem has access to an "EventUdsStatusChanged" callback, which the Dem will call to notify other components about the change in the status of an event. | In case there is a DemCallbackEventUdsStatusChangedFnc, this parameter defines the name of the function that the Dem will call. In case there is no DemCallbackEventUdsStatusChangedFnc, the Dem will have an R-Port requiring the interface CallbackEventUdsStatusChanged, whose name is generated by using the unique callback-prefix followed by the event name.
          function name DemCallbackEventUdsStatusChangedFnc [0..1]: scope=ECU, multiplicity set at pre-compile, set at pre-compile  # Function name of prototype "Dem_CBEventUdsStatusChanged"
        container DemCallbackInitMForE [0..1]  # The presence of this container indicates, that the Dem has access to an "InitMonitorForEvent" callback, which the Dem will call to initialize a monitor. | In case the container has a DemCallbackInitMForEFnc, this parameter defines the name of the function that the Dem will call. In case there is no DemCallbackInitMForEFnc, the Dem will have an R-Port requiring the interface CallbackInitMonitorForEvent, whose name is generated by using the unique callback-prefix followed by the event name.
          function name DemCallbackInitMForEFnc [0..1]: multiplicity set at pre-compile, set at pre-compile  # Function name of prototype "InitMonitorForEvent".
        container DemCallbackMonitorStatusChanged [0..*]  # The presence of this container indicates, that the Dem has access to an "MonitorStatusChanged" callback, which the Dem will call to notify other components about the change in the status of an event. | In case there is a DemCallbackMonitorStatusChangedFnc, this parameter defines the name of the function that the Dem will call. In case there is no DemCallbackMonitorStatusChangedFnc, the Dem will have an R-Port requiring the interface CallbackMonitorStatusChanged, whose name is generated by using the unique callback-prefix followed by the event name.
          function name DemCallbackMonitorStatusChangedFnc [0..1]: scope=ECU, multiplicity set at pre-compile, set at pre-compile  # Function name of prototype "<Module>_DemTriggerOnMonitorStatus"
        choice container DemDebounceAlgorithmClass  # Debounce algorithm class: counter based, time based, or monitor internal.
          container DemDebounceCounterBased [0..1]  # This container contains the configuration (parameters) for counter based debouncing.
            reference DemDebounceCounterBasedClassRef: post-build-variant-value=true, set at post-build in variant post-build / pre-compile in variant pre-compile, destination=DemDebounceCounterBasedClass  # This reference selects the DemDebounceCounterBasedClass applied for the debouncing of the DemEventParameter.
          container DemDebounceMonitorInternal [0..1]  # This container contains the configuration (parameters) for monitor internal debouncing.
            container DemCallbackGetFDC [0..1]  # DemCallbackGetFDC specifies the callback (parameter DemCallbackGetFDCFnc is present) or R-Port (no parameter DemCallbackGetFDCFnc is present) to retrieve the fault detection counter value. | In case no container is configured, no fault detection counter will be available.
              function name DemCallbackGetFDCFnc [0..1]: scope=ECU, multiplicity set at pre-compile, set at pre-compile  # This parameter defines the name of the function that the Dem will call to retrieve the fault-detection counter value from a complex driver.
          container DemDebounceTimeBased [0..1]  # This container contains the configuration (parameters) for time based debouncing.
            reference DemDebounceTimeBasedClassRef: post-build-variant-value=true, set at post-build in variant post-build / pre-compile in variant pre-compile, destination=DemDebounceTimeBasedClass  # This reference selects the DemDebounceTimeBasedClass applied for the debouncing of the DemEventParameter.
        container DemIndicatorAttribute [0..255]  # This container contains the event specific configuration of Indicators.
          enumeration DemIndicatorBehaviour: {DEM_INDICATOR_BLINKING, DEM_INDICATOR_BLINK_CONT, DEM_INDICATOR_CONTINUOUS, DEM_INDICATOR_FAST_FLASH, DEM_INDICATOR_SLOW_FLASH}, scope=ECU, post-build-variant-value=true, set at post-build in variant post-build / pre-compile in variant pre-compile  # Behaviour of the linked indicator
          integer DemIndicatorFailureCycleCounterThreshold [0..1]: 1..255, scope=ECU, multiplicity set at pre-compile, set at pre-compile  # Defines the number of failure cycles for the WarningIndicatorOnCriteria.
          integer DemIndicatorHealingCycleCounterThreshold: 0..255, scope=ECU, set at pre-compile  # Defines the number of healing cycles for the WarningIndicatorOffCriteria.
          reference DemIndicatorRef: scope=ECU, set at pre-compile, destination=DemIndicator  # Reference to the used indicator.
      container DemMultiEventTriggering [0..65535]  # Configures an event that will trigger other events whenever the event is reported.
        reference DemMultiEventTriggeringMasterEventRef: scope=ECU, set at pre-compile, destination=DemEventParameter  # Reference to the event that will trigger other events upon reception of this event.
        reference DemMultiEventTriggeringSlaveEventRef [1..255]: scope=ECU, set at pre-compile, destination=DemEventParameter  # Reference to the event that is triggered upon triggering the master event.
      container DemObdDTC [0..65535]  # This container contains the configuration (parameters) for DemObdDTC.
        boolean DemConsiderPtoStatus: scope=ECU, set at pre-compile, default-value=false  # This parameter is TRUE, when the event is affected by the Dem PTO handling.
        integer DemDtcValue [0..1]: 1..65535, scope=ECU, multiplicity set at post-build in variant post-build / pre-compile in variant pre-compile, post-build-variant-multiplicity=true, post-build-variant-value=true, set at post-build in variant post-build / pre-compile in variant pre-compile  # Unique Diagnostic Trouble Code value for OBD
        integer DemDtcValue3Byte [0..1]: 256..16777214, scope=ECU, multiplicity set at post-build in variant post-build / pre-compile in variant pre-compile, post-build-variant-multiplicity=true, post-build-variant-value=true, set at post-build in variant post-build / pre-compile in variant pre-compile  # 3 Byte OBD DTC value that is used for the UDS Diagnostic Trouble Code (DTC) if UDS and OBD DTC handling is separated. The value is defining a DTC based on SAE J2012.
        enumeration DemEventOBDReadinessGroup [0..1]: {DEM_OBD_RDY_AC, DEM_OBD_RDY_BOOSTPR, DEM_OBD_RDY_CAT, DEM_OBD_RDY_CMPRCMPT, DEM_OBD_RDY_CSER, DEM_OBD_RDY_DOR, DEM_OBD_RDY_ECS, DEM_OBD_RDY_EGR, DEM_OBD_RDY_EGSENS, DEM_OBD_RDY_EVAP, DEM_OBD_RDY_FLSYS, DEM_OBD_RDY_FLSYS_NONCONT, DEM_OBD_RDY_GPF, DEM_OBD_RDY_HCCAT, DEM_OBD_RDY_HTCAT, DEM_OBD_RDY_MISF, DEM_OBD_RDY_NONE, DEM_OBD_RDY_NOXADSORB, DEM_OBD_RDY_NOXCAT, DEM_OBD_RDY_O2SENS, DEM_OBD_RDY_O2SENSHT, DEM_OBD_RDY_OTHER, DEM_OBD_RDY_PCV, DEM_OBD_RDY_PMFLT, DEM_OBD_RDY_SECAIR, DEM_OBD_RDY_VVT}, scope=ECU, multiplicity set at pre-compile, set at pre-compile  # This parameter specifies the Event OBD Readiness group as defined by SAE J1979-DA for PID $01 and PID $41 computation. | This parameter is only applicable for emission-related ECUs.
        integer DemJ1939DTCValue [0..1]: 1..16777214, scope=ECU, multiplicity set at post-build in variant post-build / pre-compile in variant pre-compile, post-build-variant-multiplicity=true, post-build-variant-value=true, set at post-build in variant post-build / pre-compile in variant pre-compile  # Unique Diagnostic Trouble Code value for J1939 (consisting of SPN and FMI).
      container DemPidClass [0..255]  # This container contains the different PIDs for the single global OBD relevant freeze frame class. It is assembled out of one or several data elements.
        integer DemPidIdentifier: 0..255, scope=ECU, post-build-variant-value=true, set at post-build in variant post-build / pre-compile in variant pre-compile  # identifier of the PID
        container DemPidDataElement [1..255]: multiplicity set at pre-compile  # This container contains the different data elements contained in the specific PID.
          reference DemPidDataElementClassRef: scope=ECU, post-build-variant-value=true, set at post-build in variant post-build / pre-compile in variant pre-compile, destination=DemDataElementClass  # This reference contains the link to a data element class.
    container DemGeneral  # This container contains the configuration (parameters) of the BSW Dem
      boolean DemAgingRequiresNotFailedCycle: set at pre-compile, default-value=false  # Defines if the aging cycle counter is processed in operation cycles with test failed report or not. | True: Aging cycle counter is processed only in operation cycles without test failed. False (Default): No effect on aging cycle counter processing.
      boolean DemAgingRequiresTestedCycle: scope=ECU, set at pre-compile  # Defines if the aging cycle counter is processed every aging cycles or if only tested aging cycle are considered. | true: only tested aging cycle are considered for aging cycle counter false: aging cycle counter is processed every aging cycle
      enumeration DemAvailabilitySupport: {DEM_EVENT_AVAILABILITY, DEM_NO_AVAILABILITY}, set at pre-compile  # This configuration switch defines, whether support for availability is enabled or not.
      integer DemBswErrorBufferSize [0..1]: 0..255, scope=ECU, multiplicity set at pre-compile, set at pre-compile  # Maximum number of elements in buffer for handling of BSW errors (ref. to SWS_Dem_00207).
      enumeration DemClearDTCBehavior: {DEM_CLRRESP_NONVOLATILE_FINISH, DEM_CLRRESP_NONVOLATILE_TRIGGER, DEM_CLRRESP_VOLATILE}, scope=ECU, set at pre-compile  # Defines the clearing process of diagnostic information for volatile and non-volatile memory and the positive response handling for the Dcm module.
      enumeration DemClearDTCLimitation: {DEM_ALL_SUPPORTED_DTCS, DEM_ONLY_CLEAR_ALL_DTCS}, scope=ECU, set at pre-compile, default-value=DEM_ALL_SUPPORTED_DTCS  # Defines the supported Dem_<...>ClearDTC API scope.
      enumeration DemDataElementDefaultEndianness: {BIG_ENDIAN, LITTLE_ENDIAN, OPAQUE}, set at pre-compile  # Defines the default endianness of the data belonging to a data element which is applicable if the DemExternalSRDataElementClass does not define a endianness.
      boolean DemDebounceCounterBasedSupport: scope=ECU, set at pre-compile  # This configuration switch defines, whether support for counter based debouncing is enabled or not. | true: counter based debouncing support is enabled false: counter based debouncing support is disabled
      boolean DemDebounceTimeBasedSupport: scope=ECU, set at pre-compile  # This configuration switch defines, whether support for time based debouncing is enabled or not. | true: time based debouncing support is enabled false: time based debouncing support is disabled
      boolean DemDevErrorDetect: set at pre-compile, default-value=false  # Switches the development error detection and notification on or off. | * true: detection and notification is enabled. * false: detection and notification is disabled.
      enumeration DemEventCombinationSupport: {DEM_EVCOMB_DISABLED, DEM_EVCOMB_ONRETRIEVAL, DEM_EVCOMB_ONSTORAGE}, scope=ECU, set at pre-compile  # This parameter defines the type of event combination supported by the Dem.
      function name DemGeneralCallbackMonitorStatusChangedFnc [0..1]: scope=ECU, multiplicity set at pre-compile, set at pre-compile  # Function name of prototype "<Module>_DemTriggerOnMonitorStatus". | Function for the General Monitor Status Changed notification.
      boolean DemGeneralInterfaceSupport: scope=ECU, set at pre-compile  # The interfaces GeneralEvtInfo, GeneralCallbackEventDataChanged, GeneralCallbackMonitorStatusChanged and GeneralCallbackEventUdsStatusChange are provided if DemGeneralInterfaceSupport is equal to true.
      integer DemMaxNumberPrestoredFF: 0..255, scope=ECU, set at pre-compile  # Defines the maximum number for prestored freeze frames. | If set to 0, then freeze frame prestorage is not supported by the ECU.
      enumeration DemOBDSupport: {DEM_OBD_DEP_SEC_ECU, DEM_OBD_MASTER_ECU, DEM_OBD_NO_OBD_SUPPORT, DEM_OBD_PRIMARY_ECU}, scope=ECU, set at pre-compile  # This configuration switch defines OBD support and kind of OBD ECU.
      boolean DemPTOSupport: scope=ECU, set at pre-compile  # This configuration switch defines, whether PTO support (and therefore PID $1E support) is enabled or not.
      boolean DemResetConfirmedBitOnOverflow: set at pre-compile, default-value=true  # This configuration switch defines, whether the confirmed bit is reset or not while an event memory entry will be displaced.
      boolean DemResetPendingBitOnOverflow: scope=ECU, set at pre-compile, default-value=true  # This configuration switch defines, whether the pending bit is reset or | not while an event memory entry will be displaced.
      enumeration DemStatusBitHandlingTestFailedSinceLastClear: {DEM_STATUS_BIT_AGING_AND_DISPLACEMENT, DEM_STATUS_BIT_NORMAL}, scope=ECU, set at pre-compile, default-value=DEM_STATUS_BIT_NORMAL  # This configuration switch defines, whether the aging and displacement mechanism shall be applied to the "TestFailedSinceLastClear" status bits.
      boolean DemStatusBitStorageTestFailed: scope=ECU, set at pre-compile  # Activate/Deactivate the permanent storage of the "TestFailed" status bits. | true: storage activated false: storage deactivated
      enumeration DemSuppressionSupport: {DEM_DTC_SUPPRESSION, DEM_NO_SUPPRESSION}, scope=ECU, set at pre-compile  # This configuration switch defines, whether support for suppression is enabled or not.
      float DemTaskTime: 0..INF, scope=ECU, set at pre-compile  # Allow to configure the time for the periodic cyclic task. Please note: This configuration value shall be equal to the value in the Basic Software Scheduler configuration of the RTE module. | The AUTOSAR configuration standard is to use SI units, so this parameter is defined as float value in seconds. Dem configuration tools must convert this float value to the appropriate value format for the use in the software implementation of Dem. min: A negative value is not allowed. max: After event status was reported, processing shall be completed within 100ms in order to have the fault entry status information updated as soon as possible (e.g. for PID $01). upperMultiplicity: Exactly one TaskTime must be specified per configuration. lowerMultiplicity: Exactly one TaskTime must be specified per configuration.
      boolean DemTriggerFiMReports: scope=ECU, set at pre-compile  # Activate/Deactivate the notification to the Function Inhibition Manager. | true: FiM notification activated false: FiM notification deactivated
      boolean DemTriggerMonitorInitBeforeClearOk: scope=ECU, set at pre-compile  # Defines if the monitor re-initialization has to be triggered before or after the Dem module returns DEM_CLEAR_OK. | true: trigger re-initialization before DEM_CLEAR_OK false: trigger re-initialization after DEM_CLEAR_OK
      boolean DemVersionInfoApi: set at pre-compile, default-value=false  # Activate/Deactivate the version information API. | true: version information activated false: version information deactivated
      reference DemClearEventsWithoutDTCEventMemoryRef [0..1]: multiplicity set at pre-compile, set at pre-compile, destination=DemPrimaryMemory  # Indicating the event memory used as trigger to clear events without assigned DTCs.
      reference DemOBDEventMemorySetRef [0..1]: multiplicity set at pre-compile, set at pre-compile, destination=DemEventMemorySet  # References the DemEventMemorySet used for OBD ECU.
      container DemClient [1..255]: multiplicity set at pre-compile  # This container contains possible clients that are using the Dem APIs.
        enumeration DemClientFunctionality: {DEM_CLIENT_ONLY_USES_EVENTOVERFLOW_INTERFACE, DEM_CLIENT_USES_FULL_FUNCTIONALITY}, post-build-variant-value=true, set at pre-compile, default-value=DEM_CLIENT_USES_FULL_FUNCTIONALITY  # Functionality provided by Dem for the DemClient.
        integer DemClientId: 0..255, scope=ECU, multiplicity set at pre-compile, set at pre-compile, symbolic-name-value=true  # Defines a unique identifier for a Dem client. This number is used by this client in the ClientID parameter in all API with this parameter.
        boolean DemClientUsesRte: multiplicity set at pre-compile, set at pre-compile, default-value=false  # If set to true, this client shall only use the DEM via RTE (Dem will provide the C/S interfaces: CddIf, EvMemOverflowIndication). The client must not do any C_API calls to the DEM.
        reference DemEventMemorySetRef: multiplicity set at pre-compile, set at pre-compile, destination=DemEventMemorySet  # References to the client assigned event memory container that contains client specific settings and event memories.
        container DemCallbackDTCStatusChanged [0..*]  # The presence of this container indicates, that the Dem has access to a "DTCStatusChanged" callback, which the Dem will call to notify other components about the change in the status of a DTC. | In case there is a DemCallbackDTCStatusChangedFnc, this parameter defines the name of the function that the Dem will call. In case there is no DemCallbackDTCStatusChangedFnc, the Dem will have an R-Port requiring the interface CallbackDTCStatusChanged whose name is generated by using the unique callback-prefix followed by the event name. Status change notifications are supported for DTCs in primary memory only.
          function name DemCallbackDTCStatusChangedFnc [0..1]: scope=ECU, multiplicity set at pre-compile, set at pre-compile  # Function name of prototype "DTCStatusChanged".
      choice container DemDataElementClass [0..65535]  # This container contains the configuration (parameters) for an internal/external data element class.
        container DemExternalCSDataElementClass [0..1]  # This container contains the configuration (parameters) for an external client/server based data element class. | It defines, how the Dem can obtain the value of the data element from either a SW-C or another BSW module. Whether a client/server port or a C function-call is used, is defined by DemDataElementUsePort.
          integer DemDataElementArraySize [0..1]: 1..4294967295, scope=ECU, set at pre-compile  # If the data element is an array data element, it defines the number of elements in the array. Note that this is not the size in bytes.
          enumeration DemDataElementDataType: {BOOLEAN, FLOAT, FLOAT_N, SINT16, SINT16_N, SINT32, SINT32_N, SINT8, SINT8_N, UINT16, UINT16_N, UINT32, UINT32_N, UINT8, UINT8_N}, scope=ECU, multiplicity set at pre-compile, set at pre-compile  # Provide the implementation data type of this C/S data element.
          enumeration DemDataElementFncSignature [0..1]: scope=ECU, multiplicity set at pre-compile, set at pre-compile, default-value=DATA_FNC_NORMAL  # If the parameter is set to DATA_FNC_NORMAL the function omits DataLength and Dcm_NegativeResponseCodeType parameters. Tags: atp.Status=draft | If the parameter is set to DATA_FNC_PROXY the generated function call to retrieve the data element uses the signature for Dcm proxy with DataLength and Dcm_NegativeResponseCodeType parameters. Please note that the Dcm proxy is commonly handling the diagnostic data connections for the Dcm and Dem module.
            DATA_FNC_NORMAL  # Tags: atp.Status=draft
            DATA_FNC_PROXY  # Tags: atp.Status=draft
          boolean DemDataElementProvideMonitorData: scope=ECU, set at pre-compile, default-value=false  # If the parameter is set to true, the generated function call to retrieve the data element has the monitorData0 as additional first parameter.
          function name DemDataElementReadFnc [0..1]: scope=ECU, multiplicity set at pre-compile, set at pre-compile  # In case of DemDataElementUsePort is false, this parameter defines the prototype of the C function "ReadDataElement" used to get the according value.
          boolean DemDataElementUsePort: scope=ECU, set at pre-compile  # If the parameter is set to True, a R-Port is generated, to obtain the data element (interface DataServices_{Data}). | If the parameter is set to False, the information is obtained by C function-call on another BSW module specified by the parameter DemDataElementReadFnc.
        container DemExternalSRDataElementClass [0..1]  # This container contains the configuration (parameters) for an external sender/receiver based data element class. It defines, how the Dem can obtain the value of the data element from a SW-C, by using a sender/receiver port.
          integer DemDataElementArraySize [0..1]: 1..4294967295, scope=ECU, set at pre-compile  # If the data element is an array data element, it defines the number of elements in the array. Note that this is not the size in bytes.
          enumeration DemDataElementDataType: {BOOLEAN, FLOAT, FLOAT_N, SINT16, SINT16_N, SINT32, SINT32_N, SINT8, SINT8_N, UINT16, UINT16_N, UINT32, UINT32_N, UINT8, UINT8_N}, scope=ECU, multiplicity set at pre-compile, set at pre-compile  # Provide the implementation data type of data belonging to a external data.
          enumeration DemDataElementEndianness [0..1]: {BIG_ENDIAN, LITTLE_ENDIAN, OPAQUE}, multiplicity set at pre-compile, set at pre-compile  # Defines the endianness of the data belonging to an external data. | If no DemDataElementEndianness is defined the value of DemDataElementDefaultEndianness is applicable.
          choice container DemDiagnosisScaling [0..1]  # This container contains the configuration (parameters) of an alternative Diagnosis Representation. Out if this the scaling between Diagnosis and ECU internal representation and vice versa can be calculated.
            container DemAlternativeDataInterface [0..1]  # This container contains the configuration (parameters) of an alternative Diagnosis Representation by the means of a VariableDataPrototoype in a DataInterface. | Additionally a reference to PortInterfaceMapping can be defined which provide already the mapping rules between the VariableDataPrototoype in a DataInterface used by the software component (DemSRDataElementClass) and the intended Diagnosis Representation defined by DemExternalSRDataElementClass.
              foreign reference DemDataElement: set at pre-compile, destination-type=VARIABLE-DATA-PROTOTYPE  # Alternative Diagnosis Representation for the data defined by the means of a VariableDataPrototoype in a DataInterface. | The CompuMethod of the data type of the referenced VariableDataPrototype will be applied to the data type of the VariableDataPrototype in the interface used by the Dem.
              foreign reference DemPortInterfaceMapping [0..1]: multiplicity set at pre-compile, set at pre-compile, destination-type=PORT-INTERFACE-MAPPING  # Optional reference to PortInterfaceMapping which defines the mapping rules. | The PortInterfaceMapping is used to get the DataPrototypeMapping that describes a conversion between the data prototype referenced by DemDataElement and the data prototype referenced from DcmDspExternalSRDataElementClass.
            container DemAlternativeDataType [0..1]  # This container contains the configuration (parameters) of an alternative Diagnosis Representation by the means of an ApplicationDataType. | Additionally the definition of a text table mapping can be a defined for ApplicationDataTypes that refers to a CompuMethod of category TEXTTABLE and SCALE_LINEAR_AND_TEXTTABLE.
              foreign reference DemApplicationDataType: set at pre-compile, destination-type=APPLICATION-DATA-TYPE  # Alternative Diagnosis Representation for the data defined by the means of a ApplicationDataType of category VALUE, BOOLEAN or ARRAY. | The CompuMethod that applies to the referenced ApplicationDataType in case of category VALUE or BOOLEAN will be applied to the data type of the VariableDataPrototype in the interface used by the Dem.
              container DemTextTableMapping [0..*]  # The purpose of the DemDspTextTableMapping is to associate a texttable value defined in the context of the Dem to a texttable value defined in the context of a CompuMethod referenced by a DataType that shall be taken to create a dataElement in a SenderReceiverInterface. By this means it is possible to create a primitive version of a TexttableMapping (which can only be applied if a dataElement already exists). | In other words, the DemDspTextTableMapping provides a similar mechanism to the TexttableMapping in a situation where the TexttableMapping cannot be applied since the SenderReceiverInterface for the PortPrototype on the Dem ServiceComponent does not yet exist.
                integer DemDiagnosisRepresentationDataValue: 0..18446744073709551615, scope=ECU, set at pre-compile  # The data value in the diagnosis representation.
                integer DemInternalDataValue: 0..18446744073709551615, scope=ECU, set at pre-compile  # The ECU internal data value.
            container DemAlternativeDiagnosticDataElement [0..1]  # This container contains the configuration (parameters) of an alternative Diagnosis Representation by the means of Diagnostic Extract.
              foreign reference DemDiagnosticDataElementRef: set at pre-compile, destination-type=DIAGNOSTIC-DATA-ELEMENT  # Alternative Diagnosis Representation for the data defined by the means of a DiagnosticDataElement in the Diagnostic Extract. | This EcucForeignReference enables the access to all SwDataDefProps, in particular BaseType, CompuMethod and DataConstr The CompuMethod and DataConstr that applies to the referenced DiagnosticDataElement will be applied to the data type of the VariableDataPrototype in the interface used by the Dem. The mapped ImplementationDataType needs to match the given BaseType.
          choice container DemSRDataElementClass [0..1]  # This container defines the source of data in a provided port which shall be read for a external data element | This container shall contain either one DemSubElementInDataElementInstance OR DemDataElementInstance OR DemSubElementInImplDataElementInstance reference.
            container DemDataElementInstance [0..1]  # Instance Reference to the primitive data in a port where the data element is typed with an ApplicationPrimitveDataType or an ImplementationDataType.
              instance reference DemDataElementInstanceRef: set at pre-compile, destination-context=ROOT-SW-COMPOSITION-PROTOTYPE SW-COMPONENT-PROTOTYPE PORT-PROTOTYPE, destination-type=AUTOSAR-DATA-PROTOTYPE  # Instance Reference to the primitive data which shall be read or written. | Supported are VariableDataPrototypes in SenderReceiverInterfaces and NvDataInterfaces and ParameterDataPrototypes in ParameterInterfaces (read only). This reference is applicable if the AutosarDataPrototype is typed with a ApplicationPrimitiveDataType of category VALUE or BOOLEAN or if the AutosarDataPrototype is typed with a ImplementationDataType of category VALUE or TYPE_REFERENCE that in turn boils down to VALUE
            container DemSubElementInDataElementInstance [0..1]  # Instance Reference to the primitve sub-element (at any level) of composite data in a port where the data element is typed with an ApplicationCompositeDataType.
              instance reference DemSubElementInDataElementInstanceRef: set at pre-compile, destination-context=ROOT-SW-COMPOSITION-PROTOTYPE SW-COMPONENT-PROTOTYPE PORT-PROTOTYPE AUTOSAR-DATA-PROTOTYPE APPLICATION-COMPOSITE-ELEMENT-DATA-PROTOTYPE*, destination-type=APPLICATION-COMPOSITE-ELEMENT-DATA-PROTOTYPE  # Instance Reference to the primitve sub-element (at any level) of composite data in a port which shall be read or written. | Supported are VariableDataPrototypes in SenderReceiverInterfaces and NvDataInterfaces and ParameterDataPrototypes in ParameterInterfaces (read only). This reference is applicable if the AutosarDataPrototype is typed with a ApplicationCompositeDataType.
            container DemSubElementInImplDataElementInstance [0..1]  # Instance Reference to the primitve sub-element (at any level) of composite data in a port where the data element is typed with an ImplementationDataType of category STRUCTURE or ARRAY.
              instance reference DemSubElementInImplDataElementInstanceRef: set at pre-compile, destination-context=ROOT-SW-COMPOSITION-PROTOTYPE SW-COMPONENT-PROTOTYPE PORT-PROTOTYPE AUTOSAR-DATA-PROTOTYPE IMPLEMENTATION-DATA-TYPE-ELEMENT*, destination-type=IMPLEMENTATION-DATA-TYPE-ELEMENT  # Instance Reference to the primitve sub-element (at any level) of composite data in a port which shall be read or written. | Supported are VariableDataPrototypes in SenderReceiverInterfaces and NvDataInterfaces and ParameterDataPrototypes in ParameterInterfaces (read only). This reference is applicable if the AutosarDataPrototype is typed with a ImplementationDataType of category STRUCTURE or ARRAY. Please note that in case of ARRAY the index attribute in the target reference has to be set to select a single array element.
        container DemInternalDataElementClass [0..1]  # This container contains the configuration (parameters) for an internal data element class.
          integer DemDataElementDataSize [0..1]: 1..255, scope=ECU, set at pre-compile  # Defines the size of the data element in bytes.
          enumeration DemInternalDataElement: {DEM_AGINGCTR_DOWNCNT, DEM_AGINGCTR_UPCNT, DEM_AGINGCTR_UPCNT_FIRST_ACTIVE, DEM_CLR_DIST, DEM_CLR_TIME, DEM_CURRENT_FDC, DEM_CYCLES_SINCE_FIRST_FAILED, DEM_CYCLES_SINCE_LAST_FAILED, DEM_CYCLES_TESTED_SINCE_FIRST_FAILED, DEM_CYCLES_TESTED_SINCE_LAST_FAILED, DEM_DTC_PRIORITY, DEM_DTR, DEM_EVENT_ASSOCIATED_IDENTIFICATION, DEM_FAILED_CYCLES, DEM_IUMPR, DEM_J1939LAMP_STATUS, DEM_MAX_FDC_DURING_CURRENT_CYCLE, DEM_MAX_FDC_SINCE_LAST_CLEAR, DEM_MIL_DIST, DEM_MIL_TIME, DEM_MONITOR_ACTIVITY_DATA, DEM_MONITOR_DATA_0, DEM_MONITOR_DATA_1, DEM_OCCCTR, DEM_OVFLIND, DEM_SIGNIFICANCE, DEM_WARM_UPS}, scope=ECU, set at pre-compile  # This parameter defines the Dem-internal data value, which is mapped to the data element.
      container DemDidClass [0..65535]  # This container contains the configuration (parameters) for a data Id class. It is assembled out of one or several data elements.
        integer DemDidIdentifier: 0..65535, set at pre-compile  # Identifier of the Data ID.
        reference DemDidDataElementClassRef [1..255]: scope=ECU, multiplicity set at pre-compile, requires-index=true, set at pre-compile, destination=DemDataElementClass  # This reference contains the link to a data element class.
      container DemEnableCondition [0..255]  # This container contains the configuration (parameters) for enable conditions.
        integer DemEnableConditionId: 0..255, scope=ECU, set at pre-compile, symbolic-name-value=true  # Defines a unique enable condition Id. | This parameter should not be changeable by user, because the Id should be generated by Dem itself to prevent gaps and multiple use of an Id. The enable conditions should be sequentially ordered beginning with 0 and no gaps in between.
        boolean DemEnableConditionStatus: scope=ECU, set at pre-compile  # Defines the initial status for enable or disable of acceptance of event reports of a diagnostic event. | The value is the initialization after power up (before this condition is reported the first time). true: acceptance of a diagnostic event enabled false: acceptance of a diagnostic event disabled
      container DemEnableConditionGroup [0..255]  # This container contains the configuration (parameters) for enable condition groups.
        reference DemEnableConditionRef [1..255]: scope=ECU, multiplicity set at pre-compile, set at pre-compile, destination=DemEnableCondition  # References an enable condition.
      container DemEventMemorySet [1..255]  # This container is a collection of referenced event memories and related information for a Dem client.
        integer DemMaxNumberEventEntryPermanent: 0..255, scope=ECU, set at pre-compile  # Maximum number of events which can be stored in the permanent memory. | The assignment of an event to this memory type is dynamic and used for emission-related events only.
        enumeration DemTypeOfDTCSupported: {DEM_DTC_TRANSLATION_ISO11992_4, DEM_DTC_TRANSLATION_ISO14229_1, DEM_DTC_TRANSLATION_ISO15031_6, DEM_DTC_TRANSLATION_SAEJ1939_73, DEM_DTC_TRANSLATION_SAE_J2012_DA_DTCFORMAT_04}, scope=ECU, set at pre-compile  # This parameter defines the format returned by Dem_GetTranslationType and does not relate to/influence the supported Dem functionality.
        reference DemAmberWarningLampIndicatorRef [0..1]: multiplicity set at pre-compile, set at pre-compile, destination=DemIndicator  # This parameter defines the indicator representing the AmberWarningLamp . This parameter may be used for ECUs supporting J1939.
        reference DemMILIndicatorRef [0..1]: scope=ECU, multiplicity set at pre-compile, set at pre-compile, destination=DemIndicator  # This parameter defines the indicator representing the MIL. | This parameter is mandatory for ECUs supporting OBD (refer to DemOBDSupport).
        reference DemProtectLampIndicatorRef [0..1]: multiplicity set at pre-compile, set at pre-compile, destination=DemIndicator  # This parameter defines the indicator representing the ProtectLamp. This parameter may be used for ECUs supporting J1939.
        reference DemRedStopLampIndicatorRef [0..1]: multiplicity set at pre-compile, set at pre-compile, destination=DemIndicator  # This parameter defines the indicator representing the RedStopLamp. This parameter may be used for ECUs supporting J1939.
        container DemClearDTCNotification [0..255]  # Contains callback function definition which are called during clear DTC operations.
          function name DemClearDtcNotificationFnc [0..1]: multiplicity set at pre-compile, set at pre-compile  # Notification callback function name which is called on a clear DTC operation (refer to <Module>_ClearDtcNotification).
          enumeration DemClearDtcNotificationTime: {FINISH, START}, set at pre-compile  # Configure, whether the callback shall be called on start of a clear or after finishing a clear DTC operation (refer to <Module>_ClearDtcNotification)
        container DemIndicator [0..255]  # This container contains the configuration (parameters) for Indicators.
          integer DemIndicatorID: 0..255, scope=ECU, set at pre-compile, symbolic-name-value=true  # Unique identifier of an indicator.
        container DemPrimaryMemory  # This container contains the primary event memory specific parameters of the Dem module.
          integer DemDtcStatusAvailabilityMask: 0..255, scope=ECU, set at pre-compile  # Mask for the supported DTC status bits by the Dem. This mask is used in the positive response of UDS service 0x19.
          enumeration DemEventDisplacementStrategy: {DEM_DISPLACEMENT_FULL, DEM_DISPLACEMENT_NONE, DEM_DISPLACEMENT_PRIO_OCC}, scope=ECU, set at pre-compile  # This configuration switch defines, whether support for event displacement is enabled or not, and which displacement strategy is followed.
          enumeration DemEventMemoryEntryStorageTrigger: {DEM_TRIGGER_ON_CONFIRMED, DEM_TRIGGER_ON_FDC_THRESHOLD, DEM_TRIGGER_ON_TEST_FAILED}, set at pre-compile, default-value=DEM_TRIGGER_ON_TEST_FAILED  # Configures the primary trigger to allocate an event memory entry.
          integer DemMaxNumberEventEntryPrimary: 1..255, scope=ECU, set at pre-compile  # Maximum number of events which can be stored in the primary memory
          enumeration DemOccurrenceCounterProcessing: {DEM_PROCESS_OCCCTR_CDTC, DEM_PROCESS_OCCCTR_TF}, scope=ECU, set at pre-compile  # This configuration switch defines the consideration of the fault confirmation process for the occurrence counter. For OBD and mixed systems (OBD/non OBD, refer to DemOBDSupport) configuration switch shall always set to DEM_PROCESS_OCCCTR_TF.
          enumeration DemTypeOfFreezeFrameRecordNumeration: {DEM_FF_RECNUM_CALCULATED, DEM_FF_RECNUM_CONFIGURED}, scope=ECU, set at pre-compile  # This parameter defines the type of assigning freeze frame record numbers for event-specific freeze frame records.
          container DemGroupOfDTC [0..65535]  # This container contains the configuration (parameters) for DTC groups.
            integer DemGroupDTCs: 256..16776959, scope=ECU, post-build-variant-value=true, set at post-build in variant post-build / pre-compile in variant pre-compile  # DTC values of the selected group of DTC | (Range: 3 byte, 0xFFFFFF is reserved for 'all DTCs', according to ISO14229-1 Annex D.1) The DTC group 'all DTCs' is always available and will not be configured. The following ranges are reserved by ISO 14229-1 : 0x000000 to 0x0000ff and 0xffff00 to 0xffffff.
        container DemUserDefinedMemory [0..30]  # This container contains the user defined event memory specific parameters of the Dem module.
          boolean DemAffectedByControlDTCSetting [0..1]: scope=ECU, set at pre-compile  # This attribute configures how the content of the memory is affected by an active ControlDTCSetting or not. If the attribute is set to true, the user-defined fault memory is not updated if ControlDTCSetting is off. If the attribute is set to false, the user defined fault memory is updated even if ControlDTCSetting is off.
          integer DemDtcStatusAvailabilityMask: 0..255, scope=ECU, set at pre-compile  # Mask for the supported DTC status bits by the Dem. This mask is used in the positive response of UDS service 0x19.
          enumeration DemEventDisplacementStrategy: {DEM_DISPLACEMENT_FULL, DEM_DISPLACEMENT_NONE, DEM_DISPLACEMENT_PRIO_OCC}, scope=ECU, set at pre-compile  # This configuration switch defines, whether support for event displacement is enabled or not, and which displacement strategy is followed.
          enumeration DemEventMemoryEntryStorageTrigger: {DEM_TRIGGER_ON_CONFIRMED, DEM_TRIGGER_ON_FDC_THRESHOLD, DEM_TRIGGER_ON_TEST_FAILED}, set at pre-compile, default-value=DEM_TRIGGER_ON_TEST_FAILED  # Configures the primary trigger to allocate an event memory entry.
          integer DemMaxNumberEventEntryUserDefined: 1..255, scope=ECU, set at pre-compile  # Maximum number of events which can be stored in the user defined memory.
          enumeration DemOccurrenceCounterProcessing: {DEM_PROCESS_OCCCTR_CDTC, DEM_PROCESS_OCCCTR_TF}, scope=ECU, set at pre-compile  # This configuration switch defines the consideration of the fault confirmation process for the occurrence counter. For OBD and mixed systems (OBD/non OBD, refer to DemOBDSupport) configuration switch shall always set to DEM_PROCESS_OCCCTR_TF.
          enumeration DemTypeOfFreezeFrameRecordNumeration: {DEM_FF_RECNUM_CALCULATED, DEM_FF_RECNUM_CONFIGURED}, scope=ECU, set at pre-compile  # This parameter defines the type of assigning freeze frame record numbers for event-specific freeze frame records.
          integer DemUserDefinedMemoryIdentifier: 0..255, scope=ECU, set at pre-compile, symbolic-name-value=true  # Identifier used by external tester to identify the User defined event memory.
          container DemGroupOfDTC [0..65535]  # This container contains the configuration (parameters) for DTC groups.
            integer DemGroupDTCs: 256..16776959, scope=ECU, post-build-variant-value=true, set at post-build in variant post-build / pre-compile in variant pre-compile  # DTC values of the selected group of DTC | (Range: 3 byte, 0xFFFFFF is reserved for 'all DTCs', according to ISO14229-1 Annex D.1) The DTC group 'all DTCs' is always available and will not be configured. The following ranges are reserved by ISO 14229-1 : 0x000000 to 0x0000ff and 0xffff00 to 0xffffff.
      container DemExtendedDataClass [0..65535]  # This class contains the combinations of extended data records for an extended data class.
        reference DemExtendedDataRecordClassRef [1..253]: multiplicity set at pre-compile, requires-index=true, set at pre-compile, destination=DemExtendedDataRecordClass  # This reference contains the link to an extended data class record.
      container DemExtendedDataRecordClass [0..253]  # This container contains the configuration (parameters) for an extended data record class. | It is assembled out of one or several data elements.
        integer DemExtendedDataRecordNumber: 1..254, scope=ECU, set at pre-compile  # This configuration parameter specifies a number for an extended data record. The value is unique within a fault memory. | One or more extended data records can be assigned to one diagnostic event/DTC. For primary fault memory, the value 0x00 and the range from 0xF0 to 0xFF are either reserved or predefined. For user defined fault memories, only the value 0x00 is reserved and 0xFF is predefined.
        enumeration DemExtendedDataRecordTrigger [0..1]: {DEM_TRIGGER_ON_CONFIRMED, DEM_TRIGGER_ON_FDC_THRESHOLD, DEM_TRIGGER_ON_PASSED, DEM_TRIGGER_ON_PENDING, DEM_TRIGGER_ON_TEST_FAILED}, set at pre-compile  # Defines the trigger to store the ExtendedDataRecord.
        enumeration DemExtendedDataRecordUpdate [0..1]: {DEM_UPDATE_RECORD_NO, DEM_UPDATE_RECORD_YES}, scope=ECU, set at pre-compile  # This extended data record is captured if the configured trigger condition in "DemExtendedDataRecordTrigger" is fulfilled.
        reference DemDataElementClassRef [1..255]: multiplicity set at pre-compile, requires-index=true, set at pre-compile, destination=DemDataElementClass  # This reference contains the link to a data element class.
      container DemFreezeFrameClass [0..65535]  # This container contains the combinations of DIDs for freeze frames of UDS and emission related diagnostics over UDS.
        reference DemDidClassRef [1..255]: scope=ECU, multiplicity set at pre-compile, requires-index=true, set at pre-compile, destination=DemDidClass  # Reference to the DID elements which shall be contained in the freeze frame.
      container DemFreezeFrameRecNumClass [0..65535]  # This container contains a list of dedicated, different freeze frame record numbers assigned to an event. The order of record numbers in this list is assigned to the chronological order of the according freeze frame records.
        reference DemFreezeFrameRecordClassRef [1..254]: scope=ECU, multiplicity set at pre-compile, requires-index=true, set at pre-compile, destination=DemFreezeFrameRecordClass  # This parameter references record number(s) for a freeze frame record.
      container DemFreezeFrameRecordClass [0..65535]  # This container contains a list of dedicated, different freeze frame record numbers.
        integer DemFreezeFrameRecordNumber: 0..254, scope=ECU, set at pre-compile  # This parameter defines the snapshot record number for a freeze frame. This record number is unique per freeze frame record number class. The number needs to be unique within a fault memory.
        enumeration DemFreezeFrameRecordTrigger: {DEM_TRIGGER_ON_CONFIRMED, DEM_TRIGGER_ON_EVERY_TEST_FAILED, DEM_TRIGGER_ON_FDC_THRESHOLD, DEM_TRIGGER_ON_PENDING, DEM_TRIGGER_ON_TEST_FAILED, DEM_TRIGGER_ON_TEST_FAILED_THIS_OPERATION_CYCLE}, set at pre-compile  # Defines the trigger to store the FreezeFrameRecord. Tags: atp.Status=draft
        enumeration DemFreezeFrameRecordUpdate: {DEM_UPDATE_RECORD_NO, DEM_UPDATE_RECORD_YES}, scope=ECU, set at pre-compile  # This parameter defines the case, when the freeze frame record is stored/updated.
      container DemGeneralJ1939 [0..1]  # This container contains the general J1939-specific configuration (parameters) of the Dem module. | If the container exists the J1939 support is enabled.
        boolean DemJ1939ClearDtcSupport: set at pre-compile  # This configuration switch defines whether clearing J1939 DTCs (DM03 und DM11) is supported or not. | This switches on and off the API Dem_J1939DcmClearDTC.
        boolean DemJ1939Dm31Support: set at pre-compile  # This configuration switch defines whether J1939 DM31 is supported or not. | This switches on and off the APIs Dem_J1939DcmFirstDTCwithLampStatus and Dem_J1939DcmGetNextDTCwithLampStatus. .
        boolean DemJ1939ExpandedFreezeFrameSupport: set at pre-compile  # This configuration switch defines whether J1939 expanded freeze frames are supported or not. | This switches on and off the APIs Dem_J1939DcmSetFreezeFrameFilter, Dem_J1939DcmGetNextFreezeFrame and Dem_J1939DcmGetNextSPNInFreezeFrame.
        boolean DemJ1939FreezeFrameSupport: set at pre-compile  # This configuration switch defines whether J1939 freeze frames are supported or not. | This switches on and off the APIs Dem_J1939DcmSetFreezeFrameFilter and Dem_J1939DcmGetNextFreezeFrame.
        boolean DemJ1939RatioSupport: set at pre-compile  # This configuration switch defines whether J1939 performance ratios are supported or not. | This switches on and off the APIs Dem_J1939DcmSetRatioFilter and Dem_J1939DcmGetNextFilteredRatio.
        boolean DemJ1939Readiness1Support: set at pre-compile  # This configuration switch defines whether J1939 diagnostic readiness 1 is supported or not. | This switches on and off the API Dem_J1939DcmReadDiagnosticReadiness1.
        boolean DemJ1939Readiness2Support: set at pre-compile  # This configuration switch defines whether J1939 diagnostic readiness 2 is supported or not. | This switches on and off the API Dem_J1939DcmReadDiagnosticReadiness2.
        boolean DemJ1939Readiness3Support: set at pre-compile  # This configuration switch defines whether J1939 diagnostic readiness 3 is supported or not. | This switches on and off the API Dem_J1939DcmReadDiagnosticReadiness3.
        boolean DemJ1939ReadingDtcSupport: set at pre-compile  # This configuration switch defines whether J1939 DTC readout is supported or not. | This switches on and off the APIs Dem_J1939DcmSetDTCFilter, Dem_J1939DcmGetNumberOfFilteredDTC and Dem_J1939DcmGetNextFilteredDTC.
        container DemCallbackJ1939DTCStatusChanged [0..*]  # The presence of this container indicates, that the Dem has access to a "DTCStatusChanged" callback, which the Dem will call to notify other components about the change in the status of a DTC. | In case there is a DemCallbackDTCStatusChangedFnc, this parameter defines the name of the function that the Dem will call. In case there is no DemCallbackDTCStatusChangedFnc, the Dem will have an R-Port requiring the interface CallbackDTCStatusChanged whose name is generated by using the unique callback-prefix followed by the event name. Status change notifications are supported for DTCs in primary memory only.
          function name DemCallbackDTCStatusChangedFnc [0..1]: scope=ECU, multiplicity set at pre-compile, set at pre-compile  # Function name of prototype "DTCStatusChanged".
        container DemJ1939FreezeFrameClass [0..255]  # This container contains the combinations of SPNs s for a J1939 relevant freeze frame.
          reference DemSPNClassRef [1..255]: scope=ECU, multiplicity set at pre-compile, requires-index=true, set at pre-compile, destination=DemSPNClass  # Reference to an SPN. This reference defines requiresIndex = true since it represents a ordered list of references where the order describes the order of single SPNs in the J1939 Freeze Frame.
        container DemSPNClass [0..*]  # This container contains the configuration (parameters) for a SPN.
          integer DemSPNId: 0..524287, set at pre-compile  # Suspect parameter number
          reference DemSPNDataElementClassRef: scope=ECU, set at pre-compile, destination=DemDataElementClass  # This reference contains the link to a data element class.
      container DemGeneralOBD [0..1]  # This container contains the general OBD-specific configuration (parameters) of the Dem module.
        boolean DemOBDCentralizedPID21Handling: scope=ECU, set at pre-compile  # Switch to enable the centralized handling of PID $21. | true: centralized handling of PID $21 enabled false: centralized handling of PID $21 disabled
        boolean DemOBDCentralizedPID31Handling: scope=ECU, set at pre-compile  # Switch to enable the centralized handling of PID $31. | true: centralized handling of PID $31 enabled false: centralized handling of PID $31 disabled
        integer DemOBDCompliancy: 0..255, scope=ECU, multiplicity set at pre-compile, post-build-variant-value=true, set at post-build in variant post-build / pre-compile in variant pre-compile  # Configuration value to define the appropriate value to PID$1C "OBD requirements to which vehicle or engine is certified." according to the respective standards, e.g. OBD, OBDII, JOBD etc. | Notice as well J1979 or the "DiagnosticReadiness 1" DM05 message of J1939-73
        boolean DemOBDDelayedDCYConfirmedAndMIL [0..1]: set at pre-compile, default-value=false  # Controls the delayed calculation of the confirmed status for the OBD driving cycle.
        enumeration DemOBDEngineType [0..1]: {DEM_IGNITION_COMPRESSION, DEM_IGNITION_SPARK}, scope=ECU, multiplicity set at pre-compile, set at pre-compile  # Switch to provide either Gasoline or Diesel parameters.
        boolean DemOBDEventDisplacement: set at pre-compile  # Activate/Deactivate a different displacement behavior for OBD events. | OBD events with special Conditions (e.g. Pending, MIL_On...) shall not be displaced.
        boolean DemSupportedObdUdsDtcSeparation [0..1]: multiplicity set at pre-compile, post-build-variant-multiplicity=true, post-build-variant-value=true, set at pre-compile, default-value=false  # If this parameter is set to true, the OBD UDS DTC separation is enabled. If this parameter is set to false, the OBD UDS DTC separation is disabled.
        reference DemOBDDrivingCycleRef: set at pre-compile, destination=DemOperationCycle  # Defines the operationCycle which denotes the OBD driving cycle.
        choice reference DemOBDInputAcceleratorPedalInformation [0..1]: scope=ECU, multiplicity set at pre-compile, set at pre-compile, destination=[DemExternalCSDataElementClass, DemExternalSRDataElementClass]  # Input variable for the accelerator padal information, which is assigned to a specific data element used as interface for the Dem-internal PID calculations.
        choice reference DemOBDInputAmbientPressure [0..1]: scope=ECU, multiplicity set at pre-compile, set at pre-compile, destination=[DemExternalCSDataElementClass, DemExternalSRDataElementClass]  # Input variable for the ambient pressure, which is assigned to a specific data element used as interface for the Dem-internal PID calculations.
        choice reference DemOBDInputAmbientTemperature [0..1]: scope=ECU, multiplicity set at pre-compile, set at pre-compile, destination=[DemExternalCSDataElementClass, DemExternalSRDataElementClass]  # Input variable for the ambient temperature, which is assigned to a specific data element used as interface for the Dem-internal PID calculations.
        choice reference DemOBDInputDistanceInformation [0..1]: scope=ECU, multiplicity set at pre-compile, set at pre-compile, destination=[DemExternalCSDataElementClass, DemExternalSRDataElementClass]  # Input variable for the distance information, which is assigned to a specific data element used as interface for the Dem-internal PID calculations.
        choice reference DemOBDInputEngineSpeed [0..1]: scope=ECU, multiplicity set at pre-compile, set at pre-compile, destination=[DemExternalCSDataElementClass, DemExternalSRDataElementClass]  # Input variable for the engine speed, which is assigned to a specific data element used as interface for the Dem-internal PID calculations.
        choice reference DemOBDInputEngineTemperature [0..1]: scope=ECU, multiplicity set at pre-compile, set at pre-compile, destination=[DemExternalCSDataElementClass, DemExternalSRDataElementClass]  # Input variable for the engine temperature, which is assigned to a specific data element used as interface for the Dem-internal PID calculations.
        choice reference DemOBDInputProgrammingEvent [0..1]: scope=ECU, multiplicity set at pre-compile, set at pre-compile, destination=[DemExternalCSDataElementClass, DemExternalSRDataElementClass]  # Input variable for the programming event, which is assigned to a specific data element used as interface for the Dem-internal PID calculations.
        choice reference DemOBDInputVehicleSpeed [0..1]: scope=ECU, multiplicity set at pre-compile, set at pre-compile, destination=[DemExternalCSDataElementClass, DemExternalSRDataElementClass]  # Input variable for the vehicle speed, which is assigned to a specific data element used as interface for the Dem-internal PID calculations.
        reference DemOBDPFCCycleRef: set at pre-compile, destination=DemOperationCycle  # Defines the operationCycle, which is relevant for processing the OBDPFCCycle.
        choice reference DemOBDTimeSinceEngineStart [0..1]: multiplicity set at pre-compile, set at pre-compile, destination=[DemExternalCSDataElementClass, DemExternalSRDataElementClass]  # Input variable for the Time Since Engine Start information, which is assigned to a specific data element.
        reference DemOBDWarmUpCycleRef: set at pre-compile, destination=DemOperationCycle  # Defines the operationCycle which denotes the OBD warm-up cycle.
        container DemCallbackOBDDTCStatusChanged [0..*]  # The presence of this container indicates, that the Dem has access to a "DTCStatusChanged" callback, which the Dem will call to notify other components about the change in the status of a DTC. | In case there is a DemCallbackDTCStatusChangedFnc, this parameter defines the name of the function that the Dem will call. In case there is no DemCallbackDTCStatusChangedFnc, the Dem will have an R-Port requiring the interface CallbackDTCStatusChanged whose name is generated by using the unique callback-prefix followed by the event name. Status change notifications are supported for DTCs in primary memory only.
          function name DemCallbackDTCStatusChangedFnc [0..1]: scope=ECU, multiplicity set at pre-compile, set at pre-compile  # Function name of prototype "DTCStatusChanged".
      container DemNvRamBlockId [0..*]  # This container contains the configuration (parameters) for a non-volatile memory block, which is used from the Dem. If no permanent storage of event memory entries is required, no block needs to be configured. | The number of blocks which are necessary depends on the implementation and configuration (e.g. number of used event memories) of the Dem module.
        reference DemNvRamBlockIdRef: set at pre-compile, requires-symbolic-name-value=true, destination=NvMBlockDescriptor  # This reference contains the link to a non-volatile memory block. For post build time configurations worst case scenario shall be used.
      container DemOperationCycle [1..256]  # This container holds all parameters that are relevant to configure an operation cycle.
        integer DemOperationCycleId: 0..255, multiplicity set at pre-compile, set at pre-compile, symbolic-name-value=true  # This parameter's value is used, together with the aggregating container, to define a symbolic name of the operation cycle.
        reference DemLeadingCycleRef [0..1]: set at pre-compile, requires-symbolic-name-value=true, destination=DemOperationCycle  # Defines the operation cycle, which is relevant for processing this operation cycle.
      container DemRatio [0..65535]  # This container contains the OBD-specific in-use-monitor performance ratio configuration. | It is related to a specific event, a FID, and an IUMPR group.
        enumeration DemIUMPRDenGroup: {DEM_IUMPR_DEN_500MILL, DEM_IUMPR_DEN_COLDSTART, DEM_IUMPR_DEN_CSERS, DEM_IUMPR_DEN_CSERS_API, DEM_IUMPR_DEN_EVAP, DEM_IUMPR_DEN_EVAPPURGEFLOW, DEM_IUMPR_DEN_NONE, DEM_IUMPR_DEN_PHYS_API}, scope=ECU, set at pre-compile  # This parameter specifies the assigned denominator type
        enumeration DemIUMPRGroup: {DEM_IUMPR_AFRI1, DEM_IUMPR_AFRI2, DEM_IUMPR_BOOSTPRS, DEM_IUMPR_CAT1, DEM_IUMPR_CAT2, DEM_IUMPR_EGR, DEM_IUMPR_EGSENSOR, DEM_IUMPR_EVAP, DEM_IUMPR_FLSYS, DEM_IUMPR_NMHCCAT, DEM_IUMPR_NOXADSORB, DEM_IUMPR_NOXCAT, DEM_IUMPR_OXS1, DEM_IUMPR_OXS2, DEM_IUMPR_PF1, DEM_IUMPR_PF2, DEM_IUMPR_PMFILTER, DEM_IUMPR_PRIVATE, DEM_IUMPR_SAIR, DEM_IUMPR_SECOXS1, DEM_IUMPR_SECOXS2}, scope=ECU, set at pre-compile  # This parameter specifies the assigned IUMPR group of the ratio Id.
        integer DemRatioId: 0..65535, scope=ECU, set at pre-compile, symbolic-name-value=true  # Defines a unique ratio Id. | This parameter should not be changeable by user, because the Id should be generated by Dem itself to prevent gaps and multiple use of an Id. The ratio Ids should be sequentially ordered beginning with 0 and no gaps in between.
        enumeration DemRatioKind: {DEM_RATIO_API, DEM_RATIO_OBSERVER}, scope=ECU, set at pre-compile  # This parameter defines whether the ratio will be calculated API or observer based.
        reference DemDiagnosticEventRef: scope=ECU, set at pre-compile, destination=DemEventParameter  # This reference contains the link to a diagnostic event.
        reference DemFunctionIdRef [0..*]: scope=ECU, set at pre-compile, requires-symbolic-name-value=true, destination=FiMFID  # This reference contains the link to a function identifier within the FiM which is used as a primary FID.
      container DemStorageCondition [0..255]  # This container contains the configuration (parameters) for storage conditions.
        integer DemStorageConditionId: 0..255, scope=ECU, set at pre-compile, symbolic-name-value=true  # Defines a unique storage condition Id. This parameter should not be changeable by user, because the Id should be generated by Dem itself to prevent gaps and multiple use of an Id. The storage conditions should be sequentially ordered beginning with 0 and no gaps in between.
        boolean DemStorageConditionStatus: set at pre-compile  # Defines the initial status for enable or disable of storage of a diagnostic event. | The value is the initialization after power up (before this condition is reported the first time). true: storage of a diagnostic event enabled false: storage of a diagnostic event disabled
        reference DemStorageConditionReplacementEventRef [0..1]: scope=ECU, multiplicity set at pre-compile, set at pre-compile, destination=DemEventParameter  # Specifies the reference to an event which is stored to event memory and supports failure analysis.
      container DemStorageConditionGroup [0..255]  # This container contains the configuration (parameters) for storage condition groups.
        reference DemStorageConditionRef [1..255]: scope=ECU, multiplicity set at pre-compile, set at pre-compile, destination=DemStorageCondition  # References an enable condition.
  module definition Det [0..1]: variants pre-compile  # Det configuration includes the functions to be called at notification. On one | side the application functions are specified and in general it can be decided whether Dlt shall be called at each call of Det.
    container DetConfigSet [0..1]  # Configuration set container for Det.
      container DetModule [0..*]  # This container describes a non BSW module that is using the Det via Service Interface.
        integer DetModuleId: 4096..65535, set at pre-compile, symbolic-name-value=true  # Unique identifier of the error reporting component. When reporting errors to the DET, a symbolic name derived from the moduleID has to be used to identify the reporter.
        container DetModuleInstance [1..*]: multiplicity set at pre-compile, post-build-variant-multiplicity=true  # Describes the Instance used for the according Service Port. | It shall be used to differentiate software component instances when multiple instantiation is used.
          integer DetInstanceId: 0..255, set at pre-compile, default-value=0  # Describes the InstanceId used for the according Service Port. | It shall be used to differentiate software component instances when multiple instantiation is used. Else it shall be set to 0.
    container DetGeneral  # Generic configuration parameters of the Det module.
      boolean DetForwardToDlt [0..1]: multiplicity set at pre-compile, set at pre-compile  # Only if the parameter is present and set to true, the Det requires the Dlt interface and forwards it's call to the function Dlt_DetForwardErrorTrace. In this case the optional interface to Dlt_Det is required.
      boolean DetVersionInfoApi: set at pre-compile, default-value=false  # Pre-processor switch to enable / disable the API to read out the modules version information. | true: Version info API enabled. false: Version info API disabled.
    container DetNotification [0..1]  # Configuration of the notification functions.
      function name DetErrorHook [0..*]: multiplicity set at pre-compile, set at pre-compile  # Optional list of functions to be called by the Default Error Tracer in context of each call of Det_ReportError. | The type of these functions shall be identical the type of Det_ReportError itself: Std_ReturnType (*f)(uint16, uint8, uint8, uint8).
      function name DetReportRuntimeErrorCallout [0..*]: set at pre-compile  # This parameter defines the existence and the names of callout functions for the corresponding runtime error handler. | The type of these functions shall be identical the type of Det_ReportRuntimeError itself: Std_ReturnType (*f)(uint16, uint8, uint8, uint8)
  module definition Dio [0..1]: variants link-time/pre-compile  # Configuration of the Dio (Digital IO) module.
    container DioConfig  # This container contains the configuration parameters and sub containers of the AUTOSAR DIO module.
      container DioPort [1..*]  # Configuration of individual DIO ports, consisting of channels and possible channel groups. | Note that this container definition does not explicitly define a symbolic name parameter. Instead, the container's short name will be used in the Ecu Configuration Description to specify the symbolic name of the port.
        integer DioPortId: 0..4294967295, scope=ECU, set at pre-compile, symbolic-name-value=true  # Numeric identifier of the DIO port. Not all MCU ports may be used for DIO, thus there may be "gaps" in the list of all IDs. This value will be | assigned to the DIO port symbolic name (i.e. the SHORT-NAME of the DioPort container).
        reference DioPortEcucPartitionRef [0..*]: scope=ECU, multiplicity set at pre-compile, set at pre-compile, destination=EcucPartition  # Maps the DIO ports to zero or multiple ECUC partitions. The ECUC partitions referenced are a subset of the ECUC partitions where the DIO driver is mapped to.
        container DioChannel [0..*]  # Configuration of an individual DIO channel.
          integer DioChannelId: 0..4294967295, scope=ECU, set at pre-compile, symbolic-name-value=true  # Channel Id of the DIO channel. This value will be assigned to the symbolic names.
          reference DioChannelEcucPartitionRef [0..*]: scope=ECU, multiplicity set at pre-compile, set at pre-compile, destination=EcucPartition  # Maps a DIO channel to zero or multiple ECUC partitions. The ECUC partitions referenced are a subset of the ECUC partitions where the related DIO port is mapped to.
        container DioChannelGroup [0..*]  # Definition and configuration of DIO channel groups. A channel group represents several adjoining DIO channels represented by a logical group. | Note that this container definition does not explicitly define a symbolic name parameter. Instead, the container's short name will be used in the Ecu Configuration Description to specify the symbolic name of the channel group.
          string DioChannelGroupIdentification: scope=ECU, set at pre-compile, symbolic-name-value=true  # The DIO channel group is identified in DIO API by a pointer to a data structure (of type Dio_ChannelGroupType). That data structure contains the channel group information. | This parameter contains the code fragment that has to be inserted in the API call of the calling module to get the address of the variable in memory which holds the channel group information. Example values are "&MyDioGroup1" or "&MyDioGroupArray[0]"
          integer DioPortMask: 0..4294967295, set at link in variant link-time / pre-compile in variant pre-compile  # This shall be the mask which defines the positions of the channel | group. The channels shall consist of adjoining bits in the same port. The data type depends on the port width.
          integer DioPortOffset: 0..31, set at link in variant link-time / pre-compile in variant pre-compile  # The position of the Channel Group on the port, counted | from the LSB. This value can be derived from DioPortMask. calculationFormula = Position of the first bit of DioPortMask which is set to '1' counted from LSB
          reference DioChannelGroupEcucPartitionRef [0..*]: scope=ECU, multiplicity set at pre-compile, set at pre-compile, destination=EcucPartition  # Maps a DIO channel group to zero or multiple ECUC partitions. The ECUC partitions referenced are a subset of the ECUC partitions where the related DIO port is mapped to.
    container DioGeneral  # General DIO module configuration parameters.
      boolean DioDevErrorDetect: set at pre-compile, default-value=false  # Switches the development error detection and notification on or off. | * true: detection and notification is enabled. * false: detection and notification is disabled.
      boolean DioFlipChannelApi: set at pre-compile  # Adds / removes the service Dio_FlipChannel() from the code.
      boolean DioMaskedWritePortApi: set at pre-compile, default-value=false  # Adds / removes the service Dio_MaskedWritePort() from the code.
      boolean DioVersionInfoApi: set at pre-compile, default-value=false  # Adds / removes the service Dio_ GetVersionInfo() from the code.
      reference DioEcucPartitionRef [0..*]: scope=ECU, multiplicity set at pre-compile, set at pre-compile, destination=EcucPartition  # Maps the DIO driver to zero or multiple ECUC partitions to make the modules API available in this partition.
  module definition Dlt [0..1]: post-build-variant-support=true, variants link-time/post-build/pre-compile  # Configuration of the Dlt (Log&Trace) module.
    container DltConfigSet  # This container lists all the global Dlt functionalities that can be enabled or disabled at pre-compile time to optimize resource consumption.
      container DltLogLevelSetting  # Contains settings for thresholds.
        enumeration DltDefaultLogLevel: {DLT_LOG_DEBUG, DLT_LOG_ERROR, DLT_LOG_FATAL, DLT_LOG_INFO, DLT_LOG_OFF, DLT_LOG_VERBOSE, DLT_LOG_WARN}, scope=ECU, post-build-variant-value=true, set at link in variant link-time / post-build in variant post-build / pre-compile in variant pre-compile  # This is the effective log level used in case no filter matches the given AppicationId and ContextId. This can be seen as a fall-through filter definition with wildcard for AppicationId and ContextId, which will be used, when no other filter matches.
        container DltLogLevelThreshold [0..*]: multiplicity set at link in variant link-time / post-build in variant post-build / pre-compile in variant pre-compile, post-build-variant-multiplicity=true  # This container contains a preconfiguration of ApplicationId / ContextId pairs and their assigned LogLevel threshold.
          enumeration DltThreshold: {DLT_LOG_DEBUG, DLT_LOG_ERROR, DLT_LOG_FATAL, DLT_LOG_INFO, DLT_LOG_OFF, DLT_LOG_VERBOSE, DLT_LOG_WARN}, scope=ECU, post-build-variant-value=true, set at link in variant link-time / post-build in variant post-build / pre-compile in variant pre-compile  # LogLevel Threshold
          reference DltLogLevelThresholdSwcContextRef: post-build-variant-value=true, set at link in variant link-time / post-build in variant post-build / pre-compile in variant pre-compile, destination=DltSwcContext  # Reference to an ApplicationId/ContextId pair to which a LogLevel threshold is assigned.
      container DltLogOutput  # Contains settings for log/trace message output
        reference DltDefaultLogChannelRef: post-build-variant-value=true, set at link in variant link-time / post-build in variant post-build / pre-compile in variant pre-compile, destination=DltLogChannel  # Reference to the default log channel, which has to be used for a log/trace output, if no other match has been found.
        container DltLogChannel [1..*]  # Contains settings for log/trace message output
          float DltLogChannelBufferOverflowTimer: 0.001..1, scope=ECU, post-build-variant-value=true, set at link in variant link-time / post-build in variant post-build / pre-compile in variant pre-compile  # Specifies the cycle time in seconds for resetting the buffer overflow flag in case a buffer overflow occurred.
          integer DltLogChannelBufferSize: 0..4294967295, scope=ECU, set at pre-compile  # Buffer size in bytes for the LogChannel specific message buffer.
          string DltLogChannelId: scope=ECU, post-build-variant-value=true, set at link in variant link-time / post-build in variant post-build / pre-compile in variant pre-compile  # This is the 4 ASCII character long name of the log channel as used in the Dlt control messages as parameter name Dlt_interface
          integer DltLogChannelMaxMessageLength: 8..65535, scope=ECU, post-build-variant-value=true, set at link in variant link-time / pre-compile in variant post-build+pre-compile  # The maximum length of a Dlt log or trace message.
          integer DltLogChannelMaxNumOfRetries: 0..255, scope=ECU, post-build-variant-value=true, set at link in variant link-time / post-build in variant post-build / pre-compile in variant pre-compile, default-value=0  # The maximum amount of retries for sending a Dlt log or trace message.
          boolean DltLogChannelSegmentationSupported: post-build-variant-value=true, set at link in variant link-time / post-build in variant post-build / pre-compile in variant pre-compile  # Segmentation will be used if a DLT message is larger than Pdu length.
          enumeration DltLogChannelThreshold: {DLT_LOG_DEBUG, DLT_LOG_ERROR, DLT_LOG_FATAL, DLT_LOG_INFO, DLT_LOG_OFF, DLT_LOG_VERBOSE, DLT_LOG_WARN}, scope=ECU, post-build-variant-value=true, set at link in variant link-time / post-build in variant post-build / pre-compile in variant pre-compile  # LogLevel Threshold
          integer DltLogChannelTrafficShapingBandwidth [0..1]: 0..18446744073709551615, multiplicity set at link in variant link-time / post-build in variant post-build / pre-compile in variant pre-compile, post-build-variant-multiplicity=true, post-build-variant-value=true, set at link in variant link-time / post-build in variant post-build / pre-compile in variant post-build+pre-compile  # Set the maximum possible bandwith in bit/s.
          float DltLogChannelTransmitCycle: 0.001..1, scope=ECU, post-build-variant-value=true, set at link in variant link-time / post-build in variant post-build / pre-compile in variant pre-compile  # Specifies the cycle time in seconds of the transmit functionality of this log channel.
          boolean DltLogTraceStatusFlag: post-build-variant-value=true, set at link in variant link-time / post-build in variant post-build / pre-compile in variant pre-compile  # Parameter to turn on/off tracing on this LogChannel completely.
          container DltTxPdu  # Contains the configuration parameters of the AUTOSAR Dlt module's Tx Pdus.
            integer DltTxPduId [0..1]: 0..65535, scope=ECU, multiplicity set at link in variant link-time / post-build in variant post-build / pre-compile in variant pre-compile, post-build-variant-multiplicity=true, post-build-variant-value=true, set at link in variant link-time / post-build in variant post-build / pre-compile in variant pre-compile, symbolic-name-value=true, with-auto=true  # The numerical value used as the ID of this I-PDU. | This handle Id is used for the APIs calls Dlt_TxConfirmation, Dlt_TriggerTransmit, Dlt_TriggerIPDUSend or Dlt_TriggerIPDUSendWithMetaData, Dlt_CopyTxData and Dlt_TpTxConfirmation to transmit respectively confirm transmissions of I-PDUs.
            boolean DltTxPduUsesTp: post-build-variant-value=true, set at link in variant link-time / post-build in variant post-build / pre-compile in variant pre-compile  # If set to TRUE, the PDU is transmitted using the TP API. If FALSE, the IF API is used.
            reference DltTxPduRef: post-build-variant-value=true, set at link in variant link-time / post-build in variant post-build / pre-compile in variant pre-compile, destination=Pdu  # Reference to the "global" Pdu structure to allow harmonization of handle IDs in the COM-Stack.
        container DltLogChannelAssignment [0..*]: multiplicity set at link in variant link-time / post-build in variant post-build / pre-compile in variant pre-compile, post-build-variant-multiplicity=true  # This container contains a preconfiguration of ApplicationId / ContextId pairs and their assigned log channel.
          reference DltLogChannelAssignmentSwcContextRef: post-build-variant-value=true, set at link in variant link-time / post-build in variant post-build / pre-compile in variant pre-compile, destination=DltSwcContext  # Reference to an ApplicationId/ContextId pair that is assigned to a DltLogChannel.
          reference DltLogChannelRef: post-build-variant-value=true, set at link in variant link-time / post-build in variant post-build / pre-compile in variant pre-compile, destination=DltLogChannel  # Reference to a DltLogChannel that is assigned to an ApplicationId / ContextId pair.
      container DltProtocol  # Configuration parameters for handling the specific protocol variants.
        boolean DltHeaderUseEcuId: scope=ECU, post-build-variant-value=true, set at link in variant link-time / post-build in variant post-build / pre-compile in variant pre-compile  # Corresponds to field WEID (With ECU ID). If set ECU ID shall be placed in the header, else not. | If DltGeneralNvRAMSupport is enabled the value of the parameter defined here is also the initial value for the corresponding NvRam entry. If DltGeneralNvRAMSupport is not set, Link-Time or Post-Build configuration shall be used.
        boolean DltHeaderUseSessionID: scope=ECU, post-build-variant-value=true, set at link in variant link-time / post-build in variant post-build / pre-compile in variant pre-compile  # Corresponds to field WSID (with Session ID). If set the Session ID shall be placed in the header, else not. | If DltGeneralNvRAMSupport is enabled the value of the parameter defined here is also the initial value for the corresponding NvRam entry. If DltGeneralNvRAMSupport is not set, Link-Time or Post-Build configuration shall be used.
        boolean DltHeaderUseTimestamp: scope=ECU, post-build-variant-value=true, set at link in variant link-time / post-build in variant post-build / pre-compile in variant pre-compile  # Corresponds to field WTMS (With Timestamp). If set the timestamp shall be placed in the header, else not. | If DltGeneralNvRAMSupport is enabled the value of the parameter defined here is also the initial value for the corresponding NvRam entry. If DltGeneralNvRAMSupport is not set, Link-Time or Post-Build configuration shall be used.
        boolean DltUseExtHeaderInNonVerbMode: scope=ECU, post-build-variant-value=true, set at link in variant link-time / post-build in variant post-build / pre-compile in variant pre-compile  # Non Verbose messages (opposed to verbose messages) do not need an extended header. If this flag is set to true the extended header shall also be used for non verbose messages. | If DltGeneralNvRAMSupport is enabled the value of the parameter defined here is also the initial value for the corresponding NvRam entry. If DltGeneralNvRAMSupport is not set, Link-Time or Post-Build configuration shall be used.
        boolean DltUseVerboseMode: scope=ECU, post-build-variant-value=true, set at link in variant link-time / post-build in variant post-build / pre-compile in variant pre-compile  # If this flag is set to TRUE, the payload shall be transmitted in verbose mode, else the payload shall be transmitted in none-verbose mode.
        choice container DltEcuId  # This is a choice container to choose between a EcuId value or a callout to get the EcuId.
          container DltEcuIdCalloutChoice [0..1]  # EcuId via user defined callout.
            function name DltEcuIdCallout: scope=ECU, set at pre-compile  # If this choice is used the EcuId shall be fetched by calling the here configured callout function.
          container DltEcuIdValueChoice [0..1]  # EcuId value configuration
            string DltEcuIdValue: scope=ECU, set at pre-compile  # If this choice is used the EcuId shall be taken from the configured string. | This is the name of the ECU for use within the Dlt protocol. If you want to use a number representation type this as character.
      container DltRxPdu [0..*]: multiplicity set at link in variant link-time / post-build in variant post-build / pre-compile in variant pre-compile, post-build-variant-multiplicity=true  # Contains the Pdu IDs to be used for Dlt control messages reception.
        integer DltRxPduId [0..1]: 0..65535, scope=ECU, multiplicity set at link in variant link-time / post-build in variant post-build / pre-compile in variant pre-compile, post-build-variant-multiplicity=true, post-build-variant-value=true, set at link in variant link-time / post-build in variant post-build / pre-compile in variant pre-compile, symbolic-name-value=true, with-auto=true  # The numerical value used as the ID of this I-PDU. The DltRxPduId is required by the API calls Dlt_RxIndication, Dlt_TpRxIndication, Dlt_StartOfReception and Dlt_CopyRxData to receive I-PDUs from the PduR.
        boolean DltRxPduUsesTp: post-build-variant-value=true, set at link in variant link-time / post-build in variant post-build / pre-compile in variant pre-compile  # If set to TRUE, the PDU is received using the TP API. If FALSE, the IF API is used.
        reference DltRxPduRef: post-build-variant-value=true, set at link in variant link-time / post-build in variant post-build / pre-compile in variant pre-compile, destination=Pdu  # Reference to the "global" Pdu structure to allow harmonization of handle IDs in the COM-Stack.
      container DltTraceStatusSetting  # Contains settings for trace status
        boolean DltDefaultTraceStatus: scope=ECU, post-build-variant-value=true, set at link in variant link-time / post-build in variant post-build / pre-compile in variant pre-compile  # This is the effective trace status used in case no filter matches the given ApplicationId and ContextId. This can be seen as a fall-through filter definition with wildcard for ApplicationId and ContextId, which will be used, when no other filter matches.
        container DltTraceStatusAssignment [0..*]: multiplicity set at link in variant link-time / post-build in variant post-build / pre-compile in variant pre-compile, post-build-variant-multiplicity=true  # This container contains a preconfiguration of ApplicationId / ContextId pairs and their assigned trace status.
          boolean DltTraceStatus: scope=ECU, post-build-variant-value=true, set at link in variant link-time / post-build in variant post-build / pre-compile in variant pre-compile  # Trace status for the given ApplicationId/ContextId tuple.
          reference DltTraceStatusAssignmentSwcContextRef: post-build-variant-value=true, set at link in variant link-time / post-build in variant post-build / pre-compile in variant pre-compile, destination=DltSwcContext  # Reference to an ApplicationId/ContextId pair to which a DltTraceStatus is assigned.
    container DltGeneral  # This container lists all the global Dlt functionalities that can be enabled or disabled at pre-compile time to optimize resource consumption.
      boolean DltGeneralDevErrorDetect: set at pre-compile  # If the Default Error Tracer (Det) shall be used, this parameter shall be set to TRUE. Otherwise, it shall be set to FALSE.
      boolean DltGeneralInjectionSupport: set at pre-compile, default-value=false  # Enables or disables the Dlt Injection feature.
      boolean DltGeneralNvRAMSupport: set at pre-compile, default-value=false  # Enables or disables the Dlt NvRAM Support feature.
      boolean DltGeneralRegisterContextNotification: set at pre-compile, default-value=false  # If this parameter is set to TRUE, a Dlt Control Message is sent every time a SWC registeres and/or de-registers at/from the Dlt Module. Else, this notification is not sent.
      boolean DltGeneralRxDataPathSupport: set at pre-compile, default-value=false  # Enables or disables the Rx Data Path to control the Dlt module.
      float DltGeneralStartUpDelayTimer [0..1]: 0.001..10, multiplicity set at pre-compile, set at pre-compile  # Configurable delay in s of starting the transmission of Log and Trace messages after the Dlt module has been initialized.
      boolean DltGeneralTimeStampSupport: set at pre-compile, default-value=false  # If a Time Stamp shall be added to the Dlt messages, this configuration parameter shall be set to TRUE. | Otherwise, it shall be set to FALSE.
      boolean DltGeneralTrafficShapingSupport: set at pre-compile, default-value=true  # Enables or disables the TrafficShaping feature to limit the maximum bandwidth for Dlt messages. If enabled, the maximum bandwidth can be configured per LogChannel.
      boolean DltGeneralVersionInfoApi [0..1]: multiplicity set at pre-compile, set at pre-compile  # Pre-processor switch for enabling Version Info API support. | * True: version information API activated * False: version information API deactivated
      integer DltMaxNumberOfChannels: 1..65535, set at pre-compile  # Maximum number of log channels. This value is used to determine the size of arrays of log channel names in the DLT API.
      integer DltProtocolVersion [0..1]: 1..255, multiplicity set at pre-compile, set at pre-compile, default-value=1  # Selects the DLT protocol version to be used by Dlt module. Currently the versions 1 and 2 are supported.
      reference DltGeneralGptChannelRef [0..1]: multiplicity set at pre-compile, set at pre-compile, requires-symbolic-name-value=true, destination=GptChannelConfiguration  # If TimeStampSupport is used the Dlt module shall fetch the time from the Gpt module by calling Gpt_GetTimeElapsed with the here referenced GptChannel. The tick duration can be deduced from the GptChannelTickFrequency parameter of the GptChannelConfiguration container. This is necessary to calculate the microsecond resolution timestamp output in the Dlt message. | A GPT timer shall be used which starts with value 0 at ECU start-up according to the PRS Dlt Protocol Specification.
      reference DltGeneralNvRamRef [0..1]: multiplicity set at pre-compile, set at pre-compile, requires-symbolic-name-value=true, destination=NvMBlockDescriptor  # If the Dlt module shall be able to store modified parameters during runtime persistently, this reference shall be set and shall point to the NvmBlock.
      reference DltGeneralStbMTimeBaseRef [0..1]: multiplicity set at pre-compile, set at pre-compile, requires-symbolic-name-value=true, destination=StbMSynchronizedTimeBase  # If TimeStampSupport is used the Dlt module shall fetch the time from the StbM module by calling StbM_GetCurrentTime with the here referenced StbMSynchronizedTimeBase.
    container DltSwc [0..*]: multiplicity set at link in variant link-time / post-build in variant post-build / pre-compile in variant pre-compile, post-build-variant-multiplicity=true  # Contains necessary configuration parameters of the AUTOSAR Dlt module to interact with SWCs.
      integer DltSwcSessionId: 0..18446744073709551615, set at link in variant link-time+post-build / pre-compile in variant pre-compile  # An ECU wide unique ID to identify the port a SWC (instance) uses.
      boolean DltSwcSupportLogLevelAndTraceStatusChangeNotification: set at link in variant link-time+post-build / pre-compile in variant pre-compile, default-value=false  # Flag indicating, whether Dlt has to provide a R-Port for the notification of the SWC about LogLevel or TraceStatus changes.
      integer MaxSwcLogMessageLength: 8..65535, set at link in variant link-time+post-build / pre-compile in variant pre-compile  # Defines the maximum allowed length (uint16) for LogMessages. | The upper limit for the range of this parameter is currently defined by the range of the data type. The actual upper limit for the range of this parameter is identical to the maximum length of all configured Dlt log or trace messages, which is known when all log or trace messages are configured.
      integer MaxSwcTraceMessageLength: 8..65535, set at link in variant link-time+post-build / pre-compile in variant pre-compile  # Defines the maximum allowed length (uint16) for TraceMessages. | The upper limit for the range of this parameter is currently defined by the range of the data type. The actual upper limit for the range of this parameter is identical to the maximum length of all configured Dlt log or trace messages, which is known when all log or trace messages are configured.
      container DltSwcContext [0..*]: multiplicity set at link in variant link-time / post-build in variant post-build / pre-compile in variant pre-compile, post-build-variant-multiplicity=true  # This container contains the configuration of ApplicationId / ContextId pairs which are supported by this SWC.
        integer DltSwcApplicationId: 0..4294967295, post-build-variant-value=true, set at link in variant link-time / post-build in variant post-build / pre-compile in variant pre-compile  # Abbreviation for the SWC (4 characters)
        integer DltSwcContextId: 0..4294967295, post-build-variant-value=true, set at link in variant link-time / post-build in variant post-build / pre-compile in variant pre-compile  # Abbreviation for the ContextId (4 characters)
