AUTOSAR XML (schema 00053)
package /AUTOSAR/EcucDefs
  ecuc definition collection AUTOSARParameterDefinition: module=Firewall
  module definition Firewall [0..1]: post-build-variant-support=true, variants link-time/post-build/pre-compile  # Configuration of the Firewall module. Tags: atp.Status=draft
    container FirewallConfig  # This container contains the configuration parameters and sub containers of the Firewall module. Tags: atp.Status=draft
      reference FirewallInitialStateRef: multiplicity set at link in variant link-time / post-build in variant post-build / pre-compile in variant pre-compile, post-build-variant-multiplicity=true, post-build-variant-value=true, set at link in variant link-time / post-build in variant post-build / pre-compile in variant pre-compile, destination=FirewallState  # Reference to the Firewall State that is defined as the default state. Tags: atp.Status=draft
      container FirewallEthernetFrame [1..*]: multiplicity set at link in variant link-time / post-build in variant post-build / pre-compile in variant pre-compile, post-build-variant-multiplicity=true  # An ethernet frame to be filtered. Tags: atp.Status=draft
        container FirewallLowerLayerPdu  # Represents the lower layer PDU associated with an EthernetFrame. This PDU is usually linked to the EthIf via LSduR. It may accept any meta data item types for forwarding to the upper layer, but may consume meta data items of the types BROADCAST_8 and FILTER_RULE_ID_16. Tags: atp.Status=draft
          integer FirewallLowerLayerPduId: 0..65535, scope=ECU, set at pre-compile, symbolic-name-value=true, with-auto=true  # PDU identifier used for RxIndication from LSduR. Tags: atp.Status=draft
          reference FirewallLowerLayerPduRef: scope=ECU, post-build-variant-value=true, set at link in variant link-time / post-build in variant post-build / pre-compile in variant pre-compile, destination=Pdu  # Reference to the global PDU. Tags: atp.Status=draft
        container FirewallUpperLayerPdu  # Represents the upper layer PDU associated with an EthernetFrame. This PDU is linked to the LSduR and its upper layer modules, e.g. the TcpIp. It may provide any meta data item types forwarded from the lower layer. Tags: atp.Status=draft
          integer FirewallUpperLayerPduId: 0..65535, scope=ECU, set at pre-compile, symbolic-name-value=true, with-auto=true  # PDU identifier used for ReleaseRxBuffer from LSduR. Tags: atp.Status=draft
          reference FirewallUpperLayerPduRef: scope=ECU, post-build-variant-value=true, set at link in variant link-time / post-build in variant post-build / pre-compile in variant pre-compile, destination=Pdu  # Reference to the global PDU. Tags: atp.Status=draft
    container FirewallGeneral  # Contains the general configuration parameters of the module. Tags: atp.Status=draft
      boolean FirewallDevErrorDetect: set at pre-compile, default-value=false  # Switches the development error detection and notification on or off. Tags: atp.Status=draft | * true: detection and notification is enabled. * false: detection and notification is disabled.
      float FirewallMainFunctionPeriod: 0..INF, set at pre-compile, default-value=0.05  # Execution cycle of the respective Firewall_MainFunction instance in seconds. Tags: atp.Status=draft
      float FirewallSwitchRuleMgmtTimeout [0..1]: 0..INF, multiplicity set at pre-compile, set at pre-compile  # Timeout to wait for a confirmation of a switch core configuration request. Tags: atp.Status=draft
      boolean FirewallVersionInfoApi: set at pre-compile, default-value=false  # Pre-processor switch for enabling version info API support. Tags: atp.Status=draft
      boolean FirwallEnableSecurityEventReporting: scope=ECU, set at pre-compile, default-value=false  # Switches the reporting of security events to the IdsM: Tags: atp.Status=draft | - true: reporting is enabled. - false: reporting is disabled.
      container FirewallSecurityEventRefs [0..1]: multiplicity set at pre-compile  # Container for the references to IdsMEvent elements representing the security events that the Firwall module shall report to the IdsM in case the coresponding security related event occurs (and if FirewallEnableSecurityEventReporting is set to "true"). The standardized security events in this container can be extended by vendor-specific security events. Tags: atp.Status=draft
        reference SEV_FW_PACKET_BLOCKED_BY_PERSTREAMFILTERING [0..1]: multiplicity set at pre-compile, set at pre-compile, requires-symbolic-name-value=true, destination=IdsMEvent  # A network packet was blocked due to per-stream filtering in the switch Tags: atp.Status=draft
        reference SEV_FW_PACKET_BLOCKED_DATALINKLAYER_MISMATCH [0..1]: multiplicity set at pre-compile, set at pre-compile, requires-symbolic-name-value=true, destination=IdsMEvent  # A network packet was blocked due to a rule mismatch on data link layer Tags: atp.Status=draft
        reference SEV_FW_PACKET_BLOCKED_DDS_MISMATCH [0..1]: multiplicity set at pre-compile, set at pre-compile, requires-symbolic-name-value=true, destination=IdsMEvent  # A network packet was blocked due to a rule mismatch in the DDS-RTPS protocol Tags: atp.Status=draft
        reference SEV_FW_PACKET_BLOCKED_DOIP_MISMATCH [0..1]: multiplicity set at pre-compile, set at pre-compile, requires-symbolic-name-value=true, destination=IdsMEvent  # A network packet was blocked due to a rule mismatch in the DoIP protocol Tags: atp.Status=draft
        reference SEV_FW_PACKET_BLOCKED_GENERIC_MISMATCH [0..1]: multiplicity set at pre-compile, set at pre-compile, requires-symbolic-name-value=true, destination=IdsMEvent  # A network packet was blocked due to a rule mismatch on generic inspection level Tags: atp.Status=draft
        reference SEV_FW_PACKET_BLOCKED_ICMP_MISMATCH [0..1]: multiplicity set at pre-compile, set at pre-compile, requires-symbolic-name-value=true, destination=IdsMEvent  # A network packet was blocked due to a rule mismatch within the ICMP protocol Tags: atp.Status=draft
        reference SEV_FW_PACKET_BLOCKED_IPV4_MISMATCH [0..1]: multiplicity set at pre-compile, set at pre-compile, requires-symbolic-name-value=true, destination=IdsMEvent  # A network packet was blocked due to a rule mismatch on IPv4 layer Tags: atp.Status=draft
        reference SEV_FW_PACKET_BLOCKED_IPV6_MISMATCH [0..1]: multiplicity set at pre-compile, set at pre-compile, requires-symbolic-name-value=true, destination=IdsMEvent  # A network packet was blocked due to a rule mismatch on IPv6 layer Tags: atp.Status=draft
        reference SEV_FW_PACKET_BLOCKED_RATELIMIT [0..1]: multiplicity set at pre-compile, set at pre-compile, requires-symbolic-name-value=true, destination=IdsMEvent  # A network packet was blocked due to the rate limit was reached Tags: atp.Status=draft
        reference SEV_FW_PACKET_BLOCKED_SOMEIP_MISMATCH [0..1]: multiplicity set at pre-compile, set at pre-compile, requires-symbolic-name-value=true, destination=IdsMEvent  # A network packet was blocked due to a rule mismatch in the SOME/IP protocol Tags: atp.Status=draft
        reference SEV_FW_PACKET_BLOCKED_SOMEIPSD_MISMATCH [0..1]: multiplicity set at pre-compile, set at pre-compile, requires-symbolic-name-value=true, destination=IdsMEvent  # A network packet was blocked due to a rule mismatch in the SOME/IP SD protocol Tags: atp.Status=draft
        reference SEV_FW_PACKET_BLOCKED_TCP_MAXCONNECTIONS [0..1]: multiplicity set at pre-compile, set at pre-compile, requires-symbolic-name-value=true, destination=IdsMEvent  # A network packet was blocked due to the maximal number of open Tags: atp.Status=draft | TCP connections was reached
        reference SEV_FW_PACKET_BLOCKED_TCP_MISMATCH [0..1]: multiplicity set at pre-compile, set at pre-compile, requires-symbolic-name-value=true, destination=IdsMEvent  # A network packet was blocked due to a rule mismatch on TCP layer Tags: atp.Status=draft
        reference SEV_FW_PACKET_BLOCKED_TCP_STATETRANSITION [0..1]: multiplicity set at pre-compile, set at pre-compile, requires-symbolic-name-value=true, destination=IdsMEvent  # A network packet was blocked due to an invalid TCP state transition Tags: atp.Status=draft
        reference SEV_FW_PACKET_BLOCKED_TCP_TIMEOUT [0..1]: multiplicity set at pre-compile, set at pre-compile, requires-symbolic-name-value=true, destination=IdsMEvent  # A network packet was blocked due to TCP timeout Tags: atp.Status=draft
        reference SEV_FW_PACKET_BLOCKED_UDP_MISMATCH [0..1]: multiplicity set at pre-compile, set at pre-compile, requires-symbolic-name-value=true, destination=IdsMEvent  # A network packet was blocked due to a rule mismatch on UDP layer Tags: atp.Status=draft
    container FirewallRule [1..*]: multiplicity set at link in variant link-time / post-build in variant post-build / pre-compile in variant pre-compile, post-build-variant-multiplicity=true  # Firewall Rule that defines the control information in individual packets. Tags: atp.Status=draft
      integer FirewallBucketSize [0..1]: 0..65535, multiplicity set at link in variant link-time / post-build in variant post-build / pre-compile in variant pre-compile, post-build-variant-multiplicity=true, post-build-variant-value=true, set at pre-compile  # This attribute defines the capacity of the queue for rate limitation (leaky-bucket Algorithm). Tags: atp.Status=draft
      integer FirewallRefillAmount [0..1]: 0..65535, multiplicity set at link in variant link-time / post-build in variant post-build / pre-compile in variant pre-compile, post-build-variant-multiplicity=true, post-build-variant-value=true, set at link in variant link-time / post-build in variant post-build / pre-compile in variant pre-compile  # This attribute defines the output rate that describes how many packets leave the queue per second (leaky-bucket Algorithm). Tags: atp.Status=draft
      container FirewallDataLinkFilterConfig [0..1]: multiplicity set at link in variant link-time / post-build in variant post-build / pre-compile in variant pre-compile, post-build-variant-multiplicity=true  # Configuration of filter rules on the DataLink layer Tags: atp.Status=draft
        integer FirewallFilterEtherType [0..1]: 0..65535, multiplicity set at pre-compile, set at pre-compile  # Definition of the filter Ether Type. Tags: atp.Status=draft
        integer FirewallFilterVlanId [0..1]: 0..4094, multiplicity set at pre-compile, set at pre-compile  # Definition of the filter VLAN ID. Tags: atp.Status=draft
        integer FirewallFilterVlanPriority [0..1]: 0..7, multiplicity set at pre-compile, set at pre-compile  # Definition of the filter VLAN Priority. Tags: atp.Status=draft
        container FirewallFilterMACDestAddress [0..1]: multiplicity set at link in variant link-time / post-build in variant post-build / pre-compile in variant pre-compile, post-build-variant-multiplicity=true  # Configuration of one MAC destination filter. Tags: atp.Status=draft
          string FirewallFilterMACAddressKey: post-build-variant-value=true, set at link in variant link-time / post-build in variant post-build / pre-compile in variant pre-compile, max-length=17, min-length=17, regular-expression=([0-9a-fA-F]\{2}:)\{5}[0-9a-fA-F]\{2}  # Specifies the 48-bit physical address (MAC address) key value. Tags: atp.Status=draft
          string FirewallFilterMACAddressMask: post-build-variant-value=true, set at link in variant link-time / post-build in variant post-build / pre-compile in variant pre-compile, max-length=17, min-length=17, regular-expression=([0-9a-fA-F]\{2}:)\{5}[0-9a-fA-F]\{2}  # Specifies the 48-bit physical address (MAC address) mask value. Tags: atp.Status=draft
        container FirewallFilterMACSrcAddress [0..1]: multiplicity set at link in variant link-time / post-build in variant post-build / pre-compile in variant pre-compile, post-build-variant-multiplicity=true  # Configuration of one MAC source filter. Tags: atp.Status=draft
          string FirewallFilterMACAddressKey: post-build-variant-value=true, set at link in variant link-time / post-build in variant post-build / pre-compile in variant pre-compile, max-length=17, min-length=17, regular-expression=([0-9a-fA-F]\{2}:)\{5}[0-9a-fA-F]\{2}  # Specifies the 48-bit physical address (MAC address) key value. Tags: atp.Status=draft
          string FirewallFilterMACAddressMask: post-build-variant-value=true, set at link in variant link-time / post-build in variant post-build / pre-compile in variant pre-compile, max-length=17, min-length=17, regular-expression=([0-9a-fA-F]\{2}:)\{5}[0-9a-fA-F]\{2}  # Specifies the 48-bit physical address (MAC address) mask value. Tags: atp.Status=draft
      container FirewallDdsFilterConfig [0..1]: multiplicity set at link in variant link-time / post-build in variant post-build / pre-compile in variant pre-compile, post-build-variant-multiplicity=true  # Configuration of filter rules for Dds Tags: atp.Status=draft
        integer FirewallDdsAppId [0..1]: 0..4294967295, multiplicity set at link in variant link-time / post-build in variant post-build / pre-compile in variant pre-compile, post-build-variant-multiplicity=true, post-build-variant-value=true, set at link in variant link-time / post-build in variant post-build / pre-compile in variant pre-compile  # Filter for DDSI-RTPS messages in which the appId in the DDSI-RTPS header and the INFO_DST (0x0E) submessage matches. Tags: atp.Status=draft
        integer FirewallDdsHostId [0..1]: 0..4294967295, multiplicity set at link in variant link-time / post-build in variant post-build / pre-compile in variant pre-compile, post-build-variant-multiplicity=true, post-build-variant-value=true, set at link in variant link-time / post-build in variant post-build / pre-compile in variant pre-compile  # Filter for DDSI-RTPS messages in which the hostId in the DDSI-RTPS header and the INFO_DST (0x0E) submessage matches. Tags: atp.Status=draft
        integer FirewallDdsInstanceId [0..1]: 0..4294967295, multiplicity set at link in variant link-time / post-build in variant post-build / pre-compile in variant pre-compile, post-build-variant-multiplicity=true, post-build-variant-value=true, set at link in variant link-time / post-build in variant post-build / pre-compile in variant pre-compile  # Filter for DDSI-RTPS messages in which the instanceId in the DDSI-RTPS header and the INFO_DST (0x0E) submessage matches. Tags: atp.Status=draft
        integer FirewallDdsMajorProtocolVersion [0..1]: 0..255, multiplicity set at link in variant link-time / post-build in variant post-build / pre-compile in variant pre-compile, post-build-variant-multiplicity=true, post-build-variant-value=true, set at link in variant link-time / post-build in variant post-build / pre-compile in variant pre-compile  # Filter for DDSI-RTPS messages in which the majorProtocolVersion in the DDSI-RTPS header matches. Tags: atp.Status=draft
        integer FirewallDdsMinorProtocolVersion [0..1]: 0..255, multiplicity set at link in variant link-time / post-build in variant post-build / pre-compile in variant pre-compile, post-build-variant-multiplicity=true, post-build-variant-value=true, set at link in variant link-time / post-build in variant post-build / pre-compile in variant pre-compile  # Filter for DDSI-RTPS messages in which the minorProtocolVersion in the DDSI-RTPS header matches. Tags: atp.Status=draft
        integer FirewallDdsProductId [0..1]: 0..255, multiplicity set at link in variant link-time / post-build in variant post-build / pre-compile in variant pre-compile, post-build-variant-multiplicity=true, post-build-variant-value=true, set at link in variant link-time / post-build in variant post-build / pre-compile in variant pre-compile  # Filter for DDSI-RTPS messages in which the productId in the DDSI-RTPS header matches. Tags: atp.Status=draft
        integer FirewallDdsReaderEntityId [0..1]: 0..255, multiplicity set at link in variant link-time / post-build in variant post-build / pre-compile in variant pre-compile, post-build-variant-multiplicity=true, post-build-variant-value=true, set at link in variant link-time / post-build in variant post-build / pre-compile in variant pre-compile  # Filter for DDSI-RTPS messages in which the readerEntityID in a DDSI-RTPS submessage matches Tags: atp.Status=draft
        integer FirewallDdsSubmessageType [0..1]: 0..255, multiplicity set at link in variant link-time / post-build in variant post-build / pre-compile in variant pre-compile, post-build-variant-multiplicity=true, post-build-variant-value=true, set at link in variant link-time / post-build in variant post-build / pre-compile in variant pre-compile  # Defines the allowed submessage type in the DDSI-RTPS message Tags: atp.Status=draft
        integer FirewallDdsVendorId [0..1]: 0..255, multiplicity set at link in variant link-time / post-build in variant post-build / pre-compile in variant pre-compile, post-build-variant-multiplicity=true, post-build-variant-value=true, set at link in variant link-time / post-build in variant post-build / pre-compile in variant pre-compile  # Filter for DDSI-RTPS messages in which the vendorId in the DDSI-RTPS header matches. Tags: atp.Status=draft
        integer FirewallDdsWriterEntityId [0..1]: 0..255, multiplicity set at link in variant link-time / post-build in variant post-build / pre-compile in variant pre-compile, post-build-variant-multiplicity=true, post-build-variant-value=true, set at link in variant link-time / post-build in variant post-build / pre-compile in variant pre-compile  # Filter for DDSI-RTPS messages in which the writerEntityID in a DDSI-RTPS submessage matches Tags: atp.Status=draft
      container FirewallDoipFilterConfig [0..1]: multiplicity set at link in variant link-time / post-build in variant post-build / pre-compile in variant pre-compile, post-build-variant-multiplicity=true  # Configuration of filter rules for DoIP Tags: atp.Status=draft
        integer FirewallDoipInverseProtocolVersion [0..1]: 2..255, multiplicity set at link in variant link-time / post-build in variant post-build / pre-compile in variant pre-compile, post-build-variant-multiplicity=true, post-build-variant-value=true, set at link in variant link-time / post-build in variant post-build / pre-compile in variant pre-compile  # Filter to match DoIP messages in which the inverseprotocolVersion in the DoIP header matches. Tags: atp.Status=draft
        integer FirewallDoipPayloadLength [0..1]: 0..4294967295, multiplicity set at link in variant link-time / post-build in variant post-build / pre-compile in variant pre-compile, post-build-variant-multiplicity=true, post-build-variant-value=true, set at link in variant link-time / post-build in variant post-build / pre-compile in variant pre-compile  # Filter to match DoIP messages in which the payloadLength in the DoIP header matches. Tags: atp.Status=draft
        integer FirewallDoipPayloadType [0..1]: 0..65535, multiplicity set at link in variant link-time / post-build in variant post-build / pre-compile in variant pre-compile, post-build-variant-multiplicity=true, post-build-variant-value=true, set at link in variant link-time / post-build in variant post-build / pre-compile in variant pre-compile  # Filter to match DoIP messages in which the payloadType in the DoIP header matches. Tags: atp.Status=draft
        integer FirewallDoipProtocolVersion [0..1]: 2..255, multiplicity set at link in variant link-time / post-build in variant post-build / pre-compile in variant pre-compile, post-build-variant-multiplicity=true, post-build-variant-value=true, set at link in variant link-time / post-build in variant post-build / pre-compile in variant pre-compile  # Filter to match DoIP messages in which the protocolVersion in the DoIP header matches. Tags: atp.Status=draft
        integer FirewallDoipUdsService [0..1]: 0..4294967295, multiplicity set at link in variant link-time / post-build in variant post-build / pre-compile in variant pre-compile, post-build-variant-multiplicity=true, post-build-variant-value=true, set at link in variant link-time / post-build in variant post-build / pre-compile in variant pre-compile  # Filter to match DoIP messages that contain the udsService. Tags: atp.Status=draft
        container FirewallDoipDestAddress [0..1]: multiplicity set at link in variant link-time / post-build in variant post-build / pre-compile in variant pre-compile, post-build-variant-multiplicity=true  # Configuration of a source port filter. Tags: atp.Status=draft
          integer FirewallDoipDestAddressLowerValue [0..1]: 0..65535, multiplicity set at link in variant link-time / post-build in variant post-build / pre-compile in variant pre-compile, post-build-variant-multiplicity=true, post-build-variant-value=true, set at link in variant link-time / post-build in variant post-build / pre-compile in variant pre-compile  # Filter to match DoIP messages in which the destinationAddress is greater or equal than FirwallDoipDestAddressLowerValue Tags: atp.Status=draft
          integer FirewallDoipDestAddressUpperValue [0..1]: 0..65535, multiplicity set at link in variant link-time / post-build in variant post-build / pre-compile in variant pre-compile, post-build-variant-multiplicity=true, post-build-variant-value=true, set at link in variant link-time / post-build in variant post-build / pre-compile in variant pre-compile  # Filter to match DoIP messages in which the destinationAddress is smaller or equal than FirewallDoipDestAddressUpperValue Tags: atp.Status=draft
        container FirewallDoipSrcAddress [0..1]: multiplicity set at link in variant link-time / post-build in variant post-build / pre-compile in variant pre-compile, post-build-variant-multiplicity=true  # Configuration of a source port filter. Tags: atp.Status=draft
          integer FirewallDoipSrcAddressLowerValue [0..1]: 0..65535, multiplicity set at link in variant link-time / post-build in variant post-build / pre-compile in variant pre-compile, post-build-variant-multiplicity=true, post-build-variant-value=true, set at link in variant link-time / post-build in variant post-build / pre-compile in variant pre-compile  # Filter to match DoIP messages in which the sourceAddress is greater or equal than FirwallDoipDestAddressLowerValue Tags: atp.Status=draft
          integer FirewallDoipSrcAddressUpperValue [0..1]: 0..65535, multiplicity set at link in variant link-time / post-build in variant post-build / pre-compile in variant pre-compile, post-build-variant-multiplicity=true, post-build-variant-value=true, set at link in variant link-time / post-build in variant post-build / pre-compile in variant pre-compile  # Definition of the filter port upper value. Tags: atp.Status=draft
      container FirewallNetworkLayerFilterConfig [0..1]: multiplicity set at link in variant link-time / post-build in variant post-build / pre-compile in variant pre-compile, post-build-variant-multiplicity=true  # Configuration of filter rules on the Network layer Tags: atp.Status=draft
        container FirewallNetworkLayerIpv4FilterConfig [0..1]: multiplicity set at link in variant link-time / post-build in variant post-build / pre-compile in variant pre-compile, post-build-variant-multiplicity=true  # Configuration of filter rules for IPv6 on the Network layer Tags: atp.Status=draft
          boolean FirewallChecksumVerification [0..1]: multiplicity set at link in variant link-time / post-build in variant post-build / pre-compile in variant pre-compile, post-build-variant-multiplicity=true, post-build-variant-value=true, set at link in variant link-time / post-build in variant post-build / pre-compile in variant pre-compile  # Defines whether checksum verification is performed or not. Tags: atp.Status=draft
          integer FirewallDifferentiatedServiceCodePoint [0..1]: 0..65535, multiplicity set at link in variant link-time / post-build in variant post-build / pre-compile in variant pre-compile, post-build-variant-multiplicity=true, post-build-variant-value=true, set at link in variant link-time / post-build in variant post-build / pre-compile in variant pre-compile  # Filter to match packets with a DSCP value. Tags: atp.Status=draft
          boolean FirewallDoNotFragment [0..1]: multiplicity set at link in variant link-time / post-build in variant post-build / pre-compile in variant pre-compile, post-build-variant-multiplicity=true, post-build-variant-value=true, set at link in variant link-time / post-build in variant post-build / pre-compile in variant pre-compile  # Filter to match packets that have the doNotFragment bit in the Header set. Tags: atp.Status=draft
          integer FirewallExplicitCongestionNotification [0..1]: 0..65535, multiplicity set at link in variant link-time / post-build in variant post-build / pre-compile in variant pre-compile, post-build-variant-multiplicity=true, post-build-variant-value=true, set at link in variant link-time / post-build in variant post-build / pre-compile in variant pre-compile  # Filter to match packets with a ECN code point. Tags: atp.Status=draft
          integer FirewallInternetHeaderLength [0..1]: 0..65535, multiplicity set at link in variant link-time / post-build in variant post-build / pre-compile in variant pre-compile, post-build-variant-multiplicity=true, post-build-variant-value=true, set at link in variant link-time / post-build in variant post-build / pre-compile in variant pre-compile  # Filter to match packets with a minimum ipv4 header length. Tags: atp.Status=draft
          integer FirewallIpProtocolNumber [0..1]: 0..255, multiplicity set at link in variant link-time / post-build in variant post-build / pre-compile in variant pre-compile, post-build-variant-multiplicity=true, post-build-variant-value=true, set at link in variant link-time / post-build in variant post-build / pre-compile in variant pre-compile  # Filter to match packets with a IP protocol number . Tags: atp.Status=draft
          boolean FirewallMoreFragments [0..1]: multiplicity set at link in variant link-time / post-build in variant post-build / pre-compile in variant pre-compile, post-build-variant-multiplicity=true, post-build-variant-value=true, set at link in variant link-time / post-build in variant post-build / pre-compile in variant pre-compile  # Filter to match packets that have the moreFragments flag in the Header set. Tags: atp.Status=draft
          container FirewallFilterIPDestAddress [0..1]: multiplicity set at link in variant link-time / post-build in variant post-build / pre-compile in variant pre-compile, post-build-variant-multiplicity=true  # Configuration of one IP destination filter. Tags: atp.Status=draft
            string FirewallFilterIPAddressKey: post-build-variant-value=true, set at link in variant link-time / post-build in variant post-build / pre-compile in variant pre-compile  # IP address key pattern. Tags: atp.Status=draft
            string FirewallFilterIPAddressMask: post-build-variant-value=true, set at link in variant link-time / post-build in variant post-build / pre-compile in variant pre-compile  # IP address mask pattern. Tags: atp.Status=draft
          container FirewallFilterIPSrcAddress [0..1]: multiplicity set at link in variant link-time / post-build in variant post-build / pre-compile in variant pre-compile, post-build-variant-multiplicity=true  # Configuration of one IP source filter. Tags: atp.Status=draft
            string FirewallFilterIPAddressKey: post-build-variant-value=true, set at link in variant link-time / post-build in variant post-build / pre-compile in variant pre-compile  # IP address key pattern. Tags: atp.Status=draft
            string FirewallFilterIPAddressMask: post-build-variant-value=true, set at link in variant link-time / post-build in variant post-build / pre-compile in variant pre-compile  # IP address mask pattern. Tags: atp.Status=draft
          container FirewallFilterIPv4Ttl [0..1]: multiplicity set at link in variant link-time / post-build in variant post-build / pre-compile in variant pre-compile, post-build-variant-multiplicity=true  # Filter to match packets with a ttl value (TimeToLive defines the lifetime of data on the network). Tags: atp.Status=draft
            integer FirewallIpv4TtlMax: 0..255, multiplicity set at link in variant link-time / post-build in variant post-build / pre-compile in variant pre-compile, post-build-variant-multiplicity=true, post-build-variant-value=true, set at link in variant link-time / post-build in variant post-build / pre-compile in variant pre-compile  # Filter to match packets with a max ttl value. Tags: atp.Status=draft
            integer FirewallIpv4TtlMin: 0..255, multiplicity set at link in variant link-time / post-build in variant post-build / pre-compile in variant pre-compile, post-build-variant-multiplicity=true, post-build-variant-value=true, set at link in variant link-time / post-build in variant post-build / pre-compile in variant pre-compile  # Filter to match packets with a min ttl value. Tags: atp.Status=draft
          container FirewallNetworkLayerIcmpConfig [0..1]: multiplicity set at link in variant link-time / post-build in variant post-build / pre-compile in variant pre-compile, post-build-variant-multiplicity=true  # Configuration of filter rules for ICMP (Internet Control Message Protocol). Tags: atp.Status=draft
            boolean FirewallChecksumVerification [0..1]: multiplicity set at link in variant link-time / post-build in variant post-build / pre-compile in variant pre-compile, post-build-variant-multiplicity=true, post-build-variant-value=true, set at link in variant link-time / post-build in variant post-build / pre-compile in variant pre-compile  # Defines whether checksum verification is performed or not. Tags: atp.Status=draft
            integer FirewallIcmpCode: 0..65535, post-build-variant-value=true, set at link in variant link-time / post-build in variant post-build / pre-compile in variant pre-compile  # Filter to match packets with the Icmp code. Tags: atp.Status=draft
            integer FirewallIcmpType: 0..65535, post-build-variant-value=true, set at link in variant link-time / post-build in variant post-build / pre-compile in variant pre-compile  # Filter to match packets with the Icmp type. Tags: atp.Status=draft
        container FirewallNetworkLayerIpv6FilterConfig [0..1]: multiplicity set at link in variant link-time / post-build in variant post-build / pre-compile in variant pre-compile, post-build-variant-multiplicity=true  # Configuration of filter rules on the Network layer Tags: atp.Status=draft
          integer FirewallIpFlowLabel [0..1]: 1..1048575, multiplicity set at link in variant link-time / post-build in variant post-build / pre-compile in variant pre-compile, post-build-variant-multiplicity=true, post-build-variant-value=true, set at link in variant link-time / post-build in variant post-build / pre-compile in variant pre-compile  # Filter to match packets with a defined flow label. Tags: atp.Status=draft
          integer FirewallIpHopLimit [0..1]: 0..255, multiplicity set at link in variant link-time / post-build in variant post-build / pre-compile in variant pre-compile, post-build-variant-multiplicity=true, post-build-variant-value=true, set at link in variant link-time / post-build in variant post-build / pre-compile in variant pre-compile  # Filter to match packets with a minimum hop limit. Tags: atp.Status=draft
          integer FirewallIpNextHeader [0..1]: 0..255, multiplicity set at link in variant link-time / post-build in variant post-build / pre-compile in variant pre-compile, post-build-variant-multiplicity=true, post-build-variant-value=true, set at link in variant link-time / post-build in variant post-build / pre-compile in variant pre-compile  # Filter to match packets with a defined type of an extension header. Tags: atp.Status=draft
          integer FirewallITrafficClass [0..1]: 0..255, multiplicity set at link in variant link-time / post-build in variant post-build / pre-compile in variant pre-compile, post-build-variant-multiplicity=true, post-build-variant-value=true, set at link in variant link-time / post-build in variant post-build / pre-compile in variant pre-compile  # Filter to match packets with a defined traffic class or priority. Tags: atp.Status=draft
          container FirewallFilterIPDestAddress [0..1]: multiplicity set at link in variant link-time / post-build in variant post-build / pre-compile in variant pre-compile, post-build-variant-multiplicity=true  # Configuration of one IP destination filter. Tags: atp.Status=draft
            string FirewallFilterIPAddressKey: post-build-variant-value=true, set at link in variant link-time / post-build in variant post-build / pre-compile in variant pre-compile  # IP address key pattern. Tags: atp.Status=draft
            string FirewallFilterIPAddressMask: post-build-variant-value=true, set at link in variant link-time / post-build in variant post-build / pre-compile in variant pre-compile  # IP address mask pattern. Tags: atp.Status=draft
          container FirewallFilterIPSrcAddress [0..1]: multiplicity set at link in variant link-time / post-build in variant post-build / pre-compile in variant pre-compile, post-build-variant-multiplicity=true  # Configuration of one IP source filter. Tags: atp.Status=draft
            string FirewallFilterIPAddressKey: post-build-variant-value=true, set at link in variant link-time / post-build in variant post-build / pre-compile in variant pre-compile  # IP address key pattern. Tags: atp.Status=draft
            string FirewallFilterIPAddressMask: post-build-variant-value=true, set at link in variant link-time / post-build in variant post-build / pre-compile in variant pre-compile  # IP address mask pattern. Tags: atp.Status=draft
          container FirewallNetworkLayerIcmpConfig [0..1]: multiplicity set at link in variant link-time / post-build in variant post-build / pre-compile in variant pre-compile, post-build-variant-multiplicity=true  # Configuration of filter rules for ICMP (Internet Control Message Protocol). Tags: atp.Status=draft
            boolean FirewallChecksumVerification [0..1]: multiplicity set at link in variant link-time / post-build in variant post-build / pre-compile in variant pre-compile, post-build-variant-multiplicity=true, post-build-variant-value=true, set at link in variant link-time / post-build in variant post-build / pre-compile in variant pre-compile  # Defines whether checksum verification is performed or not. Tags: atp.Status=draft
            integer FirewallIcmpCode: 0..65535, post-build-variant-value=true, set at link in variant link-time / post-build in variant post-build / pre-compile in variant pre-compile  # Filter to match packets with the Icmp code. Tags: atp.Status=draft
            integer FirewallIcmpType: 0..65535, post-build-variant-value=true, set at link in variant link-time / post-build in variant post-build / pre-compile in variant pre-compile  # Filter to match packets with the Icmp type. Tags: atp.Status=draft
      container FirewallPayloadBytePatternFilterConfig [0..1]: multiplicity set at link in variant link-time / post-build in variant post-build / pre-compile in variant pre-compile, post-build-variant-multiplicity=true  # Configuration of a generic firewall rule that defines the individual bytes of a message that shall match. Tags: atp.Status=draft
        container FirewallPayloadByteConfig [0..*]: multiplicity set at link in variant link-time / post-build in variant post-build / pre-compile in variant pre-compile, post-build-variant-multiplicity=true  # Configuration of a single byte in the datagram. Tags: atp.Status=draft
          integer FirewallPaylodByteOffset: 0..18446744073709551615, multiplicity set at pre-compile, set at pre-compile  # This parameter defines the byte offset in the datagram (start byte of the Ethernet frame, i.e. offset 0 corresponds to the first byte of the destination MAC address). Tags: atp.Status=draft
          integer FirewallPaylodByteValue: 0..255, multiplicity set at pre-compile, set at pre-compile  # This attribute defines the byteValue in the datagram. Tags: atp.Status=draft
      container FirewallSomeipProtocolFilterConfig [0..1]: multiplicity set at link in variant link-time / post-build in variant post-build / pre-compile in variant pre-compile, post-build-variant-multiplicity=true  # Configuration of SOME/IP Protocol firewall rules Tags: atp.Status=draft
        integer FirewallSomeipClientId [0..1]: 0..65535, multiplicity set at link in variant link-time / post-build in variant post-build / pre-compile in variant pre-compile, post-build-variant-multiplicity=true, post-build-variant-value=true, set at link in variant link-time / post-build in variant post-build / pre-compile in variant pre-compile  # Filter for SOME/IP messages in which the clientId in the SOME/IP header matches. Tags: atp.Status=draft
        boolean FirewallSomeipLengthVerification [0..1]: multiplicity set at link in variant link-time / post-build in variant post-build / pre-compile in variant pre-compile, post-build-variant-multiplicity=true, post-build-variant-value=true, set at link in variant link-time / post-build in variant post-build / pre-compile in variant pre-compile  # Defines whether length verification is performed or not. Tags: atp.Status=draft
        integer FirewallSomeipMajorVersion [0..1]: 0..255, multiplicity set at link in variant link-time / post-build in variant post-build / pre-compile in variant pre-compile, post-build-variant-multiplicity=true, post-build-variant-value=true, set at link in variant link-time / post-build in variant post-build / pre-compile in variant pre-compile  # Filter for SOME/IP messages in which the majorVersion in the SOME/IP header matches. Tags: atp.Status=draft
        integer FirewallSomeipMessageType [0..1]: 0..255, multiplicity set at link in variant link-time / post-build in variant post-build / pre-compile in variant pre-compile, post-build-variant-multiplicity=true, post-build-variant-value=true, set at link in variant link-time / post-build in variant post-build / pre-compile in variant pre-compile  # Filter for SOME/IP messages in which the message type in the SOME/IP header matches. Tags: atp.Status=draft
        integer FirewallSomeipMethodId [0..1]: 0..65535, multiplicity set at link in variant link-time / post-build in variant post-build / pre-compile in variant pre-compile, post-build-variant-multiplicity=true, post-build-variant-value=true, set at link in variant link-time / post-build in variant post-build / pre-compile in variant pre-compile  # Filter for SOME/IP messages in which the methodId in the SOME/IP header matches. Tags: atp.Status=draft
        integer FirewallSomeipProtocolVersion [0..1]: 0..255, multiplicity set at link in variant link-time / post-build in variant post-build / pre-compile in variant pre-compile, post-build-variant-multiplicity=true, post-build-variant-value=true, set at link in variant link-time / post-build in variant post-build / pre-compile in variant pre-compile  # Filter for SOME/IP messages in which the protocol version in the SOME/IP header matches. Tags: atp.Status=draft
        integer FirewallSomeipReturnCode [0..1]: 0..255, multiplicity set at link in variant link-time / post-build in variant post-build / pre-compile in variant pre-compile, post-build-variant-multiplicity=true, post-build-variant-value=true, set at link in variant link-time / post-build in variant post-build / pre-compile in variant pre-compile  # Filter for SOME/IP messages in which the return code in the SOME/IP header matches. Tags: atp.Status=draft
        integer FirewallSomeipServiceInterfaceId [0..1]: 0..65535, multiplicity set at link in variant link-time / post-build in variant post-build / pre-compile in variant pre-compile, post-build-variant-multiplicity=true, post-build-variant-value=true, set at link in variant link-time / post-build in variant post-build / pre-compile in variant pre-compile  # Filter for SOME/IP messages in which the serviceInterfaceId in the SOME/IP header matches. Tags: atp.Status=draft
      container FirewallSomeipSdFilterConfig [0..1]: multiplicity set at link in variant link-time / post-build in variant post-build / pre-compile in variant pre-compile, post-build-variant-multiplicity=true  # Configuration of SOME/IP Service Discovery firewall rules Tags: atp.Status=draft
        integer FirewallSomeipEntryType [0..1]: 0..18446744073709551615, multiplicity set at link in variant link-time / post-build in variant post-build / pre-compile in variant pre-compile, post-build-variant-multiplicity=true, post-build-variant-value=true, set at link in variant link-time / post-build in variant post-build / pre-compile in variant pre-compile  # Filter for SOME/IP SD messages in which the entryType in the SOME/IP header matches. Tags: atp.Status=draft
        integer FirewallSomeipEventGroupId [0..1]: 0..65535, multiplicity set at link in variant link-time / post-build in variant post-build / pre-compile in variant pre-compile, post-build-variant-multiplicity=true, post-build-variant-value=true, set at link in variant link-time / post-build in variant post-build / pre-compile in variant pre-compile  # Filter for SOME/IP SD messages in which the eventGroupId in the SOME/IP header matches. Tags: atp.Status=draft
        integer FirewallSomeipServiceInstanceId [0..1]: 0..65535, multiplicity set at link in variant link-time / post-build in variant post-build / pre-compile in variant pre-compile, post-build-variant-multiplicity=true, post-build-variant-value=true, set at link in variant link-time / post-build in variant post-build / pre-compile in variant pre-compile  # Filter for SOME/IP SD messages in which the serviceInstanceId in the SOME/IP header matches. Tags: atp.Status=draft
        integer FirewallSomeipServiceInterfaceId [0..1]: 0..65535, multiplicity set at link in variant link-time / post-build in variant post-build / pre-compile in variant pre-compile, post-build-variant-multiplicity=true, post-build-variant-value=true, set at link in variant link-time / post-build in variant post-build / pre-compile in variant pre-compile  # Filter for SOME/IP messages in which the serviceInterfaceId in the SOME/IP header matches. Tags: atp.Status=draft
        container FirewallSomeipMajorVersion [0..1]: multiplicity set at link in variant link-time / post-build in variant post-build / pre-compile in variant pre-compile, post-build-variant-multiplicity=true  # Filter for SOME/IP SD messages in which the MajorVersion in the SOME/IP header is in the configured max and min value. Tags: atp.Status=draft
          integer FirewallMajorVersionMaxValue [0..1]: 0..255, multiplicity set at link in variant link-time / post-build in variant post-build / pre-compile in variant pre-compile, post-build-variant-multiplicity=true, post-build-variant-value=true, set at link in variant link-time / post-build in variant post-build / pre-compile in variant pre-compile  # Filter for SOME/IP SD messages in which the MajorVersion in the SOME/IP header is smaller or equal than this value. Tags: atp.Status=draft
          integer FirewallMajorVersionMinValue [0..1]: 0..255, multiplicity set at link in variant link-time / post-build in variant post-build / pre-compile in variant pre-compile, post-build-variant-multiplicity=true, post-build-variant-value=true, set at link in variant link-time / post-build in variant post-build / pre-compile in variant pre-compile  # Filter for SOME/IP SD messages in which the MajorVersion in the SOME/IP header is greater or equal than this value. Tags: atp.Status=draft
        container FirewallSomeipMinorVersion [0..1]: multiplicity set at link in variant link-time / post-build in variant post-build / pre-compile in variant pre-compile, post-build-variant-multiplicity=true  # Filter for SOME/IP SD messages in which the MinorVersion in the SOME/IP header is in the configured max and min value. Tags: atp.Status=draft
          integer FirewallMinorVersionMaxValue [0..1]: 0..4294967294, multiplicity set at link in variant link-time / post-build in variant post-build / pre-compile in variant pre-compile, post-build-variant-multiplicity=true, post-build-variant-value=true, set at link in variant link-time / post-build in variant post-build / pre-compile in variant pre-compile  # Filter for SOME/IP SD messages in which the MinorVersion in the SOME/IP header is smaller or equal than than this value. Tags: atp.Status=draft
          integer FirewallMinorVersionMinValue [0..1]: 0..4294967294, multiplicity set at link in variant link-time / post-build in variant post-build / pre-compile in variant pre-compile, post-build-variant-multiplicity=true, post-build-variant-value=true, set at link in variant link-time / post-build in variant post-build / pre-compile in variant pre-compile  # Filter for SOME/IP SD messages in which the MinorVersion in the SOME/IP header is greater or equal than this value. Tags: atp.Status=draft
      container FirewallTransportLayerFilterConfig [0..1]: multiplicity set at link in variant link-time / post-build in variant post-build / pre-compile in variant pre-compile, post-build-variant-multiplicity=true  # Configuration of filter rules on Transport Layer level. Tags: atp.Status=draft
        container FirewallTransportLayerTcpFilterConfig [0..1]: multiplicity set at link in variant link-time / post-build in variant post-build / pre-compile in variant pre-compile, post-build-variant-multiplicity=true  # Configuration of filter rules for TCP on Transport Layer level. Tags: atp.Status=draft
          boolean FirewallChecksumVerification [0..1]: multiplicity set at link in variant link-time / post-build in variant post-build / pre-compile in variant pre-compile, post-build-variant-multiplicity=true, post-build-variant-value=true, set at link in variant link-time / post-build in variant post-build / pre-compile in variant pre-compile  # Defines whether checksum verification is performed or not. Tags: atp.Status=draft
          integer FirewallNumberOfParallelTcpSessions [0..1]: 0..65535, multiplicity set at link in variant link-time / post-build in variant post-build / pre-compile in variant pre-compile, post-build-variant-multiplicity=true, post-build-variant-value=true, set at link in variant link-time / post-build in variant post-build / pre-compile in variant pre-compile  # This parameter defines the maximal number of TCP Sessions that are allowed to be established. Tags: atp.Status=draft
          boolean FirewallStateManagementBasedOnTcpFlags [0..1]: multiplicity set at link in variant link-time / post-build in variant post-build / pre-compile in variant pre-compile, post-build-variant-multiplicity=true, post-build-variant-value=true, set at link in variant link-time / post-build in variant post-build / pre-compile in variant pre-compile  # This attribute defines whether the StateManagement is based on TCP flags or not. Tags: atp.Status=draft
          integer FirewallTimeoutCheck [0..1]: 0..65535, multiplicity set at link in variant link-time / post-build in variant post-build / pre-compile in variant pre-compile, post-build-variant-multiplicity=true, post-build-variant-value=true, set at link in variant link-time / post-build in variant post-build / pre-compile in variant pre-compile  # This parameter defines the TCP Session timeout in seconds Tags: atp.Status=draft
          container FirewallFilterDestPort [0..1]: multiplicity set at link in variant link-time / post-build in variant post-build / pre-compile in variant pre-compile, post-build-variant-multiplicity=true  # Configuration of a destination port filter. Tags: atp.Status=draft
            integer FirewallFilterPortLowerValue: 0..65535, post-build-variant-value=true, set at link in variant link-time / post-build in variant post-build / pre-compile in variant pre-compile  # Definition of the filter port lower value. Tags: atp.Status=draft
            integer FirewallFilterPortUpperValue: 0..65535, post-build-variant-value=true, set at link in variant link-time / post-build in variant post-build / pre-compile in variant pre-compile  # Definition of the filter port upper value. Tags: atp.Status=draft
          container FirewallFilterSrcPort [0..1]: multiplicity set at link in variant link-time / post-build in variant post-build / pre-compile in variant pre-compile, post-build-variant-multiplicity=true  # Configuration of a source port filter. Tags: atp.Status=draft
            integer FirewallFilterPortLowerValue: 0..65535, post-build-variant-value=true, set at link in variant link-time / post-build in variant post-build / pre-compile in variant pre-compile  # Definition of the filter port lower value. Tags: atp.Status=draft
            integer FirewallFilterPortUpperValue: 0..65535, post-build-variant-value=true, set at link in variant link-time / post-build in variant post-build / pre-compile in variant pre-compile  # Definition of the filter port upper value. Tags: atp.Status=draft
        container FirewallTransportLayerUdpFilterConfig [0..1]: multiplicity set at link in variant link-time / post-build in variant post-build / pre-compile in variant pre-compile, post-build-variant-multiplicity=true  # Configuration of filter rules for UDP on Transport Layer level. Tags: atp.Status=draft
          boolean FirewallChecksumVerification [0..1]: multiplicity set at link in variant link-time / post-build in variant post-build / pre-compile in variant pre-compile, post-build-variant-multiplicity=true, post-build-variant-value=true, set at link in variant link-time / post-build in variant post-build / pre-compile in variant pre-compile  # Defines whether checksum verification is performed or not. Tags: atp.Status=draft
          container FirewallFilterDestPort [0..1]: multiplicity set at link in variant link-time / post-build in variant post-build / pre-compile in variant pre-compile, post-build-variant-multiplicity=true  # Configuration of a destination port filter. Tags: atp.Status=draft
            integer FirewallFilterPortLowerValue: 0..65535, post-build-variant-value=true, set at link in variant link-time / post-build in variant post-build / pre-compile in variant pre-compile  # Definition of the filter port lower value. Tags: atp.Status=draft
            integer FirewallFilterPortUpperValue: 0..65535, post-build-variant-value=true, set at link in variant link-time / post-build in variant post-build / pre-compile in variant pre-compile  # Definition of the filter port upper value. Tags: atp.Status=draft
          container FirewallFilterSrcPort [0..1]: multiplicity set at link in variant link-time / post-build in variant post-build / pre-compile in variant pre-compile, post-build-variant-multiplicity=true  # Configuration of a source port filter. Tags: atp.Status=draft
            integer FirewallFilterPortLowerValue: 0..65535, post-build-variant-value=true, set at link in variant link-time / post-build in variant post-build / pre-compile in variant pre-compile  # Definition of the filter port lower value. Tags: atp.Status=draft
            integer FirewallFilterPortUpperValue: 0..65535, post-build-variant-value=true, set at link in variant link-time / post-build in variant post-build / pre-compile in variant pre-compile  # Definition of the filter port upper value. Tags: atp.Status=draft
    container FirewallState [1..*]: multiplicity set at link in variant link-time / post-build in variant post-build / pre-compile in variant pre-compile, post-build-variant-multiplicity=true  # Collection of Firewall states in which the Firewall may be activated (via the FirewallStateRef). Tags: atp.Status=draft
      integer FirewallStateId: 0..65535, set at pre-compile, symbolic-name-value=true  # Parameter that identifies the Firewall State. Tags: atp.Status=draft
    container FirewallStateDependentRules [1..*]: multiplicity set at link in variant link-time / post-build in variant post-build / pre-compile in variant pre-compile, post-build-variant-multiplicity=true  # Firewall rules that are defined in a firewall state Tags: atp.Status=draft
      enumeration FirewallDefaultAction [0..1]: multiplicity set at link in variant link-time / post-build in variant post-build / pre-compile in variant pre-compile, post-build-variant-multiplicity=true, post-build-variant-value=true, set at link in variant link-time / post-build in variant post-build / pre-compile in variant pre-compile  # This attribute defines a defaultAction. Tags: atp.Status=draft
        ALLOW  # Tags: atp.Status=draft
        BLOCK  # Tags: atp.Status=draft
      reference FirewallStateRef [1..*]: multiplicity set at link in variant link-time / post-build in variant post-build / pre-compile in variant pre-compile, post-build-variant-multiplicity=true, post-build-variant-value=true, set at link in variant link-time / post-build in variant post-build / pre-compile in variant pre-compile, destination=FirewallState  # Reference to firewall states in which the Firewall is active. If one of the referenced Firewall States is active then the firewall rule shall be considered active as well. Tags: atp.Status=draft
      container FirewallActionForMatchingRules [1..*]: multiplicity set at link in variant link-time / post-build in variant post-build / pre-compile in variant pre-compile, post-build-variant-multiplicity=true  # Firewall action that is performed if the referenced pattern matches. Tags: atp.Status=draft
        enumeration FirewallAction [0..1]: multiplicity set at link in variant link-time / post-build in variant post-build / pre-compile in variant pre-compile, post-build-variant-multiplicity=true, post-build-variant-value=true, set at link in variant link-time / post-build in variant post-build / pre-compile in variant pre-compile  # Action that is performed by the firewall if the matchingRule is fulfilled. Tags: atp.Status=draft
          ALLOW  # Tags: atp.Status=draft
          BLOCK  # Tags: atp.Status=draft
        reference FirewallMatchingEgressRule [0..*]: multiplicity set at link in variant link-time / post-build in variant post-build / pre-compile in variant pre-compile, post-build-variant-multiplicity=true, post-build-variant-value=true, set at link in variant link-time / post-build in variant post-build / pre-compile in variant pre-compile, destination=FirewallRule  # Firewall rule expression against which the egress network traffic is matched. Tags: atp.Status=draft
        reference FirewallMatchingIngressRule [0..*]: multiplicity set at link in variant link-time / post-build in variant post-build / pre-compile in variant pre-compile, post-build-variant-multiplicity=true, post-build-variant-value=true, set at link in variant link-time / post-build in variant post-build / pre-compile in variant pre-compile, destination=FirewallRule  # Firewall rule expression against which the ingress network traffic is matched. Tags: atp.Status=draft
    container FirewallSwitchBucketCounterStatistics [0..*]: multiplicity set at link in variant link-time / post-build in variant post-build / pre-compile in variant pre-compile, post-build-variant-multiplicity=true  # Polling of switch bucket counter statistics Tags: atp.Status=draft
      float FwSwitchBucketCounterPollingInterval: multiplicity set at pre-compile, set at pre-compile  # Length of the switch bucket counter polling time interval (in seconds). Note: Shall be configured as a multiple of the IdsM main function period. Tags: atp.Status=draft
      reference FirewallEthIfSwitchRef [1..*]: multiplicity set at link in variant link-time / post-build in variant post-build / pre-compile in variant pre-compile, post-build-variant-multiplicity=true, post-build-variant-value=true, set at link in variant link-time / post-build in variant post-build / pre-compile in variant pre-compile, destination=EthIfSwitch  # Reference to EthIfSwitch for which the bucket counter statistics applies. Tags: atp.Status=draft
      reference FirewallingWithPerStreamFiltering [0..1]: multiplicity set at link in variant link-time / post-build in variant post-build / pre-compile in variant pre-compile, post-build-variant-multiplicity=true, post-build-variant-value=true, set at link in variant link-time / post-build in variant post-build / pre-compile in variant pre-compile, destination=EthIfPhysController  # Reference to EthIfSwitch for which the bucket counter statistics applies. Tags: atp.Status=draft
