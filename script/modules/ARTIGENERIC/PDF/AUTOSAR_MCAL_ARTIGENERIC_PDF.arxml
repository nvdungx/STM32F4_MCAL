AUTOSAR XML (schema 00046)
package /AUTOSAR/EcucDefs
  ecuc definition collection AUTOSARParameterDefinition: module=ArtiGeneric
  module definition ArtiGeneric [0..1]: variants post-build/pre-compile  # The ArtiGeneric contains definitions for generic objects, i.e. not belonging to a standard AUTOSAR module. Tags: atp.Status=draft
    container ArtiGenericComponentClass [0..*]: multiplicity set at pre-compile  # The class definition describes the layout of the object (similar to a "class" definition in C). Tags: atp.Status=draft
      string ArtiGenericComponentClassName: scope=ECU, set at pre-compile  # Name of the class. Tags: atp.Status=draft
      container ArtiGenericComponentClassParameter [0..*]: multiplicity set at pre-compile  # Parameter definition of a class. Tags: atp.Status=draft
        string ArtiGenericComponentClassParameterName: scope=ECU, set at pre-compile  # Name of the parameter. Tags: atp.Status=draft
        reference ArtiParameterTypeMapRef [0..1]: scope=ECU, multiplicity set at pre-compile, set at pre-compile, destination=ArtiParameterTypeMap  # Refers to a parameter type to interpret the parameter value. Tags: atp.Status=draft
    container ArtiGenericComponentInstance [0..*]: multiplicity set at pre-compile  # The instance definition describes a specific instantiated object. Tags: atp.Status=draft
      string ArtiGenericComponentInstanceName: scope=ECU, set at pre-compile  # Name of the instance. Tags: atp.Status=draft
      reference ArtiGenericComponentClassRef: scope=ECU, set at pre-compile, destination=ArtiGenericComponentClass  # Refers to a ArtGenericClass of which this object is instantiated. Tags: atp.Status=draft
      container ArtiGenericComponentInstanceParameter [0..*]: multiplicity set at pre-compile  # Parameter definition of an instance. Tags: atp.Status=draft
        reference ArtiConstantRef [0..1]: multiplicity set at pre-compile, set at pre-compile, destination=ArtiConstant  # Refers to an ArtiConstant that represents the value of this parameter. Tags: atp.Status=draft
        reference ArtiExpressionRef [0..1]: multiplicity set at pre-compile, set at pre-compile, destination=ArtiExpression  # Refers to an ArtiExpression that evaluates the value of this parameter. Tags: atp.Status=draft
        reference ArtiGenericComponentClassParameterRef [0..*]: multiplicity set at pre-compile, set at pre-compile, destination=ArtiGenericComponentClassParameter  # Refers to an ArtiGenericComponentClassParameter that defines this parameter. Tags: atp.Status=draft
        reference ArtiHookRef [0..1]: multiplicity set at pre-compile, set at pre-compile, destination=ArtiHook  # Refers to a hook that records this parameter. Tags: atp.Status=draft
