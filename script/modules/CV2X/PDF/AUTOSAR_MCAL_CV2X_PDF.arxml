AUTOSAR XML (schema 00053)
package /AUTOSAR/EcucDefs
  ecuc definition collection AUTOSARParameterDefinition: module=CV2x
  module definition CV2x [0..*]: post-build-variant-support=true, variants link-time/post-build/pre-compile  # Configuration of the CV2x module (Cellular V2X Driver). Tags: atp.Status=draft
    container CV2xConfigSet  # This container contains the configuration parameters and sub containers of the AUTOSAR CV2x module. Tags: atp.Status=draft
      container CV2xCtrlConfig  # Configuration of individual controller Tags: atp.Status=draft
        integer CV2xCtrlId: 0..255, scope=ECU, set at pre-compile, symbolic-name-value=true  # Specifies the instance ID of the configured controller. Tags: atp.Status=draft
        integer CV2xCtrlRxBufLenByte: 0..131071, set at link in variant link-time / post-build in variant post-build / pre-compile in variant pre-compile  # Limits the maximum receive buffer length (frame length) in bytes. Tags: atp.Status=draft
        integer CV2xCtrlRxBufTotal: 0..255, set at link in variant link-time / post-build in variant post-build / pre-compile in variant pre-compile  # Configures the number of receive buffers. Tags: atp.Status=draft
        integer CV2xCtrlTxBufLenByte: 0..131071, set at link in variant link-time / post-build in variant post-build / pre-compile in variant pre-compile  # Limits the maximum transmit buffer length (frame length) in bytes. Tags: atp.Status=draft
        integer CV2xCtrlTxBufTotal: 0..255, set at link in variant link-time / post-build in variant post-build / pre-compile in variant pre-compile  # Configures the number of transmit buffers. Tags: atp.Status=draft
        reference CV2xCtrlEcucPartitionRef [0..1]: scope=ECU, multiplicity set at pre-compile, post-build-variant-multiplicity=true, post-build-variant-value=true, set at pre-compile, destination=EcucPartition  # Maps the Cellular V2X controller to zero or one ECUC partitions. Tags: atp.Status=draft | The ECUC partition referenced is a subset of the ECUC partitions where the Cellular V2X driver is mapped to.
        container CV2xDemEventParameterRefs [0..1]: multiplicity set at link in variant link-time / post-build in variant post-build / pre-compile in variant pre-compile, post-build-variant-multiplicity=true  # Container for the references to DemEventParameter elements which shall be invoked using the API Tags: atp.Status=draft | Dem_SetEventStatus in case the corresponding error occurs. The EventId is taken from the referenced DemEventParameter's DemEventId symbolic value. The standardized errors are provided in this container and can be extended by vendor-specific error references.
          reference CV2X_E_ACCESS [0..1]: multiplicity set at link in variant link-time / post-build in variant post-build / pre-compile in variant pre-compile, post-build-variant-multiplicity=true, post-build-variant-value=true, set at link in variant link-time / post-build in variant post-build / pre-compile in variant pre-compile, requires-symbolic-name-value=true, destination=DemEventParameter  # Reference to the DemEventParameter which shall be issued when the error "Controller access failed" has occured. Tags: atp.Status=draft
    container CV2xGeneral  # General Configuration of Cellular V2X Driver Tags: atp.Status=draft
      boolean CV2xDevErrorDetect: set at pre-compile, default-value=false  # Switches the Default Error Tracer (Det) detection and notification ON or OFF. Tags: atp.Status=draft | - true: detection and notification is enabled. - false: detection and notification is disabled.
      integer CV2xIndex: 0..255, set at pre-compile  # Specifies the InstanceId of this module instance. If only one instance ispresent, it shall have the Id 0. Tags: atp.Status=draft
      float CV2xMainFunctionPeriod: 0..INF, set at pre-compile  # Specifies the period of main function CV2x_MainFunction in seconds. Cellular V2X driver does not require this information but the BSW scheduler. Tags: atp.Status=draft
      boolean CV2xVersionInfoApi: set at pre-compile, default-value=false  # Enables / Disables version info API. Tags: atp.Status=draft
      reference CV2xEcucPartitionRef [0..*]: scope=ECU, multiplicity set at pre-compile, post-build-variant-value=true, set at pre-compile, destination=EcucPartition  # Maps the Cellular V2X driver to zero or multiple ECUC partitions to make the modules API available in this partition. The Cellular V2X driver will operate as an independent instance in each of the partitions. Tags: atp.Status=draft
