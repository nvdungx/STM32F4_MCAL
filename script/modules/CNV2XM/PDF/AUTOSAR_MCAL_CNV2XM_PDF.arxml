AUTOSAR XML (schema 00053)
package /AUTOSAR/EcucDefs
  ecuc definition collection AUTOSARParameterDefinition: module=CnV2xM
  module definition CnV2xM [0..1]: variants pre-compile  # Configuration of the CnV2xM module. Tags: atp.Status=draft
    container CnV2xMGeneral  # This container contains the general configuration parameters of the BSW module CnV2xM. Tags: atp.Status=draft
      boolean CnV2xMDevErrorDetect: set at pre-compile, default-value=false  # Switches the Default Error Tracer (Det) detection and notification ON or OFF. Tags: atp.Status=draft | - true: enabled (ON) - false: disabled (OFF)
      float CnV2xMMainFunctionPeriod: 0..1, set at pre-compile, default-value=0.1  # This parameter defines the schedule period of CnV2xM_MainFunction.Unit:[s] Tags: atp.Status=draft
      boolean CnV2xMVersionInfoApi: set at pre-compile, default-value=false  # Enable/disables the API for reading the version information of the CnV2xM Module. Tags: atp.Status=draft | - true: enabled (ON) - false: disabled (OFF)
      reference CnV2xMEthIfCtrlRef: scope=ECU, set at pre-compile, requires-symbolic-name-value=true, destination=EthIfController  # This is represents the reference to the Ethernet interface taken to transmit the C-V2X packets to. Tags: atp.Status=draft
