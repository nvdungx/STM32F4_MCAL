AUTOSAR XML (schema 00053)
package /AUTOSAR/EcucDefs
  ecuc definition collection AUTOSARParameterDefinition: module=V2xGn
  module definition V2xGn [0..1]: variants pre-compile  # Configuration of the V2xGn (Vehicle-2-X Geo Networking) module.
    container V2xGnBeaconService  # This container contains the GeoNetworking configuration parameters related to the beacon service.
      float V2xGnItsGnBeaconServiceMaxJitter: 0.001..INF, set at pre-compile, default-value=0.75  # Maximum beacon jitter [s]. The Jitter is used for the beacon retransmission. The actual jitter value is a random number between 0 and V2xGnItsGnBeaconServiceMaxJitter. The function introduces a random component for the timer to avoid synchronization issues among | GeoAdhoc routers.
      float V2xGnItsGnBeaconServiceRetransmitTimer: 0.001..INF, set at pre-compile, default-value=3  # Duration of Beacon service retransmit timer [s].
    container V2xGnConfig  # This container contains the configuration parameters and sub containers of the V2xGn module. Tags: atp.Status=draft
      reference V2xGnEthIfRef: set at pre-compile, requires-symbolic-name-value=true, destination=EthIfController  # This represents the reference to the Ethernet interface taken to transmit the V2X-Packets to.
      container V2xGnRxPdu  # Represents the received PDU. This PDU is usually linked to the EthIf via LSduR. It consumes meta data items of the types BROADCAST_8 and ETHERNET_MAC_64. Tags: atp.Status=draft
        integer V2xGnRxPduId: 0..65535, scope=ECU, set at pre-compile, symbolic-name-value=true, with-auto=true  # PDU identifier used for RxIndication from LSduR. Tags: atp.Status=draft
        reference V2xGnRxPduRef: scope=ECU, set at pre-compile, destination=Pdu  # Reference to the global PDU. Tags: atp.Status=draft
      container V2xGnTxPdu  # Represents the transmitted PDU. This PDU is usually linked to the EthIf via LSduR. It produces meta data items of the type ETHERNET_MAC_64. Tags: atp.Status=draft
        integer V2xGnTxPduId: 0..65535, scope=ECU, set at pre-compile, symbolic-name-value=true, with-auto=true  # PDU identifier used for TxConfirmation from LSduR. Tags: atp.Status=draft
        reference V2xGnTxPduRef: scope=ECU, set at pre-compile, destination=Pdu  # Reference to the global PDU. Tags: atp.Status=draft
    container V2xGnGeneral  # This container specifies the general configuration parameters of the V2xGn module.
      boolean V2xGnDevErrorDetect: set at pre-compile, default-value=false  # Switches the Default Error Tracer (Det) detection and notification ON or OFF. | * true: enabled (ON) * false: disabled (OFF)
      float V2xGnItsGnLifetimeLocTE: 0..65535, set at pre-compile, default-value=20  # Location table maintenance: Lifetime of an entry in the location table in [s]
      integer V2xGnItsGnLocalGnAddr: 0..18446744073709551615, set at pre-compile, default-value=1  # 64bit GeoNetworking Address.
      integer V2xGnItsGnMaxGeoNetworkingHeaderSize: 0..65535, set at pre-compile, default-value=88  # Maximum size of GeoNetworking header in [Byte].
      integer V2xGnItsGnMaxSduSize: 0..65535, set at pre-compile, default-value=1398  # Maximum size of GN-SDU in [Byte].
      float V2xGnItsGnMinUpdateFrequencyEPV: 0..65535, set at pre-compile  # Minimum update frequency of ego position vector (EPV) in [s].
      integer V2xGnItsGnPaiInterval: 0..100, set at pre-compile, default-value=80  # Distance related to the confidence interval for latitude and longitude [m]. Used to determine the PAI.
      integer V2xGnItsGnProtocolVersion: 0..255, set at pre-compile, default-value=1  # GeoNetworking protocol version as defined in Annex H of [14]
      enumeration V2xGnItsGnSnDecapResultHandling: {V2XGN_NON_STRICT_SEC_HANDLING, V2XGN_STRICT_SEC_HANDLING}, set at pre-compile  # Indicates the handling of the V2xM_ReqDecap result code.
      enumeration V2xGnItsGnStationType: {V2XFAC_ST_BUS, V2XFAC_ST_CYCLIST, V2XFAC_ST_HEAVYTRUCK, V2XFAC_ST_LIGHTTRUCK, V2XFAC_ST_MOPED, V2XFAC_ST_MOTORCYCLE, V2XFAC_ST_PASSENGERCAR, V2XFAC_ST_PEDESTRIAN, V2XFAC_ST_SPECIALVEHICLES, V2XFAC_ST_TRAILER, V2XFAC_ST_TRAM, V2XFAC_ST_UNKNOWN}, set at pre-compile  # Station Type used in GeoNetworking protocol, RoadSideUnit (15) not supported by AUTOSAR.
      float V2xGnMainFunctionPeriod: 0..INF, set at pre-compile, default-value=0.001  # Specifies the period of main function V2xGn_MainFunction in seconds. V2xGn does not require this information but the BSW scheduler.
      boolean V2xGnVersionInfoApi: set at pre-compile, default-value=false  # Enable/disables the API for reading the version information of the V2xGn Module. | * true: enabled (ON) * false: disabled (OFF)
    container V2xGnPacketForwarding  # This container contains the GeoNetworking configuration parameters related to packet forwarding.
      integer V2xGnItsGnBcForwardingPacketBufferSize: 0..18446744073709551615, set at pre-compile, default-value=1024000  # Size of BC forwarding packet buffer [Byte].
      float V2xGnItsGnCbfMaxTime: 0..INF, set at pre-compile, default-value=0.001  # Maximum duration a GeoNetworking packet shall be buffered in the CBF packet buffer [s]
      float V2xGnItsGnCbfMinTime: 0..INF, set at pre-compile, default-value=0.001  # Minimum duration a GeoNetworking packet shall be buffered in the CBF packet buffer [s]
      integer V2xGnItsGnCbfPacketBufferSize: 0..18446744073709551615, set at pre-compile, default-value=256000  # Size of CBF packet buffer [Byte]
      integer V2xGnItsGnDefaultHopLimit: 0..255, set at pre-compile, default-value=10  # Default hop limit indicating the maximum number of hops a packet travels.
      integer V2xGnItsGnDefaultMaxCommunicationRange: 0..65535, set at pre-compile, default-value=1000  # Default theoretical maximum communication range [m]
      float V2xGnItsGnDefaultPacketLifetime: 0..6300, set at pre-compile, default-value=60  # Default packet lifetime [s].
      integer V2xGnItsGnDefaultTrafficClass: 0..255, set at pre-compile, default-value=0  # Forwarding: Default traffic class
      integer V2xGnItsGnDplLength: 0..65535, set at pre-compile, default-value=8  # Length of Duplicate Packet List (DPL) per source (clause A.2 of [18])
      boolean V2xGnItsGnGeoAreaLineForwardingUsed: set at pre-compile, default-value=false  # Forwarding of GBC/GAC packet if GeoAdhoc router is located outside the destination GeoArea. | * true: enabled (ON) * false: disabled (OFF)
      integer V2xGnItsGnMaxGeoAreaSize: 0..18446744073709551615, set at pre-compile, default-value=80  # Maximum size of the geographical area for a GBC and GAC packet [km2]. If the geographical area size exceeds the maximum value, the GeoNetworking packet shall not be sent (source) and not be forwarded (forwarder).
      integer V2xGnItsGnMaxPacketDataRate: 0..4294967295, set at pre-compile, default-value=100000  # Maximum packet data rate for a GeoAdhoc router [Byte/s]. If the mean (EMA) packet data rate a of a GeoAdhoc router exceeds the value, packets from this GeoAdhoc router (source or sender) are not forwarded.
      float V2xGnItsGnMaxPacketDataRateEmaBeta: 0..1, set at pre-compile, default-value=0.9  # Weight factor for the Exponential Moving Average of the packet data rate PDR in percent.
      float V2xGnItsGnMaxPacketLifetime: 0..6300, set at pre-compile, default-value=600  # Upper limit of the maximum lifetime [s]
