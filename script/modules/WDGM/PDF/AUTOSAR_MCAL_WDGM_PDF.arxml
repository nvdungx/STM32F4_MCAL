AUTOSAR XML (schema 00053)
package /AUTOSAR/EcucDefs
  ecuc definition collection AUTOSARParameterDefinition: module=WdgM
  module definition WdgM [0..1]: post-build-variant-support=true, variants post-build/pre-compile  # Configuration of the WdgM (Watchdog Manager) module.
    container WdgMConfigSet  # This container describes one of multiple configuration sets of WdgM.
      reference WdgMInitialMode: post-build-variant-value=true, set at post-build in variant post-build / pre-compile in variant pre-compile, requires-symbolic-name-value=true, destination=WdgMMode  # The mode that the Watchdog Manager is in after it has been initialized.
      container WdgMDemEventParameterRefs [0..1]  # Container for the references to DemEventParameter elements which shall be invoked using the API Dem_SetEventStatus in case the corresponding error occurs. The EventId is taken from the referenced DemEventParameter's DemEventId symbolic value. The standardized errors are provided in this container and can be extended by vendor-specific error references.
        reference WDGM_E_SUPERVISION [0..1]: multiplicity set at post-build in variant post-build / pre-compile in variant pre-compile, post-build-variant-multiplicity=true, post-build-variant-value=true, set at post-build in variant post-build / pre-compile in variant pre-compile, requires-symbolic-name-value=true, destination=DemEventParameter  # Reference to the DemEventParameter which shall be issued when the error "Supervision has failed (Global Supervision Status has reached WDGM_GLOBAL_STATUS_STOPPED) and a watchdog reset will occur" has occurred.
      container WdgMMode [1..255]  # The container describes one of several modes of the Watchdog Manager.
        integer WdgMExpiredSupervisionCycleTol: 0..65535, scope=ECU, post-build-variant-value=true, set at post-build in variant post-build / pre-compile in variant pre-compile  # This parameter shall be used to define a value that fixes the amount of expired supervision cycles for how long the blocking of watchdog triggering shall be postponed, AFTER THE GLOBAL SUPERVISION STATUS HAS REACHED THE STATE EXPIRED.
        integer WdgMModeId: 0..255, set at pre-compile, symbolic-name-value=true  # This parameter fixes the identifier for the mode. This identifier is for instance passed as a parameter to the WdgM_SetMode service.
        container WdgMAliveSupervision [0..65535]  # This container collects all configuration parameters of Alive-Supervision of one Checkpoint. Note that each Checkpoint may have different parameters. For example, it may have different min and max margin.
          integer WdgMExpectedAliveIndications: 0..65535, post-build-variant-value=true, set at post-build in variant post-build / pre-compile in variant pre-compile  # This parameter contains the amount of expected alive indications of the Checkpoint within the referenced amount of defined supervision cycles according to corresponding SE.
          integer WdgMMaxMargin: 0..255, post-build-variant-value=true, set at post-build in variant post-build / pre-compile in variant pre-compile  # This parameter contains the amount of alive indications of the Checkpoint that are acceptable to be additional to the expected alive indications within the corresponding supervision reference cycle.
          integer WdgMMinMargin: 0..255, post-build-variant-value=true, set at post-build in variant post-build / pre-compile in variant pre-compile  # This parameter contains the amount of alive indications of the Checkpoint that are acceptable to be missed from the expected alive indications within the corresponding supervision reference cycle.
          integer WdgMSupervisionReferenceCycle: 1..65535, post-build-variant-value=true, set at post-build in variant post-build / pre-compile in variant pre-compile  # This parameter shall contain the amount of supervision cycles to be used as reference by the alive-supervision mechanism to perform the checkup with counted alive indications according to corresponding SE.
          reference WdgMAliveSupervisionCheckpointRef: post-build-variant-value=true, set at post-build in variant post-build / pre-compile in variant pre-compile, requires-symbolic-name-value=true, destination=WdgMCheckpoint  # Reference to Checkpoint within a Supervised Entity that shall be supervised.
        container WdgMDeadlineSupervision [0..65535]  # This container collects all configuration parameters for Deadline Supervision for a Supervised Entity.
          float WdgMDeadlineMax: 0..INF, post-build-variant-value=true, set at post-build in variant post-build / pre-compile in variant pre-compile  # This parameter contains the longest time span after which the deadline is considered to be met. | Unit: [s]
          float WdgMDeadlineMin: 0..INF, post-build-variant-value=true, set at post-build in variant post-build / pre-compile in variant pre-compile  # This parameter contains the shortest time span after which the deadline is considered to be met. | Unit: [s]
          reference WdgMDeadlineStartRef: post-build-variant-value=true, set at post-build in variant post-build / pre-compile in variant pre-compile, requires-symbolic-name-value=true, destination=WdgMCheckpoint  # This is the reference to the start Checkpoint for Deadline Supervision.
          reference WdgMDeadlineStopRef: post-build-variant-value=true, set at post-build in variant post-build / pre-compile in variant pre-compile, requires-symbolic-name-value=true, destination=WdgMCheckpoint  # This is the reference to the stop Checkpoint for Deadline Supervision.
        container WdgMExternalLogicalSupervision [0..65535]  # This container collects all configuration parameters for Logical Supervision for one external graph.
          choice reference WdgMExternalCheckpointFinalRef [1..65535]: multiplicity set at post-build in variant post-build / pre-compile in variant pre-compile, post-build-variant-multiplicity=true, post-build-variant-value=true, set at post-build in variant post-build / pre-compile in variant pre-compile, requires-symbolic-name-value=true, destination=[WdgMCheckpoint, WdgMTransitionProxy]  # This is the reference to the final Checkpoint(s) for this External Graph which can end with a WdgMCheckpoint or in case of cross cluster transitions with a WdgMTransitionProxy. | Both WdgMCheckpoint(s) and WdgMTransitionProxy(s) could be mixed inside the same WdgMExternalLogicalSupervision.
          choice reference WdgMExternalCheckpointInitialRef [1..65535]: multiplicity set at post-build in variant post-build / pre-compile in variant pre-compile, post-build-variant-multiplicity=true, post-build-variant-value=true, set at post-build in variant post-build / pre-compile in variant pre-compile, requires-symbolic-name-value=true, destination=[WdgMCheckpoint, WdgMTransitionProxy]  # This is the reference to the initial Checkpoint(s) for this External Graph which can start with a WdgMCheckpoint or in case of cross cluster transitions with a WdgMTransitionProxy. | Both WdgMCheckpoint(s) and WdgMTransitionProxy(s) could be mixed inside the same WdgMExternalLogicalSupervision.
          container WdgMCrossClusterTransition [0..65535]  # This container configures a cross cluster transition. Tags: atp.Status=draft | A WdgMCrossClusterTransition can be configured * from a WdgMCheckpoint to a WdgMTransitionProxy * from a WdgMTransitionProxy to a WdgMCheckpoint * from a WdgMTransitionProxy to another WdgMTransitionProxy (in Host Software Cluster only) * from a WdgMTransitionProxy to the identical WdgMTransitionProxy (in Application Software Cluster only for the case that no WdgMCheckpoint has to be reached in the Application Software Cluster) * from a WdgMCheckpoint to a WdgMCheckpoint (in case the cross cluster transition graph is entirely described with WdgMCrossClusterTransition containers)
            choice reference WdgMCrossClusterTransitionDestRef: post-build-variant-value=true, set at pre-compile, requires-symbolic-name-value=true, destination=[WdgMCheckpoint, WdgMTransitionProxy]  # This is the reference to the destination of a cross cluster transition. Tags: atp.Status=draft
            choice reference WdgMCrossClusterTransitionSourceRef: post-build-variant-value=true, set at pre-compile, requires-symbolic-name-value=true, destination=[WdgMCheckpoint, WdgMTransitionProxy]  # This is the reference to the source of a cross cluster transition. Tags: atp.Status=draft
          container WdgMExternalTransition [0..65535]  # This container collects the Checkpoints for an External Transition across Supervised Entities.
            reference WdgMExternalTransitionDestRef: post-build-variant-value=true, set at post-build in variant post-build / pre-compile in variant pre-compile, requires-symbolic-name-value=true, destination=WdgMCheckpoint  # This is the reference to the destination Checkpoint of an External Transition.
            reference WdgMExternalTransitionSourceRef: post-build-variant-value=true, set at post-build in variant post-build / pre-compile in variant pre-compile, requires-symbolic-name-value=true, destination=WdgMCheckpoint  # This is the reference to the source Checkpoint of an External Transition.
          container WdgMTransitionProxy [0..65535]  # The WdgMTransitionProxy defines a proxy for a transition between the Host Software Cluster and an Application Software Cluster and vice versa. Tags: atp.Status=draft | From the Host Software Cluster perspective a Cross Cluster Transition graph leaves the host after the transition which has the WdgMTransitionProxy as a destination or initial reference and returns in this WdgMTransitionProxy after the configured transitions are occurred in the related Application Software Cluster. Afterwards the transition in the host are expected which are referencing the WdgMTransitionProxy by a source or final reference.
            foreign reference WdgMResourceRef: scope=ECU, destination-type=CP-SOFTWARE-CLUSTER-SERVICE-RESOURCE  # Reference to the CpSoftwareClusterServiceResource. Tags: atp.Status=draft
        container WdgMLocalStatusParams [0..65535]  # This container collects all configuration parameters for the Local Status of a Supervised Entity.
          integer WdgMFailedAliveSupervisionRefCycleTol: 0..255, post-build-variant-value=true, set at post-build in variant post-build / pre-compile in variant pre-compile  # This parameter shall contain the acceptable amount of reference cycles with incorrect/failed alive supervisions for this Supervised Entity.
          reference WdgMLocalStatusSupervisedEntityRef: post-build-variant-value=true, set at post-build in variant post-build / pre-compile in variant pre-compile, requires-symbolic-name-value=true, destination=WdgMSupervisedEntity  # This is the reference to the Supervised Entity for which the Local Status parameters are specified.
        container WdgMMainFunctionModeProps [0..*]: multiplicity set at pre-compile  # This container provides configuration values for a WdgMMainFunction which apply in a specific WdgMMode. Tags: atp.Status=draft
          float WdgMMainFunctionModePropsTimePeriod: 0..INF, set at pre-compile  # The period between successive calls to according instance of WdgM_MainFunction in seconds. This parameter may be used by the WdgM generator to transform the values of the WdgMModes and/or WdhMSupervisedEntities timing configuration parameters of the WdgM module to internal implementation specific counter or tick values. The WdgM module's internal timing handling is implementation specific. The WdgM module (generator) may rely on the fact that Wdg_MainFunction is scheduled according to the value configured here. Tags: atp.Status=draft | Unit: [s]
          reference WdgMMainFunctionModePropsMainFunctionRef: set at pre-compile, destination=WdgMMainFunction  # Reference to the WdgMMainFunction for which the WdgMMainFunctionModeProps apply. Tags: atp.Status=draft
        container WdgMTrigger [0..255]  # This container collects all configuration parameters for the triggering of hardware watchdogs.
          integer WdgMTriggerConditionValue: 1..65535, post-build-variant-value=true, set at post-build in variant post-build / pre-compile in variant pre-compile  # This parameter shall contain the value that is passed to WdgIf_SetTriggerCondition for this watchdog.
          enumeration WdgMWatchdogMode: {WDGIF_FAST_MODE, WDGIF_OFF_MODE, WDGIF_SLOW_MODE}, post-build-variant-value=true, set at post-build in variant post-build / pre-compile in variant pre-compile  # This parameter contains the watchdog mode that shall be used for the referenced watchdog in this Watchdog Manager mode. | Implementation Type: WdgIf_ModeType
          reference WdgMTriggerWatchdogRef: post-build-variant-value=true, set at post-build in variant post-build / pre-compile in variant pre-compile, destination=WdgMWatchdog  # This parameter is a reference to the configured watchdog.
    container WdgMGeneral  # Container defines all general configuration parameters of the Watchdog Manager.
      boolean WdgMDevErrorDetect: set at pre-compile, default-value=false  # Switches the development error detection and notification on or off. | * true: detection and notification is enabled. * false: detection and notification is disabled.
      boolean WdgMEnableTimeoutDetection: set at pre-compile, default-value=false  # This parameter enables the timeout detection part of the Deadline Supervision (needed to detect deadline supervision violation when end checkpoint is never reached). | true : Timeout detection is enabled. false : Timeout detection is disabled. Note: By default this option is disabled for backward compatibility reasons.
      boolean WdgMImmediateReset [0..1]: set at pre-compile  # This parameter enables/disablse the immediate reset feature in case of alive-supervision failure. | true: Immediate reset is enabled false: Immediate reset is disabled
      boolean WdgMOffModeEnabled [0..1]: set at pre-compile  # This parameter enables/disables the selection of the "OffMode" of the watchdog driver. | true: "OffMode" selection is allowed false: "OffMode" selection is disallowed
      enumeration WdgMSwClusterSupport [0..1]: set at pre-compile, default-value=DISABLE_SW_CLUSTER_SUPPORT  # This parameter selects the support for SW Architecture with Software Clusters. Tags: atp.Status=draft | If the parameter is not set the default behavior DISABLE_SW_CLUSTER_SUPPORT applies.
        DISABLE_SW_CLUSTER_SUPPORT  # Tags: atp.Status=draft
        ENABLE_SW_CLUSTER_SUPPORT  # Tags: atp.Status=draft
      boolean WdgMVersionInfoApi: set at pre-compile, default-value=false  # Preprocessor switch to enable/disable the existence of the API WdgM_GetVersionInfo. Shall be used to remove unneeded code segments. | true: API is enabled false: API is disabled
      container WdgMBaseSocket [0..*]: multiplicity set at pre-compile  # This container configures how many EcucPartitions specific infrastructure links are required for the WdgM instances in Application Software Clusters provided by the Host Software Cluster. Tags: atp.Status=draft | Such infrastructure links serve for: the initialization of Application Software Cluster WdgM instances by Host WdgM instance the transmission of supervision results from Application Software Cluster WdgM instances to Host WdgM instance any other implementation specific purpose which is need for the interaction of Application Software Cluster WdgM instances and Host WdgM instance If the infrastructure connection is specific to one or several EcucPartition(s) the WdgMSocketEcucPartitionRef(s) denotes the applicable EcucPartition.
        foreign reference WdgMResourceRef: scope=ECU, destination-type=CP-SOFTWARE-CLUSTER-SERVICE-RESOURCE  # Reference to the CpSoftwareClusterServiceResource. Tags: atp.Status=draft
        reference WdgMSocketEcucPartitionRef [0..*]: scope=ECU, multiplicity set at pre-compile, set at pre-compile, destination=EcucPartition  # Reference to the EcucPartition. Tags: atp.Status=draft
      container WdgMMainFunction [0..*]: multiplicity set at pre-compile  # Reference to the WdgMInstanceMainFunction which this Supervised Entity belongs to. Relevant to Alive Supervision and Deadline Supervision Tags: atp.Status=draft
        reference WdgMMainFunctionPartitionRef [0..1]: multiplicity set at pre-compile, set at pre-compile, destination=EcucPartition  # Reference to EcucPartition, where the according WdgM_MainFunction instance is assigned to. For the software architecture with single partition, this reference is unnecessary. Tags: atp.Status=draft
      container WdgMSupervisedEntity [0..65535]  # This container collects all common (mode-independent) parameters of a Supervised Entity to be supervised by the Watchdog Manager.
        integer WdgMSupervisedEntityId: 0..65535, set at pre-compile, symbolic-name-value=true  # This parameter shall contain the unique identifier of the supervised entity.
        reference WdgMInternalCheckpointInitialRef [0..65535]: set at pre-compile, requires-symbolic-name-value=true, destination=WdgMCheckpoint  # This is the reference to the initial Checkpoint for this Supervised Entity.
        reference WdgMInternallCheckpointFinalRef [0..65535]: multiplicity set at pre-compile, set at pre-compile, requires-symbolic-name-value=true, destination=WdgMCheckpoint  # This is the reference to the final Checkpoint(s) for this Supervised Entity.
        reference WdgMMainFunctionRef [0..1]: multiplicity set at pre-compile, set at pre-compile, destination=WdgMMainFunction  # Reference to the WdgMInstanceMainFunction which this Supervised Entity belongs to. Relevant to Alive Supervision and Deadline Supervision Tags: atp.Status=draft
        reference WdgMOSCounter [0..1]: multiplicity set at pre-compile, set at pre-compile, destination=OsCounter  # OS counter used by Watchdog Manager to perform the deadline supervision of the Supervised Entity.
        container WdgMCheckpoint [1..65535]  # This container collects all Checkpoints of this Supervised Entity. Each Supervised Entity has at least one Checkpoint.
          integer WdgMCheckpointId: 0..65535, set at pre-compile, symbolic-name-value=true  # This parameter shall contain the unique identifier of Checkpoint.
        container WdgMInternalTransition [0..65535]  # This container defines the graph of Internal Transitions within this Supervised Entity.
          reference WdgMInternalTransitionDestRef: set at pre-compile, requires-symbolic-name-value=true, destination=WdgMCheckpoint  # This is the reference to the destination Checkpoint of a Internal Transition within this Supervised Entity.
          reference WdgMInternalTransitionSourceRef: set at pre-compile, requires-symbolic-name-value=true, destination=WdgMCheckpoint  # This is the reference to the source Checkpoint of a Internal Transition within this Supervised Entity.
      container WdgMWatchdog [0..255]  # This container collects all common (mode-independent) parameters of a Watchdog to be triggered by the Watchdog Manager.
        string WdgMWatchdogName: set at pre-compile  # This parameter shall contain the name of the watchdog instance.
        reference WdgMWatchdogDeviceRef: set at pre-compile, requires-symbolic-name-value=true, destination=WdgIfDevice  # Reference to one device container of Watchdog Interface. In the referenced container WdgIfDevice, the parameter WdgIfDeviceIndex contains the Index parameter that WdgM has to use for WdgIf_SetTriggerCondition calls for that watchdog instance.
