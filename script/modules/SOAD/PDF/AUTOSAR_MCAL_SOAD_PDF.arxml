AUTOSAR XML (schema 00053)
package /AUTOSAR/EcucDefs
  ecuc definition collection AUTOSARParameterDefinition: module=SoAd
  module definition SoAd [0..1]: post-build-variant-support=true, variants link-time/post-build/pre-compile  # Configuration of the SoAd (Socket Adaptor) module.
    container SoAdBswModules [0..*]  # Each container describes a specific BSW module that the SoAd shall interface to.
      boolean SoAdIf: set at pre-compile  # Specifies if the BSW module supports the Communication Interface APIs or not. Value true means that the APIs are supported. A module can have both Communication Interface APIs and Transport Protocol APIs (e.g. the PduR module).
      boolean SoAdIfTriggerTransmit: set at pre-compile, default-value=false  # Specifies if the BSW module supports the TriggerTransmit API or not. Value true means that the API is supported.
      boolean SoAdIfTxConfirmation: set at pre-compile  # Specifies if the BSW module supports the TxConfirmation API or not. Value true means that the API is supported.
      boolean SoAdLocalIpAddrAssigmentChg: set at pre-compile  # Specifies if the BSW module supports the LocalIpAddrAssigmentChg API or not. Value true means that the API is supported.
      boolean SoAdSoConModeChg: set at pre-compile  # Specifies if the BSW module supports the SoConModeChg API or not. Value true means that the API is supported.
      boolean SoAdTp: set at pre-compile  # Specifies if the BSW module supports the TransportProtocol APIs or not. Value true means that the APIs are supported. A module can have both Communication Interface APIs and Transport Protocol APIs (e.g. the PduR module).
      boolean SoAdUseCallerInfix: set at pre-compile, default-value=true  # Specifies if SoAd shall use (TRUE) the infix "SoAd" when calling an upper layer module function or not (FALSE). E.g. if SoAdUseCallerInfix is TRUE for the upper layer "ABC" then SoAd will call ABC_SoAdIfRxIndication() otherwise SoAd would call ABC_IfRxIndication().
      boolean SoAdUseTypeInfix: set at pre-compile, default-value=true  # Specifies if SoAd shall use (TRUE) the API type infix "Tp" or "If" when calling an upper layer module function or not (FALSE). E.g. if SoAdUseTypeInfix is TRUE for the upper layer "ABC" then SoAd will call ABC_IfRxIndication(), otherwise SoAd would call ABC_RxIndication().
      foreign reference SoAdBswModuleRef: set at pre-compile, destination-type=ECUC-MODULE-CONFIGURATION-VALUES  # This is a reference to one BSW module's configuration (i.e. not the ECUC parameter definition template). | Example, there could be several configurations of PduR and this reference selects one of them. SoAd has to figure out from the structure of the referenced BSW module's configuration, what kind of upper layer he deals with. In case of a CDD SoAd expects UL-APIs in form of _SoAd<If|Tp><function> and expects CDD Pdu configuration structures according to the Ecu Configuration specification (chapter CDD module\Socket Adaptor). In case it is one of the standardized AUTOSAR BSW modules, the configuration structures and API names for interaction with SoAd are defined in the corresponding SWS.
    container SoAdConfig  # This container contains the configuration parameters and sub containers of the AUTOSAR SoAd module.
      container SoAdPduRoute [0..*]  # Describes the path of a PDU from an upper layer of the SoAd to the socket in the TCP/IP stack for transmission. This PDU can consume meta data items of type SOCKET_CONNECTION_ID_16.
        enumeration SoAdTxPduCollectionSemantics: {SOAD_COLLECT_LAST_IS_BEST, SOAD_COLLECT_QUEUED}, post-build-variant-value=true, set at link in variant link-time / post-build in variant post-build / pre-compile in variant pre-compile, default-value=SOAD_COLLECT_QUEUED  # Specifies if this PDU shall be collected using a queued or last-is-best semantics. This parameter is only relevant if the PDU collection feature is enabled. Shall only be set to SOAD_COLLECT_LAST_IS_BEST if the related upper layer is configured with SoAdIfTriggerTransmit set to TRUE.
        integer SoAdTxPduId: 0..65535, scope=ECU, set at pre-compile, symbolic-name-value=true, with-auto=true  # Tx PDU ID of the PDU coming from the PDU Router.
        enumeration SoAdTxUpperLayerType: {IF, TP}, scope=ECU, post-build-variant-value=true, set at link in variant link-time / post-build in variant post-build / pre-compile in variant pre-compile  # Specifies the upper layer interface type (must be "IF" in case of multiple PduRoutes).
        reference SoAdTxPduRef: scope=ECU, post-build-variant-value=true, set at link in variant link-time / post-build in variant post-build / pre-compile in variant pre-compile, destination=Pdu  # Reference to the global PDU structure
        container SoAdPduRouteDest [1..*]  # Specifies the PDU route destination.
          integer SoAdTxPduHeaderId [0..1]: 0..4294967296, multiplicity set at link in variant link-time / post-build in variant post-build / pre-compile in variant pre-compile, post-build-variant-multiplicity=true, post-build-variant-value=true, set at link in variant link-time / post-build in variant post-build / pre-compile in variant pre-compile  # ID to be sent on the TCP/IP connection if the PDU header option is enabled.
          enumeration SoAdTxUdpTriggerMode [0..1]: {TRIGGER_ALWAYS, TRIGGER_NEVER}, multiplicity set at link in variant link-time / post-build in variant post-build / pre-compile in variant pre-compile, post-build-variant-multiplicity=true, post-build-variant-value=true, set at link in variant link-time / post-build in variant post-build / pre-compile in variant pre-compile  # Specifies whether a PDU triggers the transmission of the nPduUdpTxBuffer. | If this parameter is set to TRIGGER_NEVER, SoAd shall use an nPduUdpTxBuffer for the related socket connection. nPduUdpTxBuffer can only be used for upper layers with IF API, i.e. this parameter shall only be set to TRIGGER_NEVER if all upper layers belonging to the related socket connection have SoAdTxUpperLayerType set to "IF". This parameter is only relevant for UDP connections.
          float SoAdTxUdpTriggerTimeout [0..1]: 0..INF, multiplicity set at link in variant link-time / post-build in variant post-build / pre-compile in variant pre-compile, post-build-variant-multiplicity=true, post-build-variant-value=true, set at link in variant link-time / post-build in variant post-build / pre-compile in variant pre-compile  # Specifies the timeout in [s] the nPduUdpTxBuffer shall be transmitted at the latest after this PDU is put into the buffer. This optional parameter is only relevant if SoAdTxUdpTriggerMode is TRIGGER_NEVER.
          reference SoAdTxRoutingGroupRef [0..*]: multiplicity set at link in variant link-time / post-build in variant post-build / pre-compile in variant pre-compile, post-build-variant-multiplicity=true, post-build-variant-value=true, set at link in variant link-time / post-build in variant post-build / pre-compile in variant pre-compile, destination=SoAdRoutingGroup  # Reference to the routing group.
          choice reference SoAdTxSocketConnOrSocketConnBundleRef: post-build-variant-value=true, set at link in variant link-time / post-build in variant post-build / pre-compile in variant pre-compile, destination=[SoAdSocketConnection, SoAdSocketConnectionGroup]  # Choice Reference to a SocketConnection or to a SocketConnectionGroup on which the PDU is to be sent on. The reference to a SocketConnectionGroup shall only be used for upper layers with IF API.
      container SoAdRoutingGroup [0..*]  # Each container describes a specific routing group which can be enabled or disabled. A routing group consists of PDUs. Routing of PDUs can either be forwarding of PDUs from the upper layer to a TCP or UDP socket of the TCP/IP stack specified by a SoAdPduRoute or the other way around specified by a SoAdSocketRoute.
        integer SoAdRoutingGroupId: 0..65535, scope=ECU, set at pre-compile, symbolic-name-value=true, with-auto=true  # Unique ID of Routing Group
        boolean SoAdRoutingGroupIsEnabledAtInit: post-build-variant-value=true, set at link in variant link-time / post-build in variant post-build / pre-compile in variant pre-compile  # If set to true this routing group will be enabled after initializing the SoAd module (i.e. enabled in the SoAd_Init function).
        boolean SoAdRoutingGroupTxTriggerable: set at pre-compile, default-value=false  # Specifies if the If-TxPDUs related to the PduRouteDest containers | referenced by this routing group can be triggered via SoAd_IfRoutingGroupTransmit (TRUE) or not (FALSE).
      container SoAdSocketConnectionGroup [1..*]  # Specifies the configuration of a socket connection group, i.e. specifies the socket connections belonging to the group and the parameters which are common for all socket connections of the group. A socket connection specifies how data can be received and transmited via a TCP or UDP socket.
        boolean SoAdPduHeaderEnable: post-build-variant-value=true, set at link in variant link-time / post-build in variant post-build / pre-compile in variant pre-compile  # Enables the transmission of the PDU header (ID, length) on this socket connection. | TRUE: add SoAd PDU header before PDU data FALSE: No SoAd PDU header is used
        boolean SoAdSocketAutomaticSoConSetup: post-build-variant-value=true, set at link in variant link-time / post-build in variant post-build / pre-compile in variant pre-compile, default-value=true  # Specifies if the setup of the socket connection shall be done automatically (TRUE) or manually (FALSE) via SoAd_OpenSoCon() and SoAd_CloseSoCon().
        integer SoAdSocketDifferentiatedServicesField [0..1]: 0..63, multiplicity set at link in variant link-time / post-build in variant post-build / pre-compile in variant pre-compile, post-build-variant-multiplicity=true, post-build-variant-value=true, set at link in variant link-time / post-build in variant post-build / pre-compile in variant pre-compile  # The 6-bit Differentiated Service Field in the IP headers may be used for classifying network traffic. If not set a value of zero is used to indicate packets that have not been classified.
        integer SoAdSocketFlowLabel [0..1]: 0..1048575, multiplicity set at link in variant link-time / post-build in variant post-build / pre-compile in variant pre-compile, post-build-variant-multiplicity=true, post-build-variant-value=true, set at link in variant link-time / post-build in variant post-build / pre-compile in variant pre-compile  # The 20-bit Flow Label field in the IPv6 header may be used by a source to label sequences of packets for which it requests special handling by the IPv6 routers, such as non-default quality of service. If not set a Flow Label of zero is used to indicate packets that have not been labeled.
        integer SoAdSocketFramePriority [0..1]: 0..7, multiplicity set at link in variant link-time / post-build in variant post-build / pre-compile in variant pre-compile, post-build-variant-multiplicity=true, post-build-variant-value=true, set at link in variant link-time / post-build in variant post-build / pre-compile in variant pre-compile  # Specifies the priority of the Ethernet frame. | If IEEE 802.1Q VLAN Tags are used, the specified priority will be used in the VLAN Tag PCP filed. If this optional parameter is not available the default priority specified in the TcpIp module is used.
        boolean SoAdSocketIpAddrAssignmentChgNotification: post-build-variant-value=true, set at link in variant link-time / post-build in variant post-build / pre-compile in variant pre-compile, default-value=false  # Specifies if the local IP address assignment change notification callback function of the upper layer shall be called if the assignment of the local IP address used by this socket connection changes.
        integer SoAdSocketLocalPort: 0..65535, post-build-variant-value=true, set at link in variant link-time / post-build in variant post-build / pre-compile in variant pre-compile, default-value=0  # Local UDP or TCP port used for this connection. If this parameter set to 0 SoAd requests TcpIp to select an ephemeral port.
        boolean SoAdSocketMsgAcceptanceFilterEnabled: post-build-variant-value=true, set at link in variant link-time / post-build in variant post-build / pre-compile in variant pre-compile, default-value=true  # Specifies if the message acceptance filter is enabled (TRUE) or not (FALSE). | Note: if a wildcard is used in SoAdSocketRemoteAddress AND SoAdSocketUdpListenOnly is FALSE, this parameter must be TRUE. Note: if multiple SoAdSocketConnections are configured for one SoAdSocketConnectionGroup, this parameter must be TRUE.
        boolean SoAdSocketPathMTUEnable [0..1]: multiplicity set at link in variant link-time / post-build in variant post-build / pre-compile in variant pre-compile, post-build-variant-multiplicity=true, post-build-variant-value=true, set at link in variant link-time / post-build in variant post-build / pre-compile in variant pre-compile, default-value=false  # Specifies if path MTU discovery shall be performed for this connection. If this optional parameter is not available the default behavior configured for the controller in the TcpIp module via the parameter TcpIpIpV4PathMtuEnabled or TcpIpIpV6PathMtuEnabled is applied.
        boolean SoAdSocketSoConModeChgBswMNotification [0..1]: multiplicity set at link in variant link-time / post-build in variant post-build / pre-compile in variant pre-compile, post-build-variant-multiplicity=true, post-build-variant-value=true, set at link in variant link-time / post-build in variant post-build / pre-compile in variant pre-compile  # Specifies if the BswM_SoAd_SoConModeChg notification shall be called in case of SoCon mode change
        boolean SoAdSocketSoConModeChgNotification: post-build-variant-value=true, set at link in variant link-time / post-build in variant post-build / pre-compile in variant pre-compile, default-value=false  # Specifies if the SoCon mode change notification callback function of the upper layer shall be called in case of SoCon mode change.
        integer SoAdSocketTimeToLive [0..1]: 1..255, multiplicity set at link in variant link-time / post-build in variant post-build / pre-compile in variant pre-compile, post-build-variant-multiplicity=true, post-build-variant-value=true, set at link in variant link-time / post-build in variant post-build / pre-compile in variant pre-compile  # This parameter defines a value set in the header of an Internet Protocol (IP) packet that tells network devices the maximum number of router hops the packet can make before it is discarded. The TTL value is a counter that is decremented by 1 every time the packet passes through a router.
        integer SoAdSocketTpRxBufferMin [0..1]: 0..65535, multiplicity set at link in variant link-time / post-build in variant post-build / pre-compile in variant pre-compile, post-build-variant-multiplicity=true, post-build-variant-value=true, set at link in variant link-time / post-build in variant post-build / pre-compile in variant pre-compile  # Specifies the amount of data in bytes (PDU data for the upper layer and PDU Header if used) the SoAd shall at least be able to buffer for data reception via each socket connection of the socket connection group and using an upper layer with TP. | Note: in case of a TCP socket where PduHeaderMode is used and an upper layer with IF-API, the required buffer size can be determined automatically.
        reference SoAdSocketIpAddrAssignmentChgNotifUpperLayerRef [0..1]: multiplicity set at pre-compile, set at pre-compile, destination=SoAdBswModules  # Reference to an additional upper layer that shall be called if the assignment of the local IP address used by this socket connection changes (although it is not a direct upper layer of the socket connection). Tags: atp.Status=draft
        reference SoAdSocketLocalAddressRef: post-build-variant-value=true, set at link in variant link-time / post-build in variant post-build / pre-compile in variant pre-compile, requires-symbolic-name-value=true, destination=TcpIpLocalAddr  # Local IP address and interface used for this connection.
        reference SoAdSocketSoConModeChgNotifUpperLayerRef [0..1]: multiplicity set at pre-compile, set at pre-compile, destination=SoAdBswModules  # Reference to an additional upper layer that shall receive socket connection state changes (although it is not a direct upper layer of the socket connection).
        container SoAdSocketConnection [1..*]  # Specifies the socket connection (Id and remote address information). | Note: Parameters which are common to all socket connections of a socket connection group are specified directly at the group.
          integer SoAdSocketId: 0..65535, scope=ECU, set at pre-compile, symbolic-name-value=true, with-auto=true  # Socket connection identifier used as SoConId in the interaction with upper layers.
          container SoAdSocketRemoteAddress [0..1]  # Subcontainer of SoAdSocketConnection to specify the remote address (IP address and port) for a socket connection. | If SoAdSocketRemoteAddress is not specified the remote address has to be set by the upper layer via SoAd_SetRemoteAddr().
            string SoAdSocketRemoteIpAddress: post-build-variant-value=true, set at link in variant link-time / post-build in variant post-build / pre-compile in variant pre-compile  # IP address of remote node. The configured address must be of the same TcpIpDomainType (i.e. IPv4 or IPv6) as the TcpIpLocalAddr referred by SoAdSocketLocalAddressRef . | To accept any remote IP address, set SoAdSocketRemoteIpAddress to "ANY". See message acceptance policy for more details.
            integer SoAdSocketRemotePort: 0..65535, post-build-variant-value=true, set at link in variant link-time / post-build in variant post-build / pre-compile in variant pre-compile  # Remote UDP or TCP port used for this connection. | To accept any remote port, set SoAdSocketRemotePort to 0. See message acceptance policy for more details.
        choice container SoAdSocketProtocol  # Specifies the transport protocol and transport protocol specific parameters used for the socket connections of the socket connection group.
          container SoAdSocketTcp [0..1]  # Specifies that TCP is used as transport protocol for the socket connection group and parameters only related to TCP socket connections.
            float SoAdSocketTcpAutoConnectTimeout [0..1]: 0..INF, multiplicity set at link in variant link-time / post-build in variant post-build / pre-compile in variant pre-compile, post-build-variant-multiplicity=true, post-build-variant-value=true, set at link in variant link-time / post-build in variant post-build / pre-compile in variant pre-compile  # Specifies the time in seconds how long 'TCP connect attempts are repeated to reach SOAD_SOCON_ONLINE. This parameter is restricted to socket connection groups which are initiating a TCP connection and are under control of SoAd.
            boolean SoAdSocketTcpImmediateTpTxConfirmation: scope=ECU, post-build-variant-value=true, set at link in variant link-time / post-build in variant post-build / pre-compile in variant pre-compile, default-value=false  # If set to FALSE, SoAd notifies the TP upper layer via transmit confirmation after a Tcp Ack has been received. If set to TRUE, SoAd notifies the TP upper layer via transmit confirmation immediately after transmit has been accepted by TcpIp.
            boolean SoAdSocketTcpInitiate: post-build-variant-value=true, set at link in variant link-time / post-build in variant post-build / pre-compile in variant pre-compile  # Specifies the initiator for this TCP connection. It will not be defined for UDP sockets. | TRUE: This TCP connection is initiated by this module. FALSE: This TCP connection is to be initiated in the listen mode.
            boolean SoAdSocketTcpKeepAlive: post-build-variant-value=true, set at link in variant link-time / post-build in variant post-build / pre-compile in variant pre-compile, default-value=false  # Specifies to use the keep-alive mechanism for this connection. It will not be defined for UDP sockets. | TRUE: This TCP connection will use the keep-alive mechanism. FALSE: This TCP connection will not use the keep-alive mechanism. Note: This parameter must not be set to TRUE if TcpIpTcpKeepAliveEnabled is set to FALSE.
            float SoAdSocketTcpKeepAliveInterval [0..1]: 0..INF, multiplicity set at link in variant link-time / post-build in variant post-build / pre-compile in variant pre-compile, post-build-variant-multiplicity=true, post-build-variant-value=true, set at link in variant link-time / post-build in variant post-build / pre-compile in variant pre-compile  # Specifies the interval in seconds between subsequent keepalive probes.
            integer SoAdSocketTcpKeepAliveProbesMax [0..1]: 0..65535, multiplicity set at link in variant link-time / post-build in variant post-build / pre-compile in variant pre-compile, post-build-variant-multiplicity=true, post-build-variant-value=true, set at link in variant link-time / post-build in variant post-build / pre-compile in variant pre-compile  # Maximum number of times that TCP retransmits an individual data segment before aborting the connection.
            float SoAdSocketTcpKeepAliveTime [0..1]: 0..INF, multiplicity set at link in variant link-time / post-build in variant post-build / pre-compile in variant pre-compile, post-build-variant-multiplicity=true, post-build-variant-value=true, set at link in variant link-time / post-build in variant post-build / pre-compile in variant pre-compile, default-value=7200  # Specifies the time in seconds between the last data packet sent and the first keepalive probe.
            boolean SoAdSocketTcpNoDelay [0..1]: multiplicity set at link in variant link-time / post-build in variant post-build / pre-compile in variant pre-compile, post-build-variant-multiplicity=true, post-build-variant-value=true, set at link in variant link-time / post-build in variant post-build / pre-compile in variant pre-compile  # Specifies not to use the congestion control mechanism for this connection. It will not be defined for UDP sockets. | TRUE: This TCP connection will NOT use congestion control. FALSE: This TCP connection will use congestion control. If the optional parameter is not enabled, the default behavior configured for TcpIp via the parameter TcpIpTcpNagleEnabled is applied. Note: This parameter must not be set to FALSE if TcpIpTcpNagleEnabled is set to FALSE.
            float SoAdSocketTcpRetransmissionTimeout [0..1]: 0.001..INF, multiplicity set at link in variant link-time / post-build in variant post-build / pre-compile in variant pre-compile, post-build-variant-multiplicity=true, post-build-variant-value=true, set at link in variant link-time / post-build in variant post-build / pre-compile in variant pre-compile  # Timeout in [s] before an unacknowledged TCP segment is sent again. | If the timeout is set to INF, no TCP segments shall be retransmitted.
            integer SoAdSocketTcpTxQuota [0..1]: 0..4294967295, multiplicity set at link in variant link-time / post-build in variant post-build / pre-compile in variant pre-compile, post-build-variant-multiplicity=true, post-build-variant-value=true, set at link in variant link-time / post-build in variant post-build / pre-compile in variant pre-compile  # Specifies the maximum amount of bytes (PDU data provided by the upper layer and PDU Header if used) the SoAd may queue for transmission via TCP at the TcpIp module for each socket connection of this socket connection group. | Rationale: prohibits that a socket connection consumes all available transmit buffers at the TcpIp and blocks transmissions via other socket connections. If the optional parameter is not enabled, the amount of data is not limited.
            reference SoAdSocketTCPOptionFilterRef [0..1]: multiplicity set at link in variant link-time / post-build in variant post-build / pre-compile in variant pre-compile, post-build-variant-multiplicity=true, post-build-variant-value=true, set at link in variant link-time / post-build in variant post-build / pre-compile in variant pre-compile, requires-symbolic-name-value=true, destination=TcpIpTcpConfigOptionFilter  # Specifies which TCP option filter shall be applied on the related socket.
            reference SoAdSocketTcpTlsConnectionRef [0..1]: multiplicity set at pre-compile, set at pre-compile, requires-symbolic-name-value=true, destination=TcpIpTlsConnection  # If set the TCP socket is assigned to a TLS connection. The SoAd need to call Tcpip_ChangeParameter with the reference to the TLS connection as the parameter.
          container SoAdSocketUdp [0..1]  # Specifies that UDP is used as transport protocol for the socket connection group and parameters only related to UDP socket connections.
            integer SoAdSocketnPduUdpTxBufferMin [0..1]: 0..65535, multiplicity set at link in variant link-time / post-build in variant post-build / pre-compile in variant pre-compile, post-build-variant-multiplicity=true, post-build-variant-value=true, set at link in variant link-time / post-build in variant post-build / pre-compile in variant pre-compile  # Specifies the amount of data in bytes (PDU data provided by the upper layer and PDU Header if used) the SoAd shall be able to buffer for data transmission via this socket connection in case the UDP message shall be buffered for transmission of multiple PDUs per UDP. | Note: in case of a UDP socket and an upper layer with TP API is configured, the required buffer size can be determined automatically. This optional parameter is only relevant if a nPduUdpTxBuffer is used.
            float SoAdSocketUdpAliveSupervisionTimeout [0..1]: 0..INF, multiplicity set at link in variant link-time / post-build in variant post-build / pre-compile in variant pre-compile, post-build-variant-multiplicity=true, post-build-variant-value=true, set at link in variant link-time / post-build in variant post-build / pre-compile in variant pre-compile  # Specifies the time in [s] a UDP socket connection remains in the mode SOAD_SOCON_ONLINE after the latest reception of a frame from the remote peer specified by the remote address. If this optional parameter is not enabled UDP Alive Supervision is deactivated for the related socket connection group.
            boolean SoAdSocketUdpChecksumEnabled: post-build-variant-value=true, set at link in variant link-time / post-build in variant post-build / pre-compile in variant pre-compile, default-value=true  # Specifies if UDP checksum calculation shall be enabled (TRUE) or skipped (FALSE) on the related socket. FALSE implies that the upper layer of the socket connection is either capable to handle malformed messages or applies a checksum mechanism itself.
            boolean SoAdSocketUdpListenOnly: post-build-variant-value=true, set at link in variant link-time / post-build in variant post-build / pre-compile in variant pre-compile, default-value=false  # Specifies if the socket connection group is only used for reception (TRUE) or used for both reception and transmission (FALSE).
            boolean SoAdSocketUdpStrictHeaderLenCheckEnabled: post-build-variant-value=true, set at link in variant link-time / post-build in variant post-build / pre-compile in variant pre-compile, default-value=false  # Specifies if UDP messages shall be dropped (TRUE) if the length of all contained PDUs does not match the length of the whole message or not (FALSE). Shall only be set to TRUE if SoAdPduHeaderEnable is also set to TRUE.
            float SoAdSocketUdpTriggerTimeout [0..1]: 0..INF, multiplicity set at link in variant link-time / post-build in variant post-build / pre-compile in variant pre-compile, post-build-variant-multiplicity=true, post-build-variant-value=true, set at link in variant link-time / post-build in variant post-build / pre-compile in variant pre-compile  # Specifies the timeout in [s] a nPduUdpTxBuffer is waiting for a PDU with TriggerMode = TRIGGER_ALWAYS, i.e. when the timeout expires the nPduUdpTxBuffer is transmitted. Timer is reset after each UDP transmission. This optional parameter is only relevant if a nPduUdpTxBuffer is used.
      container SoAdSocketRoute [0..*]  # Describes the path of a PDU from a socket in the TCP/IP stack to an upper layer of the SoAd after reception in the TCP/IP Stack.
        integer SoAdRxPduHeaderId [0..1]: 0..4294967296, multiplicity set at link in variant link-time / post-build in variant post-build / pre-compile in variant pre-compile, post-build-variant-multiplicity=true, post-build-variant-value=true, set at link in variant link-time / post-build in variant post-build / pre-compile in variant pre-compile  # ID contained in the packet received on the TCP/IP connection if the PDU header option is enabled.
        choice reference SoAdRxSocketConnOrSocketConnBundleRef: post-build-variant-value=true, set at link in variant link-time / post-build in variant post-build / pre-compile in variant pre-compile, destination=[SoAdSocketConnection, SoAdSocketConnectionGroup]  # Choice Reference to a SocketConnection or to a SocketConnectionGroup on which the PDU was received. The reference to a SocketConnectionGroup shall only be used for upper layers with IF API.
        container SoAdSocketRouteDest [1..*]  # Describes the upper layer destination PDU for a message received on a TcpIp socket. This PDU can produce meta data items of type SOCKET_CONNECTION_ID_16. | Multiple socket route destinations in the SoAdSocketRoute can only be used for upper layers of interface type (IF) and only for SoAdSocketRoute referring a SocketConnectionGroup. In this case SoAdRoutingGroups shall be used to map each SoAdSocketRouteDest uniquely to different socket connections of the SocketConnectionGroup.
          integer SoAdRxPduId [0..1]: 0..65535, scope=ECU, multiplicity set at link in variant link-time / post-build in variant post-build / pre-compile in variant pre-compile, post-build-variant-multiplicity=true, post-build-variant-value=true, set at link in variant link-time / post-build in variant post-build / pre-compile in variant pre-compile, with-auto=true  # This unique identifier is used for a receive cancellation request from an upper layer of the SoAd.
          enumeration SoAdRxUpperLayerType: {IF, TP}, scope=ECU, post-build-variant-value=true, set at link in variant link-time / post-build in variant post-build / pre-compile in variant pre-compile  # Specifies the upper layer interface type (must be "IF" in case of multiple RxPdus).
          reference SoAdRxPduRef: scope=ECU, post-build-variant-value=true, set at link in variant link-time / post-build in variant post-build / pre-compile in variant pre-compile, destination=Pdu  # Reference to the global PDU structure
          reference SoAdRxRoutingGroupRef [0..*]: multiplicity set at link in variant link-time / post-build in variant post-build / pre-compile in variant pre-compile, post-build-variant-multiplicity=true, post-build-variant-value=true, set at link in variant link-time / post-build in variant post-build / pre-compile in variant pre-compile, destination=SoAdRoutingGroup  # Reference to the routing group. Mandatory if the parent SoAdSocketRoute contains more than one SoAdSocketRouteDest."
    container SoAdGeneral  # This container contains all global configuration parameters of SoAd.
      boolean SoAdDevErrorDetect: set at pre-compile, default-value=false  # Switches the development error detection and notification on or off. | * true: detection and notification is enabled. * false: detection and notification is disabled.
      boolean SoAdEnableSecurityEventReporting: scope=ECU, set at pre-compile, default-value=false  # Switches the reporting of security events to the IdsM: Tags: atp.Status=draft | - true: reporting is enabled. - false: reporting is disabled.
      boolean SoAdGetAndResetMeasurementDataApi: scope=ECU, set at pre-compile  # Enables / Disables the Get and Reset Measurement Data API
      boolean SoAdIPv6AddressEnabled: scope=ECU, set at pre-compile  # Allows for increased memory allocation to store IPv6 addresses. | TRUE: Enables support for IPv6 addresses FALSE: Only IPv4 addresses are supported
      float SoAdMainFunctionPeriod: 0..INF, scope=ECU, set at pre-compile  # Determines the frequency at which the SoAd_MainFunction() is called in [s].
      integer SoAdRoutingGroupMax: 0..65535, set at pre-compile  # Specifies the maximum number of SoAd routing groups. Furthermore it defines the platform type used for RoutingGroupIdType. If SoAdRoutingGroupMax is not greater than 256, a uint8 is used, | otherwise a uint16.
      integer SoAdSoConMax: 0..65535, set at pre-compile  # Specifies the maximum number of SoAd socket connections. | Furthermore it defines the platform type used for SoAd_SoConIdType. If SoAdSoConMax is not greater than 256, a uint8 is used, otherwise uint16.
      boolean SoAdVersionInfoApi: set at pre-compile, default-value=false  # Activates the SoAd_GetVersionInfo() API. | TRUE: Enables the SoAd_GetVersionInfo() API. FALSE: SoAd_GetVersionInfo() API is not included.
      container SoAdSecurityEventRefs [0..1]: multiplicity set at pre-compile  # Container for the references to IdsMEvent elements representing the security events that the SoAd module shall report to the IdsM in case the coresponding security related event occurs (and if SoAdEnableSecurityEventReporting is set to "true"). The standardized security events in this container can be extended by vendor-specific security events. Tags: atp.Status=draft
        reference SEV_DROP_MSG_RX_UDP_LENGTH [0..1]: multiplicity set at pre-compile, set at pre-compile, requires-symbolic-name-value=true, destination=IdsMEvent  # SoAd dropped a message. The message contains at least one PDU which violates stack configuration and was received via a UDP socket. Tags: atp.Status=draft | The violation relates to the length of the PDUs compared to the overall length of the message.
        reference SEV_DROP_MSG_RX_UDP_SOCKET [0..1]: multiplicity set at pre-compile, requires-symbolic-name-value=true, destination=IdsMEvent  # SoAd received a UDP message which violates stack configuration and was dropped. Tags: atp.Status=draft | No suitable socket connection matching to configuration was found.
        reference SEV_DROP_PDU_RX_TCP [0..1]: multiplicity set at pre-compile, set at pre-compile, requires-symbolic-name-value=true, destination=IdsMEvent  # SoAd dropped a PDU. The PDU violates stack configuration and was received via a TCP socket. Tags: atp.Status=draft
        reference SEV_DROP_PDU_RX_UDP [0..1]: multiplicity set at pre-compile, set at pre-compile, requires-symbolic-name-value=true, destination=IdsMEvent  # SoAd dropped a PDU. The PDU violates stack configuration and was received via a UDP socket. Tags: atp.Status=draft
        reference SEV_REJECTED_TCP_CONNECTION [0..1]: multiplicity set at pre-compile, requires-symbolic-name-value=true, destination=IdsMEvent  # SoAd rejected a TCP connection. The connection request violates stack configuration. Tags: atp.Status=draft
