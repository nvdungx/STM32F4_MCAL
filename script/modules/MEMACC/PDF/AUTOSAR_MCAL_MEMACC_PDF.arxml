AUTOSAR XML (schema 00053)
package /AUTOSAR/EcucDefs
  ecuc definition collection AUTOSARParameterDefinition: module=MemAcc
  module definition MemAcc [0..1]: variants post-build/pre-compile  # The MemAcc module shall only coordinate conflicting resource accesses. The access dependencies shall be configured based on MemAccSynchronizationGroupConfiguration. | Note: Only relevant resource conflicts shall be coordinated to prevent any performance impact.
    container MemAccAddressAreaConfiguration [1..65535]: multiplicity set at post-build in variant post-build / pre-compile in variant pre-compile, post-build-variant-multiplicity=true  # This container includes the configuration of AddressArea specific parameters for the MemAcc module. | An AddressArea is a logical area of memory. Upper layers only use logical addresses to access the address area. It is the job of MemAcc to map between logical and physical addresses. An AddressArea contains SubAddressAreas and each SubAddressArea is part of a physically continuous memory area (sector batch).
      integer MemAccAddressAreaId: 0..65535, set at pre-compile, symbolic-name-value=true, default-value=0  # This value specifies a unique identifier which is used to reference to an AddressArea. | This identifier is used as parameter for MemAcc jobs in order to distinguish between several AddressAreas with the same logical addresses.
      integer MemAccAddressAreaPriority: 0..65535, post-build-variant-value=true, set at post-build in variant post-build / pre-compile in variant pre-compile, default-value=0  # This value specifies the priority of an AddressArea compared to other AddressAreas (0 = lowest priority, 65535 = highest priority). | For each AddressArea only one job can be processed at a time. MemAcc processes the jobs priority based. In case a job with a higher priority is requested by an upper layer, the lower priority jobs are suspended until the higher priority job is completed.
      integer MemAccBufferAlignmentValue: 0..255, set at pre-compile  # Buffer alignment value inherited by MemAcc upper layer modules. The value must be a multiple of MinReadSize.
      function name MemAccJobEndNotificationName: set at pre-compile  # Job end notification function which is called after MemAcc job completion. If this parameter is left empty, no job end notification is triggered and the upper layer module needs to poll the job results.
      container MemAccSubAddressAreaConfiguration [1..65536]: multiplicity set at post-build in variant post-build / pre-compile in variant pre-compile, post-build-variant-multiplicity=true  # This container includes the configuration parameters for a physically continuous area of memory.
        integer MemAccLogicalStartAddress: 0..18446744073709551615, post-build-variant-value=true, set at post-build in variant post-build / pre-compile in variant pre-compile, default-value=0  # This value specifies the logical start address of the SubAddressArea.
        integer MemAccNumberOfEraseRetries: 0..255, multiplicity set at pre-compile, post-build-variant-value=true, set at post-build in variant post-build / pre-compile in variant pre-compile, default-value=0  # This value specifies the number of retries of a failed erase job. | 0: No retry, a failed job will be aborted immediately > 0: Retry the number of times before aborting the job.
        integer MemAccNumberOfSectors: 1..4294967295, post-build-variant-value=true, set at post-build in variant post-build / pre-compile in variant pre-compile, default-value=1  # This value specifies the number of physical sectors of the SubAddressArea.
        integer MemAccNumberOfWriteRetries: 0..255, multiplicity set at pre-compile, post-build-variant-value=true, set at post-build in variant post-build / pre-compile in variant pre-compile, default-value=0  # This value specifies the number of retries of a failed write job. | 0: No retry, a failed job will be aborted immediately > 0: Retry the number of times before aborting the job.
        integer MemAccSectorOffset: 0..4294967295, post-build-variant-value=true, set at post-build in variant post-build / pre-compile in variant pre-compile, default-value=0  # This value specifies the sector offset of the SubAddressArea in case the SubAddressArea should not start with the first sector of the referenced MemSectorBatch.
        boolean MemAccUseEraseBurst: post-build-variant-value=true, set at post-build in variant post-build / pre-compile in variant pre-compile, default-value=false  # This parameter enables erase bursting for the related sub address area.
        boolean MemAccUseWriteBurst: post-build-variant-value=true, set at post-build in variant post-build / pre-compile in variant pre-compile, default-value=false  # This parameter enables write bursting for the related sub address area.
        reference MemAccSectorBatchRef: post-build-variant-value=true, set at post-build in variant post-build / pre-compile in variant pre-compile, destination=MemSectorBatch  # Reference to MemSectorBatch mapped to the SubAddressArea.
    container MemAccGeneral  # General configuration parameters of the MemAcc.
      boolean MemAcc64BitSupport: set at pre-compile, default-value=false  # If this option is selected, the address type shall be implemented in 64Bit.
      boolean MemAccCompareApi: set at pre-compile, default-value=false  # This parameter enables/disables the function MemAcc_Compare(). | This function allows to compare data stored in a buffer with data stored in memory.
      boolean MemAccDevErrorDetect: set at pre-compile  # Switches the development error detection and notification on or off.
      float MemAccMainFunctionPeriod: 1E-4..INF, set at pre-compile  # This value specifies the fixed call cycle for MemAcc_MainFunction(). | Additionally, if a job is ongoing on a Mem, the underlying Mem_MainFunction will be triggered directly by MemAcc at this fixed call cycle. MemAcc does not depend on a fixed cycle time; in can be triggered at arbitrary rates.
      string MemAccPublicCddHeaderFile [0..*]: multiplicity set at pre-compile, set at pre-compile, max-length=32, min-length=1  # Defines header files for callback functions which shall be included in case of CDDs. Range of characters is 1.. 32.
    container MemAccSynchronizationGroupConfiguration [0..1]: multiplicity set at post-build in variant post-build / pre-compile in variant pre-compile, post-build-variant-multiplicity=true  # This container represents one synchronization group. This container references sub address areas with same synchronization affiliation.
      integer MemAccMSynchronizationGroupId: 0..65535, post-build-variant-value=true, set at post-build in variant post-build / pre-compile in variant pre-compile, default-value=0  # This value specifies an unique identifier which is used to reference to a synchronization group. The value is used within MemAcc internally.
      reference MemAccMSynchronizationSubAddressAreaRef [1..65535]: multiplicity set at post-build in variant post-build / pre-compile in variant pre-compile, post-build-variant-multiplicity=true, post-build-variant-value=true, set at post-build in variant post-build / pre-compile in variant pre-compile, destination=MemAccSubAddressAreaConfiguration  # References to all SubAddressAreas relevant for this synchronization group.
