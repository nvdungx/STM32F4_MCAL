AUTOSAR XML (schema 00053)
package /AUTOSAR/EcucDefs
  ecuc definition collection AUTOSARParameterDefinition: module=Mka
  module definition Mka [0..1]: variants pre-compile  # Configuration of the MACsec Key Agreement module. Tags: atp.Status=draft
    container MkaCryptoAlgoConfig [1..255]  # Cryptography configuration for MACsec. Tags: atp.Status=draft
      integer MkaCryptoAlgoConfigIdx: 0..255, set at pre-compile, symbolic-name-value=true  # Instance ID of the configured Crypto configuration. Tags: atp.Status=draft
      enumeration MkaMacSecCapability: set at pre-compile, default-value=INTEGRITY_WITHOUT_CONFIDENTIALITY  # MACsec capability to use for MACsec. Tags: atp.Status=draft
        INTEGRITY_AND_CONFIDENTIALITY  # Tags: atp.Status=draft
        INTEGRITY_WITHOUT_CONFIDENTIALITY  # Tags: atp.Status=draft
      enumeration MkaMacSecConfidentialityOffset [0..1]: set at pre-compile, default-value=CONFIDENTIALITY_OFFSET_0  # The confidentiality Offset is only applicable if "Integrity and confidentiality" with a non-XPN cipher suite is selected. Tags: atp.Status=draft
        CONFIDENTIALITY_OFFSET_0  # Tags: atp.Status=draft
        CONFIDENTIALITY_OFFSET_30  # Tags: atp.Status=draft
        CONFIDENTIALITY_OFFSET_50  # Tags: atp.Status=draft
      boolean MkaMacSecReplayProtection: set at pre-compile, default-value=false  # MACsec replay protection parameter for MACsec.\newline The Replay Protection parameter is defined in the IEEE 802.1AE-2018 document, on chapter 10.4. It enables the replay protection if a packet is received with PacketNumber outside of the Window = PN - ProtectionWindow. Tags: atp.Status=draft
      integer MkaMacSecReplayProtectionWindow [0..1]: 0..18446744073709551615, set at pre-compile  # In case replay protection is active, replay protection window.The Protection Window is a positive integer between 0 and 2^32-1 (No XPN) or 2^30-1 (XPN). Tags: atp.Status=draft
      container MkaCipherSuites [1..4]  # Cipher Suite configuration to use with MACsec. | MkaCipherSuitePrio is present in case the MKA instance acts as a Key Server to select the cipher suite to use for MACsec.
        enumeration MkaMacSecCipherSuite: set at pre-compile, default-value=GCM_AES_128  # Cipher Suite to use for MACsec. Tags: atp.Status=draft
          GCM_AES_128  # Tags: atp.Status=draft
          GCM_AES_256  # Tags: atp.Status=draft
          GCM_AES_XPN_128  # Tags: atp.Status=draft
          GCM_AES_XPN_256  # Tags: atp.Status=draft
        integer MkaMacSecCipherSuitePrio: 1..4, set at pre-compile  # In case the MKA instance acts as a Key Server, the priority is used to select the Cipher Suite to use with MACsec from the common supported Ciphers (with the client in the link). Tags: atp.Status=draft | Value of 1 means the highest priority. Value of 4 means the lowest priority.
    container MkaGeneral  # This container holds the general parameters of the MKA protocol which apply to ports that are referencing this container. Tags: atp.Status=draft
      boolean MkaDevErrorDetect: set at pre-compile, default-value=false  # Switches the development error detection and notification on or off. Tags: atp.Status=draft | - true: detection and notification is enabled. . false: detection and notification is disabled.
      boolean MkaEnableSecurityEventReporting: set at pre-compile, default-value=false  # Switches the reporting of security events to the IdsM: Tags: atp.Status=draft | - true: reporting is enabled. - false: reporting is disabled
      float MkaHelloTime: 0..INF, set at pre-compile, default-value=2  # Interval [s] between MKPDUs when two participants have an active MKA communication (the participants are included in the Live Peer list of each other). Tags: atp.Status=draft
      float MkaLifeTime: 0..INF, set at pre-compile, default-value=6  # Time span [s] since last MKPDU was received from the other participant, to consider it alive. Tags: atp.Status=draft | \newline In case no valid MKPDU from the other participant is received after MkaLifeTime, the Secure Channel is shut down.
      float MkaMainFunctionPeriod: 0..INF, set at pre-compile  # The cycle time of the periodic main function of MKA. Defined in seconds. Tags: atp.Status=draft
      float MkaSakRetireTime: 0..INF, set at pre-compile, default-value=3  # During an SAK rekey, time [s] to retire the previous SAK in use. Tags: atp.Status=draft
      boolean MkaVersionInfoApi: set at pre-compile, default-value=false  # Enables / Disables version info API. Tags: atp.Status=draft
      container MkaSecurityEventRefs [0..1]: multiplicity set at pre-compile  # Container for the references to IdsMEvent elements representing the security events that the Mka module shall report to the IdsM in case the corresponding security related event occurs (and if MkaEnableSecurityEventReporting is set to "true"). The standardized security events in this container can be extended by vendor-specific security events. Tags: atp.Status=draft
        reference SEV_MKA_AUTHENTICATION_FAILURE [0..1]: multiplicity set at pre-compile, set at pre-compile, requires-symbolic-name-value=true, destination=IdsMEvent  # Event triggered when the authentication during the MKA communication has failed (wrong CKN/CAK) Tags: atp.Status=draft
        reference SEV_MKA_CIPHER_SUITE_NOT_SUPPORTED [0..1]: multiplicity set at pre-compile, set at pre-compile, requires-symbolic-name-value=true, destination=IdsMEvent  # Event triggered when there is no Cipher Suite supported Tags: atp.Status=draft
        reference SEV_MKA_PORT_NOT_ENABLED [0..1]: multiplicity set at pre-compile, set at pre-compile, requires-symbolic-name-value=true, destination=IdsMEvent  # Event triggered when the indicated port for the MKA communication is not enabled Tags: atp.Status=draft
        reference SEV_MKA_PORT_NUMBER_CHANGE [0..1]: multiplicity set at pre-compile, set at pre-compile, requires-symbolic-name-value=true, destination=IdsMEvent  # Event triggered when during the MKA communication the port number has changed Tags: atp.Status=draft
        reference SEV_MKA_TIMEOUT [0..1]: multiplicity set at pre-compile, set at pre-compile, requires-symbolic-name-value=true, destination=IdsMEvent  # Event triggered when the timeout for the MKA communication has expired Tags: atp.Status=draft
    container MkaPaeConfiguration [1..255]  # Common MKA configuration for a PAE. Tags: atp.Status=draft
      boolean MkaAutoStart: set at pre-compile, default-value=true  # Autostart or manual start of the PAE Instance. Tags: atp.Status=draft | True := Autostart False := Manual Start If Autostart = False, the method Mka_StartPae is used to start the PAE instance.
      function name MkaGetMacSecStatisticsCallbackNotification [0..1]: multiplicity set at pre-compile, set at pre-compile  # Defines the full function name for the <User>_GetMacSecStatisticsCallbackNotification() callback.
      integer MkaPaeConfigurationIdx: 0..255, set at pre-compile, symbolic-name-value=true  # Instance ID of the MkaPaeConfiguration. Tags: atp.Status=draft
      float MkaRetryBaseDelay: 0..INF, set at pre-compile  # The base delay in seconds for the retry phase of MKA. Tags: atp.Status=draft | The retry have an exponential back off delay (1x base delay, 2x base delay, 4x base delay, ...) until the retry delay overflows the MkaRetryCyclicDelay value.
      float MkaRetryCyclicDelay: 0..INF, set at pre-compile  # Interval in seconds between retries after base delay with exponential back off. Tags: atp.Status=draft
      float MkaSakRekeyTimeSpan: 0..INF, set at pre-compile  # Time [s] to trigger the rekey of an in use SAK. If set to 0, the rekey will not be triggered after a time span. Tags: atp.Status=draft
    container MkaPaeInstance [1..255]  # MKA configuration of a controlled port. Tags: atp.Status=draft
      enumeration MkaOnFailPermissiveMode: set at pre-compile  # Sets the behavior of the PAE in case MKA does not succeed when MKA is enabled. Tags: atp.Status=draft
        MKA_PERMISSIVE_MODE_NEVER  # Tags: atp.Status=draft
        MKA_PERMISSIVE_MODE_TIMEOUT  # Tags: atp.Status=draft
      float MkaOnFailPermissiveModeTimeout: 0..INF, set at pre-compile, default-value=255  # Timeout in seconds to enable the controlled port in case MkaOnFailPermissiveMode is set to Timeout. Tags: atp.Status=draft
      integer MkaPaeIdx: 0..255, set at pre-compile, symbolic-name-value=true  # Instance ID of the configured PAE. Tags: atp.Status=draft
      reference MkaEthIfControllerRef: set at pre-compile, requires-symbolic-name-value=true, destination=EthIfController  # A reference to the EthIfController which is used for transmitting / receiving EAP frames (to configure the controlled port). Tags: atp.Status=draft
      reference MkaPaeConfRef: set at pre-compile, destination=MkaPaeConfiguration  # Reference to the applicable PAE configuration. Tags: atp.Status=draft
      reference MkaSwitchPortRef [0..1]: set at pre-compile, requires-symbolic-name-value=true, destination=EthSwtPort  # A reference to the EthSwtPort enabled and set only in case PAE is attached to a switch port. Tags: atp.Status=draft
      container MkaKay  # MKA instance (KaY) for a controlled port (PaE). Tags: atp.Status=draft
        integer MkaBypassEtherType [0..255]: 0..65535, set at pre-compile  # Bypassed EtherType. Tags: atp.Status=draft | The EtherTypes included will not be MACsec protected.
        integer MkaBypassVlan [0..255]: 0..4094, set at pre-compile  # Bypassed VLAN-ID. Tags: atp.Status=draft | The VLAN-IDs included will not be MACsec protected. (VLAN-ID 0 is interpreted as no-VLAN --> Bypass untagged traffic)
        string MkaDstMacAddress: set at pre-compile  # Destination MAC address to use by the MKA instance. Tags: atp.Status=draft | The destination MAC addresses to use are defined in the IEEE 802.1X-2020 chapter 11.1.1 (Table 11-1).
        integer MkaKeyServerPriority [0..1]: 0..255, set at pre-compile  # Key Server Priority of the MKA participants. In case it is not provided, the default value is 0 for an MKA_KEY_SERVER and 255 for an MKA_PEER. Tags: atp.Status=draft
        enumeration MkaRole: set at pre-compile  # Role of the MKA instance. Tags: atp.Status=draft
          MKA_KEY_SERVER  # Tags: atp.Status=draft
          MKA_PEER  # Tags: atp.Status=draft
        string MkaSrcMacAddress: set at pre-compile  # Source MAC address to use by the MKA instance. Tags: atp.Status=draft
        container MkaKayDemEventParameterRefs  # Container for the references to DemEventParameter elements which shall be invoked using the API Dem_SetEventStatus in case the corresponding error occurs. The EventId is taken from the referenced DemEventParameter's DemEventId symbolic value. The standardized errors are provided in this container and can be extended by vendor-specific error references. Tags: atp.Status=draft
          reference MKA_E_ALGO_MISMATCH_INSTANCE [0..1]: multiplicity set at pre-compile, set at pre-compile, requires-symbolic-name-value=true, destination=DemEventParameter  # Reference to the DemEventParameter which shall be issued when the MkaKay Instance does not successfully agree on MACsec keys and at least one MkaKayParticipant does not support a common MACsec cipher suite. Tags: atp.Status=draft
          reference MKA_E_KEY_MISMATCH_INSTANCE [0..1]: multiplicity set at pre-compile, set at pre-compile, requires-symbolic-name-value=true, destination=DemEventParameter  # Reference to the DemEventParameter which shall be issued when the MkaKay Instance does not successfully agree on MACsec keys and at least one exchange for this MkaKay Instance encounters an ICV validation failure. Tags: atp.Status=draft
          reference MKA_E_KEY_NOT_PRESENT_INSTANCE [0..1]: multiplicity set at pre-compile, set at pre-compile, requires-symbolic-name-value=true, destination=DemEventParameter  # Reference to the DemEventParameter which shall be issued when the MkaKay Instance does not successfully agree on MACsec keys and at least one of the keys (CAK) for this MkaKay Instance is not present. Tags: atp.Status=draft
          reference MKA_E_TIMEOUT_INSTANCE [0..1]: multiplicity set at pre-compile, set at pre-compile, requires-symbolic-name-value=true, destination=DemEventParameter  # Reference to the DemEventParameter which shall be issued when the MkaKay Instance does not successfully agree on MACsec keys and at least one exchange for this MkaKay Instance encounters a timeout. Tags: atp.Status=draft
        container MkaKayParticipant [1..255]  # MKA participant configuration. Tags: atp.Status=draft
          boolean MkaParticipantActivate: set at pre-compile, default-value=false  # Enabled/Disabled status of the MKA participant. Tags: atp.Status=draft | - True = The MKA Participant exchanges MKPDUs - False = The MKA participant does not exchange MKPDUs.
          reference MkaCryptoAlgoRef: set at pre-compile, destination=MkaCryptoAlgoConfig  # Reference to the cryptography to use (MkaAlgoConfiguration Container). Tags: atp.Status=draft
          reference MkaCryptoCknCakKeyRef: set at pre-compile, requires-symbolic-name-value=true, destination=CsmKey  # Reference to the CKN (min. 1 & max. 32 characters) assigned to the KaY Participant in the CSM. Tags: atp.Status=draft
          reference MkaCryptoHashKey128DerivationJobRef [0..1]: multiplicity set at pre-compile, set at pre-compile, requires-symbolic-name-value=true, destination=CsmJob  # Reference to a CsmEncrypt job for AES-128 cipher suites HashKey Derivation. Tags: atp.Status=draft
          reference MkaCryptoHashKey256DerivationJobRef [0..1]: multiplicity set at pre-compile, set at pre-compile, requires-symbolic-name-value=true, destination=CsmJob  # Reference to a CsmEncrypt job for AES-256 cipher suites HashKey Derivation Tags: atp.Status=draft
          reference MkaCryptoIckDeriveJobRef: set at pre-compile, requires-symbolic-name-value=true, destination=CsmJob  # Reference to a CSM job for ICK Derivation. Tags: atp.Status=draft
          reference MkaCryptoIcvGenerateJobRef: set at pre-compile, requires-symbolic-name-value=true, destination=CsmJob  # Reference to a CSM job for ICV generation (according to IEEE_802.x ICV is always 128 bits). Tags: atp.Status=draft
          reference MkaCryptoIcvVerifyJobRef: set at pre-compile, requires-symbolic-name-value=true, destination=CsmJob  # Reference to a CSM job for ICV verification (according to IEEE_802.x ICV is always 128 bits). Tags: atp.Status=draft
          reference MkaCryptoKekDeriveJobRef: set at pre-compile, requires-symbolic-name-value=true, destination=CsmJob  # Reference to a CSM job for KEK Derivation. Tags: atp.Status=draft | (Note: CAK needs to be set as the KEK Derive job CsmJobKeyRef )
          reference MkaCryptoKeyUnwrapJobRef: set at pre-compile, requires-symbolic-name-value=true, destination=CsmJob  # Reference to a CSM job for SAK unwrap (to perform the Decrypt part of RFC3394 ). Tags: atp.Status=draft
          reference MkaCryptoKeyWrapJobRef: set at pre-compile, requires-symbolic-name-value=true, destination=CsmJob  # Reference to a CSM job for SAK wrap (to perform the Encrypt part of RFC3394 ). Tags: atp.Status=draft
          reference MkaCryptoRandomJobRef: set at pre-compile, requires-symbolic-name-value=true, destination=CsmJob  # Reference to a CSM job for random number generation. Tags: atp.Status=draft
          reference MkaCryptoSakKeyRef: set at pre-compile, requires-symbolic-name-value=true, destination=CsmKey  # Reference to a CSM key where SAK shall be stored. Tags: atp.Status=draft
      container MkaPaeRxPdu  # PDU used for reception of Ethernet frames. Tags: atp.Status=draft
        integer MkaPaeRxPduId: 0..65535, scope=ECU, set at pre-compile, symbolic-name-value=true, with-auto=true  # The PDU identifier used for RxIndication from LSduR. Tags: atp.Status=draft
        reference MkaPaeRxPduRef: scope=ECU, set at pre-compile, destination=Pdu  # Reference to the global PDU. Tags: atp.Status=draft
      container MkaPaeTxPdu  # PDU used for transmission of Ethernet frames. Tags: atp.Status=draft
        integer MkaPaeTxPduId: 0..65535, scope=ECU, set at pre-compile, symbolic-name-value=true, with-auto=true  # The PDU identifier used for TxConfirmation from LSduR. Tags: atp.Status=draft
        reference MkaPaeTxPduRef: scope=ECU, set at pre-compile, destination=Pdu  # Reference to the global PDU. Tags: atp.Status=draft
