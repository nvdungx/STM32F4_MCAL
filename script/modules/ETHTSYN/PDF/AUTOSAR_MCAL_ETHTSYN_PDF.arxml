AUTOSAR XML (schema 00053)
package /AUTOSAR/EcucDefs
  ecuc definition collection AUTOSARParameterDefinition: module=EthTSyn
  module definition EthTSyn [0..1]: post-build-variant-support=true, variants pre-compile  # Configuration of the Synchronized Time-base Manager (StbM) module with respect to global time handling on Ethernet.
    container EthTSynGeneral  # This container holds the general parameters of the Ethernet-specific Synchronized Time-base Manager
      string EthTSynDestPhyAddr: set at pre-compile, default-value=01:80:C2:00:00:0E  # Destination Physical Address (MAC-Address). | Destination Physical Hardware Address (MAC-Address) of EthTSyn-gPTP Frames. Input format has to match xx:xx:xx:xx:xx:xx, where x stands for a hex value between 0 and F.
      boolean EthTSynDevErrorDetect: set at pre-compile, default-value=false  # Switches the development error detection and notification on or off. | * true: detection and notification is enabled. * false: detection and notification is disabled.
      boolean EthTSynEnableSecurityEventReporting: set at pre-compile, default-value=false  # Switches the reporting of security events to the IdsM: | - true: reporting is enabled. - false: reporting is disabled.
      float EthTSynGlobalTimeRxToUplinkSwitchResidenceTime [0..1]: 0..4, multiplicity set at pre-compile, set at pre-compile, default-value=0  # This parameter is specifying the default value used for the residence time of the Ethernet Switch [Ingress to Uplink]. | This value is used by the EthTSyn if the calculation of the residence time failed. Unit: seconds
      float EthTSynGlobalTimeUplinkToTxSwitchResidenceTime [0..1]: 0..4, multiplicity set at pre-compile, set at pre-compile, default-value=0  # This parameter is specifying the default value used for the residence time of the Ethernet Switch [Uplink to Egress]. | This value is used by the EthTSyn if the calculation of the residence time failed. Unit: seconds
      boolean EthTSynHardwareTimestampSupport: set at pre-compile  # Activate/Deactivate the hardware time stamping functionality of the Ethernet hardware. | True: Timestamp is retrieved from the Ethernet hardware False: Timestamp is retrieved from the StbM
      float EthTSynMainFunctionPeriod: 0..INF, set at pre-compile  # Schedule period of the main function EthTSyn_MainFunction. | Unit: seconds.
      boolean EthTSynMasterSlaveConflictDetection: set at pre-compile, default-value=false  # Enables master / slave conflict detection and notification. | * true: detection and notification is enabled. * false: detection and notification is disabled.
      integer EthTSynMaxNumberOfTransmitRetries: 0..20, set at pre-compile, default-value=0  # Provide the max number of re-transmission of frames in case of transmission failure(i.e., no buffer available or driver busy). A value of 0 will disable the retry mechanism. Tags: atp.Status=draft
      boolean EthTSynMessageCompliance: set at pre-compile  # * true: IEEE 802.1AS compliant message format will be used. | * false: IEEE 802.1AS message format with AUTOSAR extension will be used.
      integer EthTSynSwitchMgmtRxMessageBufferCount [0..1]: 1..254, multiplicity set at pre-compile, set at pre-compile, default-value=10  # This parameter is used to determine the amount of Rx message buffers available in the EthTSyn when EthTSyn is used in a Bridge configuration.
      boolean EthTSynTimeValidationSupport: set at pre-compile, default-value=false  # Switches support for time validation on or off. | * true: time validation is enabled. * false: time validation is disabled.
      boolean EthTSynVersionInfoApi: set at pre-compile, default-value=false  # Activate/Deactivate the version information API (EthTSyn_GetVersionInfo). True: version information API activated False: version information API deactivated.
      reference EthTSynEthIfFrameType: set at pre-compile, destination=EthIfFrameConfig  # The chosen frame owner determines which frames (in respect to ethertype) are received. Tags: atp.Status=draft
      container EthTSynSecurityEventRefs [0..1]: multiplicity set at pre-compile  # Container for the references to IdsMEvent elements representing the security events that the EthTSyn | module shall report to the IdsM in case the coresponding security related event occurs (and if EthTSynEnableSecurityEventReportings set to "true"). The standardized security events in this container can be extended by vendor-specific security events.
        reference SEV_TSYN_ETH_FRESHNESS_NOT_AVAILABLE [0..1]: multiplicity set at pre-compile, set at pre-compile, requires-symbolic-name-value=true, destination=IdsMEvent  # FV not available from FVM. Context data provides the respective domain ID.
        reference SEV_TSYN_ETH_ICV_GENERATION_FAILED [0..1]: multiplicity set at pre-compile, set at pre-compile, requires-symbolic-name-value=true, destination=IdsMEvent  # ICV generation for Follow_Up message failed. Context data provides the respective domain ID
        reference SEV_TSYN_ETH_ICV_VERIFICATION_FAILED [0..1]: multiplicity set at pre-compile, set at pre-compile, requires-symbolic-name-value=true, destination=IdsMEvent  # ICV verification for Follow_Up message failed. Context data provides the respective domain ID.
        reference SEV_TSYN_ETH_SYNC_FUP_SEQUENCE_ERROR [0..1]: multiplicity set at pre-compile, set at pre-compile, requires-symbolic-name-value=true, destination=IdsMEvent  # Failed to receive correct sequence of SYNC and Follow_Up from the TimeMaster within (EthTSynGlobalTimeFollowUpTimeout).
    container EthTSynGlobalTimeDomain [1..*]  # This represents the existence of a global time domain on Ethernet. The EthTSyn module can administrate several global time domains at the same time that in itself form a hierarchy of domains and sub-domains. | If the EthTSyn exists it is assumed that at least one global time domain exists.
      integer EthTSynFramePrio [0..1]: 0..7, multiplicity set at pre-compile, post-build-variant-multiplicity=true, post-build-variant-value=true, set at pre-compile  # This optional parameter, if present, indicates the priority of outgoing EthTSyn message (i.e., it equals the 3-bit PCP field of a tagged VLAN message). If a VLAN is not configured, this parameter is also not configured
      float EthTSynGlobalTimeDebounceTime [0..1]: 0..4, post-build-variant-value=true, set at pre-compile  # This represents the configuration of a TX debounce time for Sync, Follow_Up, and pDelay messages compared to a message before with the same PDU. Unit: seconds
      integer EthTSynGlobalTimeDomainId: 0..127, set at pre-compile  # The global time domain ID.
      float EthTSynGlobalTimeRxDebounceTime [0..1]: 0..4, multiplicity set at pre-compile, post-build-variant-value=true, set at pre-compile  # This represents the configuration of a RX debounce time for Sync and Follow_Up. Unit: seconds
      reference EthTSynClkUnitRef [0..1]: scope=ECU, multiplicity set at pre-compile, set at pre-compile, requires-symbolic-name-value=true, destination=EthIfClkUnit  # Reference to a HW clock unit in the Ethernet controller. Tags: atp.Status=draft
      reference EthTSynGlobalTimeEthIfRef [0..*]: set at pre-compile, requires-symbolic-name-value=true, destination=EthIfController  # This represents the reference to the Ethernet interface taken to fetch the global time information.
      reference EthTSynSynchronizedTimeBaseRef: set at pre-compile, requires-symbolic-name-value=true, destination=StbMSynchronizedTimeBase  # Mandatory reference to the required synchronized time-base.
      container EthTSynGlobalTimeFollowUpDataIDList [0..1]: multiplicity set at pre-compile, post-build-variant-multiplicity=true  # The DataIDList for Follow_Up message ensures the identification of data elements due to CRC calculation and message authentication process.
        container EthTSynGlobalTimeFollowUpDataIDListElement [16..16]  # Element of the DataIDList for Follow_Up message ensures the identification of data elements due to CRC calculation and message authentication process.
          integer EthTSynGlobalTimeFollowUpDataIDListIndex: 0..15, post-build-variant-value=true, set at pre-compile  # Index of the DataIDList for Follow_Up message ensures the identification of data elements due to CRC calculation and message authentication process.
          integer EthTSynGlobalTimeFollowUpDataIDListValue: 0..255, post-build-variant-value=true, set at pre-compile  # Value of the DataIDList for Follow_Up message ensures the identification of data elements due to CRC calculation and message authentication process.
      container EthTSynPortConfig [0..*]: multiplicity set at pre-compile, post-build-variant-multiplicity=true  # Configuration of the EthTSyn-Ports within the TimeDomain.
        boolean EthTSynEnableTimeValidation: set at pre-compile, default-value=false  # Enables/disables time recording for time validation for a specific Time Domain.
        enumeration EthTSynGlobalTimePortRole [0..1]: {DYNAMIC, TIME_MASTER, TIME_SLAVE}, post-build-variant-value=true, set at pre-compile, default-value=DYNAMIC  # Parameter to set the port behavior to Time Slave, Time Master or Dynamic (Time Slave or Time Master at runtime).
        float EthTSynGlobalTimeTxPeriod [0..1]: 0..INF, post-build-variant-value=true, set at pre-compile  # This represents configuration of the TX period. Unit: seconds
        reference EthTSynSwitchManagementEthSwitchPortRef [0..1]: multiplicity set at pre-compile, set at pre-compile, requires-symbolic-name-value=true, destination=EthSwtPort  # In an AVB-Bridge config, this reference is used to assign the EthTSyn-Port to an Ethernet Switch-Port.
        container EthTSynGlobalTimeRxIcvVerification [0..1]: multiplicity set at pre-compile  # This container collects configuration that shall be used for ICV verification.
          integer EthTSynIcvRxLength: 0..1061, set at pre-compile  # Length of ICV to be transmitted within Follow_Up Message on the bus (in bytes).
          integer EthTSynIcvVerificationAttempts: 0..65535, set at pre-compile, default-value=0  # This parameter specifies the number of ICV verification attempts that are to be carried out when the verification of the ICV failed for a given secured Follow_Up message. If zero is set, then only one ICV verification attempt is done.
          enumeration EthTSynIcvVerificationBase: {ICV_MAC, ICV_SIGNATURE}, set at pre-compile  # Symmetric or asymmetric cryptography selection for the ICV generation
          float EthTSynIcvVerificationTimeout: 0..INF, set at pre-compile  # Timeout of ICV verification (respective CSM job completion in asynchronous behavior). A value of 0 disables the ICV timeout monitoring. Unit: Seconds
          integer EthTSynRxAuthenticationBuildAttempts: 0..65535, set at pre-compile, default-value=0  # This parameter specifies the number of authentication build attempts that are to be carried out when the verification of the ICV failed for a given Follow_Up message. If zero is set, then only one ICV verification attempt is done.
          reference EthTSynIcvVerificationFvIdRef [0..1]: multiplicity set at pre-compile, set at pre-compile, requires-symbolic-name-value=true, destination=StbMFreshnessValue  # This represents the reference to the FV taken to verify the ICV.
          reference EthTSynIcvVerificationJobRef: set at pre-compile, requires-symbolic-name-value=true, destination=CsmJob  # This represents the reference to the CSM job to fetch the CSM job ID.
        container EthTSynGlobalTimeTxIcvGeneration [0..1]: multiplicity set at pre-compile  # This container collects configuration that shall be used for ICV generation.
          enumeration EthTSynIcvGenerationBase: {ICV_MAC, ICV_SIGNATURE}, set at pre-compile  # Symmetric or asymmetric cryptography selection for the ICV generation
          float EthTSynIcvGenerationTimeout: 0..INF, set at pre-compile  # Timeout of ICV generation (respective CSM job completion in asynchronous behaviour). A value of 0 disables the ICV timeout monitoring. Unit: Seconds
          integer EthTSynIcvTxLength: 0..1061, set at pre-compile  # Length of ICV to be transmitted within Follow_Up Message on the bus (in bytes).
          integer EthTSynTxAuthenticationBuildAttempts: 0..65535, set at pre-compile, default-value=0  # This parameter specifies the number of authentication build attempts that are to be carried out when the generation of the ICV failed for a given Follow_Up message. If zero is set, then only one ICV generation attempt is done.
          reference EthTSynIcvGenerationFvIdRef [0..1]: multiplicity set at pre-compile, set at pre-compile, requires-symbolic-name-value=true, destination=StbMFreshnessValue  # This represents the reference to the FV taken to generate the ICV generation.
          reference EthTSynIcvGenerationJobRef: set at pre-compile, requires-symbolic-name-value=true, destination=CsmJob  # This represents the reference to the CSM job to fetch the CSM job ID.
        container EthTSynPdelayConfig: multiplicity set at pre-compile, post-build-variant-multiplicity=true  # Configuration of cyclic propagation delay measurement.
          boolean EthTSynGlobalTimePdelayRespEnable: post-build-variant-value=true, set at pre-compile, default-value=true  # This parameter allows disabling Pdelay_Resp / Pdelay_Resp_Follow_Up transmission, if no Pdelay_Req messages are expected. | FALSE: No Pdelay requests expected. Pdelay_Resp / Pdelay_Resp_Follow_Up transmission is disabled. TRUE: Pdelay requests expected. Pdelay_Resp / Pdelay_Resp_Follow_Up transmission is enabled.
          float EthTSynGlobalTimePropagationDelay: 0..4, post-build-variant-value=true, set at pre-compile, default-value=0  # If cyclic propagation delay measurement is enabled, this parameter represents the default value of the propagation delay until the first actually measured propagation delay is available. | If cyclic propagation delay measurement is disabled, this parameter replaces a measured propagation delay by a fixed value. Unit: seconds
          float EthTSynGlobalTimeTxPdelayReqPeriod: 0..4, post-build-variant-value=true, set at pre-compile, default-value=0  # This represents configuration of the TX period for Pdelay_Req messages. | A value of 0 disables the cyclic Pdelay measurement. Unit: seconds
          float EthTSynPdelayLatencyThreshold [0..1]: 0..INF, post-build-variant-value=true, set at pre-compile, default-value=1E-5  # Threshold for calculated Pdelay. If a measured Pdelay exceeds EthTSynPdelayLatencyThreshold, this value is discarded. | Unit: seconds
          float EthTSynPdelayRespAndRespFollowUpTimeout: 0..4, post-build-variant-value=true, set at pre-compile  # Timeout value for Pdelay_Resp and Pdelay_Resp_Follow_Up after a Pdelay_Req has been transmitted resp. a Pdelay_Resp has been received. | A value of 0 deactivates this timeout observation. Unit: seconds
          boolean EthTSynRateRatioEnable: scope=ECU, post-build-variant-value=true, set at pre-compile  # Enables/disables neighbor rate ratio calculation according to IEEE 802.1AS. Tags: atp.Status=draft
          integer EthTSynRateRatioMeasurementCount: 1..255, post-build-variant-value=true, set at pre-compile  # This parameter defines the number of successful pDelay measurements used to calculate the neighbor rate ratio according to IEEE 802.1AS. Tags: atp.Status=draft
        container EthTSynRxPdu [0..1]: multiplicity set at pre-compile  # PDU used for reception. Tags: atp.Status=draft | Supported MetaData entry: TIMETUPLE_TYPE_PTR
          integer EthTSynRxPduId: 0..65535, scope=ECU, set at pre-compile, symbolic-name-value=true, with-auto=true  # PDU identifier used for RxIndication from LSduR. Tags: atp.Status=draft
          reference EthTSynRxPduRef: scope=ECU, set at pre-compile, destination=Pdu  # Reference to the Pdu object representing the PDU. Tags: atp.Status=draft
        container EthTSynTxPdu [0..1]: multiplicity set at pre-compile  # PDU used for transmission. Tags: atp.Status=draft
          integer EthTSynTxPduId: 0..65535, scope=ECU, set at pre-compile, symbolic-name-value=true, with-auto=true  # PDU identifier used for TxConfirmation from LSduR. Tags: atp.Status=draft
          reference EthTSynTxPduRef: scope=ECU, set at pre-compile, destination=Pdu  # Reference to the Pdu object representing the PDU. Tags: atp.Status=draft
      choice container EthTSynPortRole [0..1]: multiplicity set at pre-compile, post-build-variant-multiplicity=true  # Specifying the Role of the EthTSyn-Port (Master or Slave).
        container EthTSynGlobalTimeMaster [0..1]: multiplicity set at pre-compile, post-build-variant-multiplicity=true  # Configuration of a (global) time master. Each time domain is required to have exactly one global time master, but may have multiple ports acting as time (sub-) master (see Time Gateway) to relay global time from the global time master to the time slaves. The global time master may or may not exist on the configured ECU. The exact role of the port is derived implicitly.
          float EthTSynCyclicMsgResumeTime: 0..INF, post-build-variant-value=true, set at pre-compile  # Defines the time where the 1st regular cycle time based message transmission takes place, after an immediate transmission before. Unit: seconds
          enumeration EthTSynGlobalTimeTxCrcSecured: {CRC_NOT_SUPPORTED, CRC_SUPPORTED}, post-build-variant-value=true, set at pre-compile  # This represents the configuration of whether or not CRC is supported.
          float EthTSynHoldOverTime [0..1]: 0..INF, multiplicity set at pre-compile, post-build-variant-multiplicity=true, post-build-variant-value=true, set at pre-compile, default-value=3  # Parameter to define timeout for transmission of Sync and Follow_Up messages on Master ports in absence of reception of Sync and Follow_Up messages on Slave port.Unit: seconds
          boolean EthTSynImmediateTimeSync: post-build-variant-value=true, set at pre-compile  # Enables/Disables the cyclic polling of StbM_GetTimeBaseUpdateCounter() within EthTSyn_MainFunction().
          boolean EthTSynTLVFollowUpICVSubTLV: set at pre-compile  # This represents the configuration of whether an AUTOSAR Follow_Up ICV Sub-TLV is used or not. | - true: This represents a configuration where an AUTOSAR Follow_Up ICV Sub-TLV is used. - false: This represents a configuration where an AUTOSAR Follow_Up ICV Sub-TLV is not used.
          boolean EthTSynTxSubTLVStatus: post-build-variant-value=true, set at pre-compile  # Definition of whether (true) or not (false) a Sub-TLV:Status Secured or Sub-TLV:Status Not Secured shall be sent in the AUTOSAR TLV of a Follow_Up message.
          boolean EthTSynTxSubTLVTime: post-build-variant-value=true, set at pre-compile  # Definition of whether (true) or not (false) a Sub-TLV:Time Secured shall be sent in the AUTOSAR TLV of a Follow_Up message.
          boolean EthTSynTxSubTLVUserData: post-build-variant-value=true, set at pre-compile  # Definition of whether (true) or not (false) a Sub-TLV:UserData Secured or Sub-TLV:UserData Not Secured shall be sent in the AUTOSAR TLV of a Follow_Up message.
          container EthTSynCrcTimeFlagsTxSecured [0..1]: multiplicity set at pre-compile, post-build-variant-multiplicity=true  # This container collects definitions which parts of the Follow_Up message elements shall be used for CRC calculation.
            boolean EthTSynCrcCorrectionField: post-build-variant-value=true, set at pre-compile, default-value=false  # correctionField from the Follow_Up Message Header shall be included in CRC calculation.
            boolean EthTSynCrcDomainNumber: post-build-variant-value=true, set at pre-compile, default-value=false  # domainNumber from the Follow_Up Message Header shall be included in CRC calculation.
            boolean EthTSynCrcMessageLength: post-build-variant-value=true, set at pre-compile, default-value=false  # messageLength from the Follow_Up Message Header shall be included in CRC calculation.
            boolean EthTSynCrcPreciseOriginTimestamp: post-build-variant-value=true, set at pre-compile, default-value=true  # preciseOriginTimestamp from the Follow_Up Message Field shall be included in CRC calculation.
            boolean EthTSynCrcSequenceId: post-build-variant-value=true, set at pre-compile, default-value=false  # sequenceId from the Follow_Up Message Header shall be included in CRC calculation.
            boolean EthTSynCrcSourcePortIdentity: post-build-variant-value=true, set at pre-compile, default-value=false  # sourcePortIdentity from the Follow_Up Message Header shall be included in CRC calculation.
        container EthTSynGlobalTimeSlave [0..1]: multiplicity set at pre-compile, post-build-variant-multiplicity=true  # Configuration of a time slave. Each global time domain is required to have at least one time slave. The configured ECU may or may not represent a time slave.
          float EthTSynGlobalTimeFollowUpTimeout: 0..4, post-build-variant-value=true, set at pre-compile  # Timeout value of the Follow_Up message (of the subsequent Sync message). | A value of 0 deactivates this timeout observation. Unit: seconds
          integer EthTSynGlobalTimeSequenceCounterHysteresis: 0..15, post-build-variant-value=true, set at pre-compile, default-value=0  # EthTSynGlobalTimeSequenceCounterHysteresis specifies the number of consecutive valid message pairs that are required by the Time Slave while being in Timeout state until a Time Tuple is forwarded to the StbM.
          integer EthTSynGlobalTimeSequenceCounterJumpWidth: 0..65535, post-build-variant-value=true, set at pre-compile, default-value=0  # The SequenceCounterJumpWidth specifies the maximum allowed jump of the Sequence Counter between two consecutive Sync messages.
          enumeration EthTSynRxCrcValidated: {CRC_IGNORED, CRC_NOT_VALIDATED, CRC_OPTIONAL, CRC_VALIDATED}, post-build-variant-value=true, set at pre-compile  # Definition of whether or not validation of the CRC takes place.
          enumeration EthTSynRxIcvVerificationType: {ICV_IGNORED, ICV_NOT_VERIFIED, ICV_OPTIONAL, ICV_VERIFIED}, set at pre-compile  # This parameter controls whether or not ICV verification shall be supported.
          boolean EthTSynRxSubTLVStatus: multiplicity set at pre-compile, set at pre-compile, default-value=false  # Definition of whether or not a Sub-TLV:Status Secured or Sub-TLV:Status Not Secured shall be present and shall be evaluated when processing a received Follow_Up message.
          boolean EthTSynRxSubTLVTime: multiplicity set at pre-compile, set at pre-compile, default-value=false  # Definition of whether or not a Sub-TLV:Time Secured shall be present and shall be evaluated when processing a received Follow_Up message
          boolean EthTSynRxSubTLVUserData: multiplicity set at pre-compile, set at pre-compile, default-value=false  # Definition of whether or not a Sub-TLV:UserData Secured or Sub-TLV:UserData Not Secured shall be present and shall be evaluated when processing a received Follow_Up message
          container EthTSynCrcFlagsRxValidated [0..1]: multiplicity set at pre-compile, post-build-variant-multiplicity=true  # This container collects definitions which parts of the Follow_Up message elements shall be included in CRC validation.
            boolean EthTSynCrcCorrectionField: post-build-variant-value=true, set at pre-compile, default-value=false  # correctionField from the Follow_Up Message Header shall be included in CRC calculation.
            boolean EthTSynCrcDomainNumber: post-build-variant-value=true, set at pre-compile, default-value=false  # domainNumber from the Follow_Up Message Header shall be included in CRC calculation.
            boolean EthTSynCrcMessageLength: post-build-variant-value=true, set at pre-compile, default-value=false  # messageLength from the Follow_Up Message Header shall be included in CRC calculation.
            boolean EthTSynCrcPreciseOriginTimestamp: post-build-variant-value=true, set at pre-compile, default-value=true  # preciseOriginTimestamp from the Follow_Up Message Field shall be included in CRC calculation.
            boolean EthTSynCrcSequenceId: post-build-variant-value=true, set at pre-compile, default-value=false  # sequenceId from the Follow_Up Message Header shall be included in CRC calculation.
            boolean EthTSynCrcSourcePortIdentity: post-build-variant-value=true, set at pre-compile, default-value=false  # sourcePortIdentity from the Follow_Up Message Header shall be included in CRC calculation.
