AUTOSAR XML (schema 00046)
package /AUTOSAR/EcucDefs
  ecuc definition collection AUTOSARParameterDefinition: module=HTTMS
  module definition HTTMS [0..1]: variants pre-compile  # Configuration of the Hardware Test Management start up and shutdown (HTMSS) module.
    container HTTMSSConfigSet [1..*]  # This is the base container that contains the configuration parameters & sub containers of HTMSS module.
    container HTTMSSGeneral  # This container holds the general parameters of the HTMSS module.
      boolean HTMSSDevErrorDetect: set at pre-compile, default-value=false  # Switch for enabling the DET.
      boolean HTMSSVersionInfoApi: set at pre-compile, default-value=false  # Activate/Deactivate the version information API.
