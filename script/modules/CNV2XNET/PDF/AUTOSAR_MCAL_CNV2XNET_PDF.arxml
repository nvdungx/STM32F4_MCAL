AUTOSAR XML (schema 00053)
package /AUTOSAR/EcucDefs
  ecuc definition collection AUTOSARParameterDefinition: module=CnV2xNet
  module definition CnV2xNet [0..1]: variants pre-compile  # Configuration of the CnV2xNet module. Tags: atp.Status=draft
    container CnV2xNetConfig  # This container contains the configuration parameters and sub containers of the CnV2xNet module. Tags: atp.Status=draft
      integer CnV2xNetDSMPprotocolVersion: 0..7, set at pre-compile, default-value=0  # DSMP protocol version as defined in chapter 4.3.3.1 [13] Tags: atp.Status=draft
      integer CnV2xNetDSMPSduSize: 0..65535, set at pre-compile, default-value=65535  # Maximum size of DSMP-SDU in [Byte] Tags: atp.Status=draft
      reference CnV2xNetEthIfRef: set at pre-compile, requires-symbolic-name-value=true, destination=EthIfController  # This is represents the reference to the Ethernet interface taken to transmit the C-V2X packets to. Tags: atp.Status=draft
      container CnV2xNetRxPdu  # Represents the received PDU. This PDU is usually linked to the EthIf via LSduR. It consumes meta data items of the types BROADCAST_8 and ETHERNET_MAC_64. Tags: atp.Status=draft
        integer CnV2xNetRxPduId: 0..65535, scope=ECU, set at pre-compile, symbolic-name-value=true, with-auto=true, default-value=0  # PDU identifier used for RxIndication from LSduR. Tags: atp.Status=draft
        reference CnV2xNetRxPduRef: scope=ECU, set at pre-compile, destination=Pdu  # Reference to the global PDU. Tags: atp.Status=draft
      container CnV2xNetTxPdu  # Represents the transmitted PDU. This PDU is usually linked to the EthIf via LSduR. It produces meta data items of the type ETHERNET_MAC_64. Tags: atp.Status=draft
        integer CnV2xNetTxPduId: 0..65535, scope=ECU, set at pre-compile, symbolic-name-value=true, with-auto=true, default-value=0  # PDU identifier used for TxConfirmation from LSduR. Tags: atp.Status=draft
        reference CnV2xNetTxPduRef: scope=ECU, set at pre-compile, destination=Pdu  # Reference to the global PDU. Tags: atp.Status=draft
    container CnV2xNetGeneral  # This container contains the configuration parameters of the BSW module CnV2xNet. Tags: atp.Status=draft
      boolean CnV2xNetDevErrorDetect: set at pre-compile, default-value=false  # Switches the Default Error Tracer (Det) detection and notification ON or OFF. Tags: atp.Status=draft | - true: enabled (ON) - false: disabled (OFF)
      float CnV2xNetMainFunctionPeriod: 0..1, set at pre-compile, default-value=0.1  # This parameter defines the schedule period of CnV2xNet_BsmBs_MainFunction.Unit:[s] Tags: atp.Status=draft
      boolean CnV2xNetTxConfirmation: set at pre-compile, default-value=false  # When enabled, transmission status information will be forwarded to the upper layer. Tags: atp.Status=draft | - true: enabled (ON) - false: disabled (OFF)
      boolean CnV2xNetVersionInfoApi: set at pre-compile, default-value=false  # Enable/disables the API for reading the version information of the CnV2xNet Module. Tags: atp.Status=draft | - true: enabled (ON) - false: disabled (OFF)
