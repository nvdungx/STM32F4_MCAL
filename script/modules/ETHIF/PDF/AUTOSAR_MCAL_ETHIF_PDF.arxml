AUTOSAR XML (schema 00053)
package /AUTOSAR/EcucDefs
  ecuc definition collection AUTOSARParameterDefinition: module=EthIf
  module definition EthIf [0..1]: post-build-variant-support=true, variants link-time/post-build/pre-compile  # Configuration of the EthIf (Ethernet Interface) module.
    container EthIfConfigSet  # Collecting container for all parameters with post-build configuration classes.
      container EthIfController [1..*]  # This container contains the configuration of EthIfController.
        integer EthIfCtrlIdx: 0..255, scope=ECU, set at pre-compile, symbolic-name-value=true, with-auto=true  # This parameter provides a zero-based consecutive index of the Ethernet Communication Controllers. Upper layer BSW modules and the EthIf itself use this index to identify a Ethernet CC.
        integer EthIfCtrlMtu: 64..9000, scope=ECU, post-build-variant-value=true, set at link in variant link-time / post-build in variant post-build / pre-compile in variant pre-compile  # Specifies the maximum transmission unit (MTU) of the EthIfCtrl in [bytes]. | Note: In case a VLAN tag is used for the EthIfCtrl, the frame length of the Ethernet frame will increase by 4 bytes.
        enumeration EthIfMacSecSupport [0..1]: multiplicity set at link in variant link-time / post-build in variant post-build / pre-compile in variant pre-compile, post-build-variant-multiplicity=true, post-build-variant-value=true, set at link in variant link-time / post-build in variant post-build / pre-compile in variant pre-compile, default-value=NO_MACSEC  # MACsec support of the ethernet interface controller. Tags: atp.Status=draft
          HW_MACSEC  # Tags: atp.Status=draft
          NO_MACSEC  # Tags: atp.Status=draft
          SW_MACSEC  # Tags: atp.Status=draft
        integer EthIfMaxTxBufsTotal: 1..4294967295, set at pre-compile  # Limits the total number of transmit buffers.
        integer EthIfVlanId [0..1]: 0..4095, scope=ECU, multiplicity set at link in variant link-time / post-build in variant post-build / pre-compile in variant pre-compile, post-build-variant-multiplicity=true, post-build-variant-value=true, set at link in variant link-time / post-build in variant post-build / pre-compile in variant pre-compile  # A virtual-LAN is identified by this attribute according to IEEE 802.1Q.
        reference EthIfEthTrcvRef [0..1]: scope=ECU, multiplicity set at link in variant link-time / post-build in variant post-build / pre-compile in variant pre-compile, post-build-variant-multiplicity=true, post-build-variant-value=true, set at link in variant link-time / post-build in variant post-build / pre-compile in variant pre-compile, requires-symbolic-name-value=true, destination=EthIfTransceiver  # Reference to an Ethernet transceiver, which is handled by the Ethernet Interface.
        reference EthIfPaeInstanceRef [0..254]: multiplicity set at link in variant link-time / post-build in variant post-build / pre-compile in variant pre-compile, post-build-variant-multiplicity=true, post-build-variant-value=true, set at link in variant link-time / post-build in variant post-build / pre-compile in variant pre-compile, requires-symbolic-name-value=true, destination=MkaPaeInstance  # Reference to MkaPaeInstance Tags: atp.Status=draft
        reference EthIfPhysControllerRef: scope=ECU, post-build-variant-value=true, set at link in variant link-time / post-build in variant post-build / pre-compile in variant pre-compile, requires-symbolic-name-value=true, destination=EthIfPhysController  # Reference to a physical Ethernet controller, which is handled by the Ethernet Interface.
        choice reference EthIfSwitchRefOrPortGroupRef [0..1]: multiplicity set at link in variant link-time / post-build in variant post-build / pre-compile in variant pre-compile, post-build-variant-multiplicity=true, post-build-variant-value=true, set at link in variant link-time / post-build in variant post-build / pre-compile in variant pre-compile, destination=[EthIfSwitch, EthIfSwitchPortGroup]  # The choice reference allows to configure that the EthIfController either references an EthIfSwitch or an EthIfSwitchPortGroup. | In case EhIfSwitchPortGroups are controlled by the BswM (e,g, according particular PNC requests), then EthIfSwitchPortGroupRefSemantics shall have the value ETHIF_SWITCH_PORT_GROUP_LINK_INFO. In case EhIfSwitchPortGroups are controlled by the EhtIfController, then EthIfSwitchPortGroupRefSemantics shall have the value ETHIF_SWITCH_PORT_GROUP_CONTROL.
      container EthIfFrameConfig [1..*]: multiplicity set at pre-compile  # Configuration of an Ethernet frame. Tags: atp.Status=draft
        integer EthIfFrameType: 0..65535, post-build-variant-value=true, set at link in variant link-time / post-build in variant post-build / pre-compile in variant pre-compile  # Selects the Ethernet frame type. Tags: atp.Status=draft
        container EthIfFrameRxPool [0..*]: multiplicity set at pre-compile  # Pool of Rx PDUs for the upper layer modules. Tags: atp.Status=draft | Several container instances can be defined for different EthIfControllers.
          reference EthIfFrameRxControllerRef [0..1]: multiplicity set at pre-compile, post-build-variant-value=true, set at link in variant link-time / post-build in variant post-build / pre-compile in variant pre-compile, destination=EthIfController  # Optional reference to an EthIfController. If this reference is defined then only messages to/from that EthIfController are assigned to the Pdu. Tags: atp.Status=draft | With this setup it is possible to define VLAN specific PDUs for dedicated EtherTypes.
          container EthIfFrameRxPdu [0..*]: multiplicity set at pre-compile  # PDU in the EthIfFrameRxPool to be used for the transport of a the corresponding Ethernet frame. Tags: atp.Status=draft | Supported MetaDataItemTypes: * TIMETUPLE_TYPE_PTR * ETHERNET_MAC_64 * BROADCAST_8
            integer EthIfFrameRxPduId: 0..65535, scope=ECU, post-build-variant-value=true, set at link in variant link-time / post-build in variant post-build / pre-compile in variant pre-compile, symbolic-name-value=true, with-auto=true  # PDU ID used by the upper layer module to indicated completed asynchronous reception of the corresponding Ethernet frame. Tags: atp.Status=draft
            reference EthIfFrameRxPduRef: scope=ECU, post-build-variant-value=true, set at link in variant link-time / post-build in variant post-build / pre-compile in variant pre-compile, destination=Pdu  # Reference to the global PDU representing the Ethernet frame to the upper layer module. Tags: atp.Status=draft
        container EthIfFrameTxPool [0..*]: multiplicity set at pre-compile  # Pool of Tx PDUs for the upper layer modules. Tags: atp.Status=draft | Several container instances can be defined for different EthIfControllers or with different EthIfFrameTxPriority.
          integer EthIfFrameTxPriority [0..1]: 0..7, multiplicity set at pre-compile, set at pre-compile  # Definition of a fixed VLAN priority of the pool. Tags: atp.Status=draft | This priority shall only be configured if the EthIfController referenced by this EthIfFrameTxPool has a EthIfVlanId. If this parameter is configured, the TxPdus of this pool shall not use MetaDataItems of type PRIORITY_8.
          reference EthIfFrameTxControllerRef [0..1]: multiplicity set at pre-compile, post-build-variant-value=true, set at link in variant link-time / post-build in variant post-build / pre-compile in variant pre-compile, destination=EthIfController  # Optional reference to an EthIfController. If this reference is defined then only messages to/from that EthIfController are assigned to the Pdu. Tags: atp.Status=draft | With this setup it is possible to define VLAN specific PDUs for dedicated EtherTypes.
          container EthIfFrameTxPdu [0..*]: multiplicity set at pre-compile  # PDU in the EthIfFrameTxPool to be used for the transport of the corresponding Ethernet frame. Tags: atp.Status=draft | Supported MetaDataItemTypes: * ETHERNET_MAC_64 * TIMETUPLE_TYPE_PTR * LISTELEM_PTR * PRIORITY_8
            integer EthIfFrameTxPduId: 0..65535, scope=ECU, post-build-variant-value=true, set at link in variant link-time / post-build in variant post-build / pre-compile in variant pre-compile, symbolic-name-value=true, with-auto=true  # PDU ID used by the upper layer module to transmit the corresponding Ethernet frame. Tags: atp.Status=draft
            reference EthIfFrameTxPduRef: scope=ECU, post-build-variant-value=true, set at link in variant link-time / post-build in variant post-build / pre-compile in variant pre-compile, destination=Pdu  # Reference to the global PDU representing the Ethernet frame to the upper layer module. Tags: atp.Status=draft
      container EthIfPhysController [1..*]  # This container contains the configuration of EthIfPhysController. | The usage of EthIfEthCtrlRef, EthIfCanXLCtrlRef, and EthIfWEthCtrlRef and EthIfCV2xCtrlRef is exclusive OR.
        integer EthIfPhysControllerIdx: 0..255, scope=ECU, set at pre-compile, symbolic-name-value=true, with-auto=true  # This parameter provides a zero-based consecutive index of the physical Ethernet controllers. Upper layer BSW modules and the Ethernet Interface itself use this index to identify a physical Ethernet controller.
        reference EthIfCanXLCtrlRef [0..1]: scope=ECU, multiplicity set at pre-compile, set at pre-compile, requires-symbolic-name-value=true, destination=CanController  # Reference to a physical CAN XL controller which is handled by a specific CAN XL driver.
        reference EthIfCV2xCtrlRef [0..1]: scope=ECU, multiplicity set at link in variant link-time / post-build in variant post-build / pre-compile in variant pre-compile, post-build-variant-multiplicity=true, post-build-variant-value=true, set at link in variant link-time / post-build in variant post-build / pre-compile in variant pre-compile, requires-symbolic-name-value=true, destination=CV2xCtrlConfig  # Reference to physical Cellular V2X controller, which is handled by a specific Cellular V2X controller driver Tags: atp.Status=draft
        reference EthIfEthCtrlRef [0..1]: scope=ECU, post-build-variant-value=true, set at link in variant link-time / post-build in variant post-build / pre-compile in variant pre-compile, requires-symbolic-name-value=true, destination=EthCtrlConfig  # Reference to a physical Ethernet controller, which is handled by a specific Ethernet controller driver.
        reference EthIfWEthCtrlRef [0..1]: scope=ECU, post-build-variant-value=true, set at link in variant link-time / post-build in variant post-build / pre-compile in variant pre-compile, requires-symbolic-name-value=true, destination=WEthCtrlConfig  # Reference to a physical Wireless Ethernet controller, which is handled by a specific Wireless Ethernet controller driver.
        container EthIfClkUnit [0..*]: multiplicity set at pre-compile  # This container contains the configuration of a HW clock unit in an Ethernet Controller. Tags: atp.Status=draft
          integer EthIfClkUnitIdx: 0..255, scope=ECU, set at pre-compile, symbolic-name-value=true  # Zero-based consecutive index of the HW clock units in the Ethernet Controller. Upper layer BSW modules and the Eth itself use this index to identify a clock in the Ethernet Controller. Tags: atp.Status=draft
          reference EthIfClkUnitRef: scope=ECU, set at pre-compile, requires-symbolic-name-value=true, destination=EthClkUnit  # Reference to a HW clock unit which is provided by the Ethernet controller for ingress/egrees timestamping of frames and optionally to follow PTP time. Tags: atp.Status=draft
        container EthIfPhysCtrlRxMainFunctionIngressQueueProcessing [0..*]: multiplicity set at pre-compile  # The function checks for new received Ethernet frames at the related Ethernet controller and the related ingress queue referenced via EthIfPhysCtrlRxIngressQueueRef, or at the related CanXL controller and the related ingress FIFO referenced via EthIfCanXLCtrlRxIngressFifoRef. Tags: atp.Status=draft | In case of Ethernet controller calling Eth_Receive() with the respective QueueIdx. In case of CanXL controller calling CanXL_Receive() with the respective FifoIdx.
          integer EthIfPhysCtrlRxIndicationIterations: 0..18446744073709551615, set at pre-compile  # Max number of Ethernet frames polled per main function invocation.
          float EthIfPhysCtrlRxMainFunctionPeriod: set at pre-compile  # Specifies the period of main function in seconds.
          reference EthIfCanXLCtrlRxIngressFifoRef [0..1]: multiplicity set at pre-compile, set at pre-compile, requires-symbolic-name-value=true, destination=CanXLEthIngressFifo  # Reference to the reception FIFO.
          reference EthIfPhysCtrlRxIngressFifoRef [0..1]: multiplicity set at pre-compile, set at pre-compile, requires-symbolic-name-value=true, destination=EthCtrlConfigIngressFifo  # Reference to the reception FIFO. Tags: atp.Status=obsolete
          reference EthIfPhysCtrlRxIngressQueueRef [0..1]: multiplicity set at pre-compile, set at pre-compile, requires-symbolic-name-value=true, destination=EthCtrlConfigIngressQueue  # Reference to the ingress Queue. Tags: atp.Status=draft
      container EthIfRxIndicationConfig [1..*]  # Configuration of receive callback functions.
        function name EthIfRxIndicationFunction: post-build-variant-value=true, set at link in variant link-time / post-build in variant post-build / pre-compile in variant pre-compile  # Specifies receive indication callback function.
      container EthIfSwitch [0..*]  # This container contains the configuration of EthIfSwitches.
        integer EthIfSwitchIdx: 0..255, scope=ECU, set at pre-compile, symbolic-name-value=true, with-auto=true  # This parameter provides a zero-based consecutive index of the Ethernet Interface Switches. Upper layer BSW modules and the EthIf itself use this index to identify a Ethernet Switch.
        reference EthIfSwitchRef: scope=ECU, post-build-variant-value=true, set at link in variant link-time / post-build in variant post-build / pre-compile in variant pre-compile, requires-symbolic-name-value=true, destination=EthSwtConfig  # Reference to a Ethernet Switch, which is handled by a specific Ethernet Switch driver.
      container EthIfSwitchPortGroup [0..*]  # This container contains the configuration of EthIfSwitchPortGroups. | If EthIfSwitchPortGroups are controlled by PNC one EthIfSwitchPortGroup per PNC shall exist. The host port shall be part of all EthIfSwitchPortGroups. The up link port of a master switch and the up link port of the slave switch shall be part of all EthIfSwitchPortGroups that contain EthSwtPorts belonging to the slave switch.
        integer EthIfSwitchPortGroupIdx: 0..255, scope=ECU, set at pre-compile, symbolic-name-value=true, with-auto=true  # This parameter provides a zero-based consecutive index of the Ethernet Switch Port Groups. Upper layer BSW modules and the EthIf itself use this index to identify an Ethernet Switch Port Group.
        enumeration EthIfSwitchPortGroupRefSemantics [0..1]: {ETHIF_SWITCH_PORT_GROUP_CONTROL, ETHIF_SWITCH_PORT_GROUP_LINK_INFO}, post-build-variant-value=true, set at link in variant link-time / post-build in variant post-build / pre-compile in variant pre-compile  # Defines how the EthIfSwitchRefOrPortGroupRef refering to a EthIfSwitchPortGroup shall be interpreted.
        reference EthIfPortRef [1..*]: post-build-variant-value=true, set at link in variant link-time / post-build in variant post-build / pre-compile in variant pre-compile, requires-symbolic-name-value=true, destination=EthSwtPort  # Reference to an Ethernet Switch Port.
      container EthIfTransceiver [0..*]  # This container contains the configuration of EthIfTransceiver. | The usage of EthIfEthTrcvRef, EthIfCanXLTrcvRef, and EthIfWEthTrcvRef is exclusive OR.
        float EthIfQualifiedUnexpectedLinkDownTime [0..1]: 0..INF, scope=ECU, set at link in variant link-time / post-build in variant post-build / pre-compile in variant pre-compile  # Specifies the time in seconds an unexpected link down is qualified. This parameter is only used for those Ethernet channels where the ECU act as a passive communication slave (referenced EthTrcv set EthTrcvActAsSlavePassiveEnabled = TRUE). | The value shall be a multiple integral of EthIf_MainFunctionState.
        integer EthIfTransceiverIdx: 0..255, scope=ECU, set at pre-compile, symbolic-name-value=true, with-auto=true  # This parameter provides a zero-based consecutive index of the Ethernet transceivers. Upper layer BSW modules and the Ethernet Interface itself use this index to identify an Ethernet tranceiver.
        reference EthIfCanXLTrcvRef [0..1]: scope=ECU, multiplicity set at pre-compile, set at pre-compile, requires-symbolic-name-value=true, destination=CanTrcvChannel  # Reference to a CAN XL transceiver, which is handled by a specific CAN XL transceiver driver.
        reference EthIfEthTrcvRef [0..1]: scope=ECU, post-build-variant-value=true, set at link in variant link-time / post-build in variant post-build / pre-compile in variant pre-compile, requires-symbolic-name-value=true, destination=EthTrcvConfig  # Reference to an Ethernet transceiver, which is handled by a specific Ethernet transceiver driver.
        reference EthIfWEthTrcvRef [0..1]: scope=ECU, post-build-variant-value=true, set at link in variant link-time / post-build in variant post-build / pre-compile in variant pre-compile, requires-symbolic-name-value=true, destination=WEthTrcvConfig  # Reference to an Wireless Ethernet transceiver, which is handled by a specific Wireless Ethernet transceiver driver.
      container EthIfTrcvLinkStateChgConfig [1..*]  # Specifies link state change callback function
        function name EthIfTrcvLinkStateChgFunction: post-build-variant-value=true, set at link in variant link-time / post-build in variant post-build / pre-compile in variant pre-compile  # Specifies link state change callback function
      container EthIfTxConfirmationConfig [0..*]  # Configuration of transmit indication callback functions.
        function name EthIfTxConfirmationFunction: post-build-variant-value=true, set at link in variant link-time / post-build in variant post-build / pre-compile in variant pre-compile  # Specifies transmit indication callback function
    container EthIfGeneral  # This container contains the general configuration parameters of the Ethernet Interface.
      boolean EthIfDevErrorDetect: set at pre-compile, default-value=false  # Switches the development error detection and notification on or off. | * true: detection and notification is enabled. * false: detection and notification is disabled.
      boolean EthIfEnableCV2xApi [0..1]: multiplicity set at pre-compile, set at pre-compile, default-value=false  # Enables / Disables API's for CV2x Tags: atp.Status=draft
      boolean EthIfEnableRxInterrupt: set at pre-compile  # Enables / Disables receive interrupt.
      boolean EthIfEnableSecurityEventReporting: scope=ECU, set at pre-compile, default-value=false  # Switches the reporting of security events to the IdsM: Tags: atp.Status=draft | - true: reporting is enabled. - false: reporting is disabled.
      boolean EthIfEnableSignalQualityApi: set at pre-compile  # Enable/disable the APIs read and clear the signal quality.
      boolean EthIfEnableTxInterrupt: set at pre-compile  # Enables / Disables the transmit interrupt.
      boolean EthIfEnableWEthApi [0..1]: multiplicity set at pre-compile, set at pre-compile, default-value=false  # Enables / Disables API's for WEth / WEthTrcv
      enumeration EthIfFwSupport: scope=ECU, set at pre-compile  # Enables / Disables the Firewall usage. Tags: atp.Status=draft
        FIREWALL_WITHOUT_PERSTREAMFILTERING  # Tags: atp.Status=draft
        FIREWALL_WITH_PERSTREAMFILTERING  # Tags: atp.Status=draft
        NO_FIREWALL  # Tags: atp.Status=draft
      boolean EthIfGetAndResetMeasurementDataApi: set at pre-compile, default-value=false  # Enables / Disables the Get and Reset Measurement Data API
      boolean EthIfGetBaudRate: set at pre-compile  # Enables / Disables GetBaudRate API.
      boolean EthIfGetCounterState: set at pre-compile  # Enables / Disables GetCounterState API.
      boolean EthIfGetCtrlIdxList: set at pre-compile, default-value=false  # Enables / Disables GetCtrlIdxList API.
      boolean EthIfGetPortMacAddrVlanApi [0..1]: multiplicity set at pre-compile, set at pre-compile  # Enables / Disables the GetPortMacAddrVlan API.
      boolean EthIfGetVlanIdSupport: set at pre-compile, default-value=false  # Enables / Disables GetVlanId API.
      boolean EthIfGlobalTimeSupport: set at pre-compile  # Enables/Disables the Global Time APIs used amongst others by Global Time Synchronization over Ethernet.
      float EthIfMainFunctionPeriod: 0..INF, set at pre-compile  # Specifies the period of main function EthIf_MainFunctionRx and EthIf_MainFunctionTx in seconds. Ethernet Interface does not require this information but the BSW scheduler.
      float EthIfMainFunctionStatePeriod [0..1]: 0..INF, multiplicity set at pre-compile, set at pre-compile  # Specifies the period of main function EthIf_MainFunctionState in seconds. Ethernet Interface does not require this information but the BSW scheduler.
      integer EthIfMaxTrcvsTotal: 1..255, set at pre-compile  # Limits the total number of transceivers.
      boolean EthIfPhcSupport: set at pre-compile  # Enables/Disables the PTP HW Clock (PHC). Tags: atp.Status=draft
      float EthIfPortStartupActiveTime [0..1]: 0.001..65.535, multiplicity set at link in variant link-time / post-build in variant post-build / pre-compile in variant pre-compile, post-build-variant-multiplicity=true, post-build-variant-value=true, set at link in variant link-time+post-build / pre-compile in variant pre-compile  # Denote the time delay after the mode "ETH_MODE_ACTIVE" of all EthIfSwitchPorts are requested via EthIf_StartAllPorts. | This is only used for ports in EthIfSwtPortGroups which are not referenced by any EthIfController.
      string EthIfPublicCddHeaderFile [0..*]: scope=ECU, multiplicity set at pre-compile, set at pre-compile, max-length=32, min-length=1  # Defines header files for callback functions which shall be included in case of CDDs. Range of characters is 1.. 32.
      integer EthIfRxIndicationIterations [0..1]: 0..65535, set at pre-compile  # Maximum number of Ethernet frames per Ethernet controller polled from the Ethernet driver within EthIf_MainFunctionRx.
      boolean EthIfSetForwardingModeApi: set at pre-compile, default-value=false  # Enables /disables EthIf_SetForwardingMode API.
      float EthIfSignalQualityCheckPeriod [0..1]: set at pre-compile  # Specifies the period in units of seconds in which the signal quality it polled in the context of EthIf_MainfunctionState. The value shall be an integral multiple of EthIfMainFunctionStatePeriod.
      boolean EthIfStartAutoNegotiation: set at pre-compile  # Enables / Disables StartAutoNegotiation API.
      boolean EthIfSwitchManagementSupport: set at pre-compile  # Enables/Disables the Switch management APIs to support a Switch-port specific communication attribute access.
      float EthIfSwitchOffPortTimeDelay [0..1]: 0.001..65.535, multiplicity set at link in variant link-time / post-build in variant post-build / pre-compile in variant pre-compile, post-build-variant-multiplicity=true, post-build-variant-value=true, set at link in variant link-time+post-build / pre-compile in variant pre-compile  # Denote the time delay after the mode "ETH_MODE_DOWN" of a EthIfSwitchPortGroup will be executed. | This is only used for EthIfSwtPortGroups which are not referenced by any EthIfController. The time delay shall be greater than the UdpNm timings, because UdpNm shall finish its shutdown handling. (Repeat Message State, Prepare Bus-Sleep state, Bus-Sleep state).
      integer EthIfTrcvLinkStateChgMainReload: 1..255, set at pre-compile  # Specifies the frequency of transceiver link state change checks in each | period of main function EthIf_MainFunctionTx.
      boolean EthIfVerifyConfigApi: set at pre-compile, default-value=false  # Enables /disables EthIf_VerifyConfig API.
      boolean EthIfVersionInfoApi: set at pre-compile, default-value=false  # Enables / Disables version info API
      boolean EthIfVersionInfoApiMacro: set at pre-compile, default-value=false  # Enables / Disables version info API macro implementation.
      boolean EthIfWakeUpSupport: set at pre-compile, default-value=false  # Configures if wake-up handling is supported or not: | TRUE: wake-up handling is supported FALSE: wake-up handling is not supported This configuration parameter also enables particular other the API at Pre-Compile-Time, e.g. EthIf_CheckWakeup.
      container EthIfSecurityEventRefs [0..1]: multiplicity set at pre-compile  # Container for the references to IdsMEvent elements representing the security events that the EthIf module shall report to the IdsM in case the coresponding security related event occurs (and if EthIfEnableSecurityEventReporting is set to "true"). The standardized security events in this container can be extended by vendor-specific security events. Tags: atp.Status=draft
        reference SEV_ETH_DROP_INV_VLAN [0..1]: multiplicity set at pre-compile, set at pre-compile, requires-symbolic-name-value=true, destination=IdsMEvent  # An Ethernet datagram was dropped due to an invalid CrtlIdx/VLAN. Tags: atp.Status=draft
        reference SEV_ETH_DROP_MAC_COLLISION [0..1]: multiplicity set at pre-compile, set at pre-compile, requires-symbolic-name-value=true, destination=IdsMEvent  # An Ethernet datagram was dropped because local MAC was same as source MAC in an incoming frame. Tags: atp.Status=draft
        reference SEV_ETH_DROP_UNKNOWN_ETHERTYPE [0..1]: multiplicity set at pre-compile, set at pre-compile, requires-symbolic-name-value=true, destination=IdsMEvent  # An Ethernet datagram was dropped due to an unknown Ethertype. Tags: atp.Status=draft
        reference SEV_ETH_DROP_VLAN_DOUBLE_TAG [0..1]: multiplicity set at pre-compile, set at pre-compile, requires-symbolic-name-value=true, destination=IdsMEvent  # An Ethernet datagram was dropped due to double VLAN tag. Tags: atp.Status=draft
