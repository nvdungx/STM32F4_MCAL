AUTOSAR XML (schema 00053)
package /AUTOSAR/EcucDefs
  ecuc definition collection AUTOSARParameterDefinition: module=Eep
  module definition Eep [0..*]: post-build-variant-support=true, variants post-build/pre-compile  # Configuration of the Eep (internal or external EEPROM driver) module. Tags: atp.Status=obsolete | Its multiplicity describes the number of EEPROM drivers present, so there will be one container for each EEPROM driver in the ECUC template. When no EEPROM driver is present then the multiplicity is 0.
    container EepGeneral  # Container for general configuration parameters of the EEPROM driver. These parameters are always pre-compile. Tags: atp.Status=obsolete
      boolean EepDevErrorDetect: set at pre-compile, default-value=false  # Switches the development error detection and notification on or off. Tags: atp.Status=obsolete | * true: detection and notification is enabled. * false: detection and notification is disabled. This element is obsolete and will be removed in a future revision.
      integer EepDriverIndex: 0..254, scope=ECU, set at pre-compile, symbolic-name-value=true  # Specifies the InstanceId of this module instance. If only one instance is present it shall have the Id 0. Tags: atp.Status=obsolete
      float EepMainFunctionPeriod [0..1]: 0..INF, multiplicity set at pre-compile, set at pre-compile  # Call cycle time of the EEPROM driver's main function. Unit: [s] Tags: atp.Status=obsolete
      boolean EepUseInterrupts: set at pre-compile, default-value=false  # Switches to activate or deactivate interrupt controlled job processing. Tags: atp.Status=obsolete | true: Interrupt controlled job processing enabled. false: Interrupt controlled job processing disabled. This element is obsolete and will be removed in a future revision.
      boolean EepVersionInfoApi: set at pre-compile, default-value=false  # Pre-processor switch to enable / disable the API to read out the modules version information. Tags: atp.Status=obsolete | true: Version info API enabled. false: Version info API disabled. This element is obsolete and will be removed in a future revision.
      boolean EepWriteCycleReduction: set at pre-compile, default-value=false  # Switches to activate or deactivate write cycle reduction (EEPROM value is read and compared before being overwritten). Tags: atp.Status=obsolete | true: Write cycle reduction enabled. false: Write cycle reduction disabled. This element is obsolete and will be removed in a future revision.
      reference EepEcucPartitionRef [0..1]: scope=ECU, multiplicity set at pre-compile, post-build-variant-multiplicity=true, post-build-variant-value=true, set at pre-compile, destination=EcucPartition  # Maps the EEP driver to zero or one ECUC partition to make the driver API available in this partition. Tags: atp.Status=obsolete
    container EepInitConfiguration  # Container for runtime configuration parameters of the EEPROM driver. Tags: atp.Status=obsolete | Implementation Type: Eep_ConfigType. This element is obsolete and will be removed in a future revision.
      integer EepBaseAddress: 0..4294967295, post-build-variant-value=true, set at post-build in variant post-build / pre-compile in variant pre-compile  # This parameter is the EEPROM device base address. Tags: atp.Status=obsolete | Implementation Type: Eep_AddressType. This element is obsolete and will be removed in a future revision.
      enumeration EepDefaultMode: post-build-variant-value=true, set at post-build in variant post-build / pre-compile in variant pre-compile, default-value=MEMIF_MODE_SLOW  # This parameter is the default EEPROM device mode after initialization. Tags: atp.Status=obsolete | Implementation Type: MemIf_ModeType. This element is obsolete and will be removed in a future revision.
        MEMIF_MODE_FAST  # Tags: atp.Status=obsolete
        MEMIF_MODE_SLOW  # Tags: atp.Status=obsolete
      integer EepFastReadBlockSize: 0..4294967295, post-build-variant-value=true, set at post-build in variant post-build / pre-compile in variant pre-compile  # Number of bytes read within one job processing cycle in fast mode. If the hardware does not support burst mode this parameter shall be set to the same value as EepNormalReadBlockSize. Tags: atp.Status=obsolete | Implementation Type: Eep_LengthType. This element is obsolete and will be removed in a future revision.
      integer EepFastWriteBlockSize: 0..4294967295, post-build-variant-value=true, set at post-build in variant post-build / pre-compile in variant pre-compile  # Number of bytes written within one job processing cycle in fast mode. If the hardware does not support burst mode this parameter shall be set to the same value as EepNormalWriteBlockSize. Tags: atp.Status=obsolete | Implementation Type: Eep_LengthType. This element is obsolete and will be removed in a future revision.
      function name EepJobEndNotification [0..1]: multiplicity set at post-build in variant post-build / pre-compile in variant pre-compile, post-build-variant-multiplicity=true, post-build-variant-value=true, set at post-build in variant post-build / pre-compile in variant pre-compile  # This parameter is a reference to a callback function for positive job result (see EEP045). Tags: atp.Status=obsolete
      function name EepJobErrorNotification [0..1]: multiplicity set at post-build in variant post-build / pre-compile in variant pre-compile, post-build-variant-multiplicity=true, post-build-variant-value=true, set at post-build in variant post-build / pre-compile in variant pre-compile  # This parameter is a reference to a callback function for negative job result (see EEP046). Tags: atp.Status=obsolete
      integer EepNormalReadBlockSize: 0..4294967295, post-build-variant-value=true, set at post-build in variant post-build / pre-compile in variant pre-compile  # Number of bytes read within one job processing cycle in normal mode. Tags: atp.Status=obsolete | Implementation Type: Eep_LengthType. This element is obsolete and will be removed in a future revision.
      integer EepNormalWriteBlockSize: 0..4294967295, post-build-variant-value=true, set at post-build in variant post-build / pre-compile in variant pre-compile  # Number of bytes written within one job processing cycle in normal mode. Tags: atp.Status=obsolete | Implementation Type: Eep_LengthType. This element is obsolete and will be removed in a future revision.
      integer EepSize: 0..4294967295, post-build-variant-value=true, set at post-build in variant post-build / pre-compile in variant pre-compile  # This parameter is the used size of EEPROM device in bytes. Tags: atp.Status=obsolete | Implementation Type: Eep_LengthType. This element is obsolete and will be removed in a future revision.
      container EepDemEventParameterRefs [0..1]  # Container for the references to DemEventParameter elements which shall be invoked using the API Dem_SetEventStatus in case the corresponding error occurs. The EventId is taken from the referenced DemEventParameter's DemEventId symbolic value. The standardized errors are provided in this container and can be extended by vendor-specific error references. Tags: atp.Status=obsolete
        reference EEP_E_COMPARE_FAILED [0..1]: multiplicity set at post-build in variant post-build / pre-compile in variant pre-compile, post-build-variant-multiplicity=true, post-build-variant-value=true, set at post-build in variant post-build / pre-compile in variant pre-compile, requires-symbolic-name-value=true, destination=DemEventParameter  # Reference to the DemEventParameter which shall be issued when the error "EEPROM compare failed (HW)" has occurred. Tags: atp.Status=obsolete
        reference EEP_E_ERASE_FAILED [0..1]: multiplicity set at post-build in variant post-build / pre-compile in variant pre-compile, post-build-variant-multiplicity=true, post-build-variant-value=true, set at post-build in variant post-build / pre-compile in variant pre-compile, requires-symbolic-name-value=true, destination=DemEventParameter  # Reference to the DemEventParameter which shall be issued when the error "EEPROM erase failed (HW)" has occurred. Tags: atp.Status=obsolete
        reference EEP_E_READ_FAILED [0..1]: multiplicity set at post-build in variant post-build / pre-compile in variant pre-compile, post-build-variant-multiplicity=true, post-build-variant-value=true, set at post-build in variant post-build / pre-compile in variant pre-compile, requires-symbolic-name-value=true, destination=DemEventParameter  # Reference to the DemEventParameter which shall be issued when the error "EEPROM read failed (HW)" has occurred. Tags: atp.Status=obsolete
        reference EEP_E_WRITE_FAILED [0..1]: multiplicity set at post-build in variant post-build / pre-compile in variant pre-compile, post-build-variant-multiplicity=true, post-build-variant-value=true, set at post-build in variant post-build / pre-compile in variant pre-compile, requires-symbolic-name-value=true, destination=DemEventParameter  # Reference to the DemEventParameter which shall be issued when the error "EEPROM write failed (HW)" has occurred. Tags: atp.Status=obsolete
      container EepExternalDriver [0..1]  # This container is present for external EEPROM drivers only. Internal EEPROM drivers do not use the parameter listed in this container, hence its multiplicity is 0 for internal drivers. Tags: atp.Status=obsolete
        choice reference EepExternalContainerRef [0..1]: multiplicity set at post-build in variant post-build / pre-compile in variant pre-compile, post-build-variant-multiplicity=true, post-build-variant-value=true, set at post-build in variant post-build / pre-compile in variant pre-compile, requires-symbolic-name-value=true, destination=[I2cSequence, SpiSequence]  # Reference to either: Tags: atp.Status=draft | * an SpiSequenceConfiguration container in case the EEP hardware is accessed via SPI * an I2CSequenceConfiguration container in case the EEPhardware is accessed via I2C
    container EepPublishedInformation  # Additional published parameters not covered by CommonPublishedInformation container. Tags: atp.Status=obsolete | Note that these parameters do not have any configuration class setting, since they are published information. This element is obsolete and will be removed in a future revision.
      integer EepAllowedWriteCycles: 0..4294967295, set at published-information  # Specified maximum number of write cycles under worst case conditions of specific EEPROM hardware (e.g. +90°C) Tags: atp.Status=obsolete
      float EepEraseTime: 0..INF, set at published-information  # Maximum time for erasing one EEPROM data unit. Tags: atp.Status=obsolete
      integer EepEraseUnitSize: 0..4294967295, set at published-information  # Size of smallest erasable EEPROM data unit in bytes. Tags: atp.Status=obsolete
      integer EepEraseValue: 0..255, set at published-information  # Value of an erased EEPROM cell. Tags: atp.Status=obsolete
      integer EepMinimumAddressType: 0..4294967295, set at published-information  # Minimum expected size of Eep_AddressType. Tags: atp.Status=obsolete
      integer EepMinimumLengthType: 0..4294967295, set at published-information  # Minimum expected size of Eep_LengthType. Tags: atp.Status=obsolete
      integer EepReadUnitSize: 0..4294967295, set at published-information  # Size of smallest readable EEPROM data unit in bytes. Tags: atp.Status=obsolete
      integer EepSpecifiedEraseCycles: 0..4294967295, set at published-information  # Number of erase cycles specified for the EEP device (usually given in the device data sheet). Tags: atp.Status=obsolete
      integer EepTotalSize: 0..4294967295, set at published-information  # Total size of EEPROM in bytes. Tags: atp.Status=obsolete | Implementation Type: Eep_LengthType. This element is obsolete and will be removed in a future revision.
      float EepWriteTime: 0..INF, set at published-information  # Maximum time for writing one EEPROM data unit. Tags: atp.Status=obsolete
      integer EepWriteUnitSize: 0..4294967295, set at published-information  # Size of smallest writeable EEPROM data unit in bytes. Tags: atp.Status=obsolete
