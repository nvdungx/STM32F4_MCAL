AUTOSAR XML (schema 00053)
package /AUTOSAR/EcucDefs
  ecuc definition collection AUTOSARParameterDefinition: module=ISO15118Chrg
  module definition ISO15118Chrg [0..1]: variants pre-compile  # Configuration of the ISO15118 module. Tags: atp.Status=draft
    container ISO15118ChrgGeneral  # General configuration of the ISO15118 module. Tags: atp.Status=draft
      boolean ISO15118ChrgDevErrorDetect: set at pre-compile, default-value=false  # Switches the development error detection and notification on or off. Tags: atp.Status=draft | * true: detection and notification is enabled. * false: detection and notification is disabled.
      float ISO15118ChrgMainFunctionCycleTime: 0..INF, set at pre-compile  # This parameter defines the cycle time in seconds of the periodic calling of ISO15118Chrg main function. Tags: atp.Status=draft
      boolean ISO15118ChrgVersionInfoApi: set at pre-compile, default-value=false  # Enables and disables the version info API. Tags: atp.Status=draft
    container ISO15118ChrgService  # Configuration paramters to configure the ISO15118ChrgService Tags: atp.Status=draft
      reference ISO15118ChrgSoAdSocketConnectionRef: scope=ECU, set at pre-compile, requires-symbolic-name-value=true, destination=SoAdSocketConnection  # Reference to SoAdSocketConnection, which specifies the socket connection of the socket connection group. The ISO15118Chrg receives the SoConId for API calls between ISO15118Chrg and SoAd. The ISO15118Chrg shall use this parameter to access TLS information. Since the referenced SoAdSocketConnection is part of a SoAdSocketConnectionGroup the SoAdSocketTcpTlsConnectionRef of the same SoAdSocketConnectionGroup can be used to retrieve the TLS information. Tags: atp.Status=draft
    container ISO15118ChrgTimer [0..*]  # Configuration of ISO15118Chrg Timers. Tags: atp.Status=draft
      float ISO15118ChrgV2gEvccMsgTimeout: scope=ECU  # This parameter define the maximum time that is allowed between a request and its corresponding response message. Tags: atp.Status=draft
    container ISO15118ChrgV2GTP [0..1]  # Configuration of the Vehicle to Grid Transport Protocol Tags: atp.Status=draft
      reference ISO15118ChrgV2GSrcTcpDataRef: scope=ECU, multiplicity set at pre-compile, set at pre-compile, destination=SoAdSocketConnectionGroup  # Reference to SoAdSocketConnectionGroup to access the local IP address and TCP port for building the endpoint option to send V2G messages. Tags: atp.Status=draft
      reference ISO15118ChrgV2GUdpSdpClientRef [0..1]: scope=ECU, multiplicity set at pre-compile, set at pre-compile, destination=SoAdSocketConnectionGroup  # Reference to SoAdSocketConnectionGroup to access the local IP address and Udp port for building the endpoint option for SECC discovery process. Tags: atp.Status=draft
      container ISO15118ChrgV2GTPPdu [0..1]: multiplicity set at pre-compile, post-build-variant-multiplicity=true  # Contains the configuration parameters of the ISO15118 module's Pdus that are exchanged between ISO15118 and the PduR. Tags: atp.Status=draft
        integer ISO15118ChrgV2GTPPduHandleId [0..1]: 0..65535, scope=ECU, multiplicity set at pre-compile, set at pre-compile, symbolic-name-value=true  # PDU identifier assigned by ISO15118Chrg module. Tags: atp.Status=draft | The parameter is required by the API calls ISO15118_V2GTpRxIndication, ISO15118_V2GTpCopyRxData, ISO15118_V2GTpStartOfReception to receive I-PDUs from the PduR. For Tx-I-PDUs this handle Id is used for the APIs calls ISO15118_V2GTpTxConfirmation, ISO15118_V2GTpCopyTxData to transmit respectively confirm transmissions of I-PDUs.
        integer ISO15118ChrgV2GTPPduPayloadType: 0..65535  # This parameter contains the information about how to decode the payload following the V2GTP header. Tags: atp.Status=draft
        integer ISO15118ChrgV2GTPPduProtocolVersion: 0..255  # This parameter specifies the protocol version of the V2GTP message that is transmitted in the Pdu. Tags: atp.Status=draft
        reference ISO15118ChrgV2GTPPduRef: set at pre-compile, destination=Pdu  # Reference to the "global" Pdu structure to allow harmonization of handle IDs in the COM-Stack. Tags: atp.Status=draft
