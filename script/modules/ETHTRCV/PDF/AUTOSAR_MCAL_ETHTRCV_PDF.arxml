AUTOSAR XML (schema 00046)
package /AUTOSAR/EcucDefs
  ecuc definition collection AUTOSARParameterDefinition: module=EthTrcv
  module definition EthTrcv [0..*]: post-build-variant-support=true, variants link-time/post-build/pre-compile  # Configuration of Ethernet Transceiver Driver module
    container EthTrcvConfigSet  # This container contains the configuration parameters and sub containers of the AUTOSAR EthTrcv module.
      container EthTrcvConfig [1..*]  # Configuration of the individual transceiver
        boolean EthTrcvAutoNegotiationEnabled: post-build-variant-value=true, set at link in variant link-time / post-build in variant post-build / pre-compile in variant pre-compile  # Specifies if Auto-Negotiation is enabled (TRUE) or disabled (FALSE) for determination of the Ethernet transceiver speed.
        enumeration EthTrcvConnNeg: {TRCV_CONN_NEG_AUTO, TRCV_CONN_NEG_MASTER, TRCV_CONN_NEG_SLAVE}, post-build-variant-value=true, set at link in variant link-time / post-build in variant post-build / pre-compile in variant pre-compile  # Specifies the connection negotiation of the Ethernet transceiver link.
        enumeration EthTrcvDuplexMode: {ETHTRCV_DUPLEX_MODE_FULL, ETHTRCV_DUPLEX_MODE_HALF}, post-build-variant-value=true, set at link in variant link-time / post-build in variant post-build / pre-compile in variant pre-compile  # Specifies the duplex mode of the Ethernet transceiver link if Auto-Negotiation is disabled. This parameter is ignored if Auto-Negotiation is enabled.
        integer EthTrcvIdx: 0..255, scope=ECU, set at pre-compile, symbolic-name-value=true  # Specifies the instance ID of the configured transceiver.
        enumeration EthTrcvMacLayerSpeed [0..1]: {ETH_MAC_LAYER_SPEED_100M, ETH_MAC_LAYER_SPEED_10G, ETH_MAC_LAYER_SPEED_10M, ETH_MAC_LAYER_SPEED_1G}, scope=ECU, multiplicity set at link in variant link-time+post-build / pre-compile in variant pre-compile, post-build-variant-multiplicity=true, post-build-variant-value=true, set at link in variant link-time+post-build / pre-compile in variant pre-compile  # Defines the baud rate of the MAC layer.
        enumeration EthTrcvMacLayerSubType [0..1]: {LIGHT, REDUCED, REVERSED, SERIAL, STANDARD, UNIVERSAL_SERIAL}, scope=ECU, multiplicity set at link in variant link-time+post-build / pre-compile in variant pre-compile, post-build-variant-multiplicity=true, post-build-variant-value=true, set at link in variant link-time+post-build / pre-compile in variant pre-compile  # Defines the MAC layer subtype of a switch port
        enumeration EthTrcvMacLayerType [0..1]: {TRCV_MAC_LAYER_TYPE_XGMII, TRCV_MAC_LAYER_TYPE_XMII, TRCV_MAC_LAYER_TYPE_XXGMII}, scope=ECU, multiplicity set at link in variant link-time / post-build in variant post-build / pre-compile in variant pre-compile, post-build-variant-multiplicity=true, post-build-variant-value=true, set at link in variant link-time / post-build in variant post-build / pre-compile in variant pre-compile  # Defines the MAC layer type of the ethernet transceiver.
        enumeration EthTrcvPhysLayerType [0..1]: {TRCV_PHYS_LAYER_TYPE_1000BASE_T, TRCV_PHYS_LAYER_TYPE_1000BASE_T1, TRCV_PHYS_LAYER_TYPE_100BASE_T1, TRCV_PHYS_LAYER_TYPE_100BASE_TX}, multiplicity set at link in variant link-time / post-build in variant post-build / pre-compile in variant pre-compile, post-build-variant-multiplicity=true, post-build-variant-value=true, set at link in variant link-time / post-build in variant post-build / pre-compile in variant pre-compile  # Specifies the physical layer type of the Ethernet transceiver link.
        enumeration EthTrcvSpeed: {TRCV_SPEED_10, TRCV_SPEED_100, TRCV_SPEED_1000}, post-build-variant-value=true, set at link in variant link-time / post-build in variant post-build / pre-compile in variant pre-compile  # Specifies the speed of the Ethernet transceiver link in [MBit/s]. If AutoNegotiation is enabled this is the maximum speed advertised for Auto-Negotiation.
        function name EthTrcvWakeUpCallout [0..1]: multiplicity set at pre-compile, set at pre-compile  # Configuration of the call-out name.
        reference EthTrcvConfigEcucPartitionRef [0..1]: scope=ECU, multiplicity set at pre-compile, post-build-variant-multiplicity=true, post-build-variant-value=true, set at pre-compile, destination=EcucPartition  # Maps the Ethernet transceiver configuration to zero or one ECUC partitions. The ECUC partition referenced is a subset of the ECUC partitions where the Ethernet transceiver driver is mapped to. Tags: atp.Status=draft
        reference EthTrcvIcuChannelRef [0..1]: multiplicity set at pre-compile, set at pre-compile, requires-symbolic-name-value=true, destination=IcuChannel  # Reference to the IcuChannel to enable/disable the interrupts for wakeups.
        container EthTrcvDemEventParameterRefs [0..1]  # Container for the references to DemEventParameter elements which shall be invoked using the API Dem_SetEventStatus in case the corresponding error occurs. The EventId is taken from the referenced DemEventParameter's DemEventId symbolic value. The standardized errors are provided in this container and can be extended by vendor-specific error references.
          reference ETHTRCV_E_ACCESS [0..1]: multiplicity set at link in variant link-time / post-build in variant post-build / pre-compile in variant pre-compile, post-build-variant-multiplicity=true, post-build-variant-value=true, set at link in variant link-time / post-build in variant post-build / pre-compile in variant pre-compile, requires-symbolic-name-value=true, destination=DemEventParameter  # Reference to the DemEventParameter which shall be issued when the error "Transceiver access failed" has occurred.
        choice container EthTrcvMgmtInterface [0..1]: multiplicity set at pre-compile  # The choice container allow to configure either the EthTrcv is accessed by a MII interface or Switch interface.
          container EthTrcvMiiInterface [0..1]: multiplicity set at pre-compile  # This container includes the MII interface configuration between an Ethernet Controller and the Ethernet Transceiver. If this container is configured the EthTrcv shall call Eth_WriteMii / Eth_ReadMii API to access the hardware ethernet tranceiver.
            integer EthTrcvCtrlIdx: 0..255, post-build-variant-value=true, set at link in variant link-time / post-build in variant post-build / pre-compile in variant pre-compile  # Specifies the controller used for MII access to the transceiver
            integer EthTrcvMiiIdx: 0..255, set at pre-compile  # Specifies the transceiver index used for MII access to the transceiver.
          container EthTrcvSwitchInterface [0..1]: multiplicity set at pre-compile  # This container includes the Switch interface configuration between an Ethernet Switch and an Ethernet Transceiver. If this container is configured the EthTrcv shall call EthSwt_WriteTrcvRegister / EthSwt_WriteTrcvRegister API to access the hardware ethernet transceiver.
            reference EthTrcvSwitchPortRef: set at pre-compile, requires-symbolic-name-value=true, destination=EthSwtPort  # Reference to a switch port.
            reference EthTrcvSwitchRef: set at pre-compile, requires-symbolic-name-value=true, destination=EthSwtConfig  # Reference to a switch configuration container.
        container EthTrcvWakeupMap [0..7]  # Container for the mapping of wake up reasons to wake up sources. At least one container is needed if EthTrcvWakeUpSupport is not ETHTRCV_WAKEUP_NOT_SUPPORTED.
          enumeration EthTrcvWakeupReason: {ETHTRCV_WUR_BUS, ETHTRCV_WUR_GENERAL, ETHTRCV_WUR_INTERNAL, ETHTRCV_WUR_PIN, ETHTRCV_WUR_POWER_ON, ETHTRCV_WUR_RESET, ETHTRCV_WUR_SYSERR}, post-build-variant-value=true, set at link in variant link-time / post-build in variant post-build / pre-compile in variant pre-compile  # This parameter defines the transceiver wake up reasons.
          reference EthTrcvWakeupSourceRef: set at pre-compile, requires-symbolic-name-value=true, destination=EcuMWakeupSource  # Configures the wake-up source defined in EcuM.
    container EthTrcvGeneral  # General configuration of Ethernet Transceiver Driver module
      boolean EthTrcvDevErrorDetect: set at pre-compile, default-value=false  # Switches the development error detection and notification on or off. | * true: detection and notification is enabled. * false: detection and notification is disabled.
      boolean EthTrcvEnableCableDiagnosticApi: set at pre-compile  # Enable/disable the APIs for cable diagnostic: EthTrcv_RunCableDiagnostic, EthTrcv_GetCableDiagnosticsResult
      boolean EthTrcvGetBaudRateApi: set at pre-compile  # Enables / Disables EthTrcv_GetBaudRate API
      boolean EthTrcvGetCableDiagnosticsResultApi: multiplicity set at pre-compile, set at pre-compile  # Enables / Disables EthTrcv_GetCableDiagnosticsResult API.
      boolean EthTrcvGetDuplexModeApi: set at pre-compile  # Enables / Disables EthTrcv_GetDuplexMode API
      boolean EthTrcvGetLinkStateApi: set at pre-compile  # Enables / Disables EthTrcv_GetLinkState API
      boolean EthTrcvGetPhyIdentifierApi: multiplicity set at pre-compile, set at pre-compile  # Enables / Disables EthTrcv_GetPhyIdentifier API.
      boolean EthTrcvGetPhySignalQualityApi: multiplicity set at pre-compile, set at pre-compile  # Enables / Disables EthTrcv_GetPhySignalQuality API.
      boolean EthTrcvGetTransceiverModeApi: set at pre-compile  # Enables / Disables EthTrcv_GetTransceiverMode API
      boolean EthTrcvGetTransceiverWakeupModeApi [0..1]: multiplicity set at pre-compile, set at pre-compile  # Enables / Disables EthTrcv_GetTransceiverWakeupMode API
      integer EthTrcvIndex: 0..255, set at pre-compile  # Specifies the InstanceId of this module instance. If only one instance is present it shall have the Id 0.
      float EthTrcvMainFunctionPeriod [0..1]: 0..Inf, multiplicity set at pre-compile, set at pre-compile  # Specifies the period of main function EthTrcv_MainFunction in seconds.
      integer EthTrcvMaxTrcvsSupported: 0..255, set at pre-compile, default-value=1
      boolean EthTrcvSetPhyTestModeApi: multiplicity set at pre-compile, set at pre-compile  # Enables / Disables EthTrcv_SetPhyTestMode API.
      boolean EthTrcvSetPhyTxModeApi: multiplicity set at pre-compile, set at pre-compile  # Enables / Disables EthTrcv_SetPhyTxMode API.
      boolean EthTrcvSetTransceiverModeApi: set at pre-compile  # Enables / Disables EthTrcv_SetTransceiverMode API
      boolean EthTrcvStartAutoNegotiationApi: set at pre-compile  # Enables / Disables EthTrcv_StartAutoNegotiation API
      boolean EthTrcvVersionInfoApi: set at pre-compile, default-value=false  # Enables / Disables version info API
      boolean EthTrcvVersionInfoApiMacro: set at pre-compile, default-value=false  # Enables / Disables version info API macro implementation
      enumeration EthTrcvWakeUpSupport: {ETHTRCV_WAKEUP_BY_INTERRUPT, ETHTRCV_WAKEUP_BY_POLLING, ETHTRCV_WAKEUP_NOT_SUPPORTED}, set at pre-compile  # Configures wake-up to polling or interrupt or to not used/not supported. In case no wake up is supported by the hardware, the BSWMD pre-configuration shall be set to ETHTRCV_WAKEUP_NOT_SUPPORTED.
      reference EthTrcvEcucPartitionRef [0..*]: scope=ECU, multiplicity set at pre-compile, post-build-variant-multiplicity=true, post-build-variant-value=true, set at pre-compile, destination=EcucPartition  # Maps the Ethernet transceiver driver to zero or multiple ECUC partitions to make the modules API available in this partition. The Ethernet transceiver driver will operate as an independent instance in each of the partitions. Tags: atp.Status=draft
