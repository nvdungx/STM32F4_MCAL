AUTOSAR XML (schema 00053)
package /AUTOSAR/EcucDefs
  ecuc definition collection AUTOSARParameterDefinition: module=EthTrcv
  module definition EthTrcv [0..*]: post-build-variant-support=true, variants link-time/post-build/pre-compile  # Configuration of Ethernet Transceiver Driver module
    container EthTrcvConfigSet  # This container contains the configuration parameters and sub containers of the AUTOSAR EthTrcv module.
      container EthTrcvConfig [1..*]  # Configuration of the individual transceiver
        boolean EthTrcvActAsSlavePassiveEnabled [0..1]: multiplicity set at pre-compile, set at pre-compile  # Specifies if the ECU is acting as a passive communication slave on the corresponding ComM channel (corresponding ComM channel has ComMNMVariant set to SLAVE_PASSIVE). Tags: atp.Status=draft | If the parameter is set to TRUE, the Ethernet transceiver driver shall poll the maintained Ethernet hardware for a signaled Sleep.Indication (according to OA TC10) in the context of the EthTrcv_MainFunction.
        enumeration EthTrcvConnNeg: {TRCV_CONN_NEG_AUTO, TRCV_CONN_NEG_MASTER, TRCV_CONN_NEG_NONE, TRCV_CONN_NEG_SLAVE}, post-build-variant-value=true, set at link in variant link-time / post-build in variant post-build / pre-compile in variant pre-compile  # Specifies the connection negotiation of the Ethernet transceiver link.
        enumeration EthTrcvDuplexMode: {ETHTRCV_DUPLEX_MODE_FULL, ETHTRCV_DUPLEX_MODE_HALF}, post-build-variant-value=true, set at link in variant link-time / post-build in variant post-build / pre-compile in variant pre-compile  # Specifies the duplex mode of the Ethernet transceiver link if Auto-Negotiation is disabled. This parameter is ignored if Auto-Negotiation is enabled (EthTrcvConnNeg=TRCV_CONN_NEG_AUTO).
        boolean EthTrcvEnablePLCA: set at pre-compile, default-value=false  # Enables the transmission with PLCA (Physical Layer Collision Avoidance) | TRUE: PLCA enabled FALSE: PLCA disabled
        boolean EthTrcvForceSleepEnabled: set at pre-compile  # Specifies if the Ethernet hardware (PHY) support to go to sleep without the confirmation of the Ethernet hardware (PHY) of the linked Ethernet communication partner according to the OA TC10. | If the parameter is set to TRUE, the Ethernet hardware (PHY) support to force its hardware state to the sleep state. This is used, if the Ethernet communication partner do not accept the Sleep.Request after the specified repetitions on Sleep.Request (see EthTrcvSleepRequestNumberOfRepetitions). If EthTrcvSleepRequestNumberOfRepetitions is not available, the EthTransceiver driver shall force the Ethernet hardware (PHY) to sleep state after the first unsuccessful Sleep.Request.
        integer EthTrcvIdx: 0..255, scope=ECU, set at pre-compile, symbolic-name-value=true, with-auto=true  # Specifies the instance ID of the configured transceiver.
        enumeration EthTrcvMacLayerSpeed [0..1]: {ETH_MAC_LAYER_SPEED_100M, ETH_MAC_LAYER_SPEED_10G, ETH_MAC_LAYER_SPEED_10M, ETH_MAC_LAYER_SPEED_1G, ETH_MAC_LAYER_SPEED_2500M, ETH_MAC_LAYER_SPEED_5G}, scope=ECU, multiplicity set at link in variant link-time+post-build / pre-compile in variant pre-compile, post-build-variant-multiplicity=true, post-build-variant-value=true, set at link in variant link-time+post-build / pre-compile in variant pre-compile  # Defines the baud rate of the MAC layer.
        enumeration EthTrcvMacLayerSubType [0..1]: {LIGHT, REDUCED, REVERSED, SERIAL, STANDARD, UNIVERSAL_SERIAL}, scope=ECU, multiplicity set at link in variant link-time+post-build / pre-compile in variant pre-compile, post-build-variant-multiplicity=true, post-build-variant-value=true, set at link in variant link-time+post-build / pre-compile in variant pre-compile  # Defines the MAC layer subtype of a switch port
        enumeration EthTrcvMacLayerType [0..1]: {TRCV_MAC_LAYER_TYPE_XGMII, TRCV_MAC_LAYER_TYPE_XMII, TRCV_MAC_LAYER_TYPE_XXGMII}, scope=ECU, multiplicity set at link in variant link-time / post-build in variant post-build / pre-compile in variant pre-compile, post-build-variant-multiplicity=true, post-build-variant-value=true, set at link in variant link-time / post-build in variant post-build / pre-compile in variant pre-compile  # Defines the MAC layer type of the ethernet transceiver.
        integer EthTrcvPhysLayerPlcaLocalNodeId [0..1]: 0..255, multiplicity set at pre-compile, set at pre-compile, default-value=255  # Configuration parameter for the transceiver node ID when the PLCA mode for 10BASE-T1S is used.
        integer EthTrcvPhysLayerPlcaMaxBurstCount [0..1]: 0..255, set at pre-compile  # Defines maximum packets allowed to be transmitted within a TO. The maximum burst count could differ per ECU within a PLCA mixed segment.
        integer EthTrcvPhysLayerPlcaMaxBurstTimer [0..1]: 0..255, set at pre-compile, default-value=128  # Limits the burst frames in bit time. The maximum burst time could differ per ECU within a PLCA mixed segment.
        integer EthTrcvPhysLayerPlcaNodeCount [0..1]: 0..255, multiplicity set at pre-compile, set at pre-compile, default-value=8  # Defines the number of communication participants on the mixed segment. This value is relevant for the head-node transceiver (EthTrcvPhysLayerNodeID = 0) in order to know when the BEACON has to be transmitted.
        integer EthTrcvPhysLayerPlcaTransmitOpportunityTimer [0..1]: 1..255, multiplicity set at pre-compile, set at pre-compile, default-value=32  # Timer for the transmission in bit time to evaluate if a Transmission Opportunity is yield or not.
        enumeration EthTrcvPhysLayerType [0..1]: {TRCV_PHYS_LAYER_TYPE_10000BASE_T1, TRCV_PHYS_LAYER_TYPE_1000BASE_T, TRCV_PHYS_LAYER_TYPE_1000BASE_T1, TRCV_PHYS_LAYER_TYPE_100BASE_T1, TRCV_PHYS_LAYER_TYPE_100BASE_TX, TRCV_PHYS_LAYER_TYPE_10BASE_T1S, TRCV_PHYS_LAYER_TYPE_2500BASE_T1, TRCV_PHYS_LAYER_TYPE_5000BASE_T1}, multiplicity set at link in variant link-time / post-build in variant post-build / pre-compile in variant pre-compile, post-build-variant-multiplicity=true, post-build-variant-value=true, set at link in variant link-time / post-build in variant post-build / pre-compile in variant pre-compile  # Specifies the physical layer type of the Ethernet transceiver link.
        float EthTrcvSleepModeExecutionDelay [0..1]: 0..INF, multiplicity set at pre-compile, set at pre-compile  # Specifies the time delay in seconds to execute a sleep (see OA TC10) for a Ethernet hardware (PHY), if a pending wake-up was detected while a ETH_MODE_DOWN was requested. | The value shall be an integral multiple of EthTrcvMainFunctionPeriod.
        integer EthTrcvSleepRequestNumberOfRepetitions: 0..255, set at pre-compile, default-value=0  # Specifies the repetitions to trigger a Sleep.Request (according to OA TC10) if a release of the communication channel was triggered by the upper layer (ETH_MODE_DOWN) and a SleepFail.Indication was signaled. Thus, the Ethernet hardware (PHY) of the connected communication partner did not accept the Sleep.Request.
        float EthTrcvSleepRequestRepetitionPeriod: 0..INF, set at pre-compile  # Specifies the repetition period in seconds of repetitions for a Sleep Request (according to OA TC10). | The value shall be a integral multiple of EthTrcvMainFunctionPeriod.
        enumeration EthTrcvSpeed: {TRCV_SPEED_10, TRCV_SPEED_100, TRCV_SPEED_1000, TRCV_SPEED_10000, TRCV_SPEED_2500, TRCV_SPEED_5000}, post-build-variant-value=true, set at link in variant link-time / post-build in variant post-build / pre-compile in variant pre-compile  # Specifies the speed of the Ethernet transceiver link in [MBit/s]. If AutoNegotiation is enabled (EthTrcvConnNeg=TRCV_CONN_NEG_AUTO) this is the maximum speed advertised for Auto-Negotiation.
        function name EthTrcvWakeUpCallout [0..1]: multiplicity set at pre-compile, set at pre-compile  # Configuration of the call-out name.
        boolean EthTrcvWakeupForwardLocalEnabled: set at pre-compile  # Specifies if remote wake up forwarding is enabled (TRUE) or disabled (FALSE) for OA TC10 compliant Ethernet Transceiver. | If the parameter is set to TRUE, the Ethernet hardware (PHY) activate a local wake up (e.g. via I/O pin), if a remote wake-up on data line (e.g. 100Base-T1) was received (either WUP or WUR).
        boolean EthTrcvWakeupForwardRemoteEnabled: set at pre-compile  # Specifies if local wake up forwarding is enabled (TRUE) or disabled (FALSE) for OA TC10 compliant Ethernet Transceiver. | If the parameter is set to TRUE, the Ethernet hardware (PHY) transmit a wake-up (WUP or WUR on the data line (e.g. 100Base-T1), when a local wake-up occurred (e.g. via I/O pin), which was triggered by neighboring Ethernet hardware (PHY).
        float EthTrcvWakeupLocalDetectionTime [0..1]: 1E-5..0.1, multiplicity set at link in variant link-time+post-build / pre-compile in variant pre-compile, set at link in variant link-time+post-build / pre-compile in variant pre-compile  # Defines the time in seconds when a local wake-up (e.g. via I/O pin) triggered by a neighboring PHY is evalutated as a valid wake-up.
        float EthTrcvWakeupLocalDurationTime [0..1]: 4E-5..0.1, multiplicity set at link in variant link-time+post-build / pre-compile in variant pre-compile, set at link in variant link-time+post-build / pre-compile in variant pre-compile  # Defines the duration time in seconds how long a local wake-up should be present on the local wake-up connection (e.g. via I/O pin) to indicate the neighboring PHYs about a wake-up.
        boolean EthTrcvWakeupLocalEnabled: set at pre-compile  # Specifies if local wake-up is enabled (TRUE) or disabled (FALSE) for OA TC10 compliant Ethernet hardware (PHY). | If the parameter is set to TRUE, the Ethernet hardware (PHY) is able to detect and react on a wake-up received by a neighboring PHY (e.g. via I/O pin).
        boolean EthTrcvWakeupRemoteEnabled: set at pre-compile  # Specifies if remote wake-up is enabled (TRUE) or disabled (FALSE) for OA TC10 compliant Ethernet hardware (PHY). | If the parameter is set to TRUE, the Ethernet hardware (PHY) wake up when receiving a remote wake-up (e.g. via 100Base-T1 data line) triggered by the connected communication partner.
        integer EthTrcvWakeupRequestNumberOfRepetitions: 0..255, set at pre-compile, default-value=0  # Specifies the repetitions to trigger a wake-up request (according to OA TC10), if an active communication request (ETH_MODE_ACTIVE_WITH_WAKEUP_REQUEST) was triggered by the upperlayer.
        float EthTrcvWakeUpRequestRepetitionPeriod [0..1]: 0..INF, multiplicity set at pre-compile, set at pre-compile  # Specifies the repetition period in seconds of a wake-up request, if an active communication request (ETH_MODE_ACTIVE_WITH_WAKEUP_REQUEST) was triggered by the upperlayer. | The value shall be an integral multiple of EthTrcvMainFunctionPeriod.
        boolean EthTrcvWakeupSleepOnDatalineEnabled [0..1]: multiplicity set at pre-compile, set at pre-compile  # Specifies if wake-up on data line according to OA TC10 is supported by the used Ethernet hardware (PHY) and if the functionality (wake-up and sleep on dataline) is enabled. | If the parameter is configured, wake-up and sleep on data line is supported according to OA TC10 by the used Ethernet hardware (PHY). If the parameter is set to TRUE, the wake-up and sleep on data line functionality according to OA TC10 is enabled. If the parameter is set to FALSE, the wake-up and sleep on data line functionality according to OA TC10 is disabled. Note: Disabling of the wake-up and sleep functionality is used if Ethernet hardware (PHY) parts are connected, where one PHY do not support the OA TC10 wake-up and sleep on dataline functionality. This may needed for legacy scenarios, where ECUs are taken over from previous car lines and no OA TC10 Ethernet hardware (PHY) were used.
        reference EthTrcvConfigEcucPartitionRef [0..1]: scope=ECU, multiplicity set at pre-compile, post-build-variant-multiplicity=true, post-build-variant-value=true, set at pre-compile, destination=EcucPartition  # Maps the Ethernet transceiver configuration to zero or one ECUC partitions. The ECUC partition referenced is a subset of the ECUC partitions where the Ethernet transceiver driver is mapped to.
        reference EthTrcvIcuChannelRef [0..1]: multiplicity set at pre-compile, set at pre-compile, requires-symbolic-name-value=true, destination=IcuChannel  # Reference to the IcuChannel to enable/disable the interrupts for wakeups.
        container EthTrcvDemEventParameterRefs [0..1]  # Container for the references to DemEventParameter elements which shall be invoked using the API Dem_SetEventStatus in case the corresponding error occurs. The EventId is taken from the referenced DemEventParameter's DemEventId symbolic value. The standardized errors are provided in this container and can be extended by vendor-specific error references.
          reference ETHTRCV_E_ACCESS [0..1]: multiplicity set at link in variant link-time / post-build in variant post-build / pre-compile in variant pre-compile, post-build-variant-multiplicity=true, post-build-variant-value=true, set at link in variant link-time / post-build in variant post-build / pre-compile in variant pre-compile, requires-symbolic-name-value=true, destination=DemEventParameter  # Reference to the DemEventParameter which shall be issued when the error "Transceiver access failed" has occurred.
        choice container EthTrcvMgmtInterface [0..1]: multiplicity set at pre-compile  # The choice container allow to configure either the EthTrcv is accessed by a MII interface or Switch interface.
          container EthTrcvMiiInterface [0..1]: multiplicity set at pre-compile  # This container includes the MII interface configuration between an Ethernet Controller and the Ethernet Transceiver. If this container is configured the EthTrcv shall call Eth_WriteMii / Eth_ReadMii API to access the hardware ethernet tranceiver. | Note: In case of external MACPHY use this parameter may be enabled.
            integer EthTrcvCtrlIdx: 0..255, post-build-variant-value=true, set at link in variant link-time / post-build in variant post-build / pre-compile in variant pre-compile  # Specifies the controller used for MII access to the transceiver
            integer EthTrcvMiiIdx: 0..255, set at pre-compile  # Specifies the transceiver index used for MII access to the transceiver.
          container EthTrcvSwitchInterface [0..1]: multiplicity set at pre-compile  # This container includes the Switch interface configuration between an Ethernet Switch and an Ethernet Transceiver. If this container is configured the EthTrcv shall call EthSwt_WriteTrcvRegister / EthSwt_WriteTrcvRegister API to access the hardware ethernet transceiver.
            reference EthTrcvSwitchPortRef: set at pre-compile, requires-symbolic-name-value=true, destination=EthSwtPort  # Reference to a switch port.
            reference EthTrcvSwitchRef: set at pre-compile, requires-symbolic-name-value=true, destination=EthSwtConfig  # Reference to a switch configuration container.
        container EthTrcvWakeupMap [0..7]  # Container for the mapping of wake up reasons to wake up sources. At least one container is needed if EthTrcvWakeUpSupport is not ETHTRCV_WAKEUP_NOT_SUPPORTED.
          enumeration EthTrcvWakeupReason: {ETHTRCV_WUR_BUS, ETHTRCV_WUR_GENERAL, ETHTRCV_WUR_INTERNAL, ETHTRCV_WUR_PIN, ETHTRCV_WUR_POWER_ON, ETHTRCV_WUR_RESET, ETHTRCV_WUR_SYSERR}, post-build-variant-value=true, set at link in variant link-time / post-build in variant post-build / pre-compile in variant pre-compile  # This parameter defines the transceiver wake up reasons.
          reference EthTrcvWakeupSourceRef: set at pre-compile, requires-symbolic-name-value=true, destination=EcuMWakeupSource  # Configures the wake-up source defined in EcuM.
    container EthTrcvGeneral  # General configuration of Ethernet Transceiver Driver module
      boolean EthTrcvDevErrorDetect: set at pre-compile, default-value=false  # Switches the development error detection and notification on or off. | * true: detection and notification is enabled. * false: detection and notification is disabled.
      boolean EthTrcvEnableCableDiagnosticApi: set at pre-compile  # Enable/disable the APIs for cable diagnostic: EthTrcv_RunCableDiagnostic, EthTrcv_GetCableDiagnosticsResult
      boolean EthTrcvGetBaudRateApi: set at pre-compile  # Enables / Disables EthTrcv_GetBaudRate API
      boolean EthTrcvGetBusWuReasonApi: set at pre-compile, default-value=false  # Enables / Disables API to obtain the recent wake-up reason detected by the used Ethernet hardware (e.g. PHY).
      boolean EthTrcvGetDuplexModeApi: set at pre-compile  # Enables / Disables EthTrcv_GetDuplexMode API
      boolean EthTrcvGetLinkStateApi: set at pre-compile  # Enables / Disables EthTrcv_GetLinkState API
      boolean EthTrcvGetPhyIdentifierApi: multiplicity set at pre-compile, set at pre-compile  # Enables / Disables EthTrcv_GetPhyIdentifier API.
      boolean EthTrcvGetTransceiverWakeupModeApi [0..1]: multiplicity set at pre-compile, set at pre-compile  # Enables / Disables EthTrcv_GetTransceiverWakeupMode API
      integer EthTrcvIndex: 0..255, set at pre-compile  # Specifies the InstanceId of this module instance. If only one instance is present it shall have the Id 0.
      float EthTrcvMainFunctionPeriod [0..1]: 0..INF, multiplicity set at pre-compile, set at pre-compile  # Specifies the period of main function EthTrcv_MainFunction in seconds.
      integer EthTrcvMaxTrcvsSupported: 0..255, set at pre-compile, default-value=1
      boolean EthTrcvSetPhyTestModeApi: multiplicity set at pre-compile, set at pre-compile  # Enables / Disables EthTrcv_SetPhyTestMode API.
      boolean EthTrcvStartAutoNegotiationApi: set at pre-compile  # Enables / Disables EthTrcv_StartAutoNegotiation API
      boolean EthTrcvVersionInfoApi: set at pre-compile, default-value=false  # Enables / Disables version info API
      boolean EthTrcvVersionInfoApiMacro: set at pre-compile, default-value=false  # Enables / Disables version info API macro implementation
      enumeration EthTrcvWakeUpSupport: {ETHTRCV_WAKEUP_BY_ASYNCHRONOUS_CHECK, ETHTRCV_WAKEUP_BY_INTERRUPT, ETHTRCV_WAKEUP_BY_POLLING, ETHTRCV_WAKEUP_NOT_SUPPORTED}, set at pre-compile  # Configures how to detect a signaled wake-up by hardware: polling, asychronous check via signal, interrupt or to not used/not supported. In case detection of a wake-up is not support (e.g. wake-up detection not needed or Ethernet hardware does not support wake-up detection), the BSWMD pre-configuration shall be set to ETHTRCV_WAKEUP_NOT_SUPPORTED.
      reference EthTrcvEcucPartitionRef [0..*]: scope=ECU, multiplicity set at pre-compile, post-build-variant-multiplicity=true, post-build-variant-value=true, set at pre-compile, destination=EcucPartition  # Maps the Ethernet transceiver driver to zero or multiple ECUC partitions to make the modules API available in this partition.
