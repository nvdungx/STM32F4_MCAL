AUTOSAR XML (schema 00046)
package /AUTOSAR/EcucDefs
  ecuc definition collection AUTOSARParameterDefinition: module=WEth
  module definition WEth [0..*]: post-build-variant-support=true, variants link-time/post-build/pre-compile  # Configuration of the WEth (Wireless Ethernet Driver) module.
    container WEthConfigSet  # This container contains the configuration parameters and sub containers of the AUTOSAR WEth module.
      container WEthCtrlConfig [1..*]  # Configuration of the individual controller
        integer WEthCtrlId: 0..255, scope=ECU, set at pre-compile, symbolic-name-value=true  # Specifies the instance ID of the configured controller.
        string WEthCtrlPhyAddress [0..1]: multiplicity set at link in variant link-time / post-build in variant post-build / pre-compile in variant pre-compile, post-build-variant-multiplicity=true, post-build-variant-value=true, set at link in variant link-time / post-build in variant post-build / pre-compile in variant pre-compile, max-length=17, min-length=17  # Specifies the unique 48-bit physical address (MAC address) of the controller in network byte order. | Regular Expression: [0-9a-fA-F]{2}[[:-][0-9a-fA-F]{2}]{5}
        integer WEthCtrlRxBufLenByte: 0..1522, post-build-variant-value=true, set at link in variant link-time / post-build in variant post-build / pre-compile in variant pre-compile  # Limits the maximum receive buffer length (frame length) in bytes.
        integer WEthCtrlTxBufLenByte: 0..1522, post-build-variant-value=true, set at link in variant link-time / post-build in variant post-build / pre-compile in variant pre-compile  # Limits the maximum transmit buffer length (frame length) in bytes.
        integer WEthRxBufTotal: 0..255, post-build-variant-value=true, set at link in variant link-time / post-build in variant post-build / pre-compile in variant pre-compile  # Configures the number of receive buffers.
        integer WEthTxBufTotal: 0..255, post-build-variant-value=true, set at link in variant link-time / post-build in variant post-build / pre-compile in variant pre-compile  # Configures the number of transmit buffers.
        reference WEthCtrlEcucPartitionRef [0..1]: scope=ECU, multiplicity set at pre-compile, post-build-variant-multiplicity=true, post-build-variant-value=true, set at pre-compile, destination=EcucPartition  # Maps the Wireless Ethernet controller to zero or one ECUC partitions. The ECUC partition referenced is a subset of the ECUC partitions where the Wireless Ethernet driver is mapped to. Tags: atp.Status=draft
        container WEthDemEventParameterRefs [0..1]  # Container for the references to DemEventParameter elements which shall be invoked using the API Dem_SetEventStatus in case the corresponding error occurs. The EventId is taken from the referenced DemEventParameter's DemEventId symbolic value. The standardized errors are provided in this container and can be extended by vendor-specific error references.
          reference WETH_E_ACCESS [0..1]: multiplicity set at link in variant link-time / post-build in variant post-build / pre-compile in variant pre-compile, post-build-variant-multiplicity=true, post-build-variant-value=true, set at link in variant link-time / post-build in variant post-build / pre-compile in variant pre-compile, requires-symbolic-name-value=true, destination=DemEventParameter  # Reference to the DemEventParameter which shall be issued when the error "Controller access failed" has occured.
    container WEthGeneral  # General configuration of Wireless Ethernet Driver module.
      boolean WEthDevErrorDetect: set at pre-compile, default-value=false  # Switches the Default Error Tracer (Det) detection and notification ON or OFF. | * true: detection and notification is enabled. * false: detection and notification is disabled.
      boolean WEthGetWEtherStatsApi: set at pre-compile  # Enables / Disables WEth_GetWEtherStats_32 and WEth_GetWEtherStats_64 API.
      integer WEthIndex: 0..255, set at pre-compile  # Specifies the InstanceId of this module instance. If only one instance is present it shall have the Id 0.
      float WEthMainFunctionPeriod: 0..Inf, set at pre-compile  # Specifies the period of main function WEth_MainFunction in seconds. Wireless Ethernet driver does not require this information but the BSW scheduler.
      boolean WEthUpdatePhysAddrFilter: set at pre-compile, default-value=false  # Enables/Disables optional API WEth_UpdatePhysAddrFilter.
      boolean WEthVersionInfoApi: set at pre-compile, default-value=false  # Enables / Disables version info API.
      reference WEthEcucPartitionRef [0..*]: scope=ECU, multiplicity set at pre-compile, post-build-variant-multiplicity=true, post-build-variant-value=true, set at pre-compile, destination=EcucPartition  # Maps the Wireless Ethernet driver to zero or multiple ECUC partitions to make the modules API available in this partition. The Wireless Ethernet driver will operate as an independent instance in each of the partitions. Tags: atp.Status=draft
