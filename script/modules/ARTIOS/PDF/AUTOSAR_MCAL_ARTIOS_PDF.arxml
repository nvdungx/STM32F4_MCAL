AUTOSAR XML (schema 00046)
package /AUTOSAR/EcucDefs
  ecuc definition collection AUTOSARParameterDefinition: module=ArtiOs
  module definition ArtiOs [0..1]: variants link-time/pre-compile  # The ArtiOs Module contains ARTI extensions to the EcucDefs/Os module. Tags: atp.Status=draft
    container ArtiOsClass [0..1]: multiplicity set at link in variant link-time / pre-compile in variant pre-compile  # Contains the layout of an ARTI "Os" object, extending the EcuC OsOS. Tags: atp.Status=draft
      reference ArtiOsAppModeClassRef: scope=ECU, set at link in variant link-time / pre-compile in variant pre-compile, destination=ArtiObjectClassParameter  # Refers to the ArtiObjectClassParameter that defines the ArtiOsAppModeInstance parameter. Tags: atp.Status=draft
    container ArtiOsInstance [0..1]: multiplicity set at link in variant link-time / pre-compile in variant pre-compile  # Represents an instance of an ARTI "Os" object, extending the EcuC OsOS. Tags: atp.Status=draft
      reference ArtiOsAppModeEcucRef: scope=ECU, set at link in variant link-time / pre-compile in variant pre-compile, destination=OsAppMode  # Refers to the EcucDefs/Os/OsAppMode of this OS. Tags: atp.Status=draft
      reference ArtiOsAppModeInstanceRef: scope=ECU, set at link in variant link-time / pre-compile in variant pre-compile, destination=ArtiObjectInstanceParameter  # Refers to the ArtiObjectInstanceParameter that contains the evaluation for the "application mode" of this OS. Tags: atp.Status=draft
      reference ArtiOsEcucRef: scope=ECU, set at link in variant link-time / pre-compile in variant pre-compile, destination=OsOS  # Refers to the EcucDefs/Os/OsOS of this OS. Tags: atp.Status=draft
      reference ArtiOsTaskHookRef [0..*]: scope=ECU, multiplicity set at link in variant link-time / pre-compile in variant pre-compile, set at link in variant link-time / pre-compile in variant pre-compile, destination=ArtiHook  # Refers to a hook for a specific task. Tags: atp.Status=draft
    container ArtiOsTaskClass [0..1]: multiplicity set at link in variant link-time / pre-compile in variant pre-compile  # Contains the layout of an ARTI "OsTask" object, extending the EcuC OsTask. Tags: atp.Status=draft
    container ArtiOsTaskInstance [0..*]: multiplicity set at link in variant link-time / pre-compile in variant pre-compile  # Represents an instance of an ARTI "OsTask" object, extending the EcuC OsTask. Tags: atp.Status=draft
      reference ArtiGenericComponentInstanceRef [0..1]: scope=ECU, multiplicity set at link in variant link-time / pre-compile in variant pre-compile, set at link in variant link-time / pre-compile in variant pre-compile, destination=ArtiGenericComponentInstance  # Refers to an ArtiGenericComponentInstance that extends the OsTask. Tags: atp.Status=draft
      reference ArtiOsTaskEcucRef: scope=ECU, set at link in variant link-time / pre-compile in variant pre-compile, destination=OsTask  # Refers to an ArtiGenericComponentInstance that extends the OsTask. Tags: atp.Status=draft
