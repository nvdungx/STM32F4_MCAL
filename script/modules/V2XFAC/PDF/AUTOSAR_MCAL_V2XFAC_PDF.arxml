AUTOSAR XML (schema 00053)
package /AUTOSAR/EcucDefs
  ecuc definition collection AUTOSARParameterDefinition: module=V2xFac
  module definition V2xFac [0..1]: variants pre-compile  # Configuration of the V2xFac module.
    container V2xFacConfig  # This container contains the configuration parameters and sub containers of the AUTOSAR V2xFac module.
      container V2xFacDmMsgConfig [1..*]: multiplicity set at pre-compile, post-build-variant-multiplicity=true  # This container contains the configuration of all messages that shall be passed on to the V2x Data Manager.
        integer V2xFacDmPortId: 0..65535, set at pre-compile  # This parameter contains the destination port identifier that references the V2x message.
        integer V2xFacV2xMessageId: 0..255, set at pre-compile  # This parameter contains the message identifier related to the V2X message that can be received on the associated BTP port as specified in ETSI ITS 102 894-2. | Note: Nothing precludes to use several message configurations to receive the same type of message on several BTP ports or several messages on the same BTP port, even if this is not intended by the standard.
        reference V2xFacDmMsgRef: set at pre-compile, requires-symbolic-name-value=true, destination=V2xDMMessage  # Symbolic name reference to [V2xDMMessage]
    container V2xFacGeneral  # This container contains the general configuration parameters of the Vehicle-2-X Facilities
      float V2xFacCaBsMainFunctionPeriod: 0..INF, set at pre-compile, default-value=0.1  # This parameter defines the schedule period of V2xFac_CaBs_MainFunction.Unit: [s]
      float V2xFacDenBsMainFunctionPeriod: 0..INF, set at pre-compile, default-value=0.1  # This parameter defines the schedule period of V2xFac_DenBs_MainFunction.Unit: [s]
      boolean V2xFacDevErrorDetect: set at pre-compile, default-value=false  # Switches the Default Error Tracer (Det) detection and notification ON or OFF. | * true: enabled (ON) * false: disabled (OFF)
      float V2xFacRxSMainFunctionPeriod: 0..INF, set at pre-compile, default-value=0.1  # This parameter defines the schedule period of V2xFac_RxS_MainFunction.Unit: [s]
      enumeration V2xFacStationType: {V2XFAC_ST_BUS, V2XFAC_ST_CYCLIST, V2XFAC_ST_HEAVYTRUCK, V2XFAC_ST_LIGHTTRUCK, V2XFAC_ST_MOPED, V2XFAC_ST_MOTORCYCLE, V2XFAC_ST_PASSENGERCAR, V2XFAC_ST_PEDESTRIAN, V2XFAC_ST_SPECIALVEHICLES, V2XFAC_ST_TRAILER, V2XFAC_ST_TRAM, V2XFAC_ST_UNKNOWN}, set at pre-compile, default-value=V2XFAC_ST_UNKNOWN  # This configuration value defines the station type information of the originating ITS-S, RoadSideUnit (15) not supported by AUTOSAR.
      boolean V2xFacVersionInfoApi: set at pre-compile, default-value=false  # Enable/disables the API for reading the version information of the V2xFac Module. | * true: enabled (ON) * false: disabled (OFF)
