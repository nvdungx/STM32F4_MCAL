AUTOSAR XML (schema 00046)
package /AUTOSAR/EcucDefs
  ecuc definition collection AUTOSARParameterDefinition: module=V2xFac
  module definition V2xFac [0..1]: variants pre-compile  # Configuration of the V2xFac module.
    container V2xFacGeneral  # This container contains the general configuration parameters of the Vehicle-2-X Basic Transport.
      float V2xFacCaBsMainFunctionPeriod: 0..Inf, set at pre-compile, default-value=0.1  # This parameter defines the schedule period of V2xFac_CaBs_MainFunction.Unit: [s]
      float V2xFacDenBsMainFunctionPeriod: 0..Inf, set at pre-compile, default-value=0.1  # This parameter defines the schedule period of V2xFac_DenBs_MainFunction.Unit: [s]
      boolean V2xFacDevErrorDetect: set at pre-compile, default-value=false  # Switches the Default Error Tracer (Det) detection and notification ON or OFF. | - true: enabled (ON) - false: disabled (OFF)
      float V2xFacIviSMainFunctionPeriod: 0..Inf, set at pre-compile, default-value=0.1  # This parameter defines the schedule period of V2xFac_IviS_MainFunction.Unit: [s]
      float V2xFacRltSMainFunctionPeriod: 0..Inf, set at pre-compile, default-value=0.1  # This parameter defines the schedule period of V2xFac_RltS_MainFunction.Unit: [s]
      enumeration V2xFacStationType: {V2XFAC_ST_BUS, V2XFAC_ST_CYCLIST, V2XFAC_ST_HEAVYTRUCK, V2XFAC_ST_LIGHTTRUCK, V2XFAC_ST_MOPED, V2XFAC_ST_MOTORCYCLE, V2XFAC_ST_PASSENGERCAR, V2XFAC_ST_PEDESTRIAN, V2XFAC_ST_SPECIALVEHICLES, V2XFAC_ST_TRAILER, V2XFAC_ST_TRAM, V2XFAC_ST_UNKNOWN}, set at pre-compile, default-value=V2XFAC_ST_UNKNOWN  # This configuration value defines the station type information of the originating ITS-S, RoadSideUnit (15) not supported by AUTOSAR.
      float V2xFacTlmSMainFunctionPeriod: 0..Inf, set at pre-compile, default-value=0.1  # This parameter defines the schedule period of V2xFac_TlmS_MainFunction. Unit: [s]
      boolean V2xFacVersionInfoApi: set at pre-compile, default-value=false  # Enable/disables the API for reading the version information of the V2xFac Module. | - true: enabled (ON) - false: disabled (OFF)
