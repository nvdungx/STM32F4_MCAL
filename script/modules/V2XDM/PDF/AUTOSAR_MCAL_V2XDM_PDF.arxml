AUTOSAR XML (schema 00053)
package /AUTOSAR/EcucDefs
  ecuc definition collection AUTOSARParameterDefinition: module=V2xDM
  module definition V2xDM [0..1]: variants pre-compile  # Configuration of the V2XDM module
    container V2xDMConfigSet  # Container contains all configuration items for the V2xDM
      container V2xDMCatalogItem [0..*]: multiplicity set at pre-compile  # Contains all catalog items of the V2x DataManager
        foreign reference V2xDMCatalogItemTypeRef: set at pre-compile, destination-type=SW-BASE-TYPE  # Reference to the base type of this catalog item.
        container V2xDMConnection [0..*]: multiplicity set at pre-compile  # Collects all connection information for this catalog item.
          container V2xDMConnectionSource [1..*]: multiplicity set at pre-compile  # Contains definition for the connected sources of V2x message items.
            enumeration V2xDMConnectionSourceOperator [0..1]: {V2XDM_CONN_SRC_OP_EXISTS, V2XDM_CONN_SRC_OP_LENGTH}, multiplicity set at pre-compile, set at pre-compile  # Selects the source type of the operator.
            reference V2xDMConnectionSourceTargetRef: set at pre-compile, destination=V2xDMSimpleType  # Links to the simple type of a V2x message.
            container V2xDMConnectionSourceContext [0..*]: multiplicity set at pre-compile  # Contains information to uniquely address a V2X message element. I.e. the V2x message element can be contained in a SequenceOf. In that case the index inside the SequenceOf must be provided to avoid an ambiguous reference.
              integer V2xDMConnectionSourceContextIndex: 0..65535, set at pre-compile  # Index to the SequenceOf element that the SourceContextRef references to.
              reference V2xDMConnectionSourceContextRef: set at pre-compile, destination=V2xDMStructuredTypeSequenceOf  # Reference to the SequenceOf element of a V2x message.
          container V2xDMConversion [0..1]: multiplicity set at pre-compile  # Allows to define a conversion routine to adapt V2x simple item(s) to the data catalog element.
            function name V2xDMConversionFunc: set at pre-compile  # This parameter provides the function name for the callback <V2xDM_ItemConversionFunc>.It is used to convert the simple type information into the data catalog item value and its base type.
            choice container V2xDMConversionFunction [0..1]: multiplicity set at pre-compile  # Defines the conversion function container that shall be applied to convert the V2x message element into the unified data catalog item.
              container V2xDMConversionFunctionLinear [0..1]: multiplicity set at pre-compile  # This container defines th parameter for the linear conversion routine.
                float V2xDMConversionFunctionLinearConstant: set at pre-compile  # This parameter defines the offset to the linear conversion function
                float V2xDMConversionFunctionLinearFactor: set at pre-compile  # This defines the scale factor for the linear conversion function.
      container V2xDMLink [0..*]: multiplicity set at pre-compile  # Defines the links between the VariableDataPrototypes of the V2x object to the V2x catalog items.
        reference V2xDMLinkCatalogItemRef: set at pre-compile, destination=V2xDMCatalogItem  # References to the catalog item that is used for this link.
        instance reference V2xDMLinkV2xObjectElementInstanceRef [1..*]: multiplicity set at pre-compile, set at pre-compile, destination-context=ROOT-SW-COMPOSITION-PROTOTYPE SW-COMPONENT-PROTOTYPE PORT-PROTOTYPE AUTOSAR-DATA-PROTOTYPE IMPLEMENTATION-DATA-TYPE-ELEMENT*, destination-type=IMPLEMENTATION-DATA-TYPE-ELEMENT  # This container references to the port prototype and VariableDataPrototype as a V2x object.
      container V2xDMMsgQueue [0..1]: multiplicity set at pre-compile  # Specifies a message queue for incoming V2x messages of the data manager. If this container is not present, no queue is used for incoming V2x messages. If it is present, the elements of the container specifies the queue depth and its elements.
        integer V2xDMMsgQueueElementSize: 0..65535, set at pre-compile  # Size of a queue entry in bytes. All queue entries have the same size. The value shall be large enough to store the largest V2x message.
        integer V2xDMMsgQueueNumberOfEntries: 0..255, set at pre-compile, default-value=0  # Specifies the number of Queue entries for incoming V2x messages. One entry per V2x message. | A number of 0 in this field disables the queue and actions are performed only in the V2xDM_RxIndication.
      container V2xDMStack  # Holds the V2x stack specific container and parameter.
        container V2xDMMessage [1..*]: multiplicity set at pre-compile  # Definition of a V2x message and its layout
          integer V2xDMMsgId: 0..4294967295, set at pre-compile, symbolic-name-value=true  # Identifier of the message. The set of V2x message identifiers shall be consecutive and gapless.
          choice reference V2xDMMsgRootRef: set at pre-compile, destination=[V2xDMSimpleType, V2xDMStructuredType]  # This element links to the first structured element within the V2x message.
          container V2xDMPdu [0..1]: multiplicity set at pre-compile  # Container for parameters that are necessary for the configuration of the V2xDM to serve as the UpperLayer of the PDU-Router module.
            enumeration V2xDMPduDirection: {V2XDM_PDU_RECEIVE, V2XDM_PDU_SEND}, set at pre-compile  # Defines the direction of the PDU: | V2XDM_PDU_SEND - V2xDM passes on the V2x message as raw data to the PduR. V2XDM_PDU_RECEIVE - V2xDM receives the V2x message through the PduR (no V2x stack present in the ECU).
            integer V2xDMPduId: 0..65535, set at pre-compile, symbolic-name-value=true  # The numerical value used as the ID of this I-PDU. The ComIPduHandleId | is required by the API calls PduR_V2xDMRxIndication to receive I-PDUs from the PduR (ComIP-duDirection: Receive) For Tx-I-PDUs (ComIPduDirection: Send), this handle Id is used for the APIs call PduR_V2xDMTransmit to transmit I-PDUs.
            reference V2xDMPduRef: set at pre-compile, destination=Pdu  # Reference to the global Pdu structure.
          choice container V2xDMSimpleType [0..*]: multiplicity set at pre-compile  # Definition of simple types within a V2x message as a choice of simple types.
            container V2xDMSimpleTypeBitString [0..1]: multiplicity set at pre-compile  # Definition of the ASN.1 Bit String
              boolean V2xDMSimpleTypeBitStringIsExtensible: set at pre-compile  # Defines if the item is extensible in future releases.
              container V2xDMSimpleTypeBitStringConstr [0..65535]: multiplicity set at pre-compile  # Container defines the constraints for the length of the bit string (Min/Max).
                integer V2xDMSimpleTypeBitStringConstrMax [0..1]: 0..65535, multiplicity set at pre-compile, set at pre-compile  # Max length of the BitString parameter.
                integer V2xDMSimpleTypeBitStringConstrMin [0..1]: 0..4294967295, multiplicity set at pre-compile, set at pre-compile  # Min length of the BitString parameter.
              container V2xDMSimpleTypeBitStringItem [0..*]: multiplicity set at pre-compile  # Defines item values as Key-Pair-Values for the BitString.
                string V2xDMSimpleTypeBitStringItemIdentifier: set at pre-compile  # Defines the name for the Key-Pair-Values for the BitString.
                integer V2xDMSimpleTypeBitStringItemValue: 0..65535, set at pre-compile  # Defines the value representation for the Key-Pair-Values for the BitString.
            container V2xDMSimpleTypeBoolean [0..1]: multiplicity set at pre-compile  # Definition of the ASN.1 boolean type
            container V2xDMSimpleTypeCharString [0..1]: multiplicity set at pre-compile  # Definition of the ASN.1 type character string
              string V2xDMSimpleTypeCharStringAlphabet [0..1]: multiplicity set at pre-compile, set at pre-compile  # Defines the character set that is used and allowed for this CharString.
              boolean V2xDMSimpleTypeCharStringIsExtensible: set at pre-compile  # Defines if future extensions of this parameter shall be considered.
              enumeration V2xDMSimpleTypeCharStringType: {V2XDM_SIMPLETYPE_CHARSTR_IA5, V2XDM_SIMPLETYPE_CHARSTR_NUMERIC, V2XDM_SIMPLETYPE_CHARSTR_UTF8}, set at pre-compile  # Defines the type of CharString SimpleType.
              container V2xDMSimpleTypeCharStringConstr [0..*]: multiplicity set at pre-compile  # Container defines the constraints for the character string (Min/Max).
                integer V2xDMSimpleTypeCharStringConstrMax [0..1]: 0..65535, multiplicity set at pre-compile, set at pre-compile  # Max number of values for the char string parameter.
                integer V2xDMSimpleTypeCharStringConstrMin [0..1]: 0..65535, multiplicity set at pre-compile, set at pre-compile  # Min number of values for the char string parameter.
            container V2xDMSimpleTypeEnum [0..1]: multiplicity set at pre-compile  # Definition of the ASN.1 enumeration type
              boolean V2XDMSimpleTypeEnumerationIsExtensible: set at pre-compile  # Defines if the enumeration can be extended in future releases (...).
              container V2XDMSimpleTypeEnumerationItem [1..*]: multiplicity set at pre-compile  # Parameter description for the enumeration simple type.
                string V2XDMSimpleTypeEnumerationItemName: set at pre-compile  # Defines the name of the enumeration item.
                integer V2XDMSimpleTypeEnumerationItemValue: 0..255, set at pre-compile  # Definition of the item value of the enumeration.
            container V2xDMSimpleTypeInteger [0..1]: multiplicity set at pre-compile  # Definition of the ASN.1 integer type
              boolean V2xDMSimpleTypeIntegerIsExtensible: set at pre-compile  # Indicates if data for the integer simple types can be extended in the future (...).
              container V2xDMSimpleTypeIntegerConstr [0..*]: multiplicity set at pre-compile  # Defines the constraints for the integer simple type
                integer V2xDMSimpleTypeIntegerConstrMax: 0..4398046511103, set at pre-compile  # Defines the max value for this integer simple type.
                integer V2xDMSimpleTypeIntegerConstrMin [0..1]: -4398046511104..0, multiplicity set at pre-compile, set at pre-compile  # Defines the min value for this integer simple type.
              container V2xDMSimpleTypeIntegerItem  # Descriptor parameters of the simple type integer item.
                string V2xDMSimpleTypeIntegerItemName: set at pre-compile  # Provide a name for this integer item.
                integer V2xDMSimpleTypeIntegerItemValue: -4398046511104..4398046511103, set at pre-compile  # The default value for this integer
            container V2xDMSimpleTypeOctetString [0..1]: multiplicity set at pre-compile  # Definition of the ASN.1 Octet String.
              boolean V2xDMSimpleTypeOctetStringIsExtensible: set at pre-compile  # Defines if the octet string can be extended in future releases (...).
              container V2xDMSimpleTypeOctetStringConstr [0..1]: multiplicity set at pre-compile  # Defines the constraint for the octet string as simple type according to ASN.1.
                integer V2xDMSimpleTypeOctetStringConstrMax [0..1]: 0..65535, multiplicity set at pre-compile, set at pre-compile  # Defines the max length for the octet string.
                integer V2xDMSimpleTypeOctetStringConstrMin [0..1]: 0..65535, multiplicity set at pre-compile, set at pre-compile  # Defines the min length for the octet string.
          choice container V2xDMStructuredType [0..*]: multiplicity set at pre-compile  # Definition of structured types in a V2x message
            container V2xDMStructuredTypeChoice [0..1]: multiplicity set at pre-compile  # Defines a choice of elements within a V2x message.
              boolean V2xDMStructuredTypeChoiceCallbackEnabled: set at pre-compile  # Enables a callback when the structure has been decoded.
              boolean V2xDMStructuredTypeChoiceIsExtensible [0..1]: multiplicity set at pre-compile, set at pre-compile, default-value=false  # Indicates if the choice container can be extended in future releases (marked with '...' in ASN.1)
              container V2xDMStructuredTypeChoiceOption [1..*]: multiplicity set at pre-compile  # Defines the reference and order of types in this choice element.
                integer V2xDMStructuredTypeChoiceOptionIndex: 0..65535, set at pre-compile  # Defines the order of elements inside the choice container.
                choice reference V2xDMStructuredTypeChoiceOptionType: set at pre-compile, destination=[V2xDMSimpleType, V2xDMStructuredType]  # Define a link to a simple or structured type that is present in this choice container.
            container V2xDMStructuredTypeSequence [0..1]: multiplicity set at pre-compile  # Defines a sequence of elements within a V2x message.
              boolean V2xDMStructuredTypeSequenceCallbackEnabled: set at pre-compile  # Enables a callback when the structure has been decoded.
              boolean V2xDMStructuredTypeSequenceIsExtensible: set at pre-compile, default-value=false  # Defines if this sequence can be extended in the future (typically declared in ASN.1 with '...').
              container V2xDMStructuredTypeSequenceChild [1..*]: multiplicity set at pre-compile  # Declares all attributes for a child element in the ASN.1 structured type sequence element.
                enumeration V2xDMStructuredTypeSequenceChildAttribute: {V2XDM_STRUCTURED_TYPE_SEQUENCE_CHILD_ATTRIBUTE_DEFAULT, V2XDM_STRUCTURED_TYPE_SEQUENCE_CHILD_ATTRIBUTE_NONE, V2XDM_STRUCTURED_TYPE_SEQUENCE_CHILD_ATTRIBUTE_OPTIONAL}, set at pre-compile  # Select the attribute of a sequence element.
                string V2xDMStructuredTypeSequenceChildDefault [0..1]: multiplicity set at pre-compile, set at pre-compile  # Default values of the structure.
                integer V2xDMStructuredTypeSequenceChildIndex: 0..65535, set at pre-compile  # Define the index of the element within the structure.
                choice reference V2xDMStructuredTypeSequenceChildType: set at pre-compile, destination=[V2xDMSimpleType, V2xDMStructuredType]  # Reference to the child element in the structure as a simple or structured type.
            container V2xDMStructuredTypeSequenceOf [0..1]: multiplicity set at pre-compile  # Defines a list of elements within a V2x message. Comparable to an array.
              boolean V2xDMStructuredTypeSequenceOfCallbackEnabled: set at pre-compile  # Enables a generated callback when the structure is decoded.
              boolean V2xDMStructuredTypeSequenceOfIsExtensible [0..1]: multiplicity set at pre-compile, set at pre-compile, default-value=false  # Defines if the SequenceOf is extensible in the future (marked as '...' in ASN.1)
              choice reference V2xDMStructuredTypeSequenceOfType: set at pre-compile, destination=[V2xDMSimpleType, V2xDMStructuredType]  # Reference to the next structured or simple type.
              container V2xDMStructuredTypeSequenceOfConstr [0..*]: multiplicity set at pre-compile  # This container defines the constraints of the SequenceOf parent container.
                integer V2xDMStructuredTypeSequenceOfConstrMax [0..1]: 0..65535, multiplicity set at pre-compile, set at pre-compile  # Defines the max. number of SequenceOf values.
                integer V2xDMStructuredTypeSequenceOfConstrMin [0..1]: 0..65535, multiplicity set at pre-compile, set at pre-compile  # Defines the minimum number of the SequenceOf container.
    container V2xDMGeneral  # This container contains the general configuration parameters of the Vehicle-2-X Data Manager.
      boolean V2xDMDevErrorDetect: set at pre-compile, default-value=false  # Switches the Default Error Tracer (Det) detection and notification ON or OFF. | * true: enabled (ON) * false: disabled (OFF)
      float V2xDMMainFunctionPeriod: 0..INF, scope=ECU, set at pre-compile, default-value=0.01  # Specifies the period of main function V2xDM_MainFunction in seconds.
      boolean V2xDMVersionInfoApi: set at pre-compile, default-value=false  # Enable/disables the API for reading the version information of the V2xDM Module. | * true: enabled (ON) * false: disabled (OFF)
      reference V2xDMEcucPartitionRef [0..1]: multiplicity set at pre-compile, set at pre-compile, destination=EcucPartition  # Reference to EcucPartition, where V2x Data Manager module is assigned to.
