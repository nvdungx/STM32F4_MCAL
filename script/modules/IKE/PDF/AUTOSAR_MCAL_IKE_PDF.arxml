AUTOSAR XML (schema 00053)
package /AUTOSAR/EcucDefs
  ecuc definition collection AUTOSARParameterDefinition: module=IKE
  module definition IKE [0..1]: variants pre-compile  # Description for the Internet Key Exchange.
    container IKECertificates  # Container for configuration of IKE certificates.
      integer IKEMaxPublicKeyLength: 64..4096, multiplicity set at pre-compile, set at pre-compile, default-value=96  # The maximum length of the public key in a certificate. | Choose 64 for ECDSA-256, 96 for ECDSA-384, etc.
      integer IKEMaxSubjectNameSize: 32..1024, multiplicity set at pre-compile, set at pre-compile, default-value=256  # The maximum size of the Subject Name field in certificates.
      reference IKECertificateBufferRef [2..2]: multiplicity set at pre-compile, set at pre-compile, requires-symbolic-name-value=true, destination=CsmKey  # The referenced keys are used as buffers for temporarily storing the peer certificates.
      container IKECertificate [2..65534]: multiplicity set at pre-compile  # Container for configuration of an identity certificate and its issuer certificate. | Use this container to configure a valid chain of certificates. The top-level certificate must be a self-signed certificate.
        reference IKEIssuerCertificateRef: multiplicity set at pre-compile, set at pre-compile, destination=IKECertificate  # The referenced certificate is the Issuer Certificate. The Issuer Certificate is used to identifiy the certificate authority (CA) which is the issuer of the Identity Certificate. The associated public key is used for verification of the certificate.
        reference KEIdentityCertificateRef: multiplicity set at pre-compile, set at pre-compile, requires-symbolic-name-value=true, destination=CsmKey  # The referenced key is the Identity Certificate which is used to identifiy an entity and to associate that identiy with a public key.
    container IKEConnections  # Container for configuration of IKE connections.
      float IKEConnectionTimeout: 1..60, multiplicity set at pre-compile, set at pre-compile, default-value=30  # Timeout for etsablishing a connection in order to handle a "half open" state.
      integer IKEFragmentSize: 576..4096, multiplicity set at pre-compile, set at pre-compile, default-value=1280  # The maximum size of IKE fragment messages when fragmentation is used. | The resulting buffer size for subsequent fragment messages is (Number of Fragments * Fragment Size). This fragment size is the maximum IP datagram size, used for both RX and TX.
      integer IKELocalPort: 0..65535, multiplicity set at pre-compile, set at pre-compile, default-value=500  # The local port is the UDP port to listen to.
      integer IKEMaxNumFragments: 1..10, multiplicity set at pre-compile, set at pre-compile, default-value=3  # The maximum number of fragment messages into which the an IKE message might be divided. If this value is set to 1, fragmentation is not supported. | The resulting buffer size for subsequent fragment messages is (Number of Fragments * Fragment Size). Used for both RX and TX and affects size of TX buffer.
      float IKEReassemblingTimeout: 0.1..60, multiplicity set at pre-compile, set at pre-compile, default-value=0.5  # The timeout for reassembling a fragmented message. All fragments of a message must be received within this interval, Otherwise all so far received fragments are discarded.
      float IKERetransmitBase: 1..2, multiplicity set at pre-compile, set at pre-compile, default-value=1.3  # The base used for calculation of the exponantioal back-off of the retransmit timeouts.
      float IKERetransmitTimeout: 1..60, multiplicity set at pre-compile, set at pre-compile, default-value=1.5  # The initial retransmit timeout.
      integer IKERetransmitTries: 0..255, multiplicity set at pre-compile, set at pre-compile, default-value=10  # The maximum number of retransmits of a request before giving up.
      container IKEConnection [1..*]: multiplicity set at pre-compile  # Container for configuration of IKE connection.
        boolean IKEAutostart: multiplicity set at pre-compile, set at pre-compile, default-value=true  # If enabled, IKE wil automatically initiate an IKE SA on this connection after start-up of the module.
        integer IKEConnectionId: 0..4294967295, multiplicity set at pre-compile, set at pre-compile, default-value=0  # Identifier of the connection.
        float IKEDpdDelay: 0..1000000000, multiplicity set at pre-compile, set at pre-compile, default-value=30  # Specifies the interval in which Dead Peer Detection (DPD) packets shall be sent in the absence of other traffic | Set to 0 to disable sending DPD packets.
        float IKEIkeLifetime: 0..1000000000, multiplicity set at pre-compile, set at pre-compile, default-value=86400  # Specifies the time after which an IKE SA is terminated. | Set to 0 if IKE SA never expires.
        float IKEIkeMarginTime: 10..1000000000, multiplicity set at pre-compile, set at pre-compile, default-value=600  # Specifies how many seconds before expiry an IKE SA should be renegotiated.
        string IKERemoteAddress: multiplicity set at pre-compile, set at pre-compile  # The remote address is the IP address of the ECU which a IKE connection shall be established with, e.g. 192.168.50.101.
        integer IKERemotePort: 0..65535, multiplicity set at pre-compile, set at pre-compile, default-value=500  # The remote port is the UDP port of the ECU which a IKE connection shall be established with.
        reference IKEECUCertificateRef [0..1]: multiplicity set at pre-compile, set at pre-compile, destination=IKECertificate  # The ECU certificate is the end-entity certificate. | The referenced certificate is the ECU certificate which cortains the public key used for authentication during the IKE connection setup.
        reference IKEECUPreSharedKeyRef [0..1]: multiplicity set at pre-compile, set at pre-compile, requires-symbolic-name-value=true, destination=CsmKey  # The ECU's pre-shared key.
        reference IKERemotePreSharedKeyRef [0..1]: multiplicity set at pre-compile, set at pre-compile, requires-symbolic-name-value=true, destination=CsmKey  # The referenced key is the key which is used to identify the remote ECU during the IKE connection setup.
        reference IKETcpIpLocalAddressRef: multiplicity set at pre-compile, set at pre-compile, requires-symbolic-name-value=true, destination=TcpIpLocalAddr  # IP address table identifier assigned by TCP/IP stack.
        reference IKETrustAnchorCertificateRef [0..1]: multiplicity set at pre-compile, set at pre-compile, destination=IKECertificate  # The referenced certificate is the Trust Anchor certificate which is used to identify the trusted Certification Authorities during the IKE connection setup.
        container IKESession [1..255]: multiplicity set at pre-compile  # Container for configuration of IKE session.
          container IKEChildSaProposal [1..65536]: multiplicity set at pre-compile  # Container for configuration of IKE Authentication Header (AH) or Encapsulating Security Payload (ESP) Security Association Proposals.
            enumeration IKESecurityProtocol: {IKE_PROTOCOL_AH, IKE_PROTOCOL_ESP}, multiplicity set at pre-compile, set at pre-compile, default-value=IKE_PROTOCOL_AH  # The security protocol (i.e., AH or ESP) to be used for this Child SA.
            boolean IKEUseExtendedSequenceNumbers: multiplicity set at pre-compile, set at pre-compile, default-value=true  # Whether this Child SA should use Extended Sequence Numbers (ESN), i.e., 64-Bit instead of 32-Bit sequence numbers.
            reference IKEEncrTransformRef [0..1]: multiplicity set at pre-compile, set at pre-compile, destination=TcpIpEncryptionAlgorithm  # The referenced Encryption Algorithm is added to this proposal. | Leave empty for AH and ESP in authentication-only mode.
            reference IKEIntegTransformRef: multiplicity set at pre-compile, set at pre-compile, destination=TcpIpIntegrityAlgorithm  # The referenced Integrity Algorithm is added to this proposal.
          container IKEIkeSaProposal [1..*]: multiplicity set at pre-compile  # Container for configuration of IKE IKE Security Association Proposal.
            reference IKEDhTransformRef: multiplicity set at pre-compile, set at pre-compile, destination=IKEDhTransform  # The referenced Diffie-Hellman Group Transform is added to this proposal.
            reference IKEEncrTransformRef: multiplicity set at pre-compile, set at pre-compile, destination=IKEEncrTransform  # The referenced Encryption Algorithm Transform is added to this proposal.
            reference IKEIntegTransformRef: multiplicity set at pre-compile, set at pre-compile, destination=IKEIntegTransform  # The referenced Integrity Algorithm Transform is added to this proposal.
            reference IKEPrfTransformRef: multiplicity set at pre-compile, set at pre-compile, destination=IKEPrfTransform  # The referenced Pseudorandom Function Transform is added to this proposal.
          container IKESignatureAuthenticationVariant [1..*]: multiplicity set at pre-compile  # Defining variants for the IKEv2 Authentication Method "Digitial Signature".
            enumeration IKEHashAlgorithm: {IKE_HASH_ALGO_SHA1, IKE_HASH_ALGO_SHA2_256, IKE_HASH_ALGO_SHA2_384, IKE_HASH_ALGO_SHA2_512}, multiplicity set at pre-compile, set at pre-compile, default-value=IKE_HASH_ALGO_SHA1  # Pre-hashing Algorithm. | Please adapt to the referenced Csm jobs.
            enumeration IKESignatureAlgorithm: {IKE_SIGNATURE_DSA, IKE_SIGNATURE_ECDSA, IKE_SIGNATURE_RSASSA_PSS, IKE_SIGNATURE_RSA_ENCRYPTION}, multiplicity set at pre-compile, set at pre-compile, default-value=IKE_SIGNATURE_ECDSA  # Signature Algorithm. | Please adapt to the referenced Csm jobs.
            integer IKESignatureLength: 64..1024, multiplicity set at pre-compile, set at pre-compile, default-value=96  # The length of a signature generated by the configured generation job and verified by the configured verification job. | E.g. 64 for ECDSA-256 or 96 for ECDSA-386.
            reference IKESignatureGenerateJobRef: multiplicity set at pre-compile, set at pre-compile, requires-symbolic-name-value=true, destination=CsmJob  # The referenced Csm job is used for the execution of the CsmSignatureGenerate primitive needed for this transform.
            reference IKESignatureVerifyJobRef: multiplicity set at pre-compile, set at pre-compile, requires-symbolic-name-value=true, destination=CsmJob  # The referenced Csm job is used for the execution of the CsmSignatureVerify primitive needed for this transform.
    container IKEGeneral  # General module settings.
      boolean IKEVersionInfoApi: multiplicity set at pre-compile, set at pre-compile, default-value=false  # Pre-processor switch to enable and disable availability of the API IKE_GetVersionInfo(). | * True: API IKE_GetVersionInfo() is available. * False: API IKE_GetVersionInfo() is not available.
      reference IKEHashJobRef: requires-symbolic-name-value=true, destination=CsmJob  # The referenced crypto job is used to calculate the SHA-1 hash of the Subject Public Key Info element needed for the encoding of the certification authorities.
      reference IKERandomJobRef: multiplicity set at pre-compile, set at pre-compile, requires-symbolic-name-value=true, destination=CsmJob  # The referenced crypto job is used for random number generation.
      reference IKETcpIpSocketOwner: multiplicity set at pre-compile, set at pre-compile, requires-symbolic-name-value=true, destination=TcpIpSocketOwner  # The ID of the socket user.
      container IKEMessageFormat: multiplicity set at pre-compile  # In order to deserialize the byte stream of IKE messages to data structures memory is statically allocated. Use the parameters in this container to minimize the used memory. But, configuring too low maximum values might result in unsuccessful deserializations of received IKE messages.
        integer IKEMaxAttributesPerTransform: 1..2, multiplicity set at pre-compile, set at pre-compile, default-value=2  # The maximum number of attributes a transform may contain.
        integer IKEMaxCertPayloadsPerMessage: 1..4, multiplicity set at pre-compile, set at pre-compile, default-value=4  # The maximum number of Certificate payloads an IKE message may contain.
        integer IKEMaxCertreqPayloadsPerMessage: 1..4, multiplicity set at pre-compile, set at pre-compile, default-value=4  # The maximum number of Certificate Request payloads an IKE message may contain.
        integer IKEMaxDeletePayloadsPerMessage: 1..2, multiplicity set at pre-compile, set at pre-compile, default-value=2  # The maximum number of Delete payloads an IKE message may contain.
        integer IKEMaxInitMessageSize: 256..3000, multiplicity set at pre-compile, set at pre-compile, default-value=512  # The maximum size of incoming IKE_INIT messages.
        integer IKEMaxNonceSize: 32..512, multiplicity set at pre-compile, set at pre-compile, default-value=64  # The maximum size of incoming nonces. | Must be be at least 32 bytes and at least half the key size of the largest configured pseudorandom function (PRF).
        integer IKEMaxNotifyPayloadsPerMessage: 1..10, multiplicity set at pre-compile, set at pre-compile, default-value=10  # The maximum number of Notify payloads an IKE message may contain.
        integer IKEMaxPayloadsPerMessage: 1..20, multiplicity set at pre-compile, set at pre-compile, default-value=20  # The maximum number of payloads an IKE message may contain.
        integer IKEMaxProposalsPerSaPayload: 1..5, multiplicity set at pre-compile, set at pre-compile, default-value=5  # The maximum number of proposals a SA payload may contain.
        integer IKEMaxSpisPerDeletePayload: 1..2, multiplicity set at pre-compile, set at pre-compile, default-value=2  # The maximum number of SPIs a Delete payload may contain.
        integer IKEMaxTrafficSelectorsPerTsPayload: 1..2, multiplicity set at pre-compile, set at pre-compile, default-value=2  # The maximum number of traffic selectors a Traffic Selector payload may contain.
        integer IKEMaxTransformsPerProp: 1..5, multiplicity set at pre-compile, set at pre-compile, default-value=5  # The maximum number of transforms a proposal may contain.
    container IKETransforms  # Container for configuration of IKE transforms.
      container IKEDhTransform [1..*]: multiplicity set at pre-compile  # Container for configuration of Diffie-Hellman Group Transform.
        enumeration IKETransformId: {IKE_TRANSFORM_DH_1024_BIT_MODP_GROUP, IKE_TRANSFORM_DH_1024_BIT_MODP_GROUP_WITH_160_BIT_PRIME_ORDER_SUBGROUP, IKE_TRANSFORM_DH_1536_BIT_MODP_GROUP, IKE_TRANSFORM_DH_192_BIT_RANDOM_ECP_GROUP, IKE_TRANSFORM_DH_2048_BIT_MODP_GROUP, IKE_TRANSFORM_DH_2048_BIT_MODP_GROUP_WITH_224_BIT_PRIME_ORDER_SUBGROUP, IKE_TRANSFORM_DH_2048_BIT_MODP_GROUP_WITH_256_BIT_PRIME_ORDER_SUBGROUP, IKE_TRANSFORM_DH_224_BIT_RANDOM_ECP_GROUP, IKE_TRANSFORM_DH_256_BIT_RANDOM_ECP_GROUP, IKE_TRANSFORM_DH_3072_BIT_MODP_GROUP, IKE_TRANSFORM_DH_384_BIT_RANDOM_ECP_GROUP, IKE_TRANSFORM_DH_4096_BIT_MODP_GROUP, IKE_TRANSFORM_DH_521_BIT_RANDOM_ECP_GROUP, IKE_TRANSFORM_DH_6144_BIT_MODP_GROUP, IKE_TRANSFORM_DH_768_BIT_MODP_GROUP, IKE_TRANSFORM_DH_8192_BIT_MODP_GROUP, IKE_TRANSFORM_DH_BRAINPOOLP224R1, IKE_TRANSFORM_DH_BRAINPOOLP256R1, IKE_TRANSFORM_DH_BRAINPOOLP384R1, IKE_TRANSFORM_DH_BRAINPOOLP512R1, IKE_TRANSFORM_DH_CURVE25519, IKE_TRANSFORM_DH_CURVE448}, multiplicity set at pre-compile, set at pre-compile, default-value=IKE_TRANSFORM_DH_256_BIT_RANDOM_ECP_GROUP  # Diffie-Hellman Group Transform ID.
        reference IKEKeyRef: multiplicity set at pre-compile, set at pre-compile, requires-symbolic-name-value=true, destination=CsmKey  # The referenced Csm key is used for the execution of key management functions needed for this transform.
      container IKEEncrTransform [1..*]: multiplicity set at pre-compile  # Container for configuration of Encryption Algorithm Transform.
        integer IKEKeyLength: 0..255, multiplicity set at pre-compile, set at pre-compile, default-value=16  # The key length of the encryption algorithm in bytes.
        enumeration IKETransformId: {IKE_TRANSFORM_ENCR_3DES, IKE_TRANSFORM_ENCR_3IDEA, IKE_TRANSFORM_ENCR_AES_CBC, IKE_TRANSFORM_ENCR_AES_CCM_12, IKE_TRANSFORM_ENCR_AES_CCM_16, IKE_TRANSFORM_ENCR_AES_CCM_8, IKE_TRANSFORM_ENCR_AES_CTR, IKE_TRANSFORM_ENCR_AES_GCM_12, IKE_TRANSFORM_ENCR_AES_GCM_16, IKE_TRANSFORM_ENCR_AES_GCM_8, IKE_TRANSFORM_ENCR_BLOWFISH, IKE_TRANSFORM_ENCR_CAMELLIA_CBC, IKE_TRANSFORM_ENCR_CAMELLIA_CCM_12, IKE_TRANSFORM_ENCR_CAMELLIA_CCM_16, IKE_TRANSFORM_ENCR_CAMELLIA_CCM_8, IKE_TRANSFORM_ENCR_CAMELLIA_CTR, IKE_TRANSFORM_ENCR_CAST, IKE_TRANSFORM_ENCR_CHACHA20_POLY1305, IKE_TRANSFORM_ENCR_DES, IKE_TRANSFORM_ENCR_DES_IV32, IKE_TRANSFORM_ENCR_DES_IV64, IKE_TRANSFORM_ENCR_IDEA, IKE_TRANSFORM_ENCR_RC5}, multiplicity set at pre-compile, set at pre-compile, default-value=IKE_TRANSFORM_ENCR_AES_CBC  # Encryption Algorithm Transform ID.
        reference IKEDecryptJobRef: multiplicity set at pre-compile, set at pre-compile, requires-symbolic-name-value=true, destination=CsmJob  # The referenced Csm job is used for the execution of the CsmDecrypt primitive needed for this transform.
        reference IKEEncryptJobRef: multiplicity set at pre-compile, set at pre-compile, requires-symbolic-name-value=true, destination=CsmJob  # The referenced Csm job is used for the execution of the CsmEncrypt primitive needed for this transform.
      container IKEIntegTransform [1..*]: multiplicity set at pre-compile  # Container for configuration of Integrity Algorithm Transform.
        enumeration IKETransformId: {IKE_TRANSFORM_AUTH_AES_CMAC_96, IKE_TRANSFORM_AUTH_AES_XCBC_96, IKE_TRANSFORM_AUTH_DES_MAC, IKE_TRANSFORM_AUTH_HMAC_MD5_128, IKE_TRANSFORM_AUTH_HMAC_MD5_96, IKE_TRANSFORM_AUTH_HMAC_SHA1_160, IKE_TRANSFORM_AUTH_HMAC_SHA1_96, IKE_TRANSFORM_AUTH_HMAC_SHA2_256_128, IKE_TRANSFORM_AUTH_HMAC_SHA2_384_192, IKE_TRANSFORM_AUTH_HMAC_SHA2_512_256, IKE_TRANSFORM_AUTH_KPDK_MD5}, multiplicity set at pre-compile, set at pre-compile, default-value=IKE_TRANSFORM_AUTH_AES_CMAC_96  # Integrity Algorithm Transform ID.
        reference IKEGenerateJobRef: multiplicity set at pre-compile, set at pre-compile, requires-symbolic-name-value=true, destination=CsmJob  # The referenced Csm job is used for the execution of the CsmMacGenerate primitive needed for this transform.
        reference IKEVerifyJobRef: multiplicity set at pre-compile, set at pre-compile, requires-symbolic-name-value=true, destination=CsmJob  # The referenced Csm job is used for the execution of the CsmMacVerify primitive needed for this transform.
      container IKEPrfTransform [1..*]: multiplicity set at pre-compile  # Container for configuration of Pseudorandom Function Transform.
        enumeration IKETransformId: {IKE_TRANSFORM_PRF_AES128_CMAC, IKE_TRANSFORM_PRF_AES128_XCBC, IKE_TRANSFORM_PRF_HMAC_MD5, IKE_TRANSFORM_PRF_HMAC_SHA1, IKE_TRANSFORM_PRF_HMAC_SHA2_256, IKE_TRANSFORM_PRF_HMAC_SHA2_384, IKE_TRANSFORM_PRF_HMAC_SHA2_512, IKE_TRANSFORM_PRF_HMAC_TIGER}, multiplicity set at pre-compile, set at pre-compile, default-value=IKE_TRANSFORM_PRF_HMAC_SHA2_256  # Pseudorandom Function Transform ID.
        reference IKEJobRef: multiplicity set at pre-compile, set at pre-compile, requires-symbolic-name-value=true, destination=CsmJob  # The referenced Csm job is used for the execution of the CsmMacGenerate primitive needed for this transform.
