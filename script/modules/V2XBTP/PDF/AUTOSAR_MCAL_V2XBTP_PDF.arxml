AUTOSAR XML (schema 00046)
package /AUTOSAR/EcucDefs
  ecuc definition collection AUTOSARParameterDefinition: module=V2xBtp
  module definition V2xBtp [0..1]: variants pre-compile  # Configuration of the V2xBtp (Vehicle-2-X Basic Transport) module.
    container V2xBtpGeneral  # This container contains the general configuration parameters of the Vehicle-2-X Basic Transport.
      boolean V2xBtpDevErrorDetect: set at pre-compile, default-value=false  # Switches the Default Error Tracer (Det) detection and notification ON or OFF. | - true: enabled (ON) - false: disabled (OFF)
      boolean V2xBtpVersionInfoApi: set at pre-compile, default-value=false  # Enable/disables the API for reading the version information of the V2xBtp Module. | - true: enabled (ON) - false: disabled (OFF)
    container V2xBtpRxIndicationFunction [1..*]  # This container contains the RxIndication functions for V2xBtp upper layers. You can configure more than one container in test vehicles, but not in production vehicles.
      string V2xBtpCddHeaderFile: set at pre-compile  # This parameter specifies the name of the header file containing the definition of the V2xBtpRxIndicationFunction module functions.
      integer V2xBtpDestinationPort: 0..65535, default-value=0  # Destination port for the <User>_RxIndication function.
      function name V2xBtpRxIndicationFunctionName: set at pre-compile  # Name of the <User>_RxIndication callback function.
