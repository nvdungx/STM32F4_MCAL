AUTOSAR XML (schema 00053)
package /AUTOSAR/EcucDefs
  ecuc definition collection AUTOSARParameterDefinition: module=Mem
  module definition Mem [0..*]: variants pre-compile  # Configuration of the Mem driver (internal or external memory driver) module. | Its multiplicity describes the actual number of Mem drivers. There will be one container for each Mem driver.
    container MemGeneral  # Container for general configuration parameters of the Mem driver. These parameters are always pre-compile.
      boolean MemDevErrorDetect: set at pre-compile  # Switches the development error detection and notification on or off.
      integer MemIndex: 0..254, set at pre-compile, symbolic-name-value=true  # Specifies the InstanceId of this module instance. If only one instance is present it shall have the Id 0.
      enumeration MemInvocation: {DIRECT_STATIC, INDIRECT_DYNAMIC, INDIRECT_STATIC}, set at pre-compile, default-value=DIRECT_STATIC  # Defines how the Mem driver services are accessed and how the Mem driver is scheduled and activated/initialized.
      float MemMainFunctionPeriod: 0..INF, set at pre-compile, default-value=0.005  # This value specifies the fixed call cycle for Mem_MainFunction(). | In case of indirect invocation the Mem_MainFunction will be triggered directly by MemAcc. Mem does not depend on a fixed cycle time; it can be triggered at arbitrary rates. Allow to configure the time for the MainFunction (in seconds). Please note: This configuration value shall be equal to the value in the ScheduleManager module.
      string MemNamePrefix: set at pre-compile  # Depending on the UseMemFuncPtrTable configuration, this prefix is either used to reference the Mem driver header structure or the according Mem API function.
      boolean MemUseFuncPtrTable: set at pre-compile  # This parameter defines if the Mem driver functions are called using the Mem function pointer table API.
      reference MemEcucPartitionRef [0..*]: scope=ECU, multiplicity set at pre-compile, set at pre-compile, destination=EcucPartition  # Maps the Mem driver to zero or multiple ECUC partition(s) to make the driver API available in these partition(s).
    container MemInstance [1..65535]: multiplicity set at pre-compile  # This container includes the Mem driver instance specific configuration parameters. | Its multiplicity describes the number of Mem driver instances of this Mem driver. There will be one container for each Mem driver instance.
      integer MemInstanceId: 0..65535, set at pre-compile, default-value=0  # This value specifies the unique numeric identifier which is used to reference a Mem driver instance in case multiple devices of the same type shall be addressed by one Mem driver. This value will be assigned to the symbolic name derived of the MemInstance container short name.
      container MemSectorBatch [1..*]: multiplicity set at pre-compile  # Configuration description of a programmable sector or sector batch. Sector batch means that homogenous and coherent sectors can be configured as one MemSector element. | It is recommended to group as many identical sectors as possible together.
        integer MemEraseSectorSize: 1..4294967295, set at pre-compile  # Size of this sector in bytes. | A sector is the smallest erasable unit.
        integer MemMinReadSize: 1..4294967295, set at pre-compile  # Smallest readable unit in bytes.
        integer MemNumberOfSectors: 1..4294967295, set at pre-compile, default-value=1  # Number of contiguous sectors with identical values for MemSectorSize and MemPageSize. | If this parameter is configured to be greater than 1, the sectors are grouped in a sector batch.
        integer MemSpecifiedEraseCycles: 0..4294967295, set at pre-compile  # Number of erase cycles specified for the memory device (usually given in the device data sheet).
        integer MemStartAddress: 0..18446744073709551615, set at pre-compile  # Physical start address of the sector (batch). | In case of a sector batch, the physical start address is the address of the first sector. The physical start address of the other sectors can be calculated by the MemSectorSize parameter.
        integer MemWritePageSize: 1..4294967295, set at pre-compile  # Size of a write page of this sector in bytes. | A write page is the smallest writeable unit.
        reference MemSectorBatchEcucPartitionRef [0..1]: scope=ECU, multiplicity set at pre-compile, set at pre-compile, destination=EcucPartition  # Maps the memory area defined by the sector batch to zero or one ECUC partition.
        container MemBurstSettings [0..1]: multiplicity set at pre-compile  # Container for burst setting configuration parameters of the Mem driver. | A sector burst can be used for improved performance.
          integer MemEraseBurstSize: 1..4294967295, set at pre-compile  # Size of sector erase burst in bytes. A sector burst can be used for improved performance and is typically (a subset of) a sector batch. | To make use of the sector erase burst feature, the physical start address of the sector batch must be aligned to the sector erase burst size.
          integer MemMaxReadSize: 1..4294967295, set at pre-compile  # This value specifies the maximum number of bytes the MemAcc module requests within one Mem read request.
          integer MemWriteBurstSize: 1..4294967295, set at pre-compile  # Size of page write/program burst in bytes. A sector burst can be used for improved performance and is typically (a subset of) a sector batch. | To make use of the write burst feature, the physical start address must be aligned to the write burst size.
    container MemPublishedInformation  # Additional published parameters not covered by CommonPublishedInformation container. | Note that these parameters do not have any configuration class setting, since they are published information.
      integer MemErasedValue: 0..4294967295, set at pre-compile  # The contents of an erased memory cell.
