AUTOSAR XML (schema 00046)
package /AUTOSAR/EcucDefs
  ecuc definition collection AUTOSARParameterDefinition: module=FrTrcv
  module definition FrTrcv [0..*]: variants pre-compile  # Configuration of the FrTrcv (FlexRay Transceiver driver) module.
    container FrTrcvChannel [1..*]  # Container gives FlexRay transceiver driver information about a single FlexRay transceiver channel. | Any FlexRay transceiver driver has such FlexRay transceiver channels.
      integer FrTrcvChannelId: 0..255, set at pre-compile, symbolic-name-value=true  # Unique identifier of the FlexRay Transceiver Channel.
      boolean FrTrcvChannelUsed: set at pre-compile, default-value=true  # Shall the related FlexRay transceiver channel be used?
      boolean FrTrcvControlsPowerSupply: set at pre-compile, default-value=false  # Is ECU power supply controlled by this transceiver?
      enumeration FrTrcvInitState: {FRTRCV_TRCVMODE_NORMAL, FRTRCV_TRCVMODE_RECEIVEONLY, FRTRCV_TRCVMODE_SLEEP, FRTRCV_TRCVMODE_STANDBY}, set at pre-compile, default-value=FRTRCV_TRCVMODE_NORMAL  # State of FlexRay transceiver after power on. | ImplementationType: FrTrcv_TrcvModeType
      enumeration FrTrcvMaxBaudrate: {FR_10M, FR_2M5, FR_5M0}, set at pre-compile  # Max baudrate for transceiver hardware type. Only used for validation purposes. Value shall be configured by configuration tool based on | FRTRCV_HARDWARE_NAME and internal information about ability of this hardware typel.
      boolean FrTrcvWakeupByBusUsed: set at pre-compile  # Is wake up by node supported? If FlexRay transceiver hardware does not support wake up by node value is always FALSE. If FlexRay transceiver hardware supports wake up by node value is TRUE or FALSE depending whether it is used or not.
      reference FrTrcvChannelEcucPartitionRef [0..1]: scope=ECU, multiplicity set at pre-compile, set at pre-compile, destination=EcucPartition  # Maps one single Flexray transceiver channel to zero or one ECUC partitions. The ECUC partition referenced is a subset of the ECUC partitions where the Flexray transceiver driver is mapped to. Tags: atp.Status=draft
      reference FrTrcvIcuChannelRef [0..1]: scope=ECU, multiplicity set at pre-compile, set at pre-compile, requires-symbolic-name-value=true, destination=IcuChannel  # Reference to the IcuChannel to enable/disable the interrupts for wakeups.
      reference FrTrcvWakeupSourceRef [0..1]: scope=ECU, multiplicity set at pre-compile, set at pre-compile, requires-symbolic-name-value=true, destination=EcuMWakeupSource  # Reference to a wakeup source in the EcuM configuration. If | FrTrcvWakeUpSupport is configured as FRTRCV_WAKEUP_NOT_SUPPORTED the FrTrcvWakeupSourceRef is not needed. Implementation Type: reference to EcuM_WakeupSourceType
      choice container FrTrcvAccess
        container FrTrcvDioAccess [0..1]  # Container gives FR transceiver driver information about accessing ports and port pins. If a FR transceiver hardware has no Dio interface, there is no instance of this container.
          container FrTrcvDioChannelAccess [1..*]  # In this Container the relation between FR transceiver hardware pin names and Dio port access information is given.
            string FrTrcvHardwareInterfaceName: set at pre-compile  # FR transceiver hardware interface name. It is typically the name of a pin. From a Dio point of view it is either a port, a single channel or a channel group. Depending on this fact either FRTRCV_DIO_PORT_SYMBOLIC_NAME or FRTRCV_DIO_CHANNEL_SYMBOLIC_NAME or FRTRCV_DIO_CHANNEL_GROUP_SYMBOLIC_NAME shall reference a Dio configuration. The FR transceiver driver implementation description shall list up this name for the appropriate FR transceiver hardware.
            choice reference FrTrcvDioSymNameRef: set at pre-compile, destination=[DioChannel, DioChannelGroup, DioPort]  # Choice Reference to a DIO Port, DIO Channel or DIO Channel Group. This reference replaces the FRTRCV_DIO_PORT_SYM_NAME, FRTRCV_DIO_CHANNEL_SYM_NAME and FRTRCV_DIO_GROUP_SYM_NAME references in the Fr Trcv SWS.
        container FrTrcvSpiSequence [0..1]  # Container gives FlexRay transceiver driver information about one SPI sequence. One SPI sequence used by FlexRay transceiver driver is in exclusive use for it. No other driver is allowed to access this sequence. FlexRay transceiver driver may use one sequence to access n FlexRay transceiver hardwares chips of the same type or n sequences are used to access one single FlexRay transceiver hardware chip. If a FlexRay transceiver hardware has no SPI interface, there is no instance of this container. | Note: as ChannelIDs and JobIDs are hardlinked to the SequenceID through the SPI configuration, if the SPI configuration is modified (in particular the ChannelIDs associated to the SPI sequence FrTrcvSpiSequence refers to), FrTrcv must be compiled again to reflect the latest changes.
          reference FrTrcvSpiSequenceName: set at pre-compile, requires-symbolic-name-value=true, destination=SpiSequence  # Reference to a Spi sequence configuration container.
      container FrTrcvBranchIdContainer [1..*]  # Only one SymbolicNameValue can be defined per container. Therefore this container is necessary.
        integer FrTrcvBranchId: 0..255, set at pre-compile, symbolic-name-value=true  # Unique branch id. It is used by CDDs and internally.
      container FrTrcvChannelDemEventParameterRefs [0..1]  # Container for the references to DemEventParameter elements which shall be invoked using the API Dem_SetEventStatus in case the corresponding error occurs. The EventId is taken from the referenced DemEventParameter's DemEventId symbolic value. The standardized errors are provided in this container and can be extended by vendor-specific error references.
        reference FRTRCV_E_FR_BUSERROR_TRCV [0..1]: scope=ECU, multiplicity set at pre-compile, set at pre-compile, requires-symbolic-name-value=true, destination=DemEventParameter  # Reference to configured DEM event to report "Error Status of Class B (SPI) transceiver bus errors where TrcvIdx is the transceiver index"
        reference FRTRCV_E_FR_ERRN_TRCV [0..1]: scope=ECU, multiplicity set at pre-compile, set at pre-compile, requires-symbolic-name-value=true, destination=DemEventParameter  # Reference to configured DEM event to report "Error Status of Class A (GPIO) transceiver"
    container FrTrcvGeneral  # Container gives FlexRay transceiver driver basic information.
      function name FrTrcvDemReportErrorStatusConfiguration [0..1]: multiplicity set at pre-compile, set at pre-compile  # Name of a C function which substitutes Dem_SetEventStatus.
      boolean FrTrcvDevErrorDetect: set at pre-compile, default-value=false  # Switches the development error detection and notification on or off. | * true: detection and notification is enabled. * false: detection and notification is disabled.
      boolean FrTrcvErrorCheckDuringCommunication: set at pre-compile  # Enable a functionality to check transceiver's state during communication.
      boolean FrTrcvErrorCheckInInit: set at pre-compile  # Enable a functionality to check transceiver's state while initialization process of FrTrcv.
      integer FrTrcvIndex: 0..255, set at pre-compile  # Specifies the InstanceId of this module instance. If only one instance is present it shall have the Id 0.
      float FrTrcvMainFunctionCycleTime [0..1]: 0..Inf, set at pre-compile  # Cyclic call time for function FrTrcvMainFunction in seconds. A multiplicity of 0 indicates no calls for this function. In this case function need not be present in compiled code.
      integer FrTrcvRetryCountInInit: 0..255, set at pre-compile  # Specifies the number of retry count when error occurs while initialization process of FrTrcv.
      enumeration FrTrcvTimerType [0..1]: {None, Timer_1us16bit}, multiplicity set at pre-compile, set at pre-compile  # Type of the Time Service Predefined Timer.
      boolean FrTrcvVersionInfoApi: set at pre-compile, default-value=false  # Switches version information API on and off. If switched off, function need not be present in compiled code.
      float FrTrcvWaitTime [0..1]: 0..2.55E-4, multiplicity set at pre-compile, set at pre-compile  # Wait time for transceiver state changes in seconds.
      enumeration FrTrcvWakeUpSupport: {FRTRCV_WAKEUP_BY_POLLING, FRTRCV_WAKEUP_NOT_SUPPORTED}, set at pre-compile  # Informs whether wake up is supported by polling or whether it is not supported. | In case no wake up is supported by FlexRay transceiver hardware setting has to be always NO. Only in case wake up is supported by polling main function FlexRayTrcv_main has to be present in source code. In case of support for wake up either by polling wake up ability may be switched on or off for each channel of one FlexRay transceiver channel independently by FrTrcvWakeupByBusUsed.
      reference FrTrcvEcucPartitionRef [0..*]: scope=ECU, multiplicity set at pre-compile, set at pre-compile, destination=EcucPartition  # Maps the Flexray transceiver driver to zero or multiple ECUC partitions to make the modules API available in this partition. The Flexray transceiver driver will operate as an independent instance in each of the partitions. Tags: atp.Status=draft
