AUTOSAR XML (schema 00046)
package /AUTOSAR/EcucDefs
  ecuc definition collection AUTOSARParameterDefinition: module=WEthTrcv
  module definition WEthTrcv [0..*]: post-build-variant-support=true, variants link-time/post-build/pre-compile  # Configuration of Ethernet Transceiver Driver module
    container WEthTrcvAntennaConfigSet  # This container contains the antenna configurations.
      container WEthTrcvAntennaConfig [1..*]  # Configuration of the individual antenna.
        integer WEthTrcvAntennaId: 0..255, scope=ECU, set at pre-compile, symbolic-name-value=true  # Specifies the instance ID of the configured antenna.
    container WEthTrcvConfigSet  # This container contains the configuration parameters and sub containers of the AUTOSAR WEthTrcv module.
      container WEthTrcvConfig [1..*]  # Configuration of the individual transceiver
        integer WEthTrcvBusId: 0..255, post-build-variant-value=true, set at link in variant link-time / post-build in variant post-build / pre-compile in variant pre-compile  # Specifies the hardware id used for lower level bus interface access (e.g. MII/SPI) to the transceiver's hardware module. For example the MII index if MII would have been used.
        integer WEthTrcvId: 0..255, scope=ECU, set at pre-compile, symbolic-name-value=true  # Specifies the instance ID of the configured transceiver.
        enumeration WEthTrcvPhysLayerType [0..1]: {TRCV_PHYS_LAYER_TYPE_80211_P}, multiplicity set at link in variant link-time / post-build in variant post-build / pre-compile in variant pre-compile, post-build-variant-multiplicity=true, post-build-variant-value=true, set at link in variant link-time / post-build in variant post-build / pre-compile in variant pre-compile  # Specifies the physical layer type of the Wireless Ethernet transceiver link.
        reference WEthTrcvConfigEcucPartitionRef [0..1]: scope=ECU, multiplicity set at pre-compile, post-build-variant-multiplicity=true, post-build-variant-value=true, set at pre-compile, destination=EcucPartition  # Maps one Wireless Ethernet transceiver to zero or one ECUC partitions. The ECUC partition referenced is a subset of the ECUC partitions where the Wireless Ethernet transceiver driver is mapped to. Tags: atp.Status=draft
        reference WEthTrcvCtrlRef: post-build-variant-value=true, set at link in variant link-time / post-build in variant post-build / pre-compile in variant pre-compile, requires-symbolic-name-value=true, destination=WEthCtrlConfig  # Specifies a reference to the wireless ethernet controller used for lower layer bus interface access to the transceiver.
        reference WEthTrcvRadioConfigSetRef: set at pre-compile, destination=WEthTrcvRadioConfigSet  # Reference to a WEthTrcvRadioConfigSet.
        container WEthTrcvDemEventParameterRefs [0..1]  # Container for the references to DemEventParameter elements which shall be invoked using the API Dem_SetEventStatus in case the corresponding error occurs. The EventId is taken from the referenced DemEventParameter's DemEventId symbolic value. The standardized errors are provided in this container and can be extended by vendor-specific error references.
          reference WETHTRCV_E_ACCESS [0..1]: multiplicity set at link in variant link-time / post-build in variant post-build / pre-compile in variant pre-compile, post-build-variant-multiplicity=true, post-build-variant-value=true, set at link in variant link-time / post-build in variant post-build / pre-compile in variant pre-compile, requires-symbolic-name-value=true, destination=DemEventParameter  # Reference to the DemEventParameter which shall be issued when the error "Transceiver access failed" has occurred.
    container WEthTrcvGeneral  # General configuration of Wireless Ethernet Transceiver Driver module
      boolean WEthTrcvDevErrorDetect: set at pre-compile, default-value=false  # Switches the Default Error Tracer (Det) detection and notification ON or OFF. | * true: detection and notification is enabled. * false: detection and notification is disabled.
      boolean WEthTrcvGetLinkStateApi: set at pre-compile  # Enables / Disables WEthTrcv_GetLinkState API
      boolean WEthTrcvGetTransceiverModeApi: set at pre-compile  # Enables / Disables WEthTrcv_GetTransceiverMode API
      integer WEthTrcvIndex: 0..255, set at pre-compile  # Specifies the InstanceId of this module instance. If only one instance is present it shall have the Id 0.
      float WEthTrcvMainFunctionPeriod [0..1]: 0..Inf, multiplicity set at pre-compile, set at pre-compile  # Specifies the period of main function WEthTrcv_MainFunction in seconds.
      integer WEthTrcvMaxTrcvsSupported: 0..255, set at pre-compile, default-value=1
      boolean WEthTrcvSetTransceiverModeApi: set at pre-compile  # Enables / Disables WEthTrcv_SetTransceiverMode API
      boolean WEthTrcvVersionInfoApi: set at pre-compile, default-value=false  # Enables / Disables version info API
      boolean WEthTrcvVersionInfoApiMacro: set at pre-compile, default-value=false  # Enables / Disables version info API macro implementation
      reference WEthTrcvEcucPartitionRef [0..*]: scope=ECU, multiplicity set at pre-compile, post-build-variant-multiplicity=true, post-build-variant-value=true, set at pre-compile, destination=EcucPartition  # Maps the Wireless Ethernet transceiver driver to zero or multiple ECUC partitions to make the modules API available in this partition. The Wireless Ethernet transceiver driver will operate as an independent instance in each of the partitions. Tags: atp.Status=draft
    container WEthTrcvRadioConfigSet [1..*]  # This container contains the radio configurations.
      container WEthTrcvRadioConfig [1..*]  # Configuration of the individual radio (PHY + MAC).
        enumeration WEthTrcvRadioChannelBandwidth: {BW_10MHZ, BW_20MHZ, BW_40MHZ, BW_5MHZ}, set at pre-compile  # Specifies the bandwidth of the physical channel.
        float WEthTrcvRadioChannelCsPowerThreshold: -100..100, set at pre-compile  # Specifies the threshold for carrier sense (CS) power of the physical channel [dBm].
        integer WEthTrcvRadioChannelFreq: 0..18446744073709551615, set at pre-compile  # Specifies the frequency of the physical channel [Hz].
        float WEthTrcvRadioChannelMaxTxPower: -100..100, set at pre-compile  # Specifies the transmit power of the physical channel [dBm].
        float WEthTrcvRadioChannelTxDatarate: 0..Inf, set at pre-compile  # Specifies the transmit datarate of the physical channel. [bit/s]
        integer WEthTrcvRadioId: 0..255, scope=ECU, set at pre-compile, symbolic-name-value=true  # Specifies the instance ID of the configured radio.
        enumeration WEthTrcvRadioMode: {OFF, RX_ON, RX_TX_ON, TX_ON, USED_FOR_CHANNEL_SWITCHING}, set at pre-compile  # Specifies the mode of the radio within a WEthTrcvRadioConfig. Inside of a WEthTrcvRadioConfigSet different modes for the respective WEthTrcvRadioConfigs are possible. The WEthTrcvRadioConfigSet can be selected at runtime.
        reference WEthTrcvRadioChannelRxAntenna: set at pre-compile, destination=WEthTrcvAntennaConfig  # Specifies the antenna used for reception of packets of the physical channel.
        reference WEthTrcvRadioChannelTxAntenna: set at pre-compile, destination=WEthTrcvAntennaConfig  # Specifies the antenna used for transmission of packets to the physical channel.
        container WEthTrcvRadioChannelTxQueueConfig [1..*]: multiplicity set at pre-compile  # Configuration of the individual EDCA transmit queue of a channel.
          integer WEthTrcvRadioChannelTxQueueAifsn: 0..15, set at pre-compile  # Specifies the arbitration inter frame space number (AIFSN) of the queue.
          integer WEthTrcvRadioChannelTxQueueCwMax: 0..255, set at pre-compile  # Specifies the maximum size of the contention windows (CW) of the queue.
          integer WEthTrcvRadioChannelTxQueueCwMin: 0..255, set at pre-compile  # Specifies the minimum size of the contention windows (CW) of the queue.
          integer WEthTrcvRadioChannelTxQueueId: 0..255, set at pre-compile  # Specifies the ID (equals priority) of the queue.
          float WEthTrcvRadioChannelTxQueueTxOpDurationLimit: 3.2E-5..0.00816, set at pre-compile  # Specifies the transmit operation duration limit of the queue in [s].
