AUTOSAR XML (schema 00053)
package /AUTOSAR/EcucDefs
  ecuc definition collection AUTOSARParameterDefinition: module=I2c
  module definition I2c [0..1]: post-build-variant-support=true, variants post-build/pre-compile  # Configuration of the I2c (Inter-Integrated Circuit) module. Tags: atp.Status=draft
    container I2cConfigSet [1..*]: multiplicity set at pre-compile  # The base for a multiple configuration set. Tags: atp.Status=draft
      container I2cChannel [1..*]: multiplicity set at pre-compile  # The Hardware specific configuration parameters of the I2c. Tags: atp.Status=draft
        integer I2cBaudRate: 0..18446744073709551615, set at pre-compile, default-value=100  # The baud rate of the bus in kbit/s. Tags: atp.Status=draft
        integer I2cHwUnitBaseAddress: 0..18446744073709551615, set at pre-compile  # The register address of the HW unit. Tags: atp.Status=draft
        enumeration I2cHwUnitMode: set at pre-compile, default-value=I2C_HW_UNIT_MODE_CONTROLLER  # Select whether the HW unit will be used in Controller or Target mode. Tags: atp.Status=draft
          I2C_HW_UNIT_MODE_CONTROLLER  # Tags: atp.Status=draft
          I2C_HW_UNIT_MODE_TARGET  # Tags: atp.Status=draft
        boolean I2cTargetListening: set at pre-compile, default-value=false  # This parameter specifies the Target mode, always listening or on demand only. Tags: atp.Status=draft
      container I2cJob [1..*]: multiplicity set at pre-compile  # Job specific configuration parameters of the I2c. Tags: atp.Status=draft
        integer I2cDeviceAddress: 0..1023, set at pre-compile, default-value=0  # The address of a Target device which is accessed by the Controller. Tags: atp.Status=draft | Values bigger than [ARTechTerm{0x7F (127)}] lead to Extended Addressing.
        integer I2cJobId: 0..255, set at pre-compile, symbolic-name-value=true, default-value=0  # The identifier of a Job. Tags: atp.Status=draft
      container I2cSequence [1..*]: multiplicity set at pre-compile  # Sequence specific configuration parameters of the I2c. Tags: atp.Status=draft
        function name I2cEndNotification: set at pre-compile  # The transmission end notification to inform the user that a transmission request has been serviced. Tags: atp.Status=draft
        integer I2cSequenceId: 0..254, set at pre-compile, symbolic-name-value=true, default-value=0  # The Id of a I2c Sequence. Tags: atp.Status=draft
        reference I2cAssignedChannel: set at pre-compile, destination=I2cChannel  # References the bus which is assigned to the Job. Tags: atp.Status=draft
        reference I2cAssignedJob [1..*]: multiplicity set at pre-compile, requires-index=true, set at pre-compile, destination=I2cJob  # Reference to a Job. Tags: atp.Status=draft
    container I2cGeneral  # General configuration parameters of the I2c. Tags: atp.Status=draft
      boolean I2cDevErrorDetect: set at pre-compile, default-value=false  # This parameter switches the Development Error Detection and Notification ON or OFF. Tags: atp.Status=draft | * True: Development error detection is enabled. * False: Development error detection is disabled.
      boolean I2cVersionInfoApi: set at pre-compile, default-value=false  # This parameter enables/disables the function I2c_GetVersionInfo() to get major, minor and patch version information. Tags: atp.Status=draft
