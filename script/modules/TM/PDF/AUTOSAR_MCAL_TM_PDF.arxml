AUTOSAR XML (schema 00053)
package /AUTOSAR/EcucDefs
  ecuc definition collection AUTOSARParameterDefinition: module=Tm
  module definition Tm [0..1]: variants pre-compile  # Configuration of the Time Service module.
    container TmGeneral  # General configuration of Time Service module.
      boolean TmDevErrorDetect: set at pre-compile, default-value=false  # Switches the development error detection and notification on or off. | * true: detection and notification is enabled. * false: detection and notification is disabled.
      boolean TmVersionInfoApi: set at pre-compile, default-value=false  # Adds / removes the service Tm_GetVersionInfo() from the code. ON or OFF.
    container TmPreDefTimerInstance [0..*]  # Contains all configurable elements for timer instances
      integer TmPreDefTimerInstanceId: 0..4294967295, set at pre-compile, symbolic-name-value=true, with-auto=true  # Instance handle of the timer.
      enumeration TmPreDefTimerType: {TM_PREDEF_TIMER_100US_32BIT, TM_PREDEF_TIMER_1US_16BIT, TM_PREDEF_TIMER_1US_24BIT, TM_PREDEF_TIMER_1US_32BIT}, set at pre-compile  # Configures the type of PreDef timer used from GPT
      enumeration TmTimerUser: {CAPI, PORT}, scope=ECU, set at pre-compile  # Specifies if timer instance is used via C-API or via port interface.
