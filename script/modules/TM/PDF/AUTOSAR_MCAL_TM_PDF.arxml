AUTOSAR XML (schema 00046)
package /AUTOSAR/EcucDefs
  ecuc definition collection AUTOSARParameterDefinition: module=Tm
  module definition Tm [0..1]: variants pre-compile  # Configuration of the Time Service module.
    container TmGeneral  # General configuration of Time Service module.
      boolean TmDevErrorDetect: set at pre-compile, default-value=false  # Switches the development error detection and notification on or off. | * true: detection and notification is enabled. * false: detection and notification is disabled.
      boolean TmEnablePredefTimer100us32bit: scope=ECU, set at pre-compile  # Specifies if the Predef Timer 100µs32bit shall be enabled (functionality and set of API services). ON or OFF.
      boolean TmEnablePredefTimer1us16bit: scope=ECU, set at pre-compile  # Specifies if the Predef Timer 1µs16bit shall be enabled (functionality and set of API services). ON or OFF.
      boolean TmEnablePredefTimer1us24bit: scope=ECU, set at pre-compile  # Specifies if the Predef Timer 1µs24bit shall be enabled (functionality and set of API services). ON or OFF.
      boolean TmEnablePredefTimer1us32bit: scope=ECU, set at pre-compile  # Specifies if the Predef Timer 1µs32bit shall be enabled (functionality and set of API services). ON or OFF.
      boolean TmVersionInfoApi: set at pre-compile, default-value=false  # Adds / removes the service Tm_GetVersionInfo() from the code. ON or OFF.
