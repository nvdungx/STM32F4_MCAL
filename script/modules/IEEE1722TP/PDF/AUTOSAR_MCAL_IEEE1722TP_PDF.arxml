AUTOSAR XML (schema 00053)
package /AUTOSAR/EcucDefs
  ecuc definition collection AUTOSARParameterDefinition: module=IEEE1722Tp
  module definition IEEE1722Tp [0..1]: post-build-variant-support=true, variants link-time/post-build/pre-compile  # Configuration of the IEEE1722Tp module. Tags: atp.Status=draft
    container IEEE1722TpConfig  # This container contains the configuration parameters and sub containers of the AUTOSAR IEEE1722Tp module. Tags: atp.Status=draft
      container IEEE1722TpLowerLayerPduPool [1..*]: multiplicity set at pre-compile  # Each container defines one lower layer Pdu pool (either for Tx or Rx). Each Stream then may select over which Pdu pool their transport shall be done. Tags: atp.Status=draft
        container IEEE1722TpLowerLayerRxPduPoolEntry [0..*]: multiplicity set at pre-compile  # This container defines one entry in the IEEE1722TpLowerLayerPduPool for Rx direction to be used for the transport of Rx Pdus from the lower layer. Tags: atp.Status=draft | This container is only required if at least one stream is consumed by the IEEE1722Tp module. Supported MetaData entry: * TIMETUPLE_TYPE_PTR
          integer IEEE1722TpLowerLayerRxPduId: 0..65535, scope=ECU, post-build-variant-value=true, set at link in variant link-time / post-build in variant post-build / pre-compile in variant pre-compile, symbolic-name-value=true, with-auto=true  # Definition of the Handle Pdu Id used by the lower layer for Rx Pdu indication. Tags: atp.Status=draft
          reference IEEE1722TpLowerLayerRxPduRef: scope=ECU, post-build-variant-value=true, set at link in variant link-time / post-build in variant post-build / pre-compile in variant pre-compile, destination=Pdu  # Reference to the EcuC Pdu used for the transport of Rx Pdu from the lower layer. Tags: atp.Status=draft
        container IEEE1722TpLowerLayerTxPduPoolEntry [0..*]: multiplicity set at pre-compile  # This container defines one entry in the IEEE1722TpLowerLayerPduPool for Tx direction to be used for the transport of Tx Pdus to the lower layer. Tags: atp.Status=draft | This container is only required if at least one stream is produced by the IEEE1722Tp module. Supported MetaData entries: * LISTELEM_PTR * ETHERNET_MAC_64
          integer IEEE1722TpLowerLayerTxPduId [0..1]: 0..65535, scope=ECU, multiplicity set at pre-compile, post-build-variant-value=true, set at link in variant link-time / post-build in variant post-build / pre-compile in variant pre-compile, symbolic-name-value=true, with-auto=true  # Definition of the Handle Pdu Id used by the lower layer for Tx Pdu confirmation. Tags: atp.Status=draft
          reference IEEE1722TpLowerLayerTxPduRef: scope=ECU, post-build-variant-value=true, set at link in variant link-time / post-build in variant post-build / pre-compile in variant pre-compile, destination=Pdu  # Reference to the EcuC Pdu used for the transport of Tx Pdu to the lower layer. Tags: atp.Status=draft
      container IEEE1722TpStream [1..*]: multiplicity set at link in variant link-time / post-build in variant post-build / pre-compile in variant pre-compile, post-build-variant-multiplicity=true  # Definition of an IEEE1722Tp stream. Tags: atp.Status=draft
        string IEEE1722TpStreamIdMacAddress [0..1]: multiplicity set at link in variant link-time / post-build in variant post-build / pre-compile in variant pre-compile, post-build-variant-multiplicity=true, post-build-variant-value=true, set at link in variant link-time / post-build in variant post-build / pre-compile in variant pre-compile, max-length=17, min-length=17, regular-expression=[0-9a-fA-F]{2}[[:-][0-9a-fA-F]{2}]{5}  # Definition of the MAC address part of the Stream Id. Tags: atp.Status=draft
        integer IEEE1722TpStreamIdUniquePart: 0..65535, post-build-variant-value=true, set at link in variant link-time / post-build in variant post-build / pre-compile in variant pre-compile  # Definition of the unique ID part of the Stream Id. Tags: atp.Status=draft
        integer IEEE1722TpStreamIndex: 0..65535, scope=ECU, post-build-variant-value=true, set at link in variant link-time / post-build in variant post-build / pre-compile in variant pre-compile, symbolic-name-value=true, with-auto=true  # Definition of the Handle Index to identify this stream for API access in the communication stack. Tags: atp.Status=draft | This value is NOT related to the stream id combined out of IEEE1722TpStreamIdUniquePart and IEEE1722TpStreamIdMacAddress.
        float IEEE1722TpStreamMaxTransitTime: post-build-variant-value=true, set at link in variant link-time / post-build in variant post-build / pre-compile in variant pre-compile  # Definition of the max transit time for the stream. Tags: atp.Status=draft | Value in seconds.
        integer IEEE1722TpStreamVersion: 0..7, post-build-variant-value=true, set at link in variant link-time / post-build in variant post-build / pre-compile in variant pre-compile  # Definition of the stream version. Tags: atp.Status=draft
        reference IEEE1722TpEthIfClkUnitRef: scope=ECU, set at pre-compile, requires-symbolic-name-value=true, destination=EthIfClkUnit  # Reference to the EthIfClkUnit from which the current synchronized time could be retrieved (e.g. determine avtp timestamp for transmission). Tags: atp.Status=draft
        reference IEEE1722TpStbMSynchronizedTimeBaseRef: scope=ECU, set at pre-compile, requires-symbolic-name-value=true, destination=StbMSynchronizedTimeBase  # Reference to the StbMSynchronizedTimeBase from which the current synchronized time could be retrieved (e.g. determine avtp timestamp for transmission). Tags: atp.Status=draft
        reference IEEE1722TpStreamLowerLayerPduPoolRef: scope=ECU, post-build-variant-value=true, set at link in variant link-time / post-build in variant post-build / pre-compile in variant pre-compile, destination=IEEE1722TpLowerLayerPduPool  # Reference to one Pdu collection for the transport towards/from the lower layer. Tags: atp.Status=draft
        choice container IEEE1722TpStreamDirection  # Choice of the IEEE1722 stream direction, either Tx or Rx is configurable. Tags: atp.Status=draft
          container IEEE1722TpStreamRx [0..1]: multiplicity set at pre-compile  # This container defines exclusive parameters for Tx direction. Tags: atp.Status=draft
            container IEEE1722TpStreamRxQueue [0..1]: multiplicity set at pre-compile  # Definition of an IEEE1722Tp stream Rx queue. Tags: atp.Status=draft
              integer IEEE1722TpStreamRxQueueSize: 0..255, post-build-variant-value=true, set at link in variant link-time / post-build in variant post-build / pre-compile in variant pre-compile  # Definition of the queue size for the stream Rx queue. The queue is configured in number of to be queued elements. Tags: atp.Status=draft
            container IEEE1722TpUpperLayerRxPduPoolEntry [0..*]: multiplicity set at pre-compile  # This container defines one entry in the IEEE1722TpUpperLayerRxPduPool for Rx direction to be used for the transport of Rx Pdus to the upper layer. Tags: atp.Status=draft | This container is only required if the stream is consumed by the IEEE1722Tp module and is not an ACF stream. Supported MetaData entries: * IEEE1722TP_COMMON_STREAM_HEADER_PTR * IEEE1722TP_RX_IEC68133_IIDC_PTR * IEEE1722TP_RX_IEC68133_PTR * IEEE1722TP_RX_IEC68133_CIP_NO_SPH_PTR * IEEE1722TP_RX_IEC68133_CIP_WITH_SPH_PTR * IEEE1722TP_RX_AAF_PCM_PTR * IEEE1722TP_RX_AAF_AES3_PTR * IEEE1722TP_RX_RVF_PTR * IEEE1722TP_RX_CRF_PTR
              integer IEEE1722TpStreamRxPduId: 0..65535, scope=ECU, post-build-variant-value=true, set at link in variant link-time / post-build in variant post-build / pre-compile in variant pre-compile, symbolic-name-value=true, with-auto=true  # Definition of the Handle Pdu Id used by the upper layer for Rx Pdu indication. Tags: atp.Status=draft | This handle Id is only required if the stream is consumed by the IEEE1722Tp module.
              reference IEEE1722TpStreamRxPduRef: scope=ECU, post-build-variant-value=true, set at link in variant link-time / post-build in variant post-build / pre-compile in variant pre-compile, destination=Pdu  # Reference to the EcuC Pdu used for the transport of Rx stream Pdu to the upper layer. Tags: atp.Status=draft
          container IEEE1722TpStreamTx [0..1]: multiplicity set at pre-compile  # This container defines exclusive parameters for Tx direction. Tags: atp.Status=draft
            container IEEE1722TpStreamTxQueue [0..1]: multiplicity set at pre-compile  # Definition of an IEEE1722Tp stream Tx queue. Tags: atp.Status=draft
              integer IEEE1722TpStreamTxQueueSize: 0..255, post-build-variant-value=true, set at link in variant link-time / post-build in variant post-build / pre-compile in variant pre-compile  # Definition of the queue size for the stream Tx queue. The queue is configured in number of to be queued elements. Tags: atp.Status=draft
            container IEEE1722TpUpperLayerTxPduPoolEntry [0..*]: multiplicity set at pre-compile  # This container defines one entry in the IEEE1722TpUpperLayerPduPool for Tx direction to be used for the transport of Tx Pdus from the upper layer. Tags: atp.Status=draft | This container is only required if the stream is produced by the IEEE1722Tp module and is not an ACF stream. Supported MetaData entries: * IEEE1722TP_COMMON_STREAM_HEADER_PTR * IEEE1722TP_TX_IEC68133_IIDC_PTR * IEEE1722TP_TX_IEC68133_PTR * IEEE1722TP_TX_IEC68133_CIP_NO_SPH_PTR * IEEE1722TP_TX_IEC68133_CIP_WITH_SPH_PTR * IEEE1722TP_TX_AAF_PCM_PTR * IEEE1722TP_TX_AAF_AES3_PTR * IEEE1722TP_TX_RVF_PTR * IEEE1722TP_TX_CRF_PTR
              integer IEEE1722TpStreamTxPduId [0..1]: 0..65535, scope=ECU, multiplicity set at pre-compile, post-build-variant-value=true, set at link in variant link-time / post-build in variant post-build / pre-compile in variant pre-compile, symbolic-name-value=true, with-auto=true  # Definition of the Handle Pdu Id used by the upper layer for Tx Pdu confirmation. Tags: atp.Status=draft
              reference IEEE1722TpStreamTxPduRef: scope=ECU, post-build-variant-value=true, set at link in variant link-time / post-build in variant post-build / pre-compile in variant pre-compile, destination=Pdu  # Reference to the EcuC Pdu used for the transport of Tx stream Pdu from the upper layer. Tags: atp.Status=draft
        choice container IEEE1722TpStreamSubtype  # Choice of the IEEE1722 stream subtype. Tags: atp.Status=draft
          container IEEE1722TpStreamAAF [0..1]  # Definition of an IEEE1722 AVTP Audio Format (AAF) stream. Tags: atp.Status=draft
            integer IEEE1722TpStreamAafAes3DataTypeH [0..1]: 0..255, multiplicity set at pre-compile, post-build-variant-value=true, set at link in variant link-time / post-build in variant post-build / pre-compile in variant pre-compile, default-value=0  # Definition of the AAF AES3 aes3_data_type_h default value. Tags: atp.Status=draft
            integer IEEE1722TpStreamAafAes3DataTypeL [0..1]: 0..255, multiplicity set at pre-compile, post-build-variant-value=true, set at link in variant link-time / post-build in variant post-build / pre-compile in variant pre-compile, default-value=0  # Definition of the AAF AES3 aes3_data_type_l default value. Tags: atp.Status=draft
            enumeration IEEE1722TpStreamAafAes3DataTypeRef [0..1]: multiplicity set at pre-compile, post-build-variant-value=true, set at link in variant link-time / post-build in variant post-build / pre-compile in variant pre-compile  # Definition of the AAF AES3 stream aes3_data_type reference (aes3_dt_ref). Tags: atp.Status=draft
              IEC61937  # Tags: atp.Status=draft
              PCM  # Tags: atp.Status=draft
              SMPTE338  # Tags: atp.Status=draft
              UNSPECIFIED  # Tags: atp.Status=draft
              VENDOR  # Tags: atp.Status=draft
            enumeration IEEE1722TpStreamAafAes3NominalFrameRate [0..1]: multiplicity set at pre-compile, post-build-variant-value=true, set at link in variant link-time / post-build in variant post-build / pre-compile in variant pre-compile  # Definition of the AAF AES3 stream nominal frame rate (nfr). Tags: atp.Status=draft
              R_16kHz  # Tags: atp.Status=draft
              R_176_4kHz  # Tags: atp.Status=draft
              R_192kHz  # Tags: atp.Status=draft
              R_24kHz  # Tags: atp.Status=draft
              R_32kHz  # Tags: atp.Status=draft
              R_44_1kHz  # Tags: atp.Status=draft
              R_48kHz  # Tags: atp.Status=draft
              R_88_2kHz  # Tags: atp.Status=draft
              R_8kHz  # Tags: atp.Status=draft
              R_96kHz  # Tags: atp.Status=draft
              R_USER  # Tags: atp.Status=draft
            integer IEEE1722TpStreamAafAes3StreamsPerFrame [0..1]: 0..1023, multiplicity set at pre-compile, post-build-variant-value=true, set at link in variant link-time / post-build in variant post-build / pre-compile in variant pre-compile  # Definition of the AAF AES3 stream streams_per_frame. Tags: atp.Status=draft
            integer IEEE1722TpStreamAafEventDefault: 0..15, post-build-variant-value=true, set at link in variant link-time / post-build in variant post-build / pre-compile in variant pre-compile, default-value=0  # Definition of the AAF stream event (evt) default value. Tags: atp.Status=draft
            enumeration IEEE1722TpStreamAafFormat: post-build-variant-value=true, set at link in variant link-time / post-build in variant post-build / pre-compile in variant pre-compile  # Definition of the AAF stream format. Tags: atp.Status=draft
              AES3_32BIT  # Tags: atp.Status=draft
              FLOAT_32BIT  # Tags: atp.Status=draft
              INT_16BIT  # Tags: atp.Status=draft
              INT_24BIT  # Tags: atp.Status=draft
              INT_32BIT  # Tags: atp.Status=draft
              USER  # Tags: atp.Status=draft
            integer IEEE1722TpStreamAafPcmBitDepth [0..1]: 0..255, multiplicity set at pre-compile, post-build-variant-value=true, set at link in variant link-time / post-build in variant post-build / pre-compile in variant pre-compile  # Definition of the AAF PCM stream bit_depth. Tags: atp.Status=draft | e.g. 16, 24, 32
            integer IEEE1722TpStreamAafPcmChannelsPerFrame [0..1]: 0..1023, multiplicity set at pre-compile, post-build-variant-value=true, set at link in variant link-time / post-build in variant post-build / pre-compile in variant pre-compile  # Definition of the AAF PCM stream channels_per_frame. Tags: atp.Status=draft | e.g. 1: mono, 2: stereo, 8: 7.1 multicannel
            enumeration IEEE1722TpStreamAafPcmNominalSampleRate [0..1]: multiplicity set at pre-compile, post-build-variant-value=true, set at link in variant link-time / post-build in variant post-build / pre-compile in variant pre-compile  # Definition of the AAF PCM stream nominal sample rate (nsr). Tags: atp.Status=draft
              R_16kHz  # Tags: atp.Status=draft
              R_176_4kHz  # Tags: atp.Status=draft
              R_192kHz  # Tags: atp.Status=draft
              R_24kHz  # Tags: atp.Status=draft
              R_32kHz  # Tags: atp.Status=draft
              R_44_1kHz  # Tags: atp.Status=draft
              R_48kHz  # Tags: atp.Status=draft
              R_88_2kHz  # Tags: atp.Status=draft
              R_8kHz  # Tags: atp.Status=draft
              R_96kHz  # Tags: atp.Status=draft
              R_USER  # Tags: atp.Status=draft
            boolean IEEE1722TpStreamAafSparseTimestamp: post-build-variant-value=true, set at link in variant link-time / post-build in variant post-build / pre-compile in variant pre-compile  # Defines the CRF stream sparce timestamp (sp). Tags: atp.Status=draft | true = 1 false = 0
          container IEEE1722TpStreamACF [0..1]  # Definition of an IEEE1722 AVTP Control Format (ACF) stream. Tags: atp.Status=draft
            integer IEEE1722TpAcfCollectionThreshold [0..1]: 0..65535, multiplicity set at pre-compile, post-build-variant-value=true, set at link in variant link-time / post-build in variant post-build / pre-compile in variant pre-compile  # Defines the size threshold in bytes which, when exceeded, triggers the sending of the ACF message. Tags: atp.Status=draft
            float IEEE1722TpAcfCollectionTimeout [0..1]: 0..65.535, multiplicity set at pre-compile, post-build-variant-value=true, set at link in variant link-time / post-build in variant post-build / pre-compile in variant pre-compile  # Defines a timeout which, when exceeded, triggers the sending of the ACF message. Tags: atp.Status=draft | Defined in seconds.
            enumeration IEEE1722TpStreamAcfHeaderType: post-build-variant-value=true, set at link in variant link-time / post-build in variant post-build / pre-compile in variant pre-compile  # Definition of the ACF stream header format. Tags: atp.Status=draft | Depending on this selection the AVTP stream data subtype will be defined.
              NON_TIME_SYNCHRONOUS  # Tags: atp.Status=draft
              TIME_SYNCHRONOUS  # Tags: atp.Status=draft
            boolean IEEE1722TpStreamAcfMixedBusTypeCollection: set at pre-compile  # Defines if this ACF-stream is allowed to collect ACF-messages of different bus kinds (i.e. whether it is allowed to collect CAN and LIN ACF-messages in one ACF-stream message). Tags: atp.Status=draft | For the ACF-stream producer this configures the collection behavior. For an ACF-stream consumer this configures that this ACF-stream was produced with this assumption. true = 1: mixed collection is allowed false = 0 : mixed collection is not allowed
            choice container IEEE1722TpStreamAcfPayload [1..*]: multiplicity set at pre-compile  # Definition of an IEEE1722Tp AVTP Control Format (ACF) stream payload. Tags: atp.Status=draft
              container IEEE1722TpStreamAcfCan [0..1]  # Definition of an IEEE1722Tp AVTP Control Format (ACF) stream payload for CAN and CAN_BRIEF. Tags: atp.Status=draft
                integer IEEE1722TpStreamAcfBusId: 0..31, post-build-variant-value=true, set at link in variant link-time / post-build in variant post-build / pre-compile in variant pre-compile  # Definition of the ACF stream bus_id. Tags: atp.Status=draft
                enumeration IEEE1722TpStreamAcfCanMessageType: post-build-variant-value=true, set at link in variant link-time / post-build in variant post-build / pre-compile in variant pre-compile  # Definition of the ACF CAN stream message type. Tags: atp.Status=draft | Depending on this selection the ACF stream acf_msg_type will be defined.
                  CAN  # Tags: atp.Status=draft
                  CAN_BRIEF  # Tags: atp.Status=draft
                container IEEE1722TpStreamAcfCanPdu [1..*]: multiplicity set at pre-compile  # Definition of a CAN Pdu transported on this ACF stream. Identification can be done by either explicit CAN Id or via meta-data. Tags: atp.Status=draft
                  boolean IEEE1722TpStreamAcfCanExtendedFrameFormat [0..1]: multiplicity set at pre-compile, post-build-variant-value=true, set at link in variant link-time / post-build in variant post-build / pre-compile in variant pre-compile  # Defines the ACF CAN stream extended_frame_format (eff). Tags: atp.Status=draft | true = 1 false = 0
                  boolean IEEE1722TpStreamAcfCanFDBitDataRateFormat [0..1]: multiplicity set at pre-compile, post-build-variant-value=true, set at link in variant link-time / post-build in variant post-build / pre-compile in variant pre-compile  # Represents the CAN-FD Data-rate (FD) format (fdf) switch. This is used, when a PDU is produced by an upper layer and transferred as encapsulated ACF_CAN via an Ethernet network. Tags: atp.Status=draft
                  boolean IEEE1722TpStreamAcfCanFDBitRateSwitch [0..1]: multiplicity set at pre-compile, post-build-variant-value=true, set at link in variant link-time / post-build in variant post-build / pre-compile in variant pre-compile  # Represents the CAN-FD bit rate switch (brs). This is used, if a PDU is produced by an upper layer and transferred as encapsulated ACF_CAN via an Ethernet network. Tags: atp.Status=draft
                  integer IEEE1722TpStreamAcfCanId [0..1]: 0..536870911, multiplicity set at pre-compile, post-build-variant-value=true, set at link in variant link-time / post-build in variant post-build / pre-compile in variant pre-compile  # Definition of the ACF stream CAN Id in case CAN Id is not taken from meta-data. Tags: atp.Status=draft
                  enumeration IEEE1722TpStreamAcfTriggerMode: post-build-variant-value=true, set at link in variant link-time / post-build in variant post-build / pre-compile in variant pre-compile  # Defines whether putting this Can/Lin Pdu to the ACF message Tags: atp.Status=draft | * always or * never triggers immediate sending of the ACF message.
                    TRIGGER_ALWAYS  # Tags: atp.Status=draft
                    TRIGGER_NEVER  # Tags: atp.Status=draft
                  container IEEE1722TpStreamAcfCanPduFilter [0..1]: multiplicity set at link in variant link-time / post-build in variant post-build / pre-compile in variant pre-compile, post-build-variant-multiplicity=true  # Optional definition of a Can Id filter. This specifically applies to the case where the Can Id is taken from the meta-data and only certain PDUs shall actually pass. Tags: atp.Status=draft | If the definition is from Can network to stream, then this filter selects which PDUs shall be put to the stream. If the definition is from stream to Can network, then this filter selects which PDUs shall be put on the Can network.
                    integer IEEE1722TpStreamAcfCanIdMask [0..1]: 0..536870911, scope=ECU, multiplicity set at link in variant link-time / post-build in variant post-build / pre-compile in variant pre-compile, post-build-variant-multiplicity=true, post-build-variant-value=true, set at link in variant link-time / post-build in variant post-build / pre-compile in variant pre-compile, default-value=536870911  # Identifier mask which denotes relevant bits in the CAN Identifier. This parameter defines a CAN Identifier range in an alternative way to IEEE1722TpStreamAcfCanIdRange. It identifies the bits of the configured CAN Identifier that must match the received CAN Identifier. Tags: atp.Status=draft | Range: 11 bits for Standard CAN Identifier, 29 bits for Extended CAN Identifier.
                    container IEEE1722TpStreamAcfCanIdRange [0..1]: multiplicity set at link in variant link-time / post-build in variant post-build / pre-compile in variant pre-compile, post-build-variant-multiplicity=true  # Identifier range definition. This parameter defines a CAN Identifier range in an alternative way to IEEE1722TpStreamAcfCanIdMask.
                      integer IEEE1722TpStreamAcfCanIdRangeLowerCanId: 0..536870911, post-build-variant-value=true, set at link in variant link-time / post-build in variant post-build / pre-compile in variant pre-compile  # Lower CAN Identifier of a receive CAN L-PDU for identifier range definition, in which all CAN Ids are mapped to one PduId.
                      integer IEEE1722TpStreamAcfCanIdRangeUpperCanId: 0..536870911, post-build-variant-value=true, set at link in variant link-time / post-build in variant post-build / pre-compile in variant pre-compile  # Upper CAN Identifier of a receive CAN L-PDU for identifier range definition, in which all CAN Ids are mapped to one PduId.
                  container IEEE1722TpStreamAcfRxPdu [0..1]: multiplicity set at pre-compile  # This container defines the EcuC Rx Pdu used for the transport of the network specific payload (Can or Lin). Tags: atp.Status=draft | Dependency: Either IEEE1722TpStreamAcfTxPdu or IEEE1722TpStreamAcfRxPdu shall be provided. Supported MetaData entries for CAN: * IEEE1722TP_COMMON_STREAM_HEADER_PTR * MESSAGE_TIMESTAMP_64 * MESSAGE_TIMESTAMP_VALID_8 * CAN_ID_32 * CAN_ID_PROPS_8 Supported MetaData entries for LIN: * IEEE1722TP_COMMON_STREAM_HEADER_PTR * MESSAGE_TIMESTAMP_64 * MESSAGE_TIMESTAMP_VALID_8 * LIN_NAD_8
                    integer IEEE1722TpStreamAcfPduId [0..1]: 0..65535, scope=ECU, multiplicity set at pre-compile, post-build-variant-value=true, set at link in variant link-time / post-build in variant post-build / pre-compile in variant pre-compile, symbolic-name-value=true, with-auto=true  # Definition of the Handle Pdu Id. Tags: atp.Status=draft
                    reference IEEE1722TpStreamAcfPduRef: scope=ECU, post-build-variant-value=true, set at link in variant link-time / post-build in variant post-build / pre-compile in variant pre-compile, destination=Pdu  # Reference to the EcuC Pdu. Tags: atp.Status=draft
                  container IEEE1722TpStreamAcfTxPdu [0..1]: multiplicity set at pre-compile  # This container defines the EcuC Tx Pdu used for the transport of the network specific payload (Can or Lin). Tags: atp.Status=draft | Dependency: Either IEEE1722TpStreamAcfTxPdu or IEEE1722TpStreamAcfRxPdu shall be provided. Supported MetaData entries for CAN: * CAN_ID_32 * CAN_ID_PROPS_8 Supported MetaData entries for LIN: * LIN_NAD_8
                    integer IEEE1722TpStreamAcfPduId [0..1]: 0..65535, scope=ECU, multiplicity set at pre-compile, post-build-variant-value=true, set at link in variant link-time / post-build in variant post-build / pre-compile in variant pre-compile, symbolic-name-value=true, with-auto=true  # Definition of the Handle Pdu Id. Tags: atp.Status=draft
                    reference IEEE1722TpStreamAcfPduRef: scope=ECU, post-build-variant-value=true, set at link in variant link-time / post-build in variant post-build / pre-compile in variant pre-compile, destination=Pdu  # Reference to the EcuC Pdu. Tags: atp.Status=draft
              container IEEE1722TpStreamAcfLin [0..1]  # Definition of an IEEE1722Tp AVTP Control Format (ACF) stream payload for LIN. Tags: atp.Status=draft | ACF message type = 0x03.
                integer IEEE1722TpStreamAcfBusId: 0..31, post-build-variant-value=true, set at link in variant link-time / post-build in variant post-build / pre-compile in variant pre-compile  # Definition of the ACF stream bus_id. Tags: atp.Status=draft
                container IEEE1722TpStreamAcfLinPdu [1..*]: multiplicity set at pre-compile  # Definition of a LIN Pdu transported on this ACF stream. Identification can be done by either explicit LIN Id or via meta-data. Tags: atp.Status=draft
                  integer IEEE1722TpStreamAcfLinId: 0..63, post-build-variant-value=true, set at link in variant link-time / post-build in variant post-build / pre-compile in variant pre-compile  # Definition of the ACF stream Lin Id. Tags: atp.Status=draft
                  enumeration IEEE1722TpStreamAcfTriggerMode: post-build-variant-value=true, set at link in variant link-time / post-build in variant post-build / pre-compile in variant pre-compile  # Defines whether putting this Can/Lin Pdu to the ACF message Tags: atp.Status=draft | * always or * never triggers immediate sending of the ACF message.
                    TRIGGER_ALWAYS  # Tags: atp.Status=draft
                    TRIGGER_NEVER  # Tags: atp.Status=draft
                  container IEEE1722TpStreamAcfRxPdu [0..1]: multiplicity set at pre-compile  # This container defines the EcuC Rx Pdu used for the transport of the network specific payload (Can or Lin). Tags: atp.Status=draft | Dependency: Either IEEE1722TpStreamAcfTxPdu or IEEE1722TpStreamAcfRxPdu shall be provided. Supported MetaData entries for CAN: * IEEE1722TP_COMMON_STREAM_HEADER_PTR * MESSAGE_TIMESTAMP_64 * MESSAGE_TIMESTAMP_VALID_8 * CAN_ID_32 * CAN_ID_PROPS_8 Supported MetaData entries for LIN: * IEEE1722TP_COMMON_STREAM_HEADER_PTR * MESSAGE_TIMESTAMP_64 * MESSAGE_TIMESTAMP_VALID_8 * LIN_NAD_8
                    integer IEEE1722TpStreamAcfPduId [0..1]: 0..65535, scope=ECU, multiplicity set at pre-compile, post-build-variant-value=true, set at link in variant link-time / post-build in variant post-build / pre-compile in variant pre-compile, symbolic-name-value=true, with-auto=true  # Definition of the Handle Pdu Id. Tags: atp.Status=draft
                    reference IEEE1722TpStreamAcfPduRef: scope=ECU, post-build-variant-value=true, set at link in variant link-time / post-build in variant post-build / pre-compile in variant pre-compile, destination=Pdu  # Reference to the EcuC Pdu. Tags: atp.Status=draft
                  container IEEE1722TpStreamAcfTxPdu [0..1]: multiplicity set at pre-compile  # This container defines the EcuC Tx Pdu used for the transport of the network specific payload (Can or Lin). Tags: atp.Status=draft | Dependency: Either IEEE1722TpStreamAcfTxPdu or IEEE1722TpStreamAcfRxPdu shall be provided. Supported MetaData entries for CAN: * CAN_ID_32 * CAN_ID_PROPS_8 Supported MetaData entries for LIN: * LIN_NAD_8
                    integer IEEE1722TpStreamAcfPduId [0..1]: 0..65535, scope=ECU, multiplicity set at pre-compile, post-build-variant-value=true, set at link in variant link-time / post-build in variant post-build / pre-compile in variant pre-compile, symbolic-name-value=true, with-auto=true  # Definition of the Handle Pdu Id. Tags: atp.Status=draft
                    reference IEEE1722TpStreamAcfPduRef: scope=ECU, post-build-variant-value=true, set at link in variant link-time / post-build in variant post-build / pre-compile in variant pre-compile, destination=Pdu  # Reference to the EcuC Pdu. Tags: atp.Status=draft
          container IEEE1722TpStreamCRF [0..1]  # Definition of an IEEE1722 Clock Reference Format (CRF) stream. Tags: atp.Status=draft
            integer IEEE1722TpStreamCrfBaseFrequency: 0..536870911, post-build-variant-value=true, set at link in variant link-time / post-build in variant post-build / pre-compile in variant pre-compile  # Definition of the CRF stream base frequency. This is defined in Hz. Tags: atp.Status=draft
            boolean IEEE1722TpStreamCrfFrameSync: post-build-variant-value=true, set at link in variant link-time / post-build in variant post-build / pre-compile in variant pre-compile  # Defines the CRF stream frame sync (fs). Tags: atp.Status=draft | true = 1 false = 0
            enumeration IEEE1722TpStreamCrfPull: post-build-variant-value=true, set at link in variant link-time / post-build in variant post-build / pre-compile in variant pre-compile  # Definition of the CRF stream pull value. Tags: atp.Status=draft
              PULL_1_0  # Tags: atp.Status=draft
              PULL_1_001  # Tags: atp.Status=draft
              PULL_1_1_001  # Tags: atp.Status=draft
              PULL_1_8  # Tags: atp.Status=draft
              PULL_24_25  # Tags: atp.Status=draft
              PULL_25_24  # Tags: atp.Status=draft
            integer IEEE1722TpStreamCrfTimestampInterval: 0..65535, post-build-variant-value=true, set at link in variant link-time / post-build in variant post-build / pre-compile in variant pre-compile  # Definition of the CRF stream timestamp interval. This is defined as multiple of base frequency. Tags: atp.Status=draft
            enumeration IEEE1722TpStreamCrfType: post-build-variant-value=true, set at link in variant link-time / post-build in variant post-build / pre-compile in variant pre-compile  # Definition of the CRF stream type. Tags: atp.Status=draft
              AUDIO_SAMPLE  # Tags: atp.Status=draft
              MACHINE_CYCLE  # Tags: atp.Status=draft
              USER  # Tags: atp.Status=draft
              VIDEO_FRAME  # Tags: atp.Status=draft
              VIDEO_LINE  # Tags: atp.Status=draft
          container IEEE1722TpStreamIIDC [0..1]  # Definition of an IEEE1722 61883_IIDC (IEC 61883/IIDC over AVTP) stream. Tags: atp.Status=draft
            integer IEEE1722TpStreamIidcChannel: 0..31, post-build-variant-value=true, set at link in variant link-time / post-build in variant post-build / pre-compile in variant pre-compile  # Definition of the IIDC channel. Tags: atp.Status=draft
            integer IEEE1722TpStreamIidcDataBlockSize: 0..255, post-build-variant-value=true, set at link in variant link-time / post-build in variant post-build / pre-compile in variant pre-compile  # Definition of the IIDC data block size (DBS). Tags: atp.Status=draft
            integer IEEE1722TpStreamIidcFractionNumber: 0..255, post-build-variant-value=true, set at link in variant link-time / post-build in variant post-build / pre-compile in variant pre-compile  # Definition of the IIDC fractionNumber (FN). Tags: atp.Status=draft
            boolean IEEE1722TpStreamIidcSourcePacketHeader: post-build-variant-value=true, set at link in variant link-time / post-build in variant post-build / pre-compile in variant pre-compile  # Defines the IIDC source packet header (SPH). Tags: atp.Status=draft | true = 1 false = 0
            integer IEEE1722TpStreamIidcStreamFormat: 0..63, post-build-variant-value=true, set at link in variant link-time / post-build in variant post-build / pre-compile in variant pre-compile  # Definition of the IIDC stream format (FMT). Tags: atp.Status=draft
            integer IEEE1722TpStreamIidcSy: 0..15, post-build-variant-value=true, set at link in variant link-time / post-build in variant post-build / pre-compile in variant pre-compile  # Definition of the IIDC sy. Tags: atp.Status=draft
            integer IEEE1722TpStreamIidcTag: 0..3, post-build-variant-value=true, set at link in variant link-time / post-build in variant post-build / pre-compile in variant pre-compile  # Definition of the IIDC tag. Tags: atp.Status=draft
            integer IEEE1722TpStreamIidcTCode: 0..31, post-build-variant-value=true, set at link in variant link-time / post-build in variant post-build / pre-compile in variant pre-compile  # Definition of the IIDC tcode. Tags: atp.Status=draft
          container IEEE1722TpStreamRVF [0..1]  # Definition of an IEEE1722 Raw Video Format (RVF) stream. Tags: atp.Status=draft
            integer IEEE1722TpStreamRvfActivePixels: 0..65535, post-build-variant-value=true, set at link in variant link-time / post-build in variant post-build / pre-compile in variant pre-compile  # Definition of the RVF stream active_pixels. Tags: atp.Status=draft
            enumeration IEEE1722TpStreamRvfColorSpace: post-build-variant-value=true, set at link in variant link-time / post-build in variant post-build / pre-compile in variant pre-compile  # Definition of the RVF stream colorspace. Tags: atp.Status=draft
              BT_Rec_601  # Tags: atp.Status=draft
              BT_Rec_709  # Tags: atp.Status=draft
              Grayscale  # Tags: atp.Status=draft
              ITU_BT_2020  # Tags: atp.Status=draft
              User  # Tags: atp.Status=draft
              XYZ  # Tags: atp.Status=draft
              YCM  # Tags: atp.Status=draft
              YCbCr  # Tags: atp.Status=draft
              YCgCo  # Tags: atp.Status=draft
              sRGB  # Tags: atp.Status=draft
            integer IEEE1722TpStreamRvfEventDefault: 0..15, post-build-variant-value=true, set at link in variant link-time / post-build in variant post-build / pre-compile in variant pre-compile, default-value=0  # Definition of the RVF stream event (evt) default value. Tags: atp.Status=draft
            enumeration IEEE1722TpStreamRvfFrameRate: post-build-variant-value=true, set at link in variant link-time / post-build in variant post-build / pre-compile in variant pre-compile  # Definition of the RVF stream frame_rate. Tags: atp.Status=draft
              FR_1  # Tags: atp.Status=draft
              FR_10  # Tags: atp.Status=draft
              FR_100  # Tags: atp.Status=draft
              FR_120  # Tags: atp.Status=draft
              FR_15  # Tags: atp.Status=draft
              FR_150  # Tags: atp.Status=draft
              FR_2  # Tags: atp.Status=draft
              FR_20  # Tags: atp.Status=draft
              FR_200  # Tags: atp.Status=draft
              FR_24  # Tags: atp.Status=draft
              FR_240  # Tags: atp.Status=draft
              FR_25  # Tags: atp.Status=draft
              FR_30  # Tags: atp.Status=draft
              FR_300  # Tags: atp.Status=draft
              FR_48  # Tags: atp.Status=draft
              FR_5  # Tags: atp.Status=draft
              FR_50  # Tags: atp.Status=draft
              FR_60  # Tags: atp.Status=draft
              FR_72  # Tags: atp.Status=draft
              FR_85  # Tags: atp.Status=draft
              FR_User  # Tags: atp.Status=draft
            boolean IEEE1722TpStreamRvfInterlaced: post-build-variant-value=true, set at link in variant link-time / post-build in variant post-build / pre-compile in variant pre-compile  # Defines the RVF stream interlaced (i). Tags: atp.Status=draft | true = 1 false = 0
            enumeration IEEE1722TpStreamRvfPixelDepth: post-build-variant-value=true, set at link in variant link-time / post-build in variant post-build / pre-compile in variant pre-compile  # Definition of the RVF stream pixel_depth. Tags: atp.Status=draft
              PD_10  # Tags: atp.Status=draft
              PD_12  # Tags: atp.Status=draft
              PD_16  # Tags: atp.Status=draft
              PD_8  # Tags: atp.Status=draft
              User  # Tags: atp.Status=draft
            enumeration IEEE1722TpStreamRvfPixelFormat: post-build-variant-value=true, set at link in variant link-time / post-build in variant post-build / pre-compile in variant pre-compile  # Definition of the RVF stream pixel_format. Tags: atp.Status=draft
              PF_4_1_1  # Tags: atp.Status=draft
              PF_4_2_0  # Tags: atp.Status=draft
              PF_4_2_2  # Tags: atp.Status=draft
              PF_4_2_2_4  # Tags: atp.Status=draft
              PF_4_4_4  # Tags: atp.Status=draft
              PF_4_4_4_4  # Tags: atp.Status=draft
              PF_Bayer_bggr  # Tags: atp.Status=draft
              PF_Bayer_gbrg  # Tags: atp.Status=draft
              PF_Bayer_grbg  # Tags: atp.Status=draft
              PF_Bayer_rggb  # Tags: atp.Status=draft
              PF_Monochrome  # Tags: atp.Status=draft
              PF_User  # Tags: atp.Status=draft
            integer IEEE1722TpStreamRvfTotalLines: 0..65535, post-build-variant-value=true, set at link in variant link-time / post-build in variant post-build / pre-compile in variant pre-compile  # Definition of the RVF stream total_lines. Tags: atp.Status=draft
    container IEEE1722TpGeneral  # Specifies the general configuration parameters of the IEEE1722Tp. Tags: atp.Status=draft
      boolean IEEE1722TpDevErrorDetect: set at pre-compile, default-value=false  # Switches the development error detection and notification on or off. Tags: atp.Status=draft | * true: detection and notification is enabled. * false: detection and notification is disabled.
      boolean IEEE1722TpVersionInfoApi: set at pre-compile, default-value=false  # If true the IEEE1722Tp_GetVersionInfo API is available. Tags: atp.Status=draft
      container IEEE1722TpMainFunctionRx  # Defines the IEEE1722TpMainFunctionRx. Tags: atp.Status=draft
        float IEEE1722TpMainFunctionRxPeriod: 0..INF, set at pre-compile  # Specifies the period of the Rx main function IEEE1722Tp_MainFunctionRx in seconds. Tags: atp.Status=draft
        reference IEEE1722TpMainFunctionRxPartitionRef [0..1]: scope=ECU, multiplicity set at pre-compile, set at pre-compile, destination=EcucPartition  # Reference to EcucPartition, where the IEEE1722Tp_MainFunctionRx is assigned to. Tags: atp.Status=draft
      container IEEE1722TpMainFunctionTx  # Defines the IEEE1722TpMainFunctionTx. Tags: atp.Status=draft
        float IEEE1722TpMainFunctionTxPeriod: 0..INF, set at pre-compile  # Specifies the period of the Tx main function IEEE1722Tp_MainFunctionTx in seconds. Tags: atp.Status=draft
        reference IEEE1722TpMainFunctionTxPartitionRef [0..1]: scope=ECU, multiplicity set at pre-compile, set at pre-compile, destination=EcucPartition  # Reference to EcucPartition, where the IEEE1722Tp_MainFunctionTx is assigned to. Tags: atp.Status=draft
