AUTOSAR XML (schema 00053)
package /AUTOSAR/EcucDefs
  ecuc definition collection AUTOSARParameterDefinition: module=Dds
  module definition Dds [0..1]: post-build-variant-support=true, variants post-build/pre-compile  # Configuration of the Dds module.
    container DdsConfig  # This container contains the configuration parameters and sub containers of the AUTOSAR Dds module.
      container DdsAppDataRxPduCollection [0..1]: multiplicity set at pre-compile  # Collection of upper layer Rx PDUs towards the application layer.
        container DdsAppDataRxPdu [0..65535]: multiplicity set at post-build in variant post-build / pre-compile in variant pre-compile, post-build-variant-multiplicity=true  # The upper layer PDU used to send received data from DDS to Application.
          integer DdsAppDataRxPduId: 0..65535, scope=ECU, set at pre-compile, symbolic-name-value=true  # The current pdu local id.
          reference DdsAppDataRxPduRef: scope=ECU, set at pre-compile, destination=Pdu  # The reference to a PDU in the global PDU structure described in the AUTOSAR ECU Configuration Specification. | This reference will be used by the Dds module to derive the PDU Id.
      container DdsAppDataTxPduCollection [0..1]: multiplicity set at pre-compile  # Collection of upper layer Tx PDUs towards the application layer.
        container DdsAppDataTxPdu [0..65535]: multiplicity set at post-build in variant post-build / pre-compile in variant pre-compile, post-build-variant-multiplicity=true  # The upper layer PDU used to transmit data from Application to DDS itself.
          integer DdsAppDataTxPduId: 0..65535, scope=ECU, set at pre-compile, symbolic-name-value=true  # The current pdu local id.
          reference DdsAppDataTxPduRef: scope=ECU, set at pre-compile, destination=Pdu  # The reference to a PDU in the global PDU structure described in the AUTOSAR ECU Configuration Specification. | This reference will be used by the Dds module to derive the PDU Id.
      container DdsDomainParticipantCollection [0..1]: multiplicity set at pre-compile  # Collection of DDS Domain Participants.
        container DdsDomainParticipant [1..65535]: multiplicity set at pre-compile  # This container represents the configuration of one single Domain Participant hosted within the current node. One node can contain more than one Domain Participant.
          integer DdsDomainId: 0..65535, scope=ECU, set at pre-compile  # The ID of the Domain to which this DDS node belongs. It unambiguously identifies the DDS Domain to which the DomainParticipant belongs. | Note: Only entities that belong to the same DDS Domain can communicate with each other.
          integer DdsDomainParticipantId: 0..65535, scope=ECU, set at pre-compile  # Identifier of a Dds Domain Participant.
          container DdsDataReceiver [0..65535]: multiplicity set at pre-compile  # Container useful to usability: it defines a DDS DataReader linked to a Sender/ReceiverInterface.
            reference DdsReceiverDataReaderRef: scope=ECU, set at pre-compile, destination=DdsDataReader  # Reference to the dataReader used by the receiver
          container DdsDataSender [0..65535]: multiplicity set at pre-compile  # Container useful to usability: it defines a DDS DataWriter linked to a Sender/ReceiverInterface.
            reference DdsSenderDataWriterRef: scope=ECU, set at pre-compile, destination=DdsDataWriter  # Reference to the dataWriter used by the sender
          container DdsDomainParticipantCryptoInfo [0..1]: multiplicity set at pre-compile  # This container contains the configuration of the Crypto service to be used by Entities belonging to this DomainParticipant. | If it is not present, it means that not security mechanism is supported.
            reference DdsDomainParticipantCsmAuthenticateJob: scope=ECU, set at pre-compile, destination=CsmJob  # The reference to the CSM job to be used to authenticate data.
            reference DdsDomainParticipantCsmVerifyJob: scope=ECU, set at pre-compile, destination=CsmJob  # The reference to the CSM job to be used to verify data.
          container DdsDomainParticipantMulticastRtpsPduCollection [0..1]: multiplicity set at pre-compile  # The pool of multicast lower layer PDUs towards lower network layers.
            container DdsRtpsMulticastDataRxPdu [0..1]: multiplicity set at post-build in variant post-build / pre-compile in variant pre-compile, post-build-variant-multiplicity=true  # The multicast reception lower layer pdu used to send data from the lower network layer to DDS itself.
              integer DdsRtpsMulticastDataRxPduId: 0..65535, scope=ECU, set at pre-compile, symbolic-name-value=true  # The current pdu local id.
              reference DdsRtpsMulticastDataRxPduRef: scope=ECU, set at pre-compile, destination=Pdu  # The reference to a PDU in the global PDU structure described in the AUTOSAR ECU Configuration Specification. | This reference will be used by the Dds module to derive the PDU Id.
            container DdsRtpsMulticastDataTxPdu [0..1]: multiplicity set at post-build in variant post-build / pre-compile in variant pre-compile, post-build-variant-multiplicity=true  # The multicast lower layer transmission PDU used to transmit data from DDS to lower network layer.
              integer DdsRtpsMulticastDataTxPduId: 0..65535, scope=ECU, set at pre-compile, symbolic-name-value=true  # The current pdu local id
              reference DdsRtpsMulticastDataTxPduRef: scope=ECU, set at pre-compile, destination=Pdu  # The reference to a PDU in the global PDU structure described in the AUTOSAR ECU Configuration Specification. | This reference will be used by the Dds module to derive the PDU Id.
          container DdsDomainParticipantQoS [0..1]: multiplicity set at pre-compile  # This container represents the configuration of QoS supported by the Dds DomainParticipant.
            container DdsEntityFactory [0..1]: multiplicity set at pre-compile  # Describes the DDS [cite{DDS}] ENTITY_FACTORY QoS policy.
              boolean DdsEntityFactoryAutoenableCreatedEntities: set at pre-compile, default-value=true  # See "ENTITY_FACTORY" chapter of DDS [cite{DDS}].
            container DdsUserData [0..1]: multiplicity set at pre-compile  # Describes the DDS [cite{DDS}] USER_DATA QoS policy.
              string DdsUserDataValue: scope=ECU, set at pre-compile  # See "USER_DATA" chapter of DDS [cite{DDS}].
          container DdsDomainParticipantUnicastRtpsPduCollection [0..1]: multiplicity set at pre-compile  # Collection of unicast lower layer PDUs towards lower network layers.
            container DdsRtpsDataRxPdu [0..1]: multiplicity set at post-build in variant post-build / pre-compile in variant pre-compile, post-build-variant-multiplicity=true  # The unicast reception lower layer pdu used to send data from the lower network layer to DDS itself.
              integer DdsRtpsDataRxPduId: 0..65535, scope=ECU, set at pre-compile, symbolic-name-value=true  # The current pdu local id.
              reference DdsRtpsDataRxPduRef: scope=ECU, set at pre-compile, destination=Pdu  # The reference to a PDU in the global PDU structure described in the AUTOSAR ECU Configuration Specification. | This reference will be used by the Dds module to derive the PDU Id.
            container DdsRtpsDataTxPdu [0..65535]: multiplicity set at post-build in variant post-build / pre-compile in variant pre-compile, post-build-variant-multiplicity=true  # The unicast transmission lower layer pdu used to transmit data from DDS to lower network layer.
              integer DdsRtpsDataTxPduId: 0..65535, scope=ECU, set at pre-compile, symbolic-name-value=true  # The current pdu local id
              reference DdsRtpsDataTxPduRef: scope=ECU, set at pre-compile, destination=Pdu  # The reference to a PDU in the global PDU structure described in the AUTOSAR ECU Configuration Specification. | This reference will be used by the Dds module to derive the PDU Id.
          container DdsPublisher [0..65535]: multiplicity set at pre-compile  # This container represents the configuration of one Publisher.
            container DdsDataWriter [1..65535]: multiplicity set at pre-compile  # This container represents the configuration of one data writer. One publisher can refer to one or more writer, but a writer can belong to one single publisher.
              reference DdsDataWriterAppDataTxPduRef [1..65535]: scope=ECU, multiplicity set at pre-compile, set at pre-compile, destination=DdsAppDataTxPdu  # This reference refers to the DdsAppDataTxPdu which is used by the upper layer of the Dds module to transfer data which is requested to be transmitted on the network as DDS serialized data.
              reference DdsDataWriterRemoteDataReaders [0..65535]: scope=ECU, multiplicity set at pre-compile, set at pre-compile, destination=DdsRemoteDataReader  # Reference to the remote DdsDataReaders that the current DdsDataWriters has to send data to. | For each remote DdsDataReader configured, the local DdsDataWriter shall send data by using the DdsDataReaderRemotePdu configured for the given remote DataReader.
              reference DdsDataWriterTopicRef: scope=ECU, set at pre-compile, destination=DdsTopic  # This reference selects the Topic on which the current Dds Writer wants to publish.
              container DdsDataWriterQoS [0..1]  # This container represents the configuration of QoS Profiles related to the current DdsDataWriter.
                container DdsDeadline [0..1]: multiplicity set at pre-compile  # Describes the DDS [cite{DDS}] DEADLINE QoS policy.
                  float DdsDeadlinePeriod: 0..65.534, scope=ECU, set at pre-compile  # See "DEADLINE" chapter of DDS [cite{DDS}]. | Time given in seconds.
                container DdsDestinationOrder [0..1]: multiplicity set at pre-compile  # Describes the DDS [cite{DDS}] DESTINATION_ORDER QoS policy.
                  enumeration DdsDestinationOrderKind: {BY_RECEPTION_TIMESTAMP, BY_SOURCE_TIMESTAMP}, scope=ECU, set at pre-compile, default-value=BY_RECEPTION_TIMESTAMP  # See "DESTINATION_ORDER" chapter of DDS [cite{DDS}].
                container DdsDurability [0..1]: multiplicity set at pre-compile  # Describes the DDS [cite{DDS}] DURABILITY QoS policy.
                  enumeration DdsDurabilityKind: {PERSISTENT, TRANSIENT, TRANSIENT_LOCAL, VOLATILE}, scope=ECU, set at pre-compile, default-value=VOLATILE  # See "DURABILITY" chapter of DDS [cite{DDS}].
                container DdsDurabilityService [0..1]: multiplicity set at pre-compile  # Describes the DDS [cite{DDS}] DURABILITY_SERVICE QoS policy.
                  float DdsDurabilityServiceCleanupDelay: 0..65.534, scope=ECU, set at pre-compile  # See "DURABILITY_SERVICE" chapter of DDS [cite{DDS}]. | Time given in seconds.
                  integer DdsDurabilityServiceHistoryDepth: 0..65534, scope=ECU, set at pre-compile, default-value=1  # See "DURABILITY_SERVICE" chapter of DDS [cite{DDS}].
                  enumeration DdsDurabilityServiceHistoryKind: {KEEP_ALL, KEEP_LAST}, scope=ECU, set at pre-compile, default-value=KEEP_LAST  # See "DURABILITY_SERVICE" chapter of DDS [cite{DDS}].
                  integer DdsDurabilityServiceMaxInstances: 0..65534, scope=ECU, set at pre-compile  # See "DURABILITY_SERVICE" chapter of DDS [cite{DDS}].
                  integer DdsDurabilityServiceMaxSamples: 0..65534, scope=ECU, set at pre-compile  # See "DURABILITY_SERVICE" chapter of DDS [cite{DDS}].
                  integer DdsDurabilityServiceMaxSamplesPerInstance: 0..65534, scope=ECU, set at pre-compile  # See "DURABILITY_SERVICE" chapter of DDS [cite{DDS}].
                container DdsHistory [0..1]: multiplicity set at pre-compile  # Describes the DDS [cite{DDS}] HISTORY QoS policy.
                  enumeration DdsHistoryKind: {KEEP_ALL, KEEP_LAST}, scope=ECU, set at pre-compile, default-value=KEEP_LAST  # See "HISTORY" chapter of DDS [cite{DDS}].
                  integer DdsHistoryOrderDepth: 0..65534, scope=ECU, set at pre-compile, default-value=1  # See "HISTORY" chapter of DDS [cite{DDS}].
                container DdsLatencyBudget [0..1]: multiplicity set at pre-compile  # Describes the DDS [cite{DDS}] LATENCY_BUDGET QoS policy.
                  float DdsLatencyBudgetDuration: 0..65.534, scope=ECU, set at pre-compile  # See "LATENCY_BUDGET" chapter of DDS [cite{DDS}]. | Time given in seconds.
                container DdsLifespan [0..1]: multiplicity set at pre-compile  # Describes the DDS [cite{DDS}] LIFESPAN QoS policy.
                  float DdsLifespanDuration: 0..65.534, scope=ECU, set at pre-compile  # See "LIFESPAN" chapter of DDS [cite{DDS}]. | Time given in seconds.
                container DdsLiveliness [0..1]: multiplicity set at pre-compile  # Describes the DDS [cite{DDS}] LIVELINESS QoS policy.
                  float DdsLivelinessLeaseDuration: 0..65.534, scope=ECU, set at pre-compile  # See "LIVELINESS" chapter of DDS [cite{DDS}]. | Time given in seconds.
                  enumeration DdsLivenessKind: {AUTOMATIC, MANUAL_BY_PARTICIPANT, MANUAL_BY_TOPIC}, scope=ECU, set at pre-compile, default-value=AUTOMATIC  # See "LIVELINESS" chapter of DDS [cite{DDS}].
                container DdsOwnership [0..1]: multiplicity set at pre-compile  # Describes the DDS [cite{DDS}] OWNERSHIP QoS policy.
                  enumeration DdsOwnershipKind: {EXCLUSIVE, SHARED}, scope=ECU, set at pre-compile, default-value=SHARED  # See "OWNERSHIP" chapter of DDS [cite{DDS}].
                container DdsOwnershipStrength [0..1]: multiplicity set at pre-compile  # Describes the DDS [cite{DDS}] OWNERSHIP_STRENGTH QoS policy.
                  integer DdsOwnershipStrengthValue: 0..65534, scope=ECU, set at pre-compile, default-value=0  # See "OWNERSHIP_STRENGTH" chapter of DDS [cite{DDS}].
                container DdsReliability [0..1]: multiplicity set at pre-compile  # Describes the DDS [cite{DDS}] RELIABILITY QoS policy.
                  enumeration DdsReliabilityKind: {BEST_EFFORT, RELIABLE}, scope=ECU, set at pre-compile  # See "RELIABILITY" chapter of DDS [cite{DDS}].
                  float DdsReliabilityMaxBlockingTime: 0..65.534, scope=ECU, set at pre-compile, default-value=0.1  # See "RELIABILITY" chapter of DDS [cite{DDS}]. | Time given in seconds.
                container DdsResourceLimits [0..1]: multiplicity set at pre-compile  # Describes the DDS [cite{DDS}] RESOURCE_LIMITS QoS policy.
                  integer DdsResouceLimitsMaxInstances: 0..65534, scope=ECU, set at pre-compile, default-value=65534  # See "RESOURCE_LIMITS" chapter of DDS [cite{DDS}].
                  integer DdsResouceLimitsMaxSamples: 0..65534, scope=ECU, set at pre-compile, default-value=65534  # See "RESOURCE_LIMITS" chapter of DDS [cite{DDS}].
                  integer DdsResouceLimitsMaxSamplesPerInstance: 0..65534, scope=ECU, set at pre-compile, default-value=65534  # See "RESOURCE_LIMITS" chapter of DDS [cite{DDS}].
                container DdsTransportPriority [0..1]: multiplicity set at pre-compile  # Describes the DDS [cite{DDS}] TRANSPORT_PRIORITY QoS policy.
                  integer DdsTransportPriorityValue: 0..65534, scope=ECU, set at pre-compile, default-value=0  # See "TRANSPORT_PRIORITY" chapter of DDS [cite{DDS}].
                container DdsUserData [0..1]: multiplicity set at pre-compile  # Describes the DDS [cite{DDS}] USER_DATA QoS policy.
                  string DdsUserDataValue: scope=ECU, set at pre-compile  # See "USER_DATA" chapter of DDS [cite{DDS}].
                container DdsWriterDataLifecycle [0..1]: multiplicity set at pre-compile  # Describes the DDS [cite{DDS}] WRITER_DATA_LIFECYCLE QoS policy.
                  boolean DdsAutodisposeUnregisteredInstances: set at pre-compile, default-value=true  # See "WRITER_DATA_LIFECYCLE" chapter of DDS [cite{DDS}].
            container DdsPublisherQoS [0..1]: multiplicity set at pre-compile  # This container represents the configuration of QoS Profiles related to the current Dds Publisher.
              container DdsEntityFactory [0..1]: multiplicity set at pre-compile  # Describes the DDS [cite{DDS}] ENTITY_FACTORY QoS policy.
                boolean DdsEntityFactoryAutoenableCreatedEntities: set at pre-compile, default-value=true  # See "ENTITY_FACTORY" chapter of DDS [cite{DDS}].
              container DdsGroupData [0..1]: multiplicity set at pre-compile  # Describes the DDS [cite{DDS}] GROUP_DATA QoS policy.
                string DdsGroupDataValue: scope=ECU, set at pre-compile  # See "GROUP_DATA" chapter of DDS [cite{DDS}].
              container DdsPartition [0..1]: multiplicity set at pre-compile  # Describes the DDS [cite{DDS}] PARTITION QoS policy.
                string DdsPartitionName [1..65534]: scope=ECU, multiplicity set at pre-compile, set at pre-compile  # See "PARTITION" chapter of DDS [cite{DDS}].
              container DdsPresentation [0..1]: multiplicity set at pre-compile  # Describes the DDS [cite{DDS}] PRESENTATION QoS policy.
                enumeration DdsPresentationAccessScope: {GROUP, INSTANCE, TOPIC}, scope=ECU, set at pre-compile  # See "PRESENTATION" chapter of DDS [cite{DDS}].
                boolean DdsPresentationCoherentAccess: set at pre-compile  # See "PRESENTATION" chapter of DDS [cite{DDS}].
                boolean DdsPresentationOrderedAccess: set at pre-compile  # See "PRESENTATION" chapter of DDS [cite{DDS}].
          container DdsRemoteDomainParticipantCollection [0..65535]: multiplicity set at pre-compile  # Collection of Remote Domain Participants.
            container DdsRemoteDomainParticipant [0..65535]: multiplicity set at pre-compile  # Static configuration of remote endpoints. This container contains information about reachability and QoS parameters of remote endpoints.
              integer DdsRtpsRemoteDomainParticipantId: 0..65535, scope=ECU, set at pre-compile  # The DomainParticipant ID of the remote DDS node. | Note: please refer to chapter "User Traffic" of Data Distribution Service (DDS), Version 1.4 for details on its usage.
              container DdsRemoteDataReader [0..65535]: multiplicity set at pre-compile  # The configuration of a specific remote DataReader.
                choice reference DdsRemoteDataReaderPdu: scope=ECU, set at pre-compile, destination=[DdsRtpsDataTxPdu, DdsRtpsMulticastDataTxPdu]  # The Pdu used to transmit data to the given remote DataReader. It could refer both a unicast and a multicast Pdu
                container DdsDataReaderQoS [0..1]  # This container represents the configuration of QoS Profiles related to the current DdsDataReader.
                  container DdsDeadline [0..1]: multiplicity set at pre-compile  # Describes the DDS [cite{DDS}] DEADLINE QoS policy.
                    float DdsDeadlinePeriod: 0..65.534, scope=ECU, set at pre-compile  # See "DEADLINE" chapter of DDS [cite{DDS}]. | Time given in seconds.
                  container DdsDestinationOrder [0..1]: multiplicity set at pre-compile  # Describes the DDS [cite{DDS}] DESTINATION_ORDER QoS policy.
                    enumeration DdsDestinationOrderKind: {BY_RECEPTION_TIMESTAMP, BY_SOURCE_TIMESTAMP}, scope=ECU, set at pre-compile, default-value=BY_RECEPTION_TIMESTAMP  # See "DESTINATION_ORDER" chapter of DDS [cite{DDS}].
                  container DdsHistory [0..1]: multiplicity set at pre-compile  # Describes the DDS [cite{DDS}] HISTORY QoS policy.
                    enumeration DdsHistoryKind: {KEEP_ALL, KEEP_LAST}, scope=ECU, set at pre-compile, default-value=KEEP_LAST  # See "HISTORY" chapter of DDS [cite{DDS}].
                    integer DdsHistoryOrderDepth: 0..65534, scope=ECU, set at pre-compile, default-value=1  # See "HISTORY" chapter of DDS [cite{DDS}].
                  container DdsLatencyBudget [0..1]: multiplicity set at pre-compile  # Describes the DDS [cite{DDS}] LATENCY_BUDGET QoS policy.
                    float DdsLatencyBudgetDuration: 0..65.534, scope=ECU, set at pre-compile  # See "LATENCY_BUDGET" chapter of DDS [cite{DDS}]. | Time given in seconds.
                  container DdsLiveliness [0..1]: multiplicity set at pre-compile  # Describes the DDS [cite{DDS}] LIVELINESS QoS policy.
                    float DdsLivelinessLeaseDuration: 0..65.534, scope=ECU, set at pre-compile  # See "LIVELINESS" chapter of DDS [cite{DDS}]. | Time given in seconds.
                    enumeration DdsLivenessKind: {AUTOMATIC, MANUAL_BY_PARTICIPANT, MANUAL_BY_TOPIC}, scope=ECU, set at pre-compile, default-value=AUTOMATIC  # See "LIVELINESS" chapter of DDS [cite{DDS}].
                  container DdsOwnership [0..1]: multiplicity set at pre-compile  # Describes the DDS [cite{DDS}] OWNERSHIP QoS policy.
                    enumeration DdsOwnershipKind: {EXCLUSIVE, SHARED}, scope=ECU, set at pre-compile, default-value=SHARED  # See "OWNERSHIP" chapter of DDS [cite{DDS}].
                  container DdsReaderDataLifecycle [0..1]: multiplicity set at pre-compile  # Describes the DDS [cite{DDS}] READER_DATA_LIFECYCLE QoS policy.
                    integer DdsAutopurgeDisposedSamplesDelay: 0..65534, scope=ECU, set at pre-compile, default-value=65534  # See "READER_DATA_LIFECYCLE" chapter of DDS [cite{DDS}].
                    integer DdsAutopurgeNowriterSamplesDelay: 0..65534, scope=ECU, set at pre-compile, default-value=65534  # See "READER_DATA_LIFECYCLE" chapter of DDS [cite{DDS}].
                  container DdsReliability [0..1]: multiplicity set at pre-compile  # Describes the DDS [cite{DDS}] RELIABILITY QoS policy.
                    enumeration DdsReliabilityKind: {BEST_EFFORT, RELIABLE}, scope=ECU, set at pre-compile  # See "RELIABILITY" chapter of DDS [cite{DDS}].
                    float DdsReliabilityMaxBlockingTime: 0..65.534, scope=ECU, set at pre-compile, default-value=0.1  # See "RELIABILITY" chapter of DDS [cite{DDS}]. | Time given in seconds.
                  container DdsResourceLimits [0..1]: multiplicity set at pre-compile  # Describes the DDS [cite{DDS}] RESOURCE_LIMITS QoS policy.
                    integer DdsResouceLimitsMaxInstances: 0..65534, scope=ECU, set at pre-compile, default-value=65534  # See "RESOURCE_LIMITS" chapter of DDS [cite{DDS}].
                    integer DdsResouceLimitsMaxSamples: 0..65534, scope=ECU, set at pre-compile, default-value=65534  # See "RESOURCE_LIMITS" chapter of DDS [cite{DDS}].
                    integer DdsResouceLimitsMaxSamplesPerInstance: 0..65534, scope=ECU, set at pre-compile, default-value=65534  # See "RESOURCE_LIMITS" chapter of DDS [cite{DDS}].
                  container DdsTimeBasedFilter [0..1]: multiplicity set at pre-compile  # Describes the DDS [cite{DDS}] TIME_BASED_FILTER QoS policy.
                    float DdsTimeBasedFilterMinimumSeparation: 0..65.534, scope=ECU, set at pre-compile  # See "TIME_BASED_FILTER" chapter of DDS [cite{DDS}]. | Time given in seconds.
                  container DdsUserData [0..1]: multiplicity set at pre-compile  # Describes the DDS [cite{DDS}] USER_DATA QoS policy.
                    string DdsUserDataValue: scope=ECU, set at pre-compile  # See "USER_DATA" chapter of DDS [cite{DDS}].
              container DdsRemoteDataWriter [0..65535]: multiplicity set at pre-compile  # The configuration of a specific remote DataWriter.
                choice reference DdsRemoteDataWriterPdu: scope=ECU, set at pre-compile, destination=[DdsRtpsDataRxPdu, DdsRtpsMulticastDataRxPdu]  # The Pdu used to receive data from the given remote DataWriter. It could refer both a unicast and a multicast Pdu
                container DdsDataWriterQoS [0..1]  # This container represents the configuration of QoS Profiles related to the current DdsDataWriter.
                  container DdsDeadline [0..1]: multiplicity set at pre-compile  # Describes the DDS [cite{DDS}] DEADLINE QoS policy.
                    float DdsDeadlinePeriod: 0..65.534, scope=ECU, set at pre-compile  # See "DEADLINE" chapter of DDS [cite{DDS}]. | Time given in seconds.
                  container DdsDestinationOrder [0..1]: multiplicity set at pre-compile  # Describes the DDS [cite{DDS}] DESTINATION_ORDER QoS policy.
                    enumeration DdsDestinationOrderKind: {BY_RECEPTION_TIMESTAMP, BY_SOURCE_TIMESTAMP}, scope=ECU, set at pre-compile, default-value=BY_RECEPTION_TIMESTAMP  # See "DESTINATION_ORDER" chapter of DDS [cite{DDS}].
                  container DdsDurability [0..1]: multiplicity set at pre-compile  # Describes the DDS [cite{DDS}] DURABILITY QoS policy.
                    enumeration DdsDurabilityKind: {PERSISTENT, TRANSIENT, TRANSIENT_LOCAL, VOLATILE}, scope=ECU, set at pre-compile, default-value=VOLATILE  # See "DURABILITY" chapter of DDS [cite{DDS}].
                  container DdsDurabilityService [0..1]: multiplicity set at pre-compile  # Describes the DDS [cite{DDS}] DURABILITY_SERVICE QoS policy.
                    float DdsDurabilityServiceCleanupDelay: 0..65.534, scope=ECU, set at pre-compile  # See "DURABILITY_SERVICE" chapter of DDS [cite{DDS}]. | Time given in seconds.
                    integer DdsDurabilityServiceHistoryDepth: 0..65534, scope=ECU, set at pre-compile, default-value=1  # See "DURABILITY_SERVICE" chapter of DDS [cite{DDS}].
                    enumeration DdsDurabilityServiceHistoryKind: {KEEP_ALL, KEEP_LAST}, scope=ECU, set at pre-compile, default-value=KEEP_LAST  # See "DURABILITY_SERVICE" chapter of DDS [cite{DDS}].
                    integer DdsDurabilityServiceMaxInstances: 0..65534, scope=ECU, set at pre-compile  # See "DURABILITY_SERVICE" chapter of DDS [cite{DDS}].
                    integer DdsDurabilityServiceMaxSamples: 0..65534, scope=ECU, set at pre-compile  # See "DURABILITY_SERVICE" chapter of DDS [cite{DDS}].
                    integer DdsDurabilityServiceMaxSamplesPerInstance: 0..65534, scope=ECU, set at pre-compile  # See "DURABILITY_SERVICE" chapter of DDS [cite{DDS}].
                  container DdsHistory [0..1]: multiplicity set at pre-compile  # Describes the DDS [cite{DDS}] HISTORY QoS policy.
                    enumeration DdsHistoryKind: {KEEP_ALL, KEEP_LAST}, scope=ECU, set at pre-compile, default-value=KEEP_LAST  # See "HISTORY" chapter of DDS [cite{DDS}].
                    integer DdsHistoryOrderDepth: 0..65534, scope=ECU, set at pre-compile, default-value=1  # See "HISTORY" chapter of DDS [cite{DDS}].
                  container DdsLatencyBudget [0..1]: multiplicity set at pre-compile  # Describes the DDS [cite{DDS}] LATENCY_BUDGET QoS policy.
                    float DdsLatencyBudgetDuration: 0..65.534, scope=ECU, set at pre-compile  # See "LATENCY_BUDGET" chapter of DDS [cite{DDS}]. | Time given in seconds.
                  container DdsLifespan [0..1]: multiplicity set at pre-compile  # Describes the DDS [cite{DDS}] LIFESPAN QoS policy.
                    float DdsLifespanDuration: 0..65.534, scope=ECU, set at pre-compile  # See "LIFESPAN" chapter of DDS [cite{DDS}]. | Time given in seconds.
                  container DdsLiveliness [0..1]: multiplicity set at pre-compile  # Describes the DDS [cite{DDS}] LIVELINESS QoS policy.
                    float DdsLivelinessLeaseDuration: 0..65.534, scope=ECU, set at pre-compile  # See "LIVELINESS" chapter of DDS [cite{DDS}]. | Time given in seconds.
                    enumeration DdsLivenessKind: {AUTOMATIC, MANUAL_BY_PARTICIPANT, MANUAL_BY_TOPIC}, scope=ECU, set at pre-compile, default-value=AUTOMATIC  # See "LIVELINESS" chapter of DDS [cite{DDS}].
                  container DdsOwnership [0..1]: multiplicity set at pre-compile  # Describes the DDS [cite{DDS}] OWNERSHIP QoS policy.
                    enumeration DdsOwnershipKind: {EXCLUSIVE, SHARED}, scope=ECU, set at pre-compile, default-value=SHARED  # See "OWNERSHIP" chapter of DDS [cite{DDS}].
                  container DdsOwnershipStrength [0..1]: multiplicity set at pre-compile  # Describes the DDS [cite{DDS}] OWNERSHIP_STRENGTH QoS policy.
                    integer DdsOwnershipStrengthValue: 0..65534, scope=ECU, set at pre-compile, default-value=0  # See "OWNERSHIP_STRENGTH" chapter of DDS [cite{DDS}].
                  container DdsReliability [0..1]: multiplicity set at pre-compile  # Describes the DDS [cite{DDS}] RELIABILITY QoS policy.
                    enumeration DdsReliabilityKind: {BEST_EFFORT, RELIABLE}, scope=ECU, set at pre-compile  # See "RELIABILITY" chapter of DDS [cite{DDS}].
                    float DdsReliabilityMaxBlockingTime: 0..65.534, scope=ECU, set at pre-compile, default-value=0.1  # See "RELIABILITY" chapter of DDS [cite{DDS}]. | Time given in seconds.
                  container DdsResourceLimits [0..1]: multiplicity set at pre-compile  # Describes the DDS [cite{DDS}] RESOURCE_LIMITS QoS policy.
                    integer DdsResouceLimitsMaxInstances: 0..65534, scope=ECU, set at pre-compile, default-value=65534  # See "RESOURCE_LIMITS" chapter of DDS [cite{DDS}].
                    integer DdsResouceLimitsMaxSamples: 0..65534, scope=ECU, set at pre-compile, default-value=65534  # See "RESOURCE_LIMITS" chapter of DDS [cite{DDS}].
                    integer DdsResouceLimitsMaxSamplesPerInstance: 0..65534, scope=ECU, set at pre-compile, default-value=65534  # See "RESOURCE_LIMITS" chapter of DDS [cite{DDS}].
                  container DdsTransportPriority [0..1]: multiplicity set at pre-compile  # Describes the DDS [cite{DDS}] TRANSPORT_PRIORITY QoS policy.
                    integer DdsTransportPriorityValue: 0..65534, scope=ECU, set at pre-compile, default-value=0  # See "TRANSPORT_PRIORITY" chapter of DDS [cite{DDS}].
                  container DdsUserData [0..1]: multiplicity set at pre-compile  # Describes the DDS [cite{DDS}] USER_DATA QoS policy.
                    string DdsUserDataValue: scope=ECU, set at pre-compile  # See "USER_DATA" chapter of DDS [cite{DDS}].
                  container DdsWriterDataLifecycle [0..1]: multiplicity set at pre-compile  # Describes the DDS [cite{DDS}] WRITER_DATA_LIFECYCLE QoS policy.
                    boolean DdsAutodisposeUnregisteredInstances: set at pre-compile, default-value=true  # See "WRITER_DATA_LIFECYCLE" chapter of DDS [cite{DDS}].
          container DdsSubscriber [0..65535]: multiplicity set at pre-compile  # This container represents the configuration of a Subscriber.
            container DdsDataReader [1..65535]: multiplicity set at pre-compile  # This container represents the configuration of one data reader. One subscriber can refer to one or more readers, but a reader can belong to one single subscriber.
              reference DdsDataReaderAppDataRxPduRef [1..65535]: scope=ECU, multiplicity set at pre-compile, set at pre-compile, destination=DdsAppDataRxPdu  # This reference refers to the DdsAppDataRxPdu which is used by Dds module to forward de-serialized DDS data to the upper layer of the DDS module.
              reference DdsDataReaderRemoteDataWriters [0..65535]: scope=ECU, multiplicity set at pre-compile, set at pre-compile, destination=DdsRemoteDataWriter  # Reference to the remote DdsDataWriters from which the current DdsDataReaders would like to receive data. | Data from a remote writer is received by using the DdsRemoteDataWriterPdu referred by the given DdsRemoteDataWriter.
              reference DdsDataReaderTopicRef: scope=ECU, set at pre-compile, destination=DdsTopic  # This reference selects the Topic on which the current Dds Reader wants to receive.
              container DdsDataReaderQoS [0..1]  # This container represents the configuration of QoS Profiles related to the current DdsDataReader.
                container DdsDeadline [0..1]: multiplicity set at pre-compile  # Describes the DDS [cite{DDS}] DEADLINE QoS policy.
                  float DdsDeadlinePeriod: 0..65.534, scope=ECU, set at pre-compile  # See "DEADLINE" chapter of DDS [cite{DDS}]. | Time given in seconds.
                container DdsDestinationOrder [0..1]: multiplicity set at pre-compile  # Describes the DDS [cite{DDS}] DESTINATION_ORDER QoS policy.
                  enumeration DdsDestinationOrderKind: {BY_RECEPTION_TIMESTAMP, BY_SOURCE_TIMESTAMP}, scope=ECU, set at pre-compile, default-value=BY_RECEPTION_TIMESTAMP  # See "DESTINATION_ORDER" chapter of DDS [cite{DDS}].
                container DdsHistory [0..1]: multiplicity set at pre-compile  # Describes the DDS [cite{DDS}] HISTORY QoS policy.
                  enumeration DdsHistoryKind: {KEEP_ALL, KEEP_LAST}, scope=ECU, set at pre-compile, default-value=KEEP_LAST  # See "HISTORY" chapter of DDS [cite{DDS}].
                  integer DdsHistoryOrderDepth: 0..65534, scope=ECU, set at pre-compile, default-value=1  # See "HISTORY" chapter of DDS [cite{DDS}].
                container DdsLatencyBudget [0..1]: multiplicity set at pre-compile  # Describes the DDS [cite{DDS}] LATENCY_BUDGET QoS policy.
                  float DdsLatencyBudgetDuration: 0..65.534, scope=ECU, set at pre-compile  # See "LATENCY_BUDGET" chapter of DDS [cite{DDS}]. | Time given in seconds.
                container DdsLiveliness [0..1]: multiplicity set at pre-compile  # Describes the DDS [cite{DDS}] LIVELINESS QoS policy.
                  float DdsLivelinessLeaseDuration: 0..65.534, scope=ECU, set at pre-compile  # See "LIVELINESS" chapter of DDS [cite{DDS}]. | Time given in seconds.
                  enumeration DdsLivenessKind: {AUTOMATIC, MANUAL_BY_PARTICIPANT, MANUAL_BY_TOPIC}, scope=ECU, set at pre-compile, default-value=AUTOMATIC  # See "LIVELINESS" chapter of DDS [cite{DDS}].
                container DdsOwnership [0..1]: multiplicity set at pre-compile  # Describes the DDS [cite{DDS}] OWNERSHIP QoS policy.
                  enumeration DdsOwnershipKind: {EXCLUSIVE, SHARED}, scope=ECU, set at pre-compile, default-value=SHARED  # See "OWNERSHIP" chapter of DDS [cite{DDS}].
                container DdsReaderDataLifecycle [0..1]: multiplicity set at pre-compile  # Describes the DDS [cite{DDS}] READER_DATA_LIFECYCLE QoS policy.
                  integer DdsAutopurgeDisposedSamplesDelay: 0..65534, scope=ECU, set at pre-compile, default-value=65534  # See "READER_DATA_LIFECYCLE" chapter of DDS [cite{DDS}].
                  integer DdsAutopurgeNowriterSamplesDelay: 0..65534, scope=ECU, set at pre-compile, default-value=65534  # See "READER_DATA_LIFECYCLE" chapter of DDS [cite{DDS}].
                container DdsReliability [0..1]: multiplicity set at pre-compile  # Describes the DDS [cite{DDS}] RELIABILITY QoS policy.
                  enumeration DdsReliabilityKind: {BEST_EFFORT, RELIABLE}, scope=ECU, set at pre-compile  # See "RELIABILITY" chapter of DDS [cite{DDS}].
                  float DdsReliabilityMaxBlockingTime: 0..65.534, scope=ECU, set at pre-compile, default-value=0.1  # See "RELIABILITY" chapter of DDS [cite{DDS}]. | Time given in seconds.
                container DdsResourceLimits [0..1]: multiplicity set at pre-compile  # Describes the DDS [cite{DDS}] RESOURCE_LIMITS QoS policy.
                  integer DdsResouceLimitsMaxInstances: 0..65534, scope=ECU, set at pre-compile, default-value=65534  # See "RESOURCE_LIMITS" chapter of DDS [cite{DDS}].
                  integer DdsResouceLimitsMaxSamples: 0..65534, scope=ECU, set at pre-compile, default-value=65534  # See "RESOURCE_LIMITS" chapter of DDS [cite{DDS}].
                  integer DdsResouceLimitsMaxSamplesPerInstance: 0..65534, scope=ECU, set at pre-compile, default-value=65534  # See "RESOURCE_LIMITS" chapter of DDS [cite{DDS}].
                container DdsTimeBasedFilter [0..1]: multiplicity set at pre-compile  # Describes the DDS [cite{DDS}] TIME_BASED_FILTER QoS policy.
                  float DdsTimeBasedFilterMinimumSeparation: 0..65.534, scope=ECU, set at pre-compile  # See "TIME_BASED_FILTER" chapter of DDS [cite{DDS}]. | Time given in seconds.
                container DdsUserData [0..1]: multiplicity set at pre-compile  # Describes the DDS [cite{DDS}] USER_DATA QoS policy.
                  string DdsUserDataValue: scope=ECU, set at pre-compile  # See "USER_DATA" chapter of DDS [cite{DDS}].
            container DdsSubscriberQoS [0..1]: multiplicity set at pre-compile  # This container represents the configuration of QoS Profiles related to the current Dds Subscriber.
              container DdsEntityFactory [0..1]: multiplicity set at pre-compile  # Describes the DDS [cite{DDS}] ENTITY_FACTORY QoS policy.
                boolean DdsEntityFactoryAutoenableCreatedEntities: set at pre-compile, default-value=true  # See "ENTITY_FACTORY" chapter of DDS [cite{DDS}].
              container DdsGroupData [0..1]: multiplicity set at pre-compile  # Describes the DDS [cite{DDS}] GROUP_DATA QoS policy.
                string DdsGroupDataValue: scope=ECU, set at pre-compile  # See "GROUP_DATA" chapter of DDS [cite{DDS}].
              container DdsPartition [0..1]: multiplicity set at pre-compile  # Describes the DDS [cite{DDS}] PARTITION QoS policy.
                string DdsPartitionName [1..65534]: scope=ECU, multiplicity set at pre-compile, set at pre-compile  # See "PARTITION" chapter of DDS [cite{DDS}].
              container DdsPresentation [0..1]: multiplicity set at pre-compile  # Describes the DDS [cite{DDS}] PRESENTATION QoS policy.
                enumeration DdsPresentationAccessScope: {GROUP, INSTANCE, TOPIC}, scope=ECU, set at pre-compile  # See "PRESENTATION" chapter of DDS [cite{DDS}].
                boolean DdsPresentationCoherentAccess: set at pre-compile  # See "PRESENTATION" chapter of DDS [cite{DDS}].
                boolean DdsPresentationOrderedAccess: set at pre-compile  # See "PRESENTATION" chapter of DDS [cite{DDS}].
          container DdsTopic [0..65535]: multiplicity set at pre-compile  # This container represents the configuration of one Topic.
            string DdsTopicName: scope=ECU, multiplicity set at pre-compile, set at pre-compile  # Identifies name of the Topic. Communication between publishers and subscribers is based on the topic name.
            foreign reference DdsTopicImplementationType [0..1]: scope=ECU, multiplicity set at pre-compile, set at pre-compile, destination-type=IMPLEMENTATION-DATA-TYPE  # This reference selects the ImplementationDataType the topic is related. A Topic is used to publish a well-defined data type, described by the referenced ImplementationDataType. | Note: if the Topic is related to a SenderReceiver communication, the reference to the ImplementationDataType shall exist
            container DdsTopicQoS [0..1]  # This container contains the configuration of the QoS supported by the DdsTopic
              container DdsDeadline [0..1]: multiplicity set at pre-compile  # Describes the DDS [cite{DDS}] DEADLINE QoS policy.
                float DdsDeadlinePeriod: 0..65.534, scope=ECU, set at pre-compile  # See "DEADLINE" chapter of DDS [cite{DDS}]. | Time given in seconds.
              container DdsDestinationOrder [0..1]: multiplicity set at pre-compile  # Describes the DDS [cite{DDS}] DESTINATION_ORDER QoS policy.
                enumeration DdsDestinationOrderKind: {BY_RECEPTION_TIMESTAMP, BY_SOURCE_TIMESTAMP}, scope=ECU, set at pre-compile, default-value=BY_RECEPTION_TIMESTAMP  # See "DESTINATION_ORDER" chapter of DDS [cite{DDS}].
              container DdsDurability [0..1]: multiplicity set at pre-compile  # Describes the DDS [cite{DDS}] DURABILITY QoS policy.
                enumeration DdsDurabilityKind: {PERSISTENT, TRANSIENT, TRANSIENT_LOCAL, VOLATILE}, scope=ECU, set at pre-compile, default-value=VOLATILE  # See "DURABILITY" chapter of DDS [cite{DDS}].
              container DdsDurabilityService [0..1]: multiplicity set at pre-compile  # Describes the DDS [cite{DDS}] DURABILITY_SERVICE QoS policy.
                float DdsDurabilityServiceCleanupDelay: 0..65.534, scope=ECU, set at pre-compile  # See "DURABILITY_SERVICE" chapter of DDS [cite{DDS}]. | Time given in seconds.
                integer DdsDurabilityServiceHistoryDepth: 0..65534, scope=ECU, set at pre-compile, default-value=1  # See "DURABILITY_SERVICE" chapter of DDS [cite{DDS}].
                enumeration DdsDurabilityServiceHistoryKind: {KEEP_ALL, KEEP_LAST}, scope=ECU, set at pre-compile, default-value=KEEP_LAST  # See "DURABILITY_SERVICE" chapter of DDS [cite{DDS}].
                integer DdsDurabilityServiceMaxInstances: 0..65534, scope=ECU, set at pre-compile  # See "DURABILITY_SERVICE" chapter of DDS [cite{DDS}].
                integer DdsDurabilityServiceMaxSamples: 0..65534, scope=ECU, set at pre-compile  # See "DURABILITY_SERVICE" chapter of DDS [cite{DDS}].
                integer DdsDurabilityServiceMaxSamplesPerInstance: 0..65534, scope=ECU, set at pre-compile  # See "DURABILITY_SERVICE" chapter of DDS [cite{DDS}].
              container DdsHistory [0..1]: multiplicity set at pre-compile  # Describes the DDS [cite{DDS}] HISTORY QoS policy.
                enumeration DdsHistoryKind: {KEEP_ALL, KEEP_LAST}, scope=ECU, set at pre-compile, default-value=KEEP_LAST  # See "HISTORY" chapter of DDS [cite{DDS}].
                integer DdsHistoryOrderDepth: 0..65534, scope=ECU, set at pre-compile, default-value=1  # See "HISTORY" chapter of DDS [cite{DDS}].
              container DdsLatencyBudget [0..1]: multiplicity set at pre-compile  # Describes the DDS [cite{DDS}] LATENCY_BUDGET QoS policy.
                float DdsLatencyBudgetDuration: 0..65.534, scope=ECU, set at pre-compile  # See "LATENCY_BUDGET" chapter of DDS [cite{DDS}]. | Time given in seconds.
              container DdsLifespan [0..1]: multiplicity set at pre-compile  # Describes the DDS [cite{DDS}] LIFESPAN QoS policy.
                float DdsLifespanDuration: 0..65.534, scope=ECU, set at pre-compile  # See "LIFESPAN" chapter of DDS [cite{DDS}]. | Time given in seconds.
              container DdsLiveliness [0..1]: multiplicity set at pre-compile  # Describes the DDS [cite{DDS}] LIVELINESS QoS policy.
                float DdsLivelinessLeaseDuration: 0..65.534, scope=ECU, set at pre-compile  # See "LIVELINESS" chapter of DDS [cite{DDS}]. | Time given in seconds.
                enumeration DdsLivenessKind: {AUTOMATIC, MANUAL_BY_PARTICIPANT, MANUAL_BY_TOPIC}, scope=ECU, set at pre-compile, default-value=AUTOMATIC  # See "LIVELINESS" chapter of DDS [cite{DDS}].
              container DdsOwnership [0..1]: multiplicity set at pre-compile  # Describes the DDS [cite{DDS}] OWNERSHIP QoS policy.
                enumeration DdsOwnershipKind: {EXCLUSIVE, SHARED}, scope=ECU, set at pre-compile, default-value=SHARED  # See "OWNERSHIP" chapter of DDS [cite{DDS}].
              container DdsReliability [0..1]: multiplicity set at pre-compile  # Describes the DDS [cite{DDS}] RELIABILITY QoS policy.
                enumeration DdsReliabilityKind: {BEST_EFFORT, RELIABLE}, scope=ECU, set at pre-compile  # See "RELIABILITY" chapter of DDS [cite{DDS}].
                float DdsReliabilityMaxBlockingTime: 0..65.534, scope=ECU, set at pre-compile, default-value=0.1  # See "RELIABILITY" chapter of DDS [cite{DDS}]. | Time given in seconds.
              container DdsResourceLimits [0..1]: multiplicity set at pre-compile  # Describes the DDS [cite{DDS}] RESOURCE_LIMITS QoS policy.
                integer DdsResouceLimitsMaxInstances: 0..65534, scope=ECU, set at pre-compile, default-value=65534  # See "RESOURCE_LIMITS" chapter of DDS [cite{DDS}].
                integer DdsResouceLimitsMaxSamples: 0..65534, scope=ECU, set at pre-compile, default-value=65534  # See "RESOURCE_LIMITS" chapter of DDS [cite{DDS}].
                integer DdsResouceLimitsMaxSamplesPerInstance: 0..65534, scope=ECU, set at pre-compile, default-value=65534  # See "RESOURCE_LIMITS" chapter of DDS [cite{DDS}].
              container DdsTopicData [0..1]: multiplicity set at pre-compile  # Describes the DDS [cite{DDS}] TOPIC_DATA QoS policy.
                string DdsTopicDataValue: scope=ECU, set at pre-compile  # See "TOPIC_DATA" chapter of DDS [cite{DDS}].
              container DdsTransportPriority [0..1]: multiplicity set at pre-compile  # Describes the DDS [cite{DDS}] TRANSPORT_PRIORITY QoS policy.
                integer DdsTransportPriorityValue: 0..65534, scope=ECU, set at pre-compile, default-value=0  # See "TRANSPORT_PRIORITY" chapter of DDS [cite{DDS}].
      container DdsRxQueueCollection [0..1]: multiplicity set at pre-compile  # Collection of Rx queues.
        container DdsRxQueue [1..65535]: multiplicity set at pre-compile  # The queue used to save DdsRtpsDataRxPdus from PduR (as lower) to DDS. | One single queue can be used to save one or more DdsRtpsDataRxPdus.
          enumeration DdsQueueAlgorithm: {FIFO, LIFO, VENDOR_SPECIFIC}, scope=ECU, set at pre-compile  # Single queue scheduling algorithm
          float DdsRxQueuePeriod: 0..65.534, scope=ECU, set at pre-compile  # Scheduling period of the single queue. | Time given in seconds.
          integer DdsRxQueueSize: 0..65535, scope=ECU, set at pre-compile  # Queue size in bytes
          reference DdsRxQueueMulticastPduRef [0..65535]: scope=ECU, multiplicity set at pre-compile, set at pre-compile, destination=DdsRtpsMulticastDataRxPdu  # Reference to a reception multicast lower layer PDU to be stored in the given queue.
          reference DdsRxQueueUnicastPduRef [0..65535]: scope=ECU, multiplicity set at pre-compile, set at pre-compile, destination=DdsRtpsDataRxPdu  # Reference to a reception unicast lower layer Pdu to be stored in the given queue.
      container DdsTxQueueCollection [0..1]: multiplicity set at pre-compile  # Collection of Tx queues.
        container DdsTxQueue [1..65535]: multiplicity set at pre-compile  # The queue used to save DdsAppDataTxPdus from PduR (as upper) to DDS. | One single queue can be used to save one or more DdsAppDataTxPdus.
          enumeration DdsQueueAlgorithm: {FIFO, LIFO, VENDOR_SPECIFIC}, scope=ECU, set at pre-compile  # Single queue scheduling algorithm
          float DdsTxQueuePeriod: 0..65.534, scope=ECU, set at pre-compile  # Scheduling period of the single queue. | Time given in seconds.
          integer DdsTxQueueSize: 0..65535, scope=ECU, set at pre-compile  # Queue size in bytes
          reference DdsTxQueuePduRef [1..65535]: scope=ECU, multiplicity set at pre-compile, set at pre-compile, destination=DdsAppDataTxPdu  # Reference to a transmission upper layer PDU to be stored in the given queue.
    container DdsGeneral  # This container lists the general configuration parameters for the Dds module.
      boolean DdsDevErrorDetect: set at pre-compile, default-value=false  # Switches the development error detection and notification on or off. | * true: detection and notification is enabled. * false: detection and notification is disabled.
      float DdsMainRxFunctionPeriod: 0..INF, set at pre-compile  # This parameter defines the cycle time in seconds of the periodic call of the Dds_MainFunction_Rx.
      float DdsMainTxFunctionPeriod: 0..INF, set at pre-compile  # This parameter defines the cycle time in seconds of the periodic call of the Dds_MainFunction_Tx.
      reference DdsSynchronizedTimeBaseRef [0..1]: scope=ECU, multiplicity set at pre-compile, set at pre-compile, requires-symbolic-name-value=true, destination=StbMSynchronizedTimeBase  # Reference to a StbM Synchronized Time Base.
