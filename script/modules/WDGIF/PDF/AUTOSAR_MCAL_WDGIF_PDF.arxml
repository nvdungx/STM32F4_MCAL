AUTOSAR XML (schema 00053)
package /AUTOSAR/EcucDefs
  ecuc definition collection AUTOSARParameterDefinition: module=WdgIf
  module definition WdgIf [0..1]: variants pre-compile  # Configuration of the WdgIf (Watchdog Interface) module.
    container WdgIfDevice [1..*]  # It contains the information for the selection of a particular Watchdog device in case multiple Watchdog drivers are connected.
      integer WdgIfDeviceIndex: 0..255, scope=ECU, set at pre-compile, symbolic-name-value=true  # Represents the watchdog interface ID so that it can be referenced by the watchdog manager.
      reference WdgIfDriverRef: set at pre-compile, requires-symbolic-name-value=true, destination=WdgGeneral  # Reference to the watchdog drivers that are controlled by the watchdog interface.
    container WdgIfGeneral  # This container collects all generic watchdog interface parameters.
      boolean WdgIfDevErrorDetect: set at pre-compile, default-value=false  # Switches the development error detection and notification on or off. | * true: detection and notification is enabled. * false: detection and notification is disabled.
      boolean WdgIfVersionInfoApi: set at pre-compile, default-value=false  # Pre-processor switch to enable / disable the service returning the version information. | true: Version information service enabled false: Version information service disabled
