AUTOSAR XML (schema 00053)
package /AUTOSAR/EcucDefs
  ecuc definition collection AUTOSARParameterDefinition: module=FrTp
  module definition FrTp [0..1]: post-build-variant-support=true, variants post-build/pre-compile  # Configuration of the FlexRay Transport Protocol module according to ISO 10681-2.
    container FrTpDemEventParameterRefs [0..1]: multiplicity set at pre-compile  # Container for the references to DemEventParameter elements which shall be invoked using the API Dem_SetEventStatus in case the corresponding error occurs. The Event Id is taken from the referenced DemEventParameter's DemEventId symbolic value. | The standardized errors are provided in this container and can be extended by vendor-specific error references.
      reference FRTP_E_DROPPED_CONSECUTIVE_FRAMES_DETECTED [0..1]: scope=ECU, multiplicity set at pre-compile, set at pre-compile, requires-symbolic-name-value=true, destination=DemEventParameter  # A Reference to DemEventParameter element which shall be invoked using the API Dem_SetEventStatus in case FRTP_E_DROPPED_CONSECUTIVE_FRAMES_DETECTED error occurs. The EventId is taken from the referenced DemEventParameter's DemEventId symbolic value.
      reference FRTP_E_FC_ABORT_RECEIVED [0..1]: scope=ECU, multiplicity set at pre-compile, set at pre-compile, requires-symbolic-name-value=true, destination=DemEventParameter  # A Reference to DemEventParameter element which shall be invoked using the API Dem_SetEventStatus in case FRTP_E_FC_ABORT_RECEIVED error occurs. The EventId is taken from the referenced DemEventParameter's DemEventId symbolic value.
      reference FRTP_E_FC_ABORT_TRANSMITTED [0..1]: scope=ECU, multiplicity set at pre-compile, set at pre-compile, requires-symbolic-name-value=true, destination=DemEventParameter  # A Reference to DemEventParameter element which shall be invoked using the API Dem_SetEventStatus in case FRTP_E_FC_ABORT_TRANSMITTED error occurs. The EventId is taken from the referenced DemEventParameter's DemEventId symbolic value.
      reference FRTP_E_FC_OVERFLOW_RECEIVED [0..1]: scope=ECU, multiplicity set at pre-compile, set at pre-compile, requires-symbolic-name-value=true, destination=DemEventParameter  # A Reference to DemEventParameter element which shall be invoked using the API Dem_SetEventStatus in case FRTP_E_FC_OVERFLOW_RECEIVED error occurs. The EventId is taken from the referenced DemEventParameter's DemEventId symbolic value.
      reference FRTP_E_FC_OVERFLOW_TRANSMITTED [0..1]: scope=ECU, multiplicity set at pre-compile, set at pre-compile, requires-symbolic-name-value=true, destination=DemEventParameter  # A Reference to DemEventParameter element which shall be invoked using the API Dem_SetEventStatus in case FRTP_E_FC_OVERFLOW_TRANSMITTED error occurs. The EventId is taken from the referenced DemEventParameter's DemEventId symbolic value.
      reference FRTP_E_FRTPNAR_TIMEOUT_OCCURRED [0..1]: scope=ECU, multiplicity set at pre-compile, set at pre-compile, requires-symbolic-name-value=true, destination=DemEventParameter  # A Reference to DemEventParameter element which shall be invoked using the API Dem_SetEventStatus in case FRTP_E_FRTPNAR_TIMEOUT_OCCURRED error occurs. The EventId is taken from the referenced DemEventParameter's DemEventId symbolic value.
      reference FRTP_E_FRTPNAS_TIMEOUT_OCCURRED [0..1]: scope=ECU, multiplicity set at pre-compile, set at pre-compile, requires-symbolic-name-value=true, destination=DemEventParameter  # A Reference to DemEventParameter element which shall be invoked using the API Dem_SetEventStatus in case FRTP_E_FRTPNAS_TIMEOUT_OCCURRED error occurs. The EventId is taken from the referenced DemEventParameter's DemEventId symbolic value.
      reference FRTP_E_FRTPNBR_TIMEOUT_OCCURRED [0..1]: scope=ECU, multiplicity set at pre-compile, set at pre-compile, requires-symbolic-name-value=true, destination=DemEventParameter  # A Reference to DemEventParameter element which shall be invoked using the API Dem_SetEventStatus in case FRTP_E_FRTPNBR_TIMEOUT_OCCURRED error occurs. The EventId is taken from the referenced DemEventParameter's DemEventId symbolic value.
      reference FRTP_E_FRTPNBS_TIMEOUT_OCCURRED [0..1]: scope=ECU, multiplicity set at pre-compile, set at pre-compile, requires-symbolic-name-value=true, destination=DemEventParameter  # A Reference to DemEventParameter element which shall be invoked using the API Dem_SetEventStatus in case FRTP_E_FRTPNBS_TIMEOUT_OCCURRED error occurs. The EventId is taken from the referenced DemEventParameter's DemEventId symbolic value.
      reference FRTP_E_FRTPNCR_TIMEOUT_OCCURRED [0..1]: scope=ECU, multiplicity set at pre-compile, set at pre-compile, requires-symbolic-name-value=true, destination=DemEventParameter  # A Reference to DemEventParameter element which shall be invoked using the API Dem_SetEventStatus in case FRTP_E_FRTPNCR_TIMEOUT_OCCURRED error occurs. The EventId is taken from the referenced DemEventParameter's DemEventId symbolic value.
      reference FRTP_E_FRTPNCS_TIMEOUT_OCCURRED [0..1]: scope=ECU, multiplicity set at pre-compile, set at pre-compile, requires-symbolic-name-value=true, destination=DemEventParameter  # A Reference to DemEventParameter element which shall be invoked using the API Dem_SetEventStatus in case FRTP_E_FRTPNCS_TIMEOUT_OCCURRED error occurs. The EventId is taken from the referenced DemEventParameter's DemEventId symbolic value.
      reference FRTP_E_SWAPPED_CONSECUTIVE_FRAMES_RECEIVED [0..1]: scope=ECU, multiplicity set at pre-compile, set at pre-compile, requires-symbolic-name-value=true, destination=DemEventParameter  # A Reference to DemEventParameter element which shall be invoked using the API Dem_SetEventStatus in case FRTP_E_SWAPPED_CONSECUTIVE_FRAMES_RECEIVED error occurs. The EventId is taken from the referenced DemEventParameter's DemEventId symbolic value.
    container FrTpGeneral  # This container contains the general configuration parameters of the FlexRay Transport Protocol module.
      boolean FrTpAckRt: set at pre-compile  # Preprocessor switch for enabling the Acknowledgement and retry mechanisms. | True: Acknowledge and Retry is enabled False: Acknowledge and Retry is disabled
      boolean FrTpChangeParamApi: set at pre-compile  # Preprocessor switch for enabling the API to change FrTp communication | parameters. True: ChangeParameter API is enabled False: ChangeParameter API is disabled.
      integer FrTpChanNum: 1..32, set at pre-compile  # Preprocessor switch for defining the number of concurrent channels the module supports. Up to 32 channels shall be definable here.
      boolean FrTpDevErrorDetect: set at pre-compile, default-value=false  # Switches the development error detection and notification on or off. | * true: detection and notification is enabled. * false: detection and notification is disabled.
      boolean FrTpFullDuplexEnable: set at pre-compile, default-value=false  # Preprocessor switch for enabling full duplex mechanisms for all channels. | True: Full duplex is enabled False: Fullduplex is disabled (Half duplex is enabled)
      float FrTpMainFuncCycle: 0..INF, set at pre-compile  # This parameter contains the calling period of the TPs Main Function. The parameter is specified in seconds.
      boolean FrTpTransmitCancellation: set at pre-compile, default-value=false  # Preprocessor switch for enabling Transmit Cancellation and Receive Cancellation. | True: Transmit/Receive Cancellation is enabled False: Transmit/Receive Cancellation is disabled
      boolean FrTpUnknownMsgLength: set at pre-compile  # Preprocessor switch to support data transfer with unknown message length. | True: Transmission with unknown message length is enabled False: Transmission with unknown message length is disabled
      boolean FrTpVersionInfoApi: set at pre-compile, default-value=false  # Preprocessor switch for enabling the Version info API. | True: Version Info API is enabled False: Version Info API is disabled
    container FrTpMultipleConfig  # This container contains the configuration parameters and sub containers of the AUTOSAR FrTp module.
      integer FrTpMaxConnectionCnt [0..1]: 0..18446744073709551615, multiplicity set at pre-compile, set at pre-compile  # Maximum number of TP connections. This parameter is needed only in case of post-build loadable implementation using static memory allocation.
      container FrTpConnection [1..*]: multiplicity set at post-build in variant post-build / pre-compile in variant pre-compile, post-build-variant-multiplicity=true  # This container contains the connection specific parameters to transfer N-PDUs via FlexRay TP.
        boolean FrTpBandwidthLimitation: post-build-variant-value=true, set at post-build in variant post-build / pre-compile in variant pre-compile  # This parameter indicates whether the connection requires a bandwidth limitation or not. If FrTpBandwidthLimitation=True the sender shall send a StartFrame always on the first PDU of a PDU-Pool.
        integer FrTpLa [0..1]: 0..65535, post-build-variant-value=true, set at post-build in variant post-build / pre-compile in variant pre-compile  # This parameter defines the Local Address for the respective connection. When the local instance is the sender, this is the Source Address within the TP frame. When the local instance is the receiver, this is the Target Address within the TP frame. If this parameter is not configured, all related Rx N-SDUs must be configured to use the meta data item TARGET_ADDRESS_16, and all related Tx-N-SDUs must be configured to use the meta data item SOURCE_ADDRESS_16.
        boolean FrTpMultipleReceiverCon: post-build-variant-value=true, set at post-build in variant post-build / pre-compile in variant pre-compile  # This parameter defines, whether this connection is an 1:1 ('false') or an 1:n ('true') connection. If data segmentation is required this parameter is used to check whether segmentation is possible or not. If the connection is 1:n segmentation is not possible and an error will occur.
        integer FrTpRa [0..1]: 0..65535, post-build-variant-value=true, set at post-build in variant post-build / pre-compile in variant pre-compile  # This parameter defines the Remote Address for the respective connection. When the local instance is the sender, this is the Target Address within the TP frame. When the local instance is the receiver, this is the Source Address within the TP frame. If this parameter is not configured, all related Rx N-SDUs must be configured to use the meta data item SOURCE_ADDRESS_16, and all related Tx-N-SDUs must be configured to use the meta data item TARGET_ADDRESS_16.
        reference FrTpConCtrlRef: post-build-variant-value=true, set at post-build in variant post-build / pre-compile in variant pre-compile, destination=FrTpConnectionControl  # FrTpConnectionControlReference: | This parameter defines a reference to a connection control container.
        reference FrTpRxPduPoolRef [0..1]: multiplicity set at post-build in variant post-build / pre-compile in variant pre-compile, post-build-variant-multiplicity=true, post-build-variant-value=true, set at post-build in variant post-build / pre-compile in variant pre-compile, destination=FrTpRxPduPool  # This parameter defines a reference to a RxPduPool.
        reference FrTpTxPduPoolRef [0..1]: multiplicity set at post-build in variant post-build / pre-compile in variant pre-compile, post-build-variant-multiplicity=true, post-build-variant-value=true, set at post-build in variant post-build / pre-compile in variant pre-compile, destination=FrTpTxPduPool  # This parameter defines a reference to a TxPduPool.
        container FrTpRxSdu [0..1]  # This parameter defines the Rx Service Data Unit Identifier (Sdu Id) which uniquely identifies a data transfer (inter-module communication) between FrTp and PDUR. This N-SDU can produce meta data items of type SOURCE_ADDRESS_16 and TARGET_ADDRESS_16.
          integer FrTpRxSduId: 0..65535, set at pre-compile, symbolic-name-value=true, with-auto=true  # This unique identifier is used for change parameter request or receive cancellation from PduR to FrTp. | ImplementationType: PduIdType
          reference FrTpRxSduRef: post-build-variant-value=true, set at post-build in variant post-build / pre-compile in variant pre-compile, destination=Pdu  # Reference to a PDU in the global PDU structure.
        container FrTpTxSdu [0..1]  # This parameter defines the Tx Service Data Unit Identifier (Sdu Id) which uniquely identifies a data transfer (inter-module communication) between FrTp and PDUR. This N-SDU can consume meta data items of type SOURCE_ADDRESS_16 and TARGET_ADDRESS_16.
          integer FrTpTxSduId: 0..65535, set at pre-compile, symbolic-name-value=true, with-auto=true  # This is a unique identifier for a to be transmitted message from the PduR to the FrTp. | ImplementationType: PduIdType
          reference FrTpTxSduRef: post-build-variant-value=true, set at post-build in variant post-build / pre-compile in variant pre-compile, destination=Pdu  # Reference to a PDU in the global PDU structure.
      container FrTpConnectionControl [1..*]: multiplicity set at post-build in variant post-build / pre-compile in variant pre-compile, post-build-variant-multiplicity=true  # This container contains the configuration parameters to control a FlexRay TP connection.
        enumeration FrTpAckType: {FRTP_ACK_WITH_RT, FRTP_NO}, post-build-variant-value=true, set at post-build in variant post-build / pre-compile in variant pre-compile  # This parameter defines the type of acknowledgement which is used for the specific channel.
        integer FrTpMaxFCWait: 0..255, post-build-variant-value=true, set at post-build in variant post-build / pre-compile in variant pre-compile  # This parameter defines the maximum number of FlowControl N-PDUs with FlowState "WAIT"
        integer FrTpMaxNbrOfNPduPerCycle: 0..31, post-build-variant-value=true, set at post-build in variant post-build / pre-compile in variant pre-compile  # This parameter is part of the ISO 10681-2 protocol's FlowControl parameter "Bandwidth Control (BC)". It limits the number of N-Pdus the sender is allowed to transmit within a FlexRay cycle.
        integer FrTpMaxRn: 0..255, post-build-variant-value=true, set at post-build in variant post-build / pre-compile in variant pre-compile  # This parameter defines the maximum number of retries (if retry is configured).
        integer FrTpSCexp: 0..7, post-build-variant-value=true, set at post-build in variant post-build / pre-compile in variant pre-compile  # This parameter is part of the ISO 10681-2 protocol's FlowControl parameter "Bandwidth Control (BC)". It represents the exponent to calculate the minimum number of "Separation Cycles" the sender has to wait for the next transmission of an FrTp N-Pdu.
        float FrTpTimeBr: 0..0.255, post-build-variant-value=true, set at post-build in variant post-build / pre-compile in variant pre-compile  # This parameter defines the time in seconds the FrTp requires to transmit a corresponding FlowControl Frame. According to ISO 10681-2 this parameter is a performance requirement.
        float FrTpTimeCs: 0..65.535, post-build-variant-value=true, set at post-build in variant post-build / pre-compile in variant pre-compile  # This parameter defines the time in seconds between the sending of two CFs or between the sending of a CF and LF or between the reception of a FC and sending of the next CF.
        float FrTpTimeoutAr: 0..65.535, post-build-variant-value=true, set at post-build in variant post-build / pre-compile in variant pre-compile  # This parameter states the timeout in seconds between the PDU transmit request of the Transport Layer to the FlexRay Interface and the corresponding confirmation of the FlexRay Interface on the receiver side (for FC or AF).
        float FrTpTimeoutAs: 0..65.535, post-build-variant-value=true, set at post-build in variant post-build / pre-compile in variant pre-compile  # This parameter specifies the timeout in seconds the FrIf shall confirm a transmitted Pdu to the FrTp via the LSduR.
        float FrTpTimeoutBs: 0..65.535, post-build-variant-value=true, set at post-build in variant post-build / pre-compile in variant pre-compile  # This parameter defines the timeout in seconds for waiting for an FC or AF on the sender side in a 1:1 connection.
        float FrTpTimeoutCr: 0..65.535, post-build-variant-value=true, set at post-build in variant post-build / pre-compile in variant pre-compile  # This parameter defines the timeout value in seconds a receiver is waiting for a CF or a LF.
      container FrTpRxPduPool [0..*]: multiplicity set at post-build in variant post-build / pre-compile in variant pre-compile, post-build-variant-multiplicity=true  # This container contains all Pdus that are assigned to that Pdu Pool.
        container FrTpRxPdu [1..*]: multiplicity set at post-build in variant post-build / pre-compile in variant pre-compile, post-build-variant-multiplicity=true  # Container to hold the PDU parameters. | ImplementationType: PduInfoType
          integer FrTpRxPduId: 0..65535, set at pre-compile, symbolic-name-value=true, with-auto=true  # This is a unique identifier for a received message which is forwarded from the FrIf via the LSduR to the FrTp. | ImplementationType: PduIdType
          reference FrTpRxPduRef: post-build-variant-value=true, set at post-build in variant post-build / pre-compile in variant pre-compile, destination=Pdu  # Reference to a PDU in the global PDU structure.
      container FrTpTxPduPool [0..*]: multiplicity set at post-build in variant post-build / pre-compile in variant pre-compile, post-build-variant-multiplicity=true  # This container contains all Pdus that are assigned to that Pdu Pool.
        container FrTpTxPdu [1..*]: multiplicity set at post-build in variant post-build / pre-compile in variant pre-compile, post-build-variant-multiplicity=true  # Container to hold the PDU parameters. | ImplementationType: PduInfoType
          integer FrTpTxConfirmationPduId: 0..65535, set at pre-compile, symbolic-name-value=true, with-auto=true  # Handle Id to be used by the FrIf to confirm the transmission of the FrTpTxPdu via the LSduR to the FrTp module (FrTp_TxConfirmation) and for requesting TriggerTransmit via LSduR at the FrTp module (FrTp_TriggerTransmit).
          reference FrTpTxPduRef: post-build-variant-value=true, set at post-build in variant post-build / pre-compile in variant pre-compile, destination=Pdu  # Reference to a PDU in the global PDU structure.
