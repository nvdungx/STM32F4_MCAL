AUTOSAR XML (schema 00053)
package /AUTOSAR/EcucDefs
  ecuc definition collection AUTOSARParameterDefinition: module=SecOC
  module definition SecOC [0..1]: post-build-variant-support=true, variants link-time/post-build/pre-compile  # Configuration of the SecOC (SecureOnboardCommunication) module.
    container SecOCGeneral  # Contains the general configuration parameters of the SecOC module.
      integer SecOCDefaultAuthenticationInformationPattern [0..1]: 0..255, multiplicity set at pre-compile, set at pre-compile  # The parameter describes the behaviour of SecOC when authentication build counter has reached the configuration value SecOCAuthenticationBuildAttempts, or the query of the freshness function returns E_NOT_OK or the calculation of the authenticator has returned a non-recoverable error such as returning E_NOT_OK or KEY_FAILURE. | If the configuration parameter is not present, SecOC module shall remove the Authentic I-PDU from its internal buffer and cancel the transmission request If the configuration parameter is present, SecOC will use this value for each byte of Freshness Value and Authenticator when building the Authentication Information, and will not cancel the transmission request.
      boolean SecOCDevErrorDetect: set at pre-compile, default-value=false  # Switches the development error detection and notification on or off. | * true: detection and notification is enabled. * false: detection and notification is disabled.
      boolean SecOCEnableForcedPassOverride: set at pre-compile, default-value=false  # When this configuration option is set to TRUE then the functionality inside the function SecOC_VerifyStatusOverride to send I-PDUs to upper layer independent of the verification result is enabled.
      boolean SecOCEnableSecurityEventReporting: scope=ECU, set at pre-compile, default-value=false  # Switches the reporting of security events to the IdsM: Tags: atp.Status=draft | - true: reporting is enabled. - false: reporting is disabled.
      boolean SecOCIgnoreVerificationResult: set at pre-compile, default-value=false  # The result of the authentication process (e.g. MAC Verify) is ignored after the first try and the SecOC proceeds like the result was a success. The calculation of the authenticator is still done, only its result will be ignored. | * true: enabled (verification result is ignored). * false: disabled (verification result is NOT ignored).
      string SecOCMaxAlignScalarType: set at pre-compile  # The scalar type which has the maximum alignment restrictions on the given platform. This type can be e.g. uint8, uint16 or uint32.
      integer SecOCMaxTransmitRetries: 0..255, set at pre-compile, default-value=10  # Maximum number of retries to send a secured I-PDU in case PduR_SecOCTransmit returns E_NOT_OK.
      boolean SecOCOverrideStatusWithDataId [0..1]: set at pre-compile, default-value=false  # This option defines if the parameter "ValueId" of the function SecOC_VerifyStatusOverride() accepts the freshness value (as a collection of one or more Secured I-PDUs to freshness) or the dataID for individual Secured I-PDUs. | * true: Function SecOC_VerifyStatusOverride accepts SecOCDataId as parameter. * false: Function SecOC_VerifyStatusOverride accepts SecOCFreshnessValueId as parameter.
      boolean SecOCPropagateOnlyFinalVerificationStatus: set at pre-compile, default-value=false  # This parameter Is used to specify if the verification status shall be reported only after the final determination of the verification status (TRUE) or on every verification attempt (FALSE).
      enumeration SecOCQueryFreshnessValue: {CFUNC, RTE}, set at pre-compile, default-value=CFUNC  # This parameter specifies if the freshness value shall be determined through a C-function (CD) or a software component (SW-C).
      function name SecOCVerificationStatusCallout [0..*]: multiplicity set at pre-compile, set at pre-compile  # Entry address of the customer specific call out routine which shall be invoked in case of a verification attempt.
      boolean SecOCVersionInfoApi: set at pre-compile, default-value=false  # If true the SecOC_GetVersionInfo API is available.
      container SecOCSecurityEventRefs [0..1]: multiplicity set at pre-compile  # Container for the references to IdsMEvent elements representing the security events that the SecOC module shall report to the IdsM in case the coresponding security related event occurs (and if SecOCEnableSecurityEventReporting is set to "true"). The standardized security events in this container can be extended by vendor-specific security events. Tags: atp.Status=draft
        reference SEV_SECOC_FRESHNESS_NOT_AVAILABLE [0..1]: multiplicity set at pre-compile, set at pre-compile, requires-symbolic-name-value=true, destination=IdsMEvent  # Failed to get freshness value from FvM. Tags: atp.Status=draft
        reference SEV_SECOC_MAC_VERIFICATION_FAILED [0..1]: multiplicity set at pre-compile, set at pre-compile, requires-symbolic-name-value=true, destination=IdsMEvent  # MAC verification of a received PDU failed. Tags: atp.Status=draft
    container SecOCMainFunctionRx [0..*]  # Each element of this container defines one instance of SecOC_MainFunctionRx.
      float SecOCMainFunctionPeriodRx: 0..INF, set at pre-compile  # Allows to configure the time for the respective MainFunction instance of the Rx path (as float in seconds).
      reference SecOCMainFunctionRxPartitionRef: set at pre-compile, destination=EcucPartition  # Reference to EcucPartition, where the according SecOC_MainFunction instance is assigned to.
    container SecOCMainFunctionTx [0..*]  # Each element of this container defines one instance of SecOC_MainFunctionTx.
      float SecOCMainFunctionPeriodTx: 0..INF, set at pre-compile  # Allows to configure the time for the respective MainFunction instance of the Tx path (as float in seconds).
      reference SecOCMainFunctionTxPartitionRef: set at pre-compile, destination=EcucPartition  # Reference to EcucPartition, where the according SecOC_MainFunction instance is assigned to.
    container SecOCRxPduProcessing [0..*]  # Contains the parameters to configure the RxPdus to be verified by the SecOC module.
      integer SecOCAuthDataFreshnessLen [0..1]: 0..65535, scope=ECU, set at pre-compile  # The length of the external authentic PDU data in bits (uint16).
      integer SecOCAuthDataFreshnessStartPosition [0..1]: 0..65535, scope=ECU, set at pre-compile  # This value determines the start position in bits (uint16) of the Authentic PDU that shall be passed on to the Freshness SWC. The bit counting is done according to TPS_SYST_01068 and the bit ordering is done according to TPS_SYST_01069.
      integer SecOCAuthenticationBuildAttempts [0..1]: 0..65535, set at pre-compile  # This parameter specifies the number of authentication build attempts.
      integer SecOCAuthenticationVerifyAttempts [0..1]: 0..65535, set at pre-compile, default-value=0  # This parameter specifies the number of authentication verify attempts that are to be carried out when the verification of the authentication information failed for a given Secured I-PDU. If zero is set, then only one authentication verification attempt is done.
      integer SecOCAuthInfoTruncLength: 1..65535, post-build-variant-value=true, set at link in variant link-time / post-build in variant post-build / pre-compile in variant pre-compile  # This parameter defines the length in bits of the authentication code to be included in the payload of the Secured I-PDU.
      enumeration SecOCClientServerVerificationStatusPropagationMode: {BOTH, FAILURE_ONLY, NONE}, post-build-variant-value=true, set at link in variant link-time / post-build in variant post-build / pre-compile in variant pre-compile  # This parameter is used to determine the propagation of the verification status through the client/server interface to an SW-C.
      integer SecOCDataId: 0..65535, post-build-variant-value=true, set at link in variant link-time / post-build in variant post-build / pre-compile in variant pre-compile  # This parameter defines a unique numerical identifier for the Secured I-PDU.
      boolean SecOCDynamicRuntimeLengthHandling [0..1]: multiplicity set at pre-compile, set at pre-compile  # Defines whether the length information for handling this received Pdu is taken from the configuration or from the actually provided length information during runtime. | true: SecuredIPdu length information is taken from the actually provided length information during runtime. false: SecuredIPdu length information is taken from parameter PduLength of the Pdu.
      integer SecOCFreshnessValueId: 0..65535, post-build-variant-value=true, set at link in variant link-time / post-build in variant post-build / pre-compile in variant pre-compile  # This parameter defines the Id of the Freshness Value. | The Freshness Value might be a normal counter or a time value.
      integer SecOCFreshnessValueLength: 0..64, post-build-variant-value=true, set at link in variant link-time / post-build in variant post-build / pre-compile in variant pre-compile  # This parameter defines the complete length in bits of the Freshness Value. As long as the key doesn't change the counter shall not overflow. The length of the counter shall be determined based on the expected life time of the corresponding key and frequency of usage of the counter.
      integer SecOCFreshnessValueTruncLength: 0..64, post-build-variant-value=true, set at link in variant link-time / post-build in variant post-build / pre-compile in variant pre-compile  # This parameter defines the length in bits of the Freshness Value to be included in the payload of the Secured I-PDU. This length is specific to the least significant bits of the complete Freshness Counter. If the parameter is 0 no Freshness Value is included in the Secured I-PDU.
      enumeration SecOCReceptionOverflowStrategy: {QUEUE, REJECT, REPLACE}, set at pre-compile  # This parameter defines the overflow strategy for receiving PDUs
      integer SecOCReceptionQueueSize [0..1]: 1..65535, set at pre-compile  # This parameter defines the queue size in case the overflow strategy for receiving PDUs is set to QUEUE.
      boolean SecOCUseAuthDataFreshness: scope=ECU, set at pre-compile, default-value=false  # A Boolean value that indicates if a part of the Authentic-PDU shall be passed on to the SWC that verifies and generates the Freshness. If it is set to TRUE, the values SecOCAuthDataFreshnessStartPosition and SecOCAuthDataFreshnessLen must be set to specify the bit position and length within the Authentic-PDU.
      enumeration SecOCVerificationStatusPropagationMode: {BOTH, FAILURE_ONLY, NONE}, post-build-variant-value=true, set at link in variant link-time / post-build in variant post-build / pre-compile in variant pre-compile  # This parameter is used to describe the propagation of the status of each verification attempt from the SecOC module to SWCs.
      reference SecOCRxAuthServiceConfigRef: requires-symbolic-name-value=true, destination=CsmJob  # This reference is used to define which crypto service function is called for authentication. | If PDUs with a dynamic length are used (e.g. CanTP or Dynamic Length PDUs) a MAC algorithm has to be chosen, that is not vulnerable to length extension attack (e.g. CMAC/HMAC).
      reference SecOCRxPduMainFunctionRef [0..1]: multiplicity set at pre-compile, set at pre-compile, destination=SecOCMainFunctionRx  # Reference to the SecOC_MainFunctionRx this PDU belongs to. | Mandatory, if multiple main functions are defined.
      reference SecOCSameBufferPduRef [0..1]: multiplicity set at pre-compile, set at pre-compile, destination=SecOCSameBufferPduCollection  # This reference is used to collect Pdus that are using the same SecOC buffer.
      container SecOCRxAuthenticPduLayer  # This container specifies the Pdu that is transmitted by the SecOC module to the PduR after the Mac was verified.
        enumeration SecOCPduType: {SECOC_IFPDU, SECOC_TPPDU}, set at pre-compile  # This parameter defines API Type to use for communication with PduR.
        integer SecOCRxAuthenticLayerPduId: 0..65535, set at pre-compile, with-auto=true  # PDU identifier assigned by SecOC module. Used by PduR for SecOC_TpCancelReceive.
        reference SecOCRxAuthenticLayerPduRef: post-build-variant-value=true, set at link in variant link-time / post-build in variant post-build / pre-compile in variant pre-compile, destination=Pdu  # Reference to the global Pdu.
      container SecOCRxPduSecuredArea [0..1]  # This container specifies an area in the Authentic I-Pdu that will be the input to the Authenticator verification algorithm. If this container does not exist in the configuration the complete Authentic I-Pdu will be the input to the Authenticator verification algorithm.
        integer SecOCSecuredRxPduLength: 1..4294967295, post-build-variant-value=true, set at link in variant link-time / post-build in variant post-build / pre-compile in variant pre-compile  # This parameter defines the length (in bytes) of the area within the Pdu which is secured
        integer SecOCSecuredRxPduOffset: 0..4294967295, post-build-variant-value=true, set at link in variant link-time / post-build in variant post-build / pre-compile in variant pre-compile, default-value=0  # This parameter defines the start position (offset in bytes) of the area within the Pdu which is secured
      choice container SecOCRxSecuredPduLayer  # This container specifies the Pdu that is received by the SecOC module from the PduR. For this Pdu the Mac verification is provided.
        container SecOCRxSecuredPdu [0..1]  # This container specifies the Pdu that is received by the SecOC module from the PduR. For this Pdu the Mac verification is provided.
          integer SecOCAuthPduHeaderLength [0..1]: 0..4, set at pre-compile, default-value=0  # This parameter indicates the length (in bytes) of the Secured I-PDU Header in the Secured I-PDU. The length of zero means there's no header in the PDU.
          integer SecOCRxSecuredLayerPduId: 0..65535, set at pre-compile, symbolic-name-value=true, with-auto=true  # PDU identifier assigned by SecOC module. Used by PduR for <nowiki>SecOC_[If|Tp]RxIndication</nowiki>.
          boolean SecOCSecuredRxPduVerification: post-build-variant-value=true, set at pre-compile, default-value=false  # This parameter defines whether the signature authentication or MAC verification shall be performed on this Secured I-PDU. If set to false, the SecOC module extracts the Authentic I-PDU from the Secured I-PDU without verification.
          reference SecOCRxSecuredLayerPduRef: post-build-variant-value=true, set at link in variant link-time / post-build in variant post-build / pre-compile in variant pre-compile, destination=Pdu  # Reference to the global Pdu.
        container SecOCRxSecuredPduCollection [0..1]  # This container specifies two Pdus that are received by the SecOC module from the PduR and a message linking between them. | SecOCRxAuthenticPdu contains the original Authentic I-PDU, i.e. the secured data, and the SecOCRxCryptographicPdu contains the Authenticator, i.e. the actual Authentication Information.
          boolean SecOCSecuredRxPduVerification: post-build-variant-value=true, set at pre-compile, default-value=false  # This parameter defines whether the signature authentication or MAC verification shall be performed on this Secured I-PDU. If set to false, the SecOC module extracts the Authentic I-PDU from the Secured I-PDU without verification.
          container SecOCRxAuthenticPdu  # This container specifies the PDU (that is received by the SecOC module from the PduR) which contains the Secured I-PDU Header and the Authentic I-PDU.
            integer SecOCAuthPduHeaderLength [0..1]: 0..4, set at pre-compile, default-value=0  # This parameter indicates the length (in bytes) of the Secured I-PDU Header in the Secured I-PDU. The length of zero means there's no header in the PDU.
            integer SecOCRxAuthenticPduId: 0..65535, set at pre-compile, symbolic-name-value=true, with-auto=true  # PDU identifier of the Authentic I-PDU assigned by SecOC module. Used by PduR for SecOC_IfRxIndication.
            reference SecOCRxAuthenticPduRef: post-build-variant-value=true, set at link in variant link-time / post-build in variant post-build / pre-compile in variant pre-compile, destination=Pdu  # Reference to the global Pdu.
          container SecOCRxCryptographicPdu  # This container specifies the Cryptographic Pdu that is received by the SecOC module from the PduR.
            integer SecOCRxCryptographicPduId: 0..65535, set at pre-compile, symbolic-name-value=true, with-auto=true  # PDU identifier of the Cryptographic I-PDU assigned by SecOC module. Used by PduR for SecOC_IfRxIndication.
            reference SecOCRxCryptographicPduRef: post-build-variant-value=true, set at link in variant link-time / post-build in variant post-build / pre-compile in variant pre-compile, destination=Pdu  # Reference to the global Pdu.
          container SecOCUseMessageLink [0..1]  # SecOC links an Authentic I-PDU and Cryptographic I-PDU together by repeating a specific part (Message Linker) of the Authentic I-PDU in the Cryptographic I-PDU.
            integer SecOCMessageLinkLen: 0..65535, set at pre-compile  # Length of the Message Linker inside the Authentic I-PDU in bits.
            integer SecOCMessageLinkPos: 0..65535, set at pre-compile  # The position of the Message Linker inside the Authentic I-PDU in bits. | The bit counting is done according to 01068 and the bit ordering is done according to TPS_SYST_01069.
    container SecOCSameBufferPduCollection [0..*]: multiplicity set at pre-compile  # SecOCBuffer configuration that may be used by a collection of Pdus.
      integer SecOCBufferLength: 0..4294967295, set at pre-compile  # This parameter defines the Buffer in bytes that is used by the SecOC module.
    container SecOCTxPduProcessing [0..*]  # Contains the parameters to configure the TxPdus to be secured by the SecOC module.
      integer SecOCAuthenticationBuildAttempts [0..1]: 0..65535, set at pre-compile  # This parameter specifies the number of authentication build attempts.
      integer SecOCAuthInfoTruncLength: 1..65535, post-build-variant-value=true, set at link in variant link-time / post-build in variant post-build / pre-compile in variant pre-compile  # This parameter defines the length in bits of the authentication code to be included in the payload of the Secured I-PDU.
      integer SecOCDataId: 0..65535, post-build-variant-value=true, set at link in variant link-time / post-build in variant post-build / pre-compile in variant pre-compile  # This parameter defines a unique numerical identifier for the Secured I-PDU.
      integer SecOCFreshnessValueId: 0..65535, post-build-variant-value=true, set at link in variant link-time / post-build in variant post-build / pre-compile in variant pre-compile  # This parameter defines the Id of the Freshness Value. | The Freshness Value might be a normal counter or a time value.
      integer SecOCFreshnessValueLength: 0..64, post-build-variant-value=true, set at link in variant link-time / post-build in variant post-build / pre-compile in variant pre-compile  # This parameter defines the complete length in bits of the Freshness Value. As long as the key doesn't change the counter shall not overflow. The length of the counter shall be determined based on the expected life time of the corresponding key and frequency of usage of the counter.
      integer SecOCFreshnessValueTruncLength: 0..64, post-build-variant-value=true, set at link in variant link-time / post-build in variant post-build / pre-compile in variant pre-compile  # This parameter defines the length in bits of the Freshness Value to be included in the payload of the Secured I-PDU. This length is specific to the least significant bits of the complete Freshness Counter. If the parameter is 0 no Freshness Value is included in the Secured I-PDU.
      boolean SecOCProvideTxTruncatedFreshnessValue: set at pre-compile, default-value=false  # This parameter specifies if the Tx query freshness function provides the truncated freshness info instead of generating this by SecOC In this case, SecOC shall add this data to the Authentic PDU instead of truncating the freshness value.
      boolean SecOCReAuthenticateAfterTriggerTransmit: post-build-variant-value=true, set at link in variant link-time / post-build in variant post-build / pre-compile in variant pre-compile, default-value=true  # This parameter specifies if the authentication information of the Secured PDU is updated after | the successful transmission of a triggered transmission was confirmed. TRUE if the authentication information shall be updated after triggered transmission. FALSE if the authentication information shall not be updated after triggered transmission. Note: This parameter should only be set to FALSE if the upper layer SecOC_IfTransmit have the same or a higher frequency than the SecOC_TriggerTransmit calls.
      integer SecOCTxPduUnusedAreasDefault: 0..255, set at link in variant link-time+post-build / pre-compile in variant pre-compile, default-value=0  # The AUTOSAR SecOC module fills not used areas of a transmitted Secured Pdu or a transmitted Cryptographic Pdu with this byte pattern. This attribute is mandatory to avoid undefined behavior.
      boolean SecOCUseTxConfirmation [0..1]: set at pre-compile, default-value=false  # A Boolean value that indicates if the function SecOC_SPduTxConfirmation shall be called for this PDU.
      reference SecOCSameBufferPduRef [0..1]: multiplicity set at pre-compile, set at pre-compile, destination=SecOCSameBufferPduCollection  # This reference is used to collect Pdus that are using the same SecOC buffer.
      reference SecOCTxAuthServiceConfigRef: requires-symbolic-name-value=true, destination=CsmJob  # This reference is used to define which crypto service function is called for authentication. | If PDUs with a dynamic length are used (e.g. CanTP or Dynamic Length PDUs) a MAC algorithm has to be chosen, that is not vulnerable to length extension attack (e.g. CMAC/HMAC).
      reference SecOCTxPduMainFunctionRef [0..1]: multiplicity set at pre-compile, set at pre-compile, destination=SecOCMainFunctionTx  # Reference to the SecOC_MainFunctionTx this PDU belongs to. | Mandatory, if multiple main functions are defined.
      container SecOCTxAuthenticPduLayer  # This container specifies the Pdu that is received by the SecOC module from the PduR. For this Pdu the Mac generation is provided.
        enumeration SecOCPduType: {SECOC_IFPDU, SECOC_TPPDU}, set at pre-compile  # This parameter defines API Type to use for communication with PduR.
        integer SecOCTxAuthenticLayerPduId: 0..65535, set at pre-compile, symbolic-name-value=true, with-auto=true  # PDU identifier assigned by SecOC module. Used by PduR for <nowiki>SecOC_[If|Tp]Transmit</nowiki>.
        reference SecOCTxAuthenticLayerPduRef: post-build-variant-value=true, set at link in variant link-time / post-build in variant post-build / pre-compile in variant pre-compile, destination=Pdu  # Reference to the global Pdu.
      container SecOCTxPduSecuredArea [0..1]  # This container specifies an area in the Authentic I-Pdu that will be the input to the Authenticator generation algorithm. If this container does not exist in the configuration the complete Authentic I-Pdu will be the input to the Authenticator generation algorithm.
        integer SecOCSecuredTxPduLength: 1..4294967295, post-build-variant-value=true, set at link in variant link-time / post-build in variant post-build / pre-compile in variant pre-compile  # This parameter defines the length (in bytes) of the area within the Pdu which shall be secured
        integer SecOCSecuredTxPduOffset: 0..4294967295, post-build-variant-value=true, set at link in variant link-time / post-build in variant post-build / pre-compile in variant pre-compile, default-value=0  # This parameter defines the start position (offset in bytes) of the area within the Pdu which shall be secured
      choice container SecOCTxSecuredPduLayer  # This container specifies the Pdu that is transmitted by the SecOC module to the PduR after the Mac was generated.
        container SecOCTxSecuredPdu [0..1]  # This container specifies one Pdu that is transmitted by the SecOC module to the PduR after the Mac was generated. This Pdu contains the cryptographic information.
          integer SecOCAuthPduHeaderLength [0..1]: 0..4, set at pre-compile, default-value=0  # This parameter indicates the length (in bytes) of the Secured I-PDU Header in the Secured I-PDU. The length of zero means there's no header in the PDU.
          integer SecOCTxSecuredLayerPduId: 0..65535, set at pre-compile, symbolic-name-value=true, with-auto=true  # PDU identifier assigned by SecOC module. | Used by PduR for confirmation (<nowiki>SecOC_[If|Tp]TxConfirmation</nowiki>) and for TriggerTransmit.
          reference SecOCTxSecuredLayerPduRef: post-build-variant-value=true, set at link in variant link-time / post-build in variant post-build / pre-compile in variant pre-compile, destination=Pdu  # Reference to the global Pdu.
        container SecOCTxSecuredPduCollection [0..1]  # This container specifies the Pdu that is transmitted by the SecOC module to the PduR after the Mac was generated. Two separate Pdus are transmitted to the PduR: | Authentic I-PDU and Cryptographic I-PDU.
          container SecOCTxAuthenticPdu  # This container specifies the PDU (that is transmitted by the SecOC module to the PduR) which contains the Secured I-PDU Header and the Authentic I-PDU.
            integer SecOCAuthPduHeaderLength [0..1]: 0..4, set at pre-compile, default-value=0  # This parameter indicates the length (in bytes) of the Secured I-PDU Header in the Secured I-PDU. The length of zero means there's no header in the PDU.
            integer SecOCTxAuthenticPduId: 0..65535, set at pre-compile, symbolic-name-value=true, with-auto=true  # PDU identifier of the Authentic I-PDU assigned by SecOC module. Used by PduR for confirmation (SecOC_IfTxConfirmation) and for TriggerTransmit.
            reference SecOCTxAuthenticPduRef: post-build-variant-value=true, set at link in variant link-time / post-build in variant post-build / pre-compile in variant pre-compile, destination=Pdu  # Reference to the global Pdu.
          container SecOCTxCryptographicPdu  # This container specifies the Cryptographic Pdu that is transmitted by the SecOC module to the PduR after the Mac was generated.
            integer SecOCTxCryptographicPduId: 0..65535, set at pre-compile, symbolic-name-value=true, with-auto=true  # PDU identifier of the Cryptographic I-PDU assigned by SecOC module. Used by PduR for confirmation (SecOC_IfTxConfirmation) and for TriggerTransmit.
            reference SecOCTxCryptographicPduRef: post-build-variant-value=true, set at link in variant link-time / post-build in variant post-build / pre-compile in variant pre-compile, destination=Pdu  # Reference to the global Pdu.
          container SecOCUseMessageLink [0..1]  # SecOC links an Authentic I-PDU and Cryptographic I-PDU together by repeating a specific part (Message Linker) of the Authentic I-PDU in the Cryptographic I-PDU.
            integer SecOCMessageLinkLen: 0..65535, set at pre-compile  # Length of the Message Linker inside the Authentic I-PDU in bits.
            integer SecOCMessageLinkPos: 0..65535, set at pre-compile  # The position of the Message Linker inside the Authentic I-PDU in bits. | The bit counting is done according to 01068 and the bit ordering is done according to TPS_SYST_01069.
