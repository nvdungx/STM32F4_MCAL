AUTOSAR XML (schema 00053)
package /AUTOSAR/EcucDefs
  ecuc definition collection AUTOSARParameterDefinition: module=TcpIp
  module definition TcpIp [0..1]: post-build-variant-support=true, variants link-time/post-build/pre-compile  # Configuration of the TcpIp (TCP/IP stack) module.
    container TcpIpConfig  # This container contains the configuration parameters and sub containers of the AUTOSAR TcpIp module.
      container TcpIpCtrl [1..*]  # Specifies the EthIf controller used for IP communication.
        integer TcpIpIpFramePrioDefault [0..1]: 0..7, multiplicity set at link in variant link-time / post-build in variant post-build / pre-compile in variant pre-compile, post-build-variant-multiplicity=true, post-build-variant-value=true, set at link in variant link-time / post-build in variant post-build / pre-compile in variant pre-compile, default-value=0  # Specifies the default value for the priority for all outgoing frames. | Note: the value can be changed for each socket individually via TcpIp_ChangeParameter() service. If this optional parameter is not available, 0 is used as default priority.
        reference TcpIpDhcpServerConfigRef [0..1]: post-build-variant-value=true, set at link in variant link-time / post-build in variant post-build / pre-compile in variant pre-compile, destination=TcpIpDhcpServerConfig  # Reference to a TcpIpDhcpServerConfig which shall be used for this controller setting (VLAN).
        reference TcpIpEthIfCtrlRef: post-build-variant-value=true, set at link in variant link-time / post-build in variant post-build / pre-compile in variant pre-compile, requires-symbolic-name-value=true, destination=EthIfController  # Reference to EthIf controller where the IP address shall be assigned.
        reference TcpIpIpSecConfigSetRef [0..1]: multiplicity set at pre-compile, set at pre-compile, destination=TcpIpIpSecConfigSet  # Reference to set of SDP entries which shall be used for IPsec.
        container TcpIpCtrlRxPdu [1..*]: multiplicity set at pre-compile  # PDU used for reception of Ethernet frames. Tags: atp.Status=draft | Supported MetaDataItemTypes: * ETHERNET_MAC_64 * BROADCAST_8
          integer TcpIpCtrlRxPduId: 0..65535, scope=ECU, set at pre-compile, symbolic-name-value=true, with-auto=true  # The PDU identifier used for RxIndication from LSduR. Tags: atp.Status=draft
          reference TcpIpCtrlRxPduRef: scope=ECU, set at pre-compile, destination=Pdu  # Reference to the global PDU. Tags: atp.Status=draft
        container TcpIpCtrlTxPdu [1..*]: multiplicity set at pre-compile  # PDU used for transmission of Ethernet frames. Tags: atp.Status=draft | Supported MetaDataItemTypes: * ETHERNET_MAC_64 * PRIORITY_8 * LISTELEM_PTR
          integer TcpIpCtrlTxPduId: 0..65535, scope=ECU, set at pre-compile, symbolic-name-value=true, with-auto=true  # The PDU identifier used for TxConfirmation from LSduR. Tags: atp.Status=draft
          reference TcpIpCtrlTxPduRef: scope=ECU, set at pre-compile, destination=Pdu  # Reference to the global PDU. Tags: atp.Status=draft
        choice container TcpIpIpVXCtrl  # Specifies whether this controller is an Internet Protocol version 4 (IPv4) or Internet Protocol version 6 (IPv4) instance.
          container TcpIpIpV4Ctrl [0..1]  # Specifies an Internet Protocol version 4 (IPv4) instance.
            reference TcpIpArpConfigRef [0..1]: multiplicity set at pre-compile, set at pre-compile, destination=TcpIpArpConfig  # Reference to ARP configuration for this IPv4 instance. | (Multiple IPv4 instances may use the same configuration container but will operate independently)
            reference TcpIpAutoIpConfigRef [0..1]: multiplicity set at pre-compile, set at pre-compile, destination=TcpIpAutoIpConfig  # Reference to AutoIp configuration for this IPv4 instance. | (Multiple IPv4 instances may use the same configuration container but will operate independently)
            reference TcpIpDhcpConfigRef [0..1]: multiplicity set at pre-compile, set at pre-compile, destination=TcpIpDhcpConfig  # Reference to DHCP configuration for this IPv4 instance. | (Multiple IPv4 instances may use the same configuration container but will operate independently)
            reference TcpIpFragmentationConfigRef [0..1]: multiplicity set at pre-compile, set at pre-compile, destination=TcpIpIpFragmentationConfig  # Reference to Fragmentation configuration for this IPv4 instance. | (Multiple IPv4 instances may use the same configuration container but will operate independently)
            container TcpIpIpV4MtuConfig  # This container specifies the Maximum Transmission Unit parameters for this IPv4 instance.
              boolean TcpIpIpV4PathMtuEnabled: set at pre-compile, default-value=false  # If enabled the IPv4 processes incoming ICMPv4 "Packet Too Big" messages and stores a MTU value for each destination address.
              float TcpIpIpV4PathMtuTimeout: 1..86400, set at pre-compile, default-value=600  # If this value is >0 the IpV4 will reset the MTU value stored for each destination after n seconds. | see [RFC1191 6.3. Purging stale PMTU information] Default: 600 seconds (10 minutes)
          container TcpIpIpV6Ctrl [0..1]  # Specifies an Internet Protocol version 6 (IPv6) instance.
            reference TcpIpIpV6DhcpConfigRef [0..1]: multiplicity set at pre-compile, set at pre-compile, destination=TcpIpDhcpV6Config  # Reference to DHCPv6 configuration. | (Multiple IPv6 instances may use the same configuration container but will operate independently)
            reference TcpIpIpV6FragmentationConfigRef [0..1]: multiplicity set at pre-compile, set at pre-compile, destination=TcpIpIpV6FragmentationConfig  # Reference to IPv6 Fragmentation Configuration. | (Multiple IPv6 instances may use the same configuration container but will operate independently)
            reference TcpIpIpV6NdpConfigRef: set at pre-compile, destination=TcpIpNdpConfig  # Reference to Neighbor Discovery Protocol Configuration. | (Multiple IPv6 instances may use the same configuration container but will operate independently)
            container TcpIpIpV6MtuConfig  # This container specifies the Maximum Transmission Unit parameters for this IPv6 instance.
              boolean TcpIpIpV6PathMtuEnabled: set at pre-compile, default-value=false  # If enabled the IPv6 processes incoming ICMPv6 "Packet Too Big" messages and stores a MTU value for each destination address. | See RFC1981 "Path MTU Discovery for IP version 6" for details about PathMTU.
              float TcpIpIpV6PathMtuTimeout: 1..86400, set at pre-compile, default-value=600  # If this value is >0 the IpV6 will reset the MTU value stored for each destination after n seconds. | see [RFC1981 5.3. Purging stale PMTU information] Default: 600 seconds (10 minutes)
      container TcpIpDhcpServerConfig [0..*]: multiplicity set at link in variant link-time / post-build in variant post-build / pre-compile in variant pre-compile, post-build-variant-multiplicity=true  # Specifies the configuration parameters of the DHCP Server sub-module.
        string TcpIpDhcpDefaultRouter [0..1]: multiplicity set at link in variant link-time / post-build in variant post-build / pre-compile in variant pre-compile, post-build-variant-multiplicity=true, post-build-variant-value=true, set at link in variant link-time / post-build in variant post-build / pre-compile in variant pre-compile  # IP address of default router (gateway).
        integer TcpIpDhcpNetmask [0..1]: 0..128, multiplicity set at link in variant link-time / post-build in variant post-build / pre-compile in variant pre-compile, post-build-variant-multiplicity=true, post-build-variant-value=true, set at link in variant link-time / post-build in variant post-build / pre-compile in variant pre-compile  # Network mask of IPv4 address or address prefix of IPv6 address in CIDR Notation, i.e. decimal value between 0 and 32 (IPv4) or 0 and 128 (IPv6) that describes the number of significant bits defining the network number or prefix of an IP address.
        reference TcpIpDhcpEthIfSwitchRef [0..1]: scope=ECU, multiplicity set at link in variant link-time / post-build in variant post-build / pre-compile in variant pre-compile, post-build-variant-multiplicity=true, post-build-variant-value=true, set at link in variant link-time / post-build in variant post-build / pre-compile in variant pre-compile, requires-symbolic-name-value=true, destination=EthIfSwitch  # Reference to EthIfSwitch representation. | Optional in case the Dhcp server is operating without an Ethernet switch.
        container TcpIpDhcpAddressAssignment [0..*]: multiplicity set at link in variant link-time / post-build in variant post-build / pre-compile in variant pre-compile, post-build-variant-multiplicity=true  # Defines a Ethernet Switch port based IP address assignment.
          string TcpIpDhcpAddressLowerBound: post-build-variant-value=true, set at link in variant link-time / post-build in variant post-build / pre-compile in variant pre-compile  # The lower bound IP address which shall be assigned. | If lower bound and upper bound are identical exactly this IP address shall be assigned.
          string TcpIpDhcpAddressUpperBound: post-build-variant-value=true, set at link in variant link-time / post-build in variant post-build / pre-compile in variant pre-compile  # The upper bound IP address which shall be assigned. | If lower bound and upper bound are identical exactly this IP address shall be assigned.
          reference TcpIpDhcpSwitchPortRef [0..1]: scope=ECU, multiplicity set at link in variant link-time / post-build in variant post-build / pre-compile in variant pre-compile, post-build-variant-multiplicity=true, post-build-variant-value=true, set at link in variant link-time / post-build in variant post-build / pre-compile in variant pre-compile, requires-symbolic-name-value=true, destination=EthSwtPort  # Reference to Ethernet Switch port. | Optional in case the Dhcp server is operating without an Ethernet switch.
      container TcpIpDuplicateAddressDetectionConfig [0..1]  # Specifies the DAD callout function.
        function name TcpIpDuplicateAddressDetectionCalloutName: set at pre-compile  # This parameter defines the name of the DAD callout function <Up_DADAddressConflict>.
      container TcpIpIpConfig [0..1]  # Specifies the configuration parameters of the IP (Internet Protocol) sub-module
        container TcpIpIpV4Config [0..1]  # Specifies the configuration parameters of the IPv4 (Internet Protocol version 4) sub-module.
          container TcpIpArpConfig [0..*]  # Specifies the configuration parameters of the ARP (Address Resolution Protocol) sub-module.
            boolean TcpIpArpDefensiveProcessing [0..1]: multiplicity set at pre-compile, set at pre-compile, default-value=false  # If enabled the ARP shall only process ARP replies which are received in reaction to a previously transmitted ARP request as well as skipping updates to the ARP table based on received Gratuitous ARP packets. If disabled all ARP packets shall be processed as specified in IETF RFC 826.
            integer TcpIpArpNumGratuitousARPonStartup: 0..255, post-build-variant-value=true, set at link in variant link-time / post-build in variant post-build / pre-compile in variant pre-compile  # Specifies the number of gratuitous ARP replies which shall be sent on assignment of a new IP address.
            boolean TcpIpArpPacketQueueEnabled: set at pre-compile, default-value=false  # Enables (TRUE) or disables (FALSE) support of the ARP Packet Queue according to IETF RFC 1122, section 2.3.2.2.
            float TcpIpArpRequestTimeout: 0..INF, post-build-variant-value=true, set at link in variant link-time / post-build in variant post-build / pre-compile in variant pre-compile, default-value=1  # Specifies a timeout in seconds for the validity of ARP requests. After the transmission of an ARP request the TcpIp shall skip the transmission of any further ARP requests to the same destination within a duration of TcpIpArpRequestTimeout seconds. (IETF RFC 1122, section 2.3.2.1) The value for this parameter shall be an integral multiple of TcpIpMainFunctionPeriod or 0. If this parameter set to 0 this features is disabled and no delay between ARP requests is enforced.
            float TcpIpArpTableEntryTimeout: 0..INF, post-build-variant-value=true, set at link in variant link-time / post-build in variant post-build / pre-compile in variant pre-compile  # Timeout in seconds after which an unused ARP entry is removed.
            integer TcpIpArpTableSizeMax: 0..65535, set at pre-compile  # Maximum number of entries in the ARP table.
          container TcpIpAutoIpConfig [0..*]  # Specifies the configuration parameters of the Auto-IP (automatic private IP addressing) sub-module.
            float TcpIpAutoIpInitTimeout: 0..INF, post-build-variant-value=true, set at link in variant link-time / post-build in variant post-build / pre-compile in variant pre-compile  # The time in seconds Auto-IP waits at startup, before beginning with ARP probing. This delay is used to give DHCP time to acquire a lease in case a DHCP server is present.
          container TcpIpDhcpConfig [0..*]  # Specifies the configuration parameters of the DHCPv4. | This container may be referenced by multiple IPv4 instances if they shall use the same configuration. This container may have multiple instances if different configurations are required for different IPv4 instances.
          container TcpIpIcmpConfig [0..1]  # Specifies the configuration parameters of the ICMP (Internet Control Message Protocol) sub-module.
            boolean TcpIpIcmpEchoReplyEnabled: set at pre-compile, default-value=false  # Enables or disables transmission of ICMP echo reply message in case of a ICMP echo reception.
            integer TcpIpIcmpTtl: 1..255, post-build-variant-value=true, set at link in variant link-time / post-build in variant post-build / pre-compile in variant pre-compile  # Default Time-to-live value of outgoing ICMP packets.
            container TcpIpIcmpMsgHandler [0..1]  # This container is a subcontainer of TcpIpIcmpConfig and specifies the configuration parameters for the ICMP message handler.
              function name TcpIpIcmpMsgHandlerName: set at link in variant link-time+post-build / pre-compile in variant pre-compile  # This parameter defines the name of the ICMP message handler function <Up_IcmpMsgHandler>.
          container TcpIpIpFragmentationConfig [0..*]  # Specifies the configuration parameters of IPv4 packet fragmentation/reassembly. | This container may be referenced by multiple IPv4 instances if they shall use the same configuration. This container may have multiple instances if different configurations are required for different IPv4 instances.
            boolean TcpIpIpFragmentationRxEnabled: set at pre-compile, default-value=false  # Enables (TRUE) or disables (FALSE) support for reassembling of incoming datagrams that are fragmented according to IETF RFC 815 (IP Datagram Reassembly Algorithms).
            integer TcpIpIpNumFragments [0..1]: 0..255, multiplicity set at link in variant link-time / post-build in variant post-build / pre-compile in variant pre-compile, post-build-variant-multiplicity=true, post-build-variant-value=true, set at link in variant link-time / post-build in variant post-build / pre-compile in variant pre-compile, default-value=0  # Specifies the maximum number of IP fragments per datagram. | Note: this parameter is only relevant if TcpIpIpFragmentationRxEnabled is TRUE.
            integer TcpIpIpNumReassDgrams [0..1]: 0..65535, multiplicity set at link in variant link-time / post-build in variant post-build / pre-compile in variant pre-compile, post-build-variant-multiplicity=true, post-build-variant-value=true, set at link in variant link-time / post-build in variant post-build / pre-compile in variant pre-compile, default-value=3  # Specifies the maximum number of fragmented IP datagrams that can be reassembled in parallel. | Note: this parameter is only relevant if TcpIpIpFragmentationRxEnabled is TRUE.
            float TcpIpIpReassTimeout [0..1]: 0..INF, multiplicity set at link in variant link-time / post-build in variant post-build / pre-compile in variant pre-compile, post-build-variant-multiplicity=true, post-build-variant-value=true, set at link in variant link-time / post-build in variant post-build / pre-compile in variant pre-compile, default-value=60  # Specifies the timeout in [s] after which an incomplete datagram gets discarded. | Note: this parameter is only relevant if TcpIpIpFragmentationRxEnabled is TRUE.
        container TcpIpIpV6Config [0..1]  # Specifies the configuration parameters of the IPv6 (Internet Protocol version 6) sub-module.
          container TcpIpDhcpV6Config [0..*]  # Specifies the configuration parameters of the DHCPv6. | This container may be referenced by multiple IPv6 instances if they shall use the same configuration. This container may have multiple instances if different configurations are required for different IPv6 instances.
            float TcpIpDhcpV6CnfDelayMax: 0..100, set at pre-compile, default-value=1  # Maximum delay (s) before sending the first Confirm message. If this value is bigger than the previous minimum delay value a random delay will be chosen from the interval.
            float TcpIpDhcpV6CnfDelayMin: 0..100, set at pre-compile, default-value=0  # Minimum delay (s) before the first Confirm message will be sent.
            float TcpIpDhcpV6InfDelayMax: 0..100, set at pre-compile, default-value=1  # Maximum delay (s) before sending the first Information Request message. If this value is bigger than the previous minimum delay value a random delay will be chosen from the interval.
            float TcpIpDhcpV6InfDelayMin: 0..100, set at pre-compile, default-value=0  # Minimum delay (s) before the first Information Request message will be sent.
            float TcpIpDhcpV6SolDelayMax: 0..100, set at pre-compile, default-value=1  # Maximum delay (s) before sending the first Solicit message. If this value is bigger than the previous minimum delay value a random delay will be chosen from the interval.
            float TcpIpDhcpV6SolDelayMin: 0..100, set at pre-compile, default-value=0  # Minimum delay (s) before the first Solicit message will be sent.
          container TcpIpIcmpV6Config  # Specifies the configuration parameters of the ICMPv6 (Internet Control Message Protocol for IPv6) sub-module.
            boolean TcpIpIcmpV6EchoReplyAvoidFragmentation: set at pre-compile, default-value=false  # If enabled, the stack will respond only to incoming ICMPv6 Echo Requests (Pings) that fit the MTU of the respective interface, i.e. can be transmitted without IPv6 fragmentation. Only relevant if TcpIpIcmpV6EchoReplyEnabled is enabled.
            boolean TcpIpIcmpV6EchoReplyEnabled: set at pre-compile, default-value=false  # If enabled, the stack will respond to incoming ICMPv6 Echo Requests (Pings).
            integer TcpIpIcmpV6HopLimit: 1..255, post-build-variant-value=true, set at link in variant link-time / post-build in variant post-build / pre-compile in variant pre-compile  # Default Hop-Limit value of outgoing ICMPv6 packets.
            boolean TcpIpIcmpV6MsgDestinationUnreachableEnabled: set at pre-compile  # Dis/Enables transmission of Destination Unreachable Messages
            boolean TcpIpIcmpV6MsgParameterProblemEnabled: set at pre-compile, default-value=true  # If enabled an ICMPv6 parameter problem message will be sent if a received packet has been dropped due to unknown options or headers that are found in the packet. | [RFC8200 4. IPv6 Extension Headers]
            container TcpIpIcmpV6MsgHandler [0..1]  # This container is a subcontainer of TcpIpIcmpConfig and specifies the configuration parameters for the ICMPv6 message handler.
              function name TcpIpIcmpV6MsgHandlerName: set at link in variant link-time+post-build / pre-compile in variant pre-compile  # This parameter defines the name of the ICMP message handler function <Up_IcmpMsgHandler>.
          container TcpIpIpV6ConfigExtHeaderFilter [0..*]  # This container describes the white list for the filtering of IPv6 extension headers, i.e. frames containing IPv6 extension headers not listed here shall be silently dropped.
            integer TcpIpIpV6ConfigExtHeaderFilterEntry [1..*]: 0..255, set at pre-compile  # IPv6 Extension Header type allowed by this filter.
          container TcpIpIpV6FragmentationConfig [0..*]  # Specifies the configuration parameters of IPv6 packet fragmentation/reassembly. | This container may be referenced by multiple IPv6 instances if they shall use the same configuration. This container may have multiple instances if different configurations are required for different IPv6 instances.
            integer TcpIpIpV6ReassemblyBufferCount: 0..255, set at pre-compile, default-value=255  # Number of buffers that can be used for fragment reassembly. In case of a reassembly error or if not all fragments are received in time this buffer will be blocked until the specified "Fragment Reassembly Timeout" has been exceeded. | A value of 0 disables fragment reassembly. [RFC8200 5. Packet Size Issues] "In order to send a packet larger than a path's MTU, a node may use the IPv6 Fragment header to fragment the packet at the source and have it reassembled at the destination(s). However, the use of such fragmentation is discouraged in any application that is able to adjust its packets to fit the measured path MTU (i.e., down to 1280 octets)."
            integer TcpIpIpV6ReassemblyBufferSize [0..1]: 1500..65535, multiplicity set at pre-compile, set at pre-compile, default-value=1500  # [RFC8200 5. Packet Size Issues] | "A node must be able to accept a fragmented packet that, after reassembly, is as large as 1500 octets. A node is permitted to accept fragmented packets that reassemble to more than 1500 octets."the measured path MTU (i.e., down to 1280 octets)."
            integer TcpIpIpV6ReassemblySegmentCount [0..1]: 1..255, multiplicity set at pre-compile, set at pre-compile, default-value=5  # Specifies the maximum number of consecutive data segments that can be managed in each reassembly buffer. If all fragments are received in order, only one segment will be needed. | To deal with fragments received out of order this value should be configured bigger than 1.
            float TcpIpIpV6ReassemblyTimeout [0..1]: 0.001..100, multiplicity set at pre-compile, set at pre-compile, default-value=60  # [RFC8200 4.5 Fragment Header] | Default: 60 seconds
            integer TcpIpIpV6TxFragmentBufferCount: 1..1000, set at pre-compile, default-value=2  # These buffers will be used if the IpV6 receives packets from the upper layer that do not fit into the MTU and thus must be fragmented. | A value of 0 disables tx fragmentation. If the upper layer transmits packets that do not fit into the link or path MTU, the IpV6 will split-up the packet into fragments. see "Enable Fragment Reassembly"
            integer TcpIpIpV6TxFragmentBufferSize [0..1]: 1500..65535, multiplicity set at pre-compile, set at pre-compile, default-value=1500  # Size of each fragment tx buffer in bytes
          container TcpIpNdpConfig [0..*]  # Specifies the configuration parameters of the Neighbor Discovery Protocol for IPv6 | This container may be referenced by multiple IPv6 instances if they shall use the same configuration. This container may have multiple instances if different configurations are required for different IPv6 instances.
            container TcpIpNdpArNudConfig [0..1]  # Specifies the configuration parameters for NDP Address Resolution and Neighbor Unreachability Detection.
              float TcpIpNdpDefaultReachableTime: 0..120, set at pre-compile, default-value=30  # Configuration of the ReachableTime (s) specified in [RFC4861 6.3.2. Host Variables]. | "The time a neighbor is considered reachable after receiving a reachability confirmation." If "TcpIpNdpDynamicReachableTimeEnabled" is checked, this value may be reconfigured based on received Router Advertisements. Default: REACHABLE_TIME = 30 seconds
              float TcpIpNdpDefaultRetransTimer: 0..60, set at pre-compile, default-value=1  # Configures the default value (s) for the RetransTimer variable specified in [RFC4861 6.3.2. Host Variables]. | "The time between retransmissions of Neighbor Solicitation messages to a neighbor when resolving the address or when probing the reachability of a neighbor." If "TcpIpNdpDynamicRetransTimeEnabled" is checked, this value may be reconfigured based on received Router Advertisements. Default: RETRANS_TIMER = 1 second
              boolean TcpIpNdpDefensiveProcessing: set at pre-compile, default-value=false  # If enabled the NDP shall only process Neighbor Advertisements which are received in reaction to a previously transmitted Neighbor Solicitation as well as skipping updates to the Neighbor Cache based on received Neighbor Solicitations. If disabled all Neighbor Advertisements and Solicitations shall be processed as specified in RFC4861. | [RFC4861 7.2.5. Receipt of Neighbor Advertisements]
              float TcpIpNdpDelayFirstProbeTime: 0..60, set at pre-compile, default-value=5  # Delay before sending the first NUD probe in (s). | [RFC4861 7.3.3. Node Behavior] Default: DELAY_FIRST_PROBE_TIME = 5 seconds
              integer TcpIpNdpMaxNeighborCacheSize: 1..254, set at pre-compile, default-value=5  # Maximum number of entries in the neighbor cache. | [RFC4861 5.1. Conceptual Data Structures]
              integer TcpIpNdpMaxRandomFactor: 0..100, set at pre-compile, default-value=15  # Maximum random factor used for randomization | [RFC4861 10. Protocol Constants] Default: 15 (MAX_RANDOM_FACTOR = 1.5)
              integer TcpIpNdpMinRandomFactor: 0..100, set at pre-compile, default-value=5  # Minimum random factor used for randomization | [RFC4861 10. Protocol Constants] Default: 5 (MIN_RANDOM_FACTOR = 0.5)
              boolean TcpIpNdpNeighborUnreachabilityDetectionEnabled: set at pre-compile, default-value=true  # Neighbor Unreachability Detection is used to remove unused entries from the neighbor cache. This feature is a basic feature of NDP and should be turned on.
              integer TcpIpNdpNumMulticastSolicitations: 0..255, set at pre-compile, default-value=3  # Maximum number of multicast solicitations that will be sent when performing address resolution. | [RFC4861 7.2.2. Sending Neighbor Solicitations] Default: MAX_MULTICAST_SOLICIT = 3
              integer TcpIpNdpNumUnicastSolicitations: 0..255, set at pre-compile, default-value=3  # Maximum number of unicast solicitations that will be sent when performig Neighbor Unreachability Detection. | [RFC4861 7.3.3. Node Behavior] Default: MAX_UNICAST_SOLICIT = 3
              boolean TcpIpNdpPacketQueueEnabled: set at pre-compile, default-value=true  # Enables (TRUE) or disables (FALSE) support of a NDP Packet Queue according to IETF RFC 4861, section 7.2.2.
              boolean TcpIpNdpRandomReachableTimeEnabled: set at pre-compile, default-value=true  # If enabled the value of ReachableTime will be multiplied with a random value between MIN_RANDOM_FACTOR and MAX_RANDOM_FACTOR in order to prevent multiple nodes from transmitting at exactly the same time | [RFC4861 6.3.2. Host Variables / ReachableTime]
            container TcpIpNdpPrefixRouterDiscoveryConfig [0..1]  # Specifies the configuration parameters for NDP Prefix and Router Discovery.
              integer TcpIpNdpDefaultRouterListSize: 2..254, set at pre-compile, default-value=2  # Maximum number of default router entries. | [RFC4861 5.1. Conceptual Data Structures]
              integer TcpIpNdpDestinationCacheSize: 1..254, set at pre-compile, default-value=5  # Maximum number of entries in the destination cache. | [RFC4861 5.1. Conceptual Data Structures]
              boolean TcpIpNdpDynamicHopLimitEnabled: set at pre-compile, default-value=true  # If enabled the default hop limit may be reconfigured based on received Router Advertisements. | [RFC4861 6.3.4. Processing Received Router Advertisements]
              boolean TcpIpNdpDynamicMtuEnabled: set at pre-compile, default-value=false  # Allow dynamic reconfiguration of link MTU via Router Advertisements. | [RFC4861 4.6.4. MTU]
              boolean TcpIpNdpDynamicReachableTimeEnabled: set at pre-compile, default-value=true  # If enabled the default Reachable Time value may be reconfigured based on received Router Advertisements. | [RFC4861 6.3.4. Processing Received Router Advertisements] Default: Enabled
              boolean TcpIpNdpDynamicRetransTimeEnabled: set at pre-compile, default-value=true  # If enabled the default Retransmit Timer value may be reconfigured based on received Router Advertisements. | [RFC4861 6.3.4. Processing Received Router Advertisements] Default: Enabled
              float TcpIpNdpMaxRtrSolicitationDelay: 0.001..60, set at pre-compile, default-value=1  # Maximum delay before the first Router Solicitation will be sent after interface initialization in (s). | [RFC4861 6.3.7. Sending Router Solicitations] Default: MAX_RTR_SOLICITATION_DELAY = 1 second
              integer TcpIpNdpMaxRtrSolicitations: 0..255, set at pre-compile, default-value=3  # Maximum number of Router Solicitations that will be sent before the first Router Advertisement has been received. | 0 = No Router Solicitations will be sent. This has no impact on handling Router Advertisements. [RFC4861 6.3.7. Sending Router Solicitations] Default: MAX_RTR_SOLICITATIONS = 3 transmissions
              integer TcpIpNdpPrefixListSize: 1..254, set at pre-compile, default-value=5  # Maximum number of entries in the on-link prefix list. | [RFC4861 5.1. Conceptual Data Structures]
              boolean TcpIpNdpRndRtrSolicitationDelayEnabled: set at pre-compile, default-value=true  # If enabled the first router solicitation will be delayed randomly from [0...MAX_RTR_SOLICITATION_DELAY]. Otherwise the first router solicitation will be sent after exactly MAX_RTR_SOLICITATION_DELAY milliseconds. | [RFC4861 6.3.7. Sending Router Solicitations] Default: Enabled
              float TcpIpNdpRtrSolicitationInterval: 0.001..60, set at pre-compile, default-value=4  # Interval between consecutive Router Solicitations in (s). | [RFC4861 6.3.7. Sending Router Solicitations] Default: RTR_SOLICITATION_INTERVAL = 4 seconds
              container TcpIpNdpPrefixList [0..1]  # Specifies a list of prefixes to be treated as "on-link" according to IETF RFC 4861 Section 5.1.
                container TcpIpNdpPrefixListEntry [1..*]  # Single entry in the prefix list.
                  string TcpIpNdpPrefixListEntryPrefixAddress: set at pre-compile  # The prefix of an IP address. This prefix can be used for on-link determination.
                  integer TcpIpNdpPrefixListEntryPrefixLength: 0..128, set at pre-compile  # The number of leading bits in the Prefix that are valid.
            container TcpIpNdpSlaacConfig [0..1]  # Specifies the configuration parameters for StateLess Address AutoConfiguration.
              integer TcpIpNdpSlaacDadNumberOfTransmissions: 0..254, set at pre-compile, default-value=1  # Number of Neighbor Solicitations that have to be unanswered in order to set an autoconfigurated address to PREFERRED (usable) state. | [RFC4861 5.1. Node Configuration Variables] Default: DupAddrDetectTransmits = 1 Setting this value to 0 turns off DAD.
              float TcpIpNdpSlaacDadRetransmissionDelay: 0..10, set at pre-compile, default-value=1  # Sets the maximum value for the address configuration delay (s). | According to [RFC4861 5.4.2. Sending Neighbor Solicitation Messages] this value should be the same as MAX_RTR_SOLICITATION_DELAY. Default: MAX_RTR_SOLICITATION_DELAY = 1 second
              boolean TcpIpNdpSlaacDelayEnabled: set at pre-compile, default-value=false  # If enabled transmission of the first DAD Neighbor Solicitation will be delayed by a random value from [0...MAX_DAD_DELAY]. | "This serves to alleviate congestion when many nodes start up on the link at the same time, such as after a power failure, and may help to avoid race conditions when more than one node is trying to solicit for the same address at the same time." "The delay will avoid similar congestion when multiple nodes are going to configure addresses by receiving the same single multicast router advertisement." [RFC4861 5.4.2. Sending Neighbor Solicitation Messages] Default: True
              boolean TcpIpNdpSlaacOptimisticDadEnabled: set at pre-compile, default-value=false  # Enable Optimistic Duplicate Address Detection (DAD) according to RFC4429.
      container TcpIpIpSecConfigSet [0..*]  # Specifies the IPsec configuration.
        function name TcpIpIpSecAuditEventCalloutFunction [0..1]: multiplicity set at pre-compile, set at pre-compile  # This parameter specifies the name of a callout function that will be called for each auditable event.
        string TcpIpIpSecCalloutHeaderFile [0..1]: multiplicity set at pre-compile, set at pre-compile  # This parameter specifies the name of the header file containing the definition for the functions specified in TcpIpIpSecSpdCalloutFunction and TcpIpIpSecAuditEvent
        function name TcpIpIpSecSpdCalloutFunction [0..1]: multiplicity set at pre-compile, set at pre-compile  # This parameter specifies the name of a callout function that shall be called for each Rx/Tx messag, after the IPsec has processed all corresponding SPD entries and has determined the policy. The callout function allows it to override the applied policy.
        integer TcpIpRemoteDeviceNum: 1..18446744073709551615, set at pre-compile  # Amount of remote clients which will negotiate a Security Association (SA).
        container TcpIpEncryptionAlgorithm [0..*]: multiplicity set at pre-compile  # Container for configuration of supported encryption algorithm transforms. This container is used to configure supported algorithms for ESP. The transform algorithm must be configured in the Crypto module.
          enumeration TcpIpEncryptionTransformIdentifier: {TCPIP_IPSEC_TRANSFORM_ENCR_3DES, TCPIP_IPSEC_TRANSFORM_ENCR_3IDEA, TCPIP_IPSEC_TRANSFORM_ENCR_AES_CBC, TCPIP_IPSEC_TRANSFORM_ENCR_AES_CCM_12, TCPIP_IPSEC_TRANSFORM_ENCR_AES_CCM_16, TCPIP_IPSEC_TRANSFORM_ENCR_AES_CCM_8, TCPIP_IPSEC_TRANSFORM_ENCR_AES_CCM_8_IIV, TCPIP_IPSEC_TRANSFORM_ENCR_AES_CTR, TCPIP_IPSEC_TRANSFORM_ENCR_AES_GCM_12, TCPIP_IPSEC_TRANSFORM_ENCR_AES_GCM_16, TCPIP_IPSEC_TRANSFORM_ENCR_AES_GCM_16_IIV, TCPIP_IPSEC_TRANSFORM_ENCR_AES_GCM_8, TCPIP_IPSEC_TRANSFORM_ENCR_BLOWFISH, TCPIP_IPSEC_TRANSFORM_ENCR_CAMELLIA_CBC, TCPIP_IPSEC_TRANSFORM_ENCR_CAMELLIA_CCM_12, TCPIP_IPSEC_TRANSFORM_ENCR_CAMELLIA_CCM_16, TCPIP_IPSEC_TRANSFORM_ENCR_CAMELLIA_CCM_8, TCPIP_IPSEC_TRANSFORM_ENCR_CAMELLIA_CTR, TCPIP_IPSEC_TRANSFORM_ENCR_CAST, TCPIP_IPSEC_TRANSFORM_ENCR_CHACHA20_POLY1305, TCPIP_IPSEC_TRANSFORM_ENCR_CHACHA20_POLY1305_II, TCPIP_IPSEC_TRANSFORM_ENCR_DES, TCPIP_IPSEC_TRANSFORM_ENCR_DES_IV32, TCPIP_IPSEC_TRANSFORM_ENCR_DES_IV64, TCPIP_IPSEC_TRANSFORM_ENCR_IDEA, TCPIP_IPSEC_TRANSFORM_ENCR_NULL, TCPIP_IPSEC_TRANSFORM_ENCR_RC5}, set at pre-compile, default-value=TCPIP_IPSEC_TRANSFORM_ENCR_DES  # Encryption algorithm transform identifier. Parameter values are defined as per IETF RFC 7296 3.3.2
          container TcpIpEncryptionTransformJobPair [1..*]: multiplicity set at pre-compile  # Container for storing the CSM integrity transform job references for performing authentication. Valid for ESP and AH.At least one Integrity transform job pair needs to be configured for each Integrity Algorithm.
            reference TcpIpCsmDecryptJobRef: set at pre-compile, requires-symbolic-name-value=true, destination=CsmJob  # The referenced Csm job is used for the execution of the CsmMacVerify primitive needed for this transform. | Must be a valid decryption job of the parent type.
            reference TcpIpCsmEncryptJobRef: set at pre-compile, requires-symbolic-name-value=true, destination=CsmJob  # The referenced Csm job is used for the execution of the CsmMacGenerate primitive needed for this transform. | Must be a valid encryption job of the parent type.
        container TcpIpIntegrityAlgorithm [1..*]: multiplicity set at pre-compile  # Container for configuration of supported integrity algorithm transforms. This container is used to configure supported algorithms for AH. The transform algorithm must be configured in the Crypto module.
          enumeration TcpIpIntegrityTransformIdentifier: {TCPIP_IPSEC_TRANSFORM_AUTH_AES_128_GMAC, TCPIP_IPSEC_TRANSFORM_AUTH_AES_192_GMAC, TCPIP_IPSEC_TRANSFORM_AUTH_AES_256_GMAC, TCPIP_IPSEC_TRANSFORM_AUTH_AES_CMAC_96, TCPIP_IPSEC_TRANSFORM_AUTH_AES_XCBC_96, TCPIP_IPSEC_TRANSFORM_AUTH_DES_MAC, TCPIP_IPSEC_TRANSFORM_AUTH_HMAC_MD5_128, TCPIP_IPSEC_TRANSFORM_AUTH_HMAC_MD5_96, TCPIP_IPSEC_TRANSFORM_AUTH_HMAC_SHA1_160, TCPIP_IPSEC_TRANSFORM_AUTH_HMAC_SHA1_96, TCPIP_IPSEC_TRANSFORM_AUTH_HMAC_SHA2_256_128, TCPIP_IPSEC_TRANSFORM_AUTH_HMAC_SHA2_384_192, TCPIP_IPSEC_TRANSFORM_AUTH_HMAC_SHA2_512_256, TCPIP_IPSEC_TRANSFORM_AUTH_KPDK_MD5}, set at pre-compile, default-value=TCPIP_IPSEC_TRANSFORM_AUTH_HMAC_SHA2_256_128  # Integrity algorithm transform identifier. Parameter values are defined as per IETF RFC 7296 3.3.2
          container TcpIpIntegrityTransformJobPair [1..*]: multiplicity set at pre-compile  # Container for storing the CSM integrity transform job references for performing authentication. Valid for ESP and AH.At least one Integrity transform job pair needs to be configured for each Integrity Algorithm.
            reference TcpIpCsmGenerateJobRef: set at pre-compile, requires-symbolic-name-value=true, destination=CsmJob  # The referenced Csm job is used for the execution of the CsmMacGenerate primitive needed for this transform. | Must be a valid MAC generate job of the parent type.
            reference TcpIpCsmVerifyJobRef: set at pre-compile, requires-symbolic-name-value=true, destination=CsmJob  # The referenced Csm job is used for the execution of the CsmMacVerify primitive needed for this transform. | Must be a valid MAC verify job of the parent type.
        container TcpIpSpdEntry [1..*]: multiplicity set at pre-compile  # Entry of the Security Policy Database (SPD).
          enumeration TcpIpIpSecHeaderType: {TCPIP_IPSEC_HDR_AH, TCPIP_IPSEC_HDR_ESP, TCPIP_IPSEC_HDR_NONE}, set at pre-compile, default-value=TCPIP_IPSEC_HDR_AH  # Header type specifying the IPsec security mechanism.
          enumeration TcpIpIpSecPolicy: {TCPIP_IPSEC_POLICY_BYPASS, TCPIP_IPSEC_POLICY_DISCARD, TCPIP_IPSEC_POLICY_OPTIONAL, TCPIP_IPSEC_POLICY_PROTECT}, set at pre-compile  # Policy for usage of IPsec.
          integer TcpIpIpSecPriority: 0..18446744073709551615, default-value=0  # Priority of the SPD entry. The processing of entries is based on priority, starting with the highest priority "0". The first matching SPD entry defines the policy.
          string TcpIpLocalIpAddrEnd [0..1]: multiplicity set at pre-compile, set at pre-compile  # End value of the remote IP address range.
          string TcpIpLocalIpAddrStart [0..1]: multiplicity set at pre-compile, set at pre-compile  # Start value of the local IP address range.
          integer TcpIpLocalPortRangeEnd [0..1]: 1..65535, multiplicity set at pre-compile, set at pre-compile  # End value of the local port range.
          integer TcpIpLocalPortRangeStart [0..1]: 1..65535, multiplicity set at pre-compile, set at pre-compile  # Start value of the local port range.
          enumeration TcpIpProtocol: {TCPIP_PROTOCOL_ANY, TCPIP_PROTOCOL_ICMP, TCPIP_PROTOCOL_TCP, TCPIP_PROTOCOL_UDP}, set at pre-compile  # Relevant IP protocol. | Note: As specified in IETF Rfc 4301 section 6, ICMP error messages will always be BYPASSed. The policy for TCPIP_PROTOCOL_ICMP only applies to ICMP non-error messages. (Echo reply/response).
          string TcpIpRemIpAddrEnd [0..1]: multiplicity set at pre-compile, set at pre-compile  # End value of the remote IP address range.
          string TcpIpRemIpAddrStart [0..1]: multiplicity set at pre-compile, set at pre-compile  # Start value of the remote IP address range.
          integer TcpIpRemPortRangeEnd [0..1]: 1..65535, multiplicity set at pre-compile, set at pre-compile  # End value of the remote port range.
          integer TcpIpRemPortRangeStart [0..1]: 1..65535, multiplicity set at pre-compile, set at pre-compile  # Start value of the remote port range.
      container TcpIpLocalAddr [1..*]  # Specifies the local IP (Internet Protocol) addresses used for IP communication.
        enumeration TcpIpAddressType: {TCPIP_ANYCAST, TCPIP_MULTICAST, TCPIP_UNICAST}, post-build-variant-value=true, set at link in variant link-time / post-build in variant post-build / pre-compile in variant pre-compile  # Address type.
        integer TcpIpAddrId: 0..65535, scope=ECU, set at pre-compile, symbolic-name-value=true, with-auto=true  # IP address table identifier assigned by TCP/IP stack.
        enumeration TcpIpDomainType: {TCPIP_AF_INET, TCPIP_AF_INET6}, post-build-variant-value=true, set at link in variant link-time / post-build in variant post-build / pre-compile in variant pre-compile  # Address family.
        reference TcpIpCtrlRef: post-build-variant-value=true, set at link in variant link-time / post-build in variant post-build / pre-compile in variant pre-compile, destination=TcpIpCtrl  # Reference to a TcpIpCtrl specifying the EthIf Controller where the IP address shall be assigned.
        reference TcpIpLocalAddrIPv6ExtHeaderFilterRef [0..1]: multiplicity set at link in variant link-time / post-build in variant post-build / pre-compile in variant pre-compile, post-build-variant-multiplicity=true, post-build-variant-value=true, set at link in variant link-time / post-build in variant post-build / pre-compile in variant pre-compile, destination=TcpIpIpV6ConfigExtHeaderFilter  # Reference to a set of IPv6 Extension Headers which are allowed for this local IPv6 address. | Note: this parameter is only relevant if the related TcpIpDomainType is TCPIP_AF_INET6.
        container TcpIpAddrAssignment [1..*]  # This container is a subcontainer of TcpIpLocalAddr and specifies the assignment policy for the IP address.
          enumeration TcpIpAssignmentLifetime [0..1]: {TCPIP_FORGET, TCPIP_STORE}, post-build-variant-value=true, set at link in variant link-time / post-build in variant post-build / pre-compile in variant pre-compile, default-value=TCPIP_FORGET  # Defines the lifetime of a dynamically fetched IP address. | If TcpIpAssignmentMethod = TCPIP_STATIC then TcpIpAssignmentLifetime shall be omitted.
          enumeration TcpIpAssignmentMethod: {TCPIP_DHCP, TCPIP_IPV6_ROUTER, TCPIP_LINKLOCAL, TCPIP_LINKLOCAL_DOIP, TCPIP_STATIC}, post-build-variant-value=true, set at link in variant link-time / post-build in variant post-build / pre-compile in variant pre-compile  # Method of address assignment
          integer TcpIpAssignmentPriority: 1..4, post-build-variant-value=true, set at link in variant link-time / post-build in variant post-build / pre-compile in variant pre-compile  # Priority of assignment (1 is highest). If a new address from an assignment method with a higher priority is available, it overwrites the IP address previously assigned by an assignment method with a lower priority.
          enumeration TcpIpAssignmentTrigger: {TCPIP_AUTOMATIC, TCPIP_MANUAL}, post-build-variant-value=true, set at link in variant link-time / post-build in variant post-build / pre-compile in variant pre-compile  # Trigger of address assignment.
        container TcpIpStaticIpAddressConfig [0..1]  # This container is a subcontainer of TcpIpLocalAddr and specifies a static IP address including directly related parameters.
          string TcpIpDefaultRouter [0..1]: multiplicity set at link in variant link-time / post-build in variant post-build / pre-compile in variant pre-compile, post-build-variant-multiplicity=true, post-build-variant-value=true, set at link in variant link-time / post-build in variant post-build / pre-compile in variant pre-compile  # IP address of default router (gateway)
          integer TcpIpNetmask [0..1]: 0..128, multiplicity set at link in variant link-time / post-build in variant post-build / pre-compile in variant pre-compile, post-build-variant-multiplicity=true, post-build-variant-value=true, set at link in variant link-time / post-build in variant post-build / pre-compile in variant pre-compile  # Network mask of IPv4 address or address prefix of IPv6 address in CIDR Notation, i.e. decimal value between 0 and 32 (IPv4) or 0 and 128 (IPv6) that describes the number of significant bits defining the network number or prefix of an IP address.
          string TcpIpStaticIpAddress: post-build-variant-value=true, set at link in variant link-time / post-build in variant post-build / pre-compile in variant pre-compile  # Static IP Address. | To specify any IP address for a certain EthIfCtrl, "ANY" has to be set as wildcard. See TcpIp_Bind() for more details.
      container TcpIpNvmBlock [0..1]: multiplicity set at link in variant link-time+post-build / pre-compile in variant pre-compile  # Configuration of optional usage of Nvm in case the TcpIp module requires non volatile memory in the Ecu to store information (e.g. IP Address received via DHCP and shall be stored).
        reference TcpIpNvmBlockDescriptorRef: scope=ECU, set at link in variant link-time+post-build / pre-compile in variant pre-compile, requires-symbolic-name-value=true, destination=NvMBlockDescriptor  # Reference to the Nvm block description in the Nvm module configuration.
      container TcpIpPhysAddrConfig [0..1]  # Specifies the physical address configuration.
        container TcpIpPhysAddrChgHandler [0..1]  # This container is a subcontainer of TcpIpPhysAddrConfig and | specifies the configuration parameters for physical address change handler.
          function name TcpIpPhysAddrChgHandlerName: scope=ECU, set at pre-compile  # This parameter defines the name of the physical address change function <Up>_PhysAddrTableChg.
      container TcpIpSocketOwnerConfig  # Specifies the upper layer modules of TcpIp using the socket API.
        container TcpIpSocketOwner [1..*]  # This container is a subcontainer of TcpIpSocketOwnerConfig and specifies an upper layer of TcpIp that uses the socket API.
          string TcpIpSocketOwnerCopyTxDataName [0..1]: set at link in variant link-time+post-build / pre-compile in variant pre-compile  # This parameter defines the name of the <Up_CopyTxData> function of the TcpIpSocketOwner module. The function name shall only be configurable if TcpIpSocketOwnerUpperLayerType is set to CDD.
          string TcpIpSocketOwnerHeaderFileName [0..1]: set at link in variant link-time+post-build / pre-compile in variant pre-compile  # This parameter specifies the name of the header file containing the definition of the TcpIpSocketOwner module functions. The header file name shall only be configurable if TcpIpSocketOwnerUpperLayerType is set to CDD.
          integer TcpIpSocketOwnerId: 0..65535, set at pre-compile, symbolic-name-value=true, default-value=0  # This value specifies the ID of the socket user.
          string TcpIpSocketOwnerLocalIpAddrAssignmentChgName [0..1]: set at link in variant link-time+post-build / pre-compile in variant pre-compile  # This parameter defines the name of the <Up_LocalIpAddrAssignmentChg> function of the TcpIpSocketOwner module. The function name shall only be configurable if TcpIpSocketOwnerUpperLayerType is set to CDD.
          string TcpIpSocketOwnerRxIndicationName [0..1]: set at link in variant link-time+post-build / pre-compile in variant pre-compile  # This parameter defines the name of the <Up_RxIndication> function of the TcpIpSocketOwner module. The function name shall only be configurable if TcpIpSocketOwnerUpperLayerType is set to CDD.
          string TcpIpSocketOwnerTcpAcceptedName [0..1]: set at link in variant link-time+post-build / pre-compile in variant pre-compile  # This parameter defines the name of the <Up_TcpAccepted> function of the TcpIpSocketOwner module. The function name shall only be configurable if TcpIpSocketOwnerUpperLayerType is set to CDD.
          string TcpIpSocketOwnerTcpConnectedName [0..1]: set at link in variant link-time+post-build / pre-compile in variant pre-compile  # This parameter defines the name of the <Up_TcpConnected> function of the TcpIpSocketOwner module. The function name shall only be configurable if TcpIpSocketOwnerUpperLayerType is set to CDD.
          function name TcpIpSocketOwnerTcpIpEventName [0..1]: set at link in variant link-time+post-build / pre-compile in variant pre-compile  # This parameter defines the name of the <Up_TcpIpEvent> function of the TcpIpSocketOwner module. The function name shall only be configurable if TcpIpSocketOwnerUpperLayerType is set to CDD.
          string TcpIpSocketOwnerTxConfirmationName [0..1]: set at link in variant link-time+post-build / pre-compile in variant pre-compile  # This parameter defines the name of the <Up_TxConfirmation> function of the TcpIpSocketOwner module. The function name shall only be configurable if TcpIpSocketOwnerUpperLayerType is set to CDD.
          enumeration TcpIpSocketOwnerUpperLayerType: {CDD, SOAD}, post-build-variant-value=true, set at link in variant link-time+post-build / pre-compile in variant pre-compile  # This parameter specifies the type of the upper layer module.
      container TcpIpTcpConfig [0..1]  # Specifies the configuration parameters of the TCP (Transmission Control Protocol) sub-module.
        float TcpIpDelayedAckTimeout: 0..0.5, post-build-variant-value=true, set at link in variant link-time / post-build in variant post-build / pre-compile in variant pre-compile, default-value=0.5  # The maximal time an acknowledgment is delayed for transmission in seconds.For further details, see also IETF RfC 1122 section 4.2.3.2.
        boolean TcpIpTcpCongestionAvoidanceEnabled: set at pre-compile  # Enables (TRUE) or disables (FALSE) support of TCP congestion avoidance algorithm according to IETF RFC 5681.
        boolean TcpIpTcpFastRecoveryEnabled: set at pre-compile  # Enables (TRUE) or disables (FALSE) support of TCP Fast Recovery according to IETF RFC 5681.
        boolean TcpIpTcpFastRetransmitEnabled: set at pre-compile  # Enables (TRUE) or disables (FALSE) support of TCP Fast Retransmission according to IETF RFC 5681.
        float TcpIpTcpFinWait2Timeout: 0..INF, post-build-variant-value=true, set at link in variant link-time / post-build in variant post-build / pre-compile in variant pre-compile  # Timeout in [s] to receive a FIN from the remote node (after this node has initiated connection termination), i.e. maximum time waiting in FINWAIT-2 for a connection termination request from the remote TCP.
        boolean TcpIpTcpKeepAliveEnabled: set at pre-compile, default-value=false  # Enables (TRUE) or disables (FALSE) TCP Keep Alive Probes according to IETF RFC 1122 chapter 4.2.3.6
        float TcpIpTcpKeepAliveInterval: 0..INF, post-build-variant-value=true, set at link in variant link-time / post-build in variant post-build / pre-compile in variant pre-compile  # Specifies the interval in [s] between subsequent keepalive probes.
        integer TcpIpTcpKeepAliveProbesMax: 0..65535, post-build-variant-value=true, set at link in variant link-time / post-build in variant post-build / pre-compile in variant pre-compile  # Maximum number of times that a TCP Keep Alive is retransmitted before the connection is closed.
        float TcpIpTcpKeepAliveTime: 0..INF, post-build-variant-value=true, set at link in variant link-time / post-build in variant post-build / pre-compile in variant pre-compile, default-value=7200  # Specifies the time in [s] between the last data packet sent (simple ACKs are not considered data) and the first keepalive probe. Note: Setting this configuration parameter to a value smaller or equal to the value of TcpIpMainFunctionPeriod results in the transmission of keep alive probes within every MainFunction cycle.
        float TcpIpTcpMaxRetransmissionTimeout [0..1]: 0.001..INF, post-build-variant-value=true, set at link in variant link-time / post-build in variant post-build / pre-compile in variant pre-compile  # Maximum value (clamp) of clamped exponential backoff timeout in [s] before an unacknowledged TCP segment is sent again. If the timeout is disabled or set to INF, clamped exponential backoff shall not be used.
        integer TcpIpTcpMaxRtx [0..1]: 0..255, post-build-variant-value=true, set at link in variant link-time / post-build in variant post-build / pre-compile in variant pre-compile  # Maximum number of times that a TCP segment is retransmitted before the TCP connection is closed. This parameter is only valid if TcpIpTcpRetransmissionTimeout/TcpIpTcpMaxRetransmissionTimeout is configured. | Note: This parameter also applies for FIN retransmissions.
        float TcpIpTcpMsl: 0..INF, post-build-variant-value=true, set at link in variant link-time / post-build in variant post-build / pre-compile in variant pre-compile  # Maximum segment lifetime in [s]. | (Note: TIME-WAIT = 2 x TcpIpTcpMsl - to ensure that the remote node received the acknowledgment to its connection termination request.)
        boolean TcpIpTcpNagleEnabled: set at pre-compile  # Enables (TRUE) or disables (FALSE) support of Nagle's algorithm according to IETF RFC 1122 (chapter 4.2.3.4 When to Send Data). If enabled the Nagle's algorithm is activated per default for all TCP sockets, but can be deactivated via TcpIp_ChangeParameter() API.
        integer TcpIpTcpReceiveWindowMax: 0..65535, post-build-variant-value=true, set at link in variant link-time / post-build in variant post-build / pre-compile in variant pre-compile  # Default value of maximum receive window in bytes.
        float TcpIpTcpRetransmissionTimeout [0..1]: 0.001..INF, post-build-variant-value=true, set at link in variant link-time / post-build in variant post-build / pre-compile in variant pre-compile  # Timeout in [s] before an unacknowledged TCP segment is sent again. If the timeout is disabled or set to INF, no TCP segments shall be retransmitted. Value can be overwritten by TcpIp_ChangeParameter() API for a particular connection. If TcpIpTcpMaxRetransmissionTimeout is enabled then TcpIpTcpRetransmissionTimeout or value overwritten by TcpIp_ChangeParameter() API is considered as initial value for first retransmission before the next valid acknowledgment arrives.
        boolean TcpIpTcpSackEnabled: set at pre-compile  # Defines if the SACK (selective acknowledgement) mechanism shall be supported according to IETF RFC 2018. Tags: atp.Status=draft
        boolean TcpIpTcpSlowStartEnabled: set at pre-compile  # Enables (TRUE) or disables (FALSE) support of TCP slow start algorithm according to IETF RFC 5681.
        integer TcpIpTcpSynMaxRtx: 0..255, post-build-variant-value=true, set at link in variant link-time / post-build in variant post-build / pre-compile in variant pre-compile  # Maximum number of times that a TCP SYN is retransmitted. | Note: SYN will be retried after TcpIpTcpRetransmissionTimeout/TcpIpTcpMaxRetransmissionTimeout. The connection will be dropped if no matching connection request has been received after the last TCP SYN has been sent and TcpIpTcpRetransmissionTimeout/TcpIpTcpMaxRetransmissionTimeout has been expired.
        float TcpIpTcpSynReceivedTimeout: 0..INF, post-build-variant-value=true, set at link in variant link-time / post-build in variant post-build / pre-compile in variant pre-compile  # Timeout in [s] to complete a remotely initiated TCP connection establishment, i.e. maximum time waiting in SYN-RECEIVED for a confirming connection request acknowledgment after having both received and sent a connection request.
        integer TcpIpTcpTtl: 1..255, post-build-variant-value=true, set at link in variant link-time / post-build in variant post-build / pre-compile in variant pre-compile  # Default Time-to-live value of outgoing TCP packets.
        integer TcpIpTcpWindowScale: 0..14, set at pre-compile  # Defines the TCP window scale. Tags: atp.Status=draft
        boolean TcpIpTcpWindowScaleOptionEnabled: set at pre-compile, default-value=false  # Defines if the TCP window scale option and mechanism shall be supported according to IETF RFC 7323, chapter 2. Tags: atp.Status=draft
        container TcpIpTcpConfigOptionFilter [0..*]: multiplicity set at link in variant link-time / post-build in variant post-build / pre-compile in variant pre-compile, post-build-variant-multiplicity=true  # This container describes the white list for the filtering of TCP options, i.e. segments containing TCP options not listed here shall be silently dropped.
          integer TcpIpTcpConfigOptionFilterEntry [0..*]: 0..255, multiplicity set at link in variant link-time / post-build in variant post-build / pre-compile in variant pre-compile, post-build-variant-multiplicity=true, post-build-variant-value=true, set at link in variant link-time / post-build in variant post-build / pre-compile in variant pre-compile  # TCP option kind allowed by this filter.
          integer TcpIpTcpConfigOptionFilterId: 0..255, post-build-variant-value=true, set at link in variant link-time / post-build in variant post-build / pre-compile in variant pre-compile, symbolic-name-value=true, with-auto=true  # Identification of the TCP option filter.
      container TcpIpTlsConfig [0..1]  # Specifies the configuration parameters of the TLS (Transport Layer Security) sub module.
        integer TcpIpTlsMaxConnections: 1..65535, set at pre-compile  # Defines the max. number of TLS connections that can be opened at the same time.
        reference TcpIpTlsCsmRandomGenerateJobRef: set at pre-compile, requires-symbolic-name-value=true, destination=CsmJob  # Reference to a CSM job to generate a random value.
        container TcpIpTlsCiphersuites  # This container provides the information about supported ciphersuites used by TLS.
          function name TcpIpTlsRootCertUpdateCalloutFunction [0..1]: multiplicity set at pre-compile, set at pre-compile  # This optional parameter specifies the name of a callout function that is used when a new, valid, root certificate is received during a TLS handshake. Can be used to perform actions based on the received certificate. Tags: atp.Status=draft
          string TcpIpTlsRootCertUpdateCalloutHeaderFile [0..1]: multiplicity set at pre-compile, set at pre-compile  # This optional parameter specifies the name of the header file containing the definition for the function specified in TcpIpTlsRootCertUpdateCalloutFunction. Tags: atp.Status=draft
          container TcpIpTlsCertificateIdentity [1..*]  # This container provides information about the certificates used for ciphersuites.
            string TcpIpTlsServerNameIdentification [0..1]: multiplicity set at pre-compile, set at pre-compile  # Defines a server identification name. If present, the name will be added as an extension with the "TLS client hello" handshake message. The TLS server will check for the name to identify the server certificate.
            reference TcpIpTlsCipherKeyMLocalCertificate [0..1]: multiplicity set at pre-compile, set at pre-compile, requires-symbolic-name-value=true, destination=KeyMCertificate  # Reference to a KeyM certificate used to address the local certificate.
            reference TcpIpTlsCipherKeyMRemoteCertificate [0..1]: multiplicity set at pre-compile, set at pre-compile, requires-symbolic-name-value=true, destination=KeyMCertificate  # Reference to KeyM certificate container to reference the remote certificate.
            container TcpIpTlsTrustedCAList [0..1]: multiplicity set at pre-compile  # This container contains references to trusted CA certificates, whose names are sent in the client's ClientHello message, if *TcpIpTlsUseExtensionTrustedCAKeys* is set to TRUE. Tags: atp.Status=draft
              reference TcpIpTlsTrustedCAListEntry [0..*]: multiplicity set at pre-compile, set at pre-compile, requires-symbolic-name-value=true, destination=KeyMCertificate  # Reference to a KeyM certificate of a root CA. The list is sent by the TLS client in the Client Hello's trusted_ca_keys extension Tags: atp.Status=draft
          container TcpIpTlsCiphersuiteDefinition [1..*]  # This container provides the static information of a ciphersuite used by TLS.
            integer TcpIpTlsCiphersuiteId: 0..65535, set at pre-compile  # ID that represents the ciphersuite according to IETF, e.g. RFC4492, Sect. 6, RFC8446, Appendix B.4 or RFC5246, Appendix A.5.
            string TcpIpTlsCiphersuiteName [0..1]: set at pre-compile  # Provides a verbal name for the ciphersuite. The name should be the one defined in the respective RFC, e.g. TLS_ECDHE_ECDSA_WITH_AES_128_CBC_SHA256 (TLS 1.2) or TLS_AES_128_GCM_SHA256 (TLS 1.3)
            integer TcpIpTlsCiphersuitePriority: 1..65535, set at pre-compile  # Defines the priority of the cipher. The higher the number the lower the priority.
            boolean TcpIpTlsUseAEADCipher: set at pre-compile, default-value=false  # Specifies if the ciphersuite supports AEAD for data en-/decryption.
            boolean TcpIpTlsUsePresharedKeys: set at pre-compile, default-value=false  # Defines if this ciphersuite uses pre-shared keys. If so, additional configuration or callbacks will be used for pre-shared key negotiation.
            boolean TcpIpTlsUseSecurityExtensionForceEncryptThenMac: set at pre-compile, default-value=false  # Defines if the security extension according to IETF RFC 7366 shall be supported. This is useful for ciphersuites using CBC mode.
            enumeration TcpIpTlsVersion: {TLS_VERSION_V12, TLS_VERSION_V13}, set at pre-compile  # Declares the TLS version that this ciphersuite shall be used for.
          container TcpIpTlsCiphersuiteWorker [1..*]  # This container provides the jobs and keys necessary for TLS data transmission and reception.
            integer TcpIpTlsCipherAEADCipherKeyLength [0..1]: 1..65535, multiplicity set at pre-compile, set at pre-compile  # Defines the key length for en- / decryption with authentication data (AEAD).
            integer TcpIpTlsCipherEncryptKeyLength [0..1]: 1..65535, set at pre-compile  # Defines the key length used for en- or decryption. The key length is valid for (symmetric) encryption and decryption.
            integer TcpIpTlsCipherMacKeyLength [0..1]: 1..65535, set at pre-compile  # Specifies the length of the MAC key
            reference TcpIpTlsCipherCsmDecryptJobRef [0..1]: set at pre-compile, requires-symbolic-name-value=true, destination=CsmJob  # Reference to a CSM job to perform the data decryption operation
            reference TcpIpTlsCipherCsmDecryptKeyRef [0..1]: set at pre-compile, requires-symbolic-name-value=true, destination=CsmKey  # Reference to a CSM key associated to the CSM job that performs the data decryption operation
            reference TcpIpTlsCipherCsmEncryptJobRef [0..1]: set at pre-compile, requires-symbolic-name-value=true, destination=CsmJob  # Reference to a CSM job to perform the data encryption operation
            reference TcpIpTlsCipherCsmEncryptKeyRef [0..1]: set at pre-compile, requires-symbolic-name-value=true, destination=CsmKey  # Reference to a CSM key associated to the CSM job that performs the data encryption operation
            reference TcpIpTlsCipherCsmMacGenerateJobRef: set at pre-compile, requires-symbolic-name-value=true, destination=CsmJob  # Reference to a CSM job to perform the MAC generate operation
            reference TcpIpTlsCipherCsmMacGenerateKeyRef: set at pre-compile, requires-symbolic-name-value=true, destination=CsmKey  # Reference to a CSM key associated to the CSM job that performs the MAC generate operation
            reference TcpIpTlsCipherCsmMacVerifyJobRef: set at pre-compile, requires-symbolic-name-value=true, destination=CsmJob  # Reference to a CSM job to perform the MAC verify operation
            reference TcpIpTlsCipherCsmMacVerifyKeyRef: set at pre-compile, requires-symbolic-name-value=true, destination=CsmKey  # Reference to a CSM key associated to the CSM job that performs the MAC verify operation
            reference TcpIpTlsCiphersuiteDefinitionRef: set at pre-compile, destination=TcpIpTlsCiphersuiteDefinition  # Reference to a ciphersuite definition container
            reference TcpIpTlsConnectionHandshakeRef [1..*]: multiplicity set at pre-compile, set at pre-compile, destination=TcpIpTlsHandshake  # References the container that contains the jobs and keys for handshake operation. | Referencing multiple handshake containers allow to share them between workers and to choose the next unused during the handshake.
          container TcpIpTlsHandshake [1..*]  # This container provides information that is needed to process a handshake. It contains the appropriate references to jobs and keys of the CSM to perform the key exchange cryptographic for the ciphersuite and involved certificates.
            enumeration TcpIpTlsCsmPRFSupportType [0..1]: {TLS_PRF_CSM_FULL_SUPPORT, TLS_PRF_CSM_INOUT_REDIRECT_SUPPORT, TLS_PRF_CSM_NO_SUPPORT, TLS_PRF_NO_SUPPORT}, multiplicity set at pre-compile, set at pre-compile  # Specifies how the CSM job supports the PRF operation.
            reference TcpIpTlsCsmHashVerifyJobRef: set at pre-compile, requires-symbolic-name-value=true, destination=CsmJob  # Reference to a CSM job to perform the hash operation for the whole handshake.
            reference TcpIpTlsCsmKeyExchangeCalcPubValJobRef [0..1]: multiplicity set at pre-compile, set at pre-compile, requires-symbolic-name-value=true, destination=CsmJob  # Reference to a CSM job to perform the DH Key Exchange algorithm operation
            reference TcpIpTlsCsmKeyExchangeCalcSecretJobRef [0..1]: multiplicity set at pre-compile, set at pre-compile, requires-symbolic-name-value=true, destination=CsmJob  # Reference to a CSM job to perform the Key Exchange algorithm operation
            reference TcpIpTlsCsmKeyExchangeDecryptJobRef [0..1]: multiplicity set at pre-compile, set at pre-compile, requires-symbolic-name-value=true, destination=CsmJob  # Reference to a CSM job to perform data decryption, e.g. with RSA key exchange operation.
            reference TcpIpTlsCsmKeyExchangeDecryptKeyRef [0..1]: multiplicity set at pre-compile, set at pre-compile, requires-symbolic-name-value=true, destination=CsmKey  # Reference to a CSM key to perform data decryption, e.g. with RSA, used for exchange operation.
            reference TcpIpTlsCsmKeyExchangeEncryptJobRef [0..1]: multiplicity set at pre-compile, set at pre-compile, requires-symbolic-name-value=true, destination=CsmJob  # Reference to a CSM job to perform data encryption, e.g. with RSA key exchange operation.
            reference TcpIpTlsCsmKeyExchangeEncryptKeyRef [0..1]: multiplicity set at pre-compile, set at pre-compile, requires-symbolic-name-value=true, destination=CsmKey  # Reference to a CSM key to perform data encryption, e.g. with RSA, used for exchange operation.
            reference TcpIpTlsCsmKeyExchangeKeyRef [0..1]: multiplicity set at pre-compile, set at pre-compile, requires-symbolic-name-value=true, destination=CsmKey  # Reference to a CSM key used for Diffie Hellman (DH) key exchange operation.
            reference TcpIpTlsCsmKeyExchangeSignatureGenerateJobRef [0..1]: multiplicity set at pre-compile, set at pre-compile, requires-symbolic-name-value=true, destination=CsmJob  # Reference to a CSM job to perform signature generation for DH operation
            reference TcpIpTlsCsmKeyExchangeSignatureGenerateKeyRef [0..1]: multiplicity set at pre-compile, set at pre-compile, requires-symbolic-name-value=true, destination=CsmKey  # Reference to a CSM key to perform signature generation for DH operation
            reference TcpIpTlsCsmKeyExchangeSignatureVerifyJobRef [0..1]: multiplicity set at pre-compile, set at pre-compile, requires-symbolic-name-value=true, destination=CsmJob  # Reference to a CSM job to perform signature verification for DH operation
            reference TcpIpTlsCsmKeyExchangeSignatureVerifyKeyRef [0..1]: multiplicity set at pre-compile, set at pre-compile, requires-symbolic-name-value=true, destination=CsmKey  # Reference to a CSM key to perform signature verification for DH operation
            reference TcpIpTlsCsmMasterSecretKeyRef [0..1]: multiplicity set at pre-compile, set at pre-compile, requires-symbolic-name-value=true, destination=CsmKey  # This is the reference to the master key that is calculated during the session.
            reference TcpIpTlsCsmPrfMacJobRef: set at pre-compile, requires-symbolic-name-value=true, destination=CsmJob  # Reference to a CSM job to perform the PRF hash operation
            reference TcpIpTlsCsmPrfMacKeyRef: set at pre-compile, requires-symbolic-name-value=true, destination=CsmKey  # Reference to a CSM key associated to the CSM job that performs the PRF hash operation
          container TcpIpTlsPskIdentity [0..*]  # This container provides information about static definition of pre-shared keys. It is used during the handshake to negotiate pre-shared keys between a client and a server. | Note: The callbacks for pre-shared keys are an alternative to the static definition. The callbacks allow to define the associated keys at runtime if pre-shared keys are used but no static definition is available. The container definition is used for static configuration.
            string TcpIpTlsPresharedKeyIdentity [0..1]: multiplicity set at pre-compile, set at pre-compile  # This item provides the key identification. The TLS client selects the pre-shared key based on the identification hint provided by the server and returns the key identification name back to the server.
            string TcpIpTlsPresharedKeyIdentityHint [0..1]: multiplicity set at pre-compile, set at pre-compile  # Provides the identity hint for a pre-shared key. This information is transmitted by the TLS Server to provide its identification to the TLS client. | The TLS client uses the same information to select the pre-shared key.
            function name TcpIpTlsPskGetClientKeyIdentityFunc [0..1]: multiplicity set at pre-compile, set at pre-compile  # Defines the function name for the Up_TlsClientGetPskIdentity() callback.
            function name TcpIpTlsPskGetKeyIdentityHintFunc [0..1]: multiplicity set at pre-compile, set at pre-compile  # Defines the function name for the Up_TlsServerGetPskIdentityHint() callback.
            function name TcpIpTlsPskGetServerKeyIdentityFunc [0..1]: multiplicity set at pre-compile, set at pre-compile  # Defines the function name for the Up_TlsServerGetPskIdentity () callback.
            reference TcpIpTlsPresharedKeyCsmKeyRef [0..1]: multiplicity set at pre-compile, set at pre-compile, requires-symbolic-name-value=true, destination=CsmKey  # Reference to a CSM key associated to the CSM job that performs the PRF hash operation
        container TcpIpTlsConnection [1..*]  # This container defines the properties of a TLS connection
          function name TcpIpTlsConnectionGetTimeFunc [0..1]: multiplicity set at pre-compile, set at pre-compile  # Defines the function name for the Up_TlsGetCurrentTimeStamp() callback.
          integer TcpIpTlsConnectionId: 0..65535, set at pre-compile, symbolic-name-value=true  # Identifier of the connection. The set of configured identifiers shall be consecutive and gapless.
          enumeration TcpIpTlsConnectionType: {TLS_CLIENT, TLS_SERVER}, set at pre-compile  # Specifies if the TLS connection is a server or a client.
          integer TcpIpTlsMaxFragmentLength: 1..16384, set at pre-compile  # Specifies the max length in bytes of a TLS fragment that is sent as a block. | If ISO 15118-2 shall be supported, the range is 512 .. 16384.
          integer TcpIpTlsPortAssignment [0..1]: 1..65535, multiplicity set at pre-compile, set at pre-compile  # Specifies the port address that is used for TLS communication.
          boolean TcpIpTlsUseClientAuthenticationRequest [0..1]: multiplicity set at pre-compile, set at pre-compile, default-value=false  # Defines if client authentication shall be applied for this TLS connection.
          boolean TcpIpTlsUseExtensionCertificateStatusRequest: set at pre-compile, default-value=false  # Defines if the optional extension status_request_v2 shall be supported. Tags: atp.Status=draft
          boolean TcpIpTlsUseExtensionMaxFragmentLength: set at pre-compile, default-value=false  # Defines if the optional extension for max_fragment_length shall be supported. Tags: atp.Status=draft
          boolean TcpIpTlsUseExtensionRecordSizeLimit: set at pre-compile, default-value=false  # Defines if the security extension for record_size_limit shall be supported as defined in IETF RFC 8449, chapter 4.1.
          boolean TcpIpTlsUseExtensionTrustedCAKeys: set at pre-compile, default-value=false  # Defines if the optional extension for trusted_ca_keys shall be supported Tags: atp.Status=draft
          reference TcpIpTlsCertificateIdentityRef [1..*]: multiplicity set at pre-compile, set at pre-compile, destination=TcpIpTlsCertificateIdentity  # References the container that contains the certificate and identity information.
          reference TcpIpTlsConnectionCiphersuiteWorkerRef [1..*]: multiplicity set at pre-compile, set at pre-compile, destination=TcpIpTlsCiphersuiteWorker  # References the container that contains the jobs and keys to process the application data.
          reference TcpIpTlsConnectionGroupRef [0..1]: multiplicity set at pre-compile, set at pre-compile, destination=TcpIpTlsConnectionGroup  # Assigns the TLS connection to a connection group.
          reference TcpIpTlsConnectionPskIdentityRef [0..*]: multiplicity set at pre-compile, set at pre-compile, destination=TcpIpTlsPskIdentity  # References the container that contains information about pre-shared keys.
          reference TcpIpTlsIpAddressAssignment [0..1]: multiplicity set at pre-compile, set at pre-compile, destination=TcpIpStaticIpAddressConfig  # Contains additional information about the endpoint IP address information. If this reference is present, the IP address of the connecting socket shall also be checked if a TLS connection shall be assigned automatically to a socket.
        container TcpIpTlsConnectionGroup [0..*]  # This optional container is used to collect all TlsConnections that belong to a TlsConnectionGroup. The intention of a TLS connection group is to share resources among TLS connections collected in a group, because only one connection of a group can be used at a time.
      container TcpIpUdpConfig [0..1]  # Specifies the configuration parameters of the UDP (User Datagram Protocol) sub-module
        integer TcpIpUdpTtl: 1..255, post-build-variant-value=true, set at link in variant link-time / post-build in variant post-build / pre-compile in variant pre-compile  # Default Time-to-live value of outgoing UDP packets.
    container TcpIpGeneral  # This container is a subcontainer of TcpIp and specifies the general configuration parameters of the TCP/IP stack.
      integer TcpIpBufferMemory: 0..4294967295, set at link in variant link-time+post-build / pre-compile in variant pre-compile  # Memory size in bytes reserved for TCP/IP buffers.
      boolean TcpIpDevErrorDetect: set at pre-compile, default-value=false  # Switches the development error detection and notification on or off. | * true: detection and notification is enabled. * false: detection and notification is disabled.
      boolean TcpIpDhcpServerEnabled: set at pre-compile  # Enables (TRUE) or disables (FALSE) the DHCP (Dynamic Host Configuration Protocol) Server.
      boolean TcpIpEnableSecurityEventReporting: scope=ECU, set at pre-compile, default-value=false  # Switches the reporting of security events to the IdsM: Tags: atp.Status=draft | - true: reporting is enabled. - false: reporting is disabled.
      boolean TcpIpGetAndResetMeasurementDataApi: set at pre-compile  # Enables / Disables the Get and Reset Measurement Data API
      float TcpIpMainFunctionPeriod: 0..INF, set at link in variant link-time+post-build / pre-compile in variant pre-compile  # Period of TcpIp_MainFunction in [s].
      boolean TcpIpResetIpAssignmentApi: set at pre-compile  # Enables/disables the API TcpIp_ResetIpAssignment of a DHCP-client.
      enumeration TcpIpScalabilityClass: {SC1, SC2, SC3}, set at pre-compile  # In order to customize the TcpIp Stack to the specific needs of the user it can be scaled according to the scalability classes.
      boolean TcpIpTcpEnabled: set at pre-compile  # Enables (TRUE) or disabled (FALSE) support of TCP (Transmission Control Protocol).
      integer TcpIpTcpSocketMax: 0..65535, set at pre-compile  # Maximum number of TCP sockets
      boolean TcpIpUdpEnabled: set at pre-compile  # Enables (TRUE) or disabled (FALSE) support of UDP (User Datagram Protocol)
      integer TcpIpUdpSocketMax: 0..65535, set at pre-compile  # Maximum number of UDP sockets.
      boolean TcpIpVersionInfoApi: set at pre-compile, default-value=false  # If true the TcpIp_GetVersionInfo API is available.
      container TcpIpIpV4General  # This container is a subcontainer of TcpIp and specifies the general configuration parameters of the TCP/IP stack for IPv4
        boolean TcpIpArpEnabled: set at pre-compile  # Enables (TRUE) or disables (FALSE) support of ARP (Address Resolution Protocol).
        boolean TcpIpAutoIpEnabled: set at pre-compile  # Enables (TRUE) or disables (FALSE) the Auto-IP (automatic private IP addressing) sub-module.
        boolean TcpIpDhcpClientEnabled: set at pre-compile  # Enables (TRUE) or disables (FALSE) the DHCP (Dynamic Host Configuration Protocol) Client.
        boolean TcpIpIcmpEnabled: set at pre-compile  # Enables (TRUE) or disabled (FALSE) support of ICMP (Internet Control Message Protocol).
        boolean TcpIpIpV4Enabled: set at pre-compile  # Enables (TRUE) or disables (FALSE) support of IPv4 (Internet Protocol version 4).
        integer TcpIpLocalAddrIpv4EntriesMax: 0..255, set at pre-compile  # Maximum number of LocalAddr table entries for IPv4.
        boolean TcpIpPathMtuDiscoveryEnabled: set at pre-compile  # Enables (TRUE) or disables (FALSE) the discovery of the maximum transmission unit on a path according to IETF RfC 1191.
      container TcpIpIpV6General  # This container is a subcontainer of TcpIp and specifies the general configuration parameters of the TCP/IP stack for IPv6.
        boolean TcpIpDhcpV6ClientEnabled: set at pre-compile  # Enables (TRUE) or disables (FALSE) the DHCPv6 (Dynamic Host Configuration Protocol for IPv6) Client.
        boolean TcpIpIpV6Enabled: set at pre-compile  # Enables (TRUE) or disables (FALSE) support of IPv6 (Internet Protocol version 6).
        boolean TcpIpIpV6PathMtuDiscoveryEnabled: set at pre-compile  # Enables (TRUE) or disables (FALSE) Path MTU Discovery support for IPv6 according to IETF RFC 1981.
        integer TcpIpLocalAddrIpv6EntriesMax: 0..255, set at pre-compile  # Maximum number of LocalAddr table entries for IPv6.
        boolean TcpIpNdpAddressResolutionUnrechabilityDetectionEnabled: set at pre-compile  # Enables (TRUE) or disables (FALSE) support of Address Resoultion and Neighbor Unreachability Detetion via NDP.
        boolean TcpIpNdpPrefixAndRouterDiscoveryEnabled: set at pre-compile  # Enables (TRUE) or disables (FALSE) support of Prefix and Router Discovery via NDP.
      container TcpIpSecurityEventRefs [0..1]: multiplicity set at pre-compile  # Container for the references to IdsMEvent elements representing the security events that the TcpIp module shall report to the IdsM in case the coresponding security related event occurs (and if TcpIpEnableSecurityEventReporting is set to "true"). The standardized security events in this container can be extended by vendor-specific security events. Tags: atp.Status=draft
        reference SEV_ARP_IP_ADDR_CONFLICT [0..1]: multiplicity set at pre-compile, set at pre-compile, requires-symbolic-name-value=true, destination=IdsMEvent  # Received local IP address in ARP reply for different MAC. Tags: atp.Status=draft
        reference SEV_IPV4_DROP_INV_ADDR [0..1]: multiplicity set at pre-compile, set at pre-compile, requires-symbolic-name-value=true, destination=IdsMEvent  # Dropped datagram because of invalid IPV4 address. Tags: atp.Status=draft
        reference SEV_IPV6_DROP_INV_ADDR [0..1]: multiplicity set at pre-compile, set at pre-compile, requires-symbolic-name-value=true, destination=IdsMEvent  # Dropped datagram because of invalid IPV6 address. Tags: atp.Status=draft
        reference SEV_TCP_DROP_INV_PORT [0..1]: multiplicity set at pre-compile, set at pre-compile, requires-symbolic-name-value=true, destination=IdsMEvent  # Dropped TCP packet because of invalid destination TCP-Port. Tags: atp.Status=draft
        reference SEV_TLS_CONNECTION_CLOSED [0..1]: multiplicity set at pre-compile, set at pre-compile, requires-symbolic-name-value=true, destination=IdsMEvent  # A TLS connection was closed normally. Tags: atp.Status=draft
        reference SEV_TLS_CONNECTION_ESTABLISHED [0..1]: multiplicity set at pre-compile, set at pre-compile, requires-symbolic-name-value=true, destination=IdsMEvent  # A TLS connection was successfully established. Tags: atp.Status=draft
        reference SEV_TLS_ERROR [0..1]: multiplicity set at pre-compile, set at pre-compile, requires-symbolic-name-value=true, destination=IdsMEvent  # An alert message was detected (either received or generated) by TLS. Tags: atp.Status=draft
        reference SEV_UDP_DROP_INV_PORT [0..1]: multiplicity set at pre-compile, set at pre-compile, requires-symbolic-name-value=true, destination=IdsMEvent  # Dropped UDP packet because of invalid destination UDP-Port. Tags: atp.Status=draft
