AUTOSAR XML (schema 00053)
package /AUTOSAR/EcucDefs
  ecuc definition collection AUTOSARParameterDefinition: module=Crc
  module definition Crc [0..1]: variants pre-compile  # Configuration of the Crc (Crc routines) module.
    container CrcGeneral  # General configuration of CRC module
      enumeration Crc16ARCMode [0..1]: {CRC_16_ARC_HARDWARE, CRC_16_ARC_RUNTIME, CRC_16_ARC_TABLE}, multiplicity set at pre-compile, set at pre-compile  # Switch to select one of the available CRC-16/ARC (polynomial 8005) calculation methods
      enumeration Crc16Mode [0..1]: {CRC_16_HARDWARE, CRC_16_RUNTIME, CRC_16_TABLE}, multiplicity set at pre-compile, set at pre-compile  # Switch to select one of the available CRC 16-bit (CCITT) calculation methods
      enumeration Crc32Mode [0..1]: {CRC_32_HARDWARE, CRC_32_RUNTIME, CRC_32_TABLE}, multiplicity set at pre-compile, set at pre-compile  # Switch to select one of the available CRC 32-bit (IEEE-802.3 CRC32 Ethernet Standard) calculation methods
      enumeration Crc32P4Mode [0..1]: {CRC_32P4_HARDWARE, CRC_32P4_RUNTIME, CRC_32P4_TABLE}, multiplicity set at pre-compile, set at pre-compile  # Switch to select one of the available CRC 32-bit E2E Profile 4 calculation methods.
      enumeration Crc32P76Mode [0..1]: multiplicity set at pre-compile, set at pre-compile, default-value=CRC_32P76_TABLE  # Switch to select one of the available CRC 32-bit SAE J1939-76 calculation methods. Tags: atp.Status=draft
        CRC_32P76_HARDWARE  # Tags: atp.Status=draft
        CRC_32P76_RUNTIME  # Tags: atp.Status=draft
        CRC_32P76_TABLE  # Tags: atp.Status=draft
      enumeration Crc64Mode [0..1]: {CRC_64_HARDWARE, CRC_64_RUNTIME, CRC_64_TABLE}, multiplicity set at pre-compile, set at pre-compile  # Switch to select one of the available CRC 64-bit calculation methods.
      enumeration Crc8H2FMode [0..1]: {CRC_8H2F_HARDWARE, CRC_8H2F_RUNTIME, CRC_8H2F_TABLE}, multiplicity set at pre-compile, set at pre-compile  # Switch to select one of the available CRC 8-bit (2Fh polynomial) calculation methods
      enumeration Crc8Mode [0..1]: {CRC_8_HARDWARE, CRC_8_RUNTIME, CRC_8_TABLE}, multiplicity set at pre-compile, set at pre-compile  # Switch to select one of the available CRC 8-bit (SAE J1850) calculation methods
