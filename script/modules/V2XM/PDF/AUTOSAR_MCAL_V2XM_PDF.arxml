AUTOSAR XML (schema 00046)
package /AUTOSAR/EcucDefs
  ecuc definition collection AUTOSARParameterDefinition: module=V2xM
  module definition V2xM [0..1]: variants pre-compile  # Configuration of the V2xM (V2XManagement) module.
    container V2xMConfig  # This container contains the configuration parameters and sub containers of the AUTOSAR V2xM module.
      container V2xMSecurityConfig  # Configuration of the security services of V2xM.
        boolean V2xMSecurityVerificationOnDemand: set at pre-compile  # Switches the Verification on Demand (VoD) ON or OFF. | * true: enabled (ON) * false: disabled (OFF)
        reference V2xMSecurityNvMBlockDescriptorLongTermCertificates: set at pre-compile, requires-symbolic-name-value=true, destination=NvMBlockDescriptor  # Reference to NVRAM block containing the none volatile data of long term certificates.
        reference V2xMSecurityNvMBlockDescriptorPseudonymCertificates: set at pre-compile, requires-symbolic-name-value=true, destination=NvMBlockDescriptor  # Reference to NVRAM block containing the none volatile data of pseudonym certificates.
        reference V2xMSignatureGenerationConfigRef: set at pre-compile, destination=CsmSignatureGenerateConfig  # Select CSM service configuration that is used for authentication.
        reference V2xMSignatureVerifyConfigRef: set at pre-compile, destination=CsmSignatureVerifyConfig  # Select CSM service configuration that is used for authentication.
    container V2xMGeneral  # General configuration of V2xM module.
      boolean V2xMDevErrorDetect: set at pre-compile, default-value=false  # Switches the Default Error Tracer (Det) detection and notification ON or OFF. | - true: enabled (ON) - false: disabled (OFF)
      float V2xMMainFunctionPeriod: 0..0.1, set at pre-compile, default-value=0.1  # This parameter defines the schedule period of V2xM_MainFunction.Unit: [s]
      boolean V2xMVersionInfoApi: set at pre-compile, default-value=false  # Enable/disables the API for reading the version information of the V2xM Module. | - true: enabled (ON) - false: disabled (OFF)
      reference V2xMEthIfCtrlRef: set at pre-compile, requires-symbolic-name-value=true, destination=EthIfController  # Reference to EthIf controller where the channel and radio parameters should be read and written to.
      reference V2xMGptChannelConfigurationRef [0..1]: set at pre-compile, requires-symbolic-name-value=true, destination=GptChannelConfiguration  # Reference to General Purpose Timer.
      reference V2xMNvMBlockDescriptor: set at pre-compile, requires-symbolic-name-value=true, destination=NvMBlockDescriptor  # Reference to NVRAM block containing the none volatile data.
      reference V2xMStbMSynchronizedTimeBaseRef [0..1]: set at pre-compile, requires-symbolic-name-value=true, destination=StbMSynchronizedTimeBase  # Reference to synchronized time-base.
