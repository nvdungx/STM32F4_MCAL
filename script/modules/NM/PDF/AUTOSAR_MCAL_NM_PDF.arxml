AUTOSAR XML (schema 00053)
package /AUTOSAR/EcucDefs
  ecuc definition collection AUTOSARParameterDefinition: module=Nm
  module definition Nm [0..1]: variants link-time/pre-compile  # The Generic Network Management Interface module
    container NmChannelConfig [1..*]  # This container contains the configuration (parameters) of the bus channel(s). The channel parameter shall be harmonized within the whole communication stack.
      boolean NmActiveCoordinator [0..1]: multiplicity set at pre-compile, set at pre-compile  # This parameter indicates whether a NM channel - part of a Nm Coordination cluster - will be coordinated actively (NmActiveCoordinator = TRUE) or passively (NmActiveCoordinator = FALSE).
      boolean NmChannelSleepMaster: set at link in variant link-time / pre-compile in variant pre-compile  # This parameter shall be set to indicate if the sleep of this network can be absolutely decided by the local node only and that no other nodes can oppose that decision. | If this parameter is set to TRUE, the Nm shall assume that the channel is always ready to go to sleep and that no calls to Nm_RemoteSleepIndication or Nm_RemoteSleepCancellation will be made from the <Bus>Nm representing this channel. If this parameter is set to FALSE, the Nm shall not assume that the network is ready to sleep until a call has been made to Nm_RemoteSleepCancellation.
      boolean NmComUserDataSupport [0..1]: multiplicity set at pre-compile, set at pre-compile, default-value=false  # This parameter indicates whether on a NM channel user data is accessed via Com signals or by SetUserData API.
      integer NmCoordClusterIndex [0..1]: 0..255, multiplicity set at link in variant link-time / pre-compile in variant pre-compile, set at link in variant link-time / pre-compile in variant pre-compile  # If this parameter is undefined for a channel, the corresponding bus does not belong to an NM coordination cluster.
      boolean NmDynamicPncToChannelMappingEnabled [0..1]: set at link in variant link-time / pre-compile in variant pre-compile, default-value=false  # Channel-specific parameter to enable the dynamic PNC-to-channel-mapping feature. Tags: atp.Status=draft | False: Dynamic PNC-to-channel-mapping is disabled True: Dynamic PNC-to-channel-mapping is enabled
      boolean NmPassiveModeEnabled: set at pre-compile  # This parameter indicates whether a NM channel is active,e.g. can request communication and keep the bus awake, or passive, e.g. can just be woken up and kept awake by other ECUs.
      integer NmPncBitVectorLength: 0..63, scope=ECU, set at link in variant link-time / pre-compile in variant pre-compile, default-value=0  # Parameter to configure the length of the PNC bit request information in bytes, which is transmitted within NM PDU by the corresponding <Bus>Nm.
      boolean NmPnEnabled [0..1]: multiplicity set at link in variant link-time / pre-compile in variant pre-compile, set at link in variant link-time / pre-compile in variant pre-compile, default-value=false  # If this parameter is true, then this NM channel supports Partial Networking.
      boolean NmPnEraCalcEnabled [0..1]: multiplicity set at link in variant link-time / pre-compile in variant pre-compile, set at link in variant link-time / pre-compile in variant pre-compile, default-value=false  # Specifies if NmIf calculates the PN request information for external requests. (ERA)
      boolean NmStateReportEnabled: set at pre-compile  # Specifies if the NMS shall be set for the corresponding network. | false: No NMS shall be set true: The NMS shall be set
      boolean NmSynchronizingNetwork: set at link in variant link-time / pre-compile in variant pre-compile  # If this parameter is true, then this network is a synchronizing network for the NM coordination cluster which it belongs to. The network is expected to call Nm_SynchronizationPoint() at regular intervals.
      reference NmComMChannelRef: set at link in variant link-time / pre-compile in variant pre-compile, requires-symbolic-name-value=true, destination=ComMChannel  # Reference to the corresponding ComM Channel.
      reference NmStateReportSignalRef [0..1]: multiplicity set at pre-compile, set at pre-compile, requires-symbolic-name-value=true, destination=ComSignal  # Reference to the signal for setting the NMS by calling Com_SendSignal for the respective channel.
      choice container NmBusType
        container NmGenericBusNmConfig [0..1]
          string NmGenericBusNmPrefix: set at link in variant link-time / pre-compile in variant pre-compile  # The prefix which identifies the generic <Bus>Nm. This will be used to determine the API name to be called by Nm for the provided interfaces of the <Bus>Nm. This string will used for the module prefix before the "_" character in the API call name.
          float NmGenericBusNmShutdownTime: 0..INF, set at link in variant link-time / pre-compile in variant pre-compile  # This parameter shall be | used to calculate shutdown delay time.
        container NmStandardBusNmConfig [0..1]
          enumeration NmStandardBusType: {NM_BUSNM_CANNM, NM_BUSNM_FRNM, NM_BUSNM_J1939NM, NM_BUSNM_LOCALNM, NM_BUSNM_UDPNM}, set at link in variant link-time / pre-compile in variant pre-compile  # Identifies the bus type of the channel for standard AUTOSAR <Bus>Nms and is used to determine which set of API calls to be called by Nm for the <Bus>Nms. | Note: The Ethernet bus' NM is UdpNm !
      container NmPnFilterMaskByte [0..63]: multiplicity set at link in variant link-time / pre-compile in variant pre-compile  # Information for the filter of the PNC bit vector.
        integer NmPnFilterMaskByteIndex: 0..62, set at link in variant link-time / pre-compile in variant pre-compile  # Index of the filter mask byte. Specifies the position within the filter mask byte array.
        integer NmPnFilterMaskByteValue: 0..255, set at link in variant link-time / pre-compile in variant pre-compile, default-value=0  # Parameter to configure the filter mask byte.
    container NmGlobalConfig  # This container contains all global configuration parameters of the Nm Interface.
      reference NmEcucPartitionRef [0..1]: multiplicity set at pre-compile, set at pre-compile, destination=EcucPartition  # Reference to EcucPartition, where Nm module is assigned to.
      container NmGlobalConstants
        integer NmNumberOfChannels: 1..255, set at pre-compile  # Number of NM channels allowed within one ECU.
      container NmGlobalFeatures
        boolean NmBusSynchronizationEnabled: set at pre-compile  # Pre-processor switch for enabling bus synchronization support of the <Bus>Nms. This feature is required for NM Coordinator nodes only.
        function name NmCarWakeUpCallout [0..1]: multiplicity set at link in variant link-time / pre-compile in variant pre-compile, set at link in variant link-time / pre-compile in variant pre-compile  # Name of the callout function to be called if Nm_CarWakeUpIndication() is called. If this parameter is not configured, the Nm will call BswM_Nm_CarWakeUpIndication.
        boolean NmCarWakeUpRxEnabled: set at link in variant link-time / pre-compile in variant pre-compile, default-value=false  # Enables or disables CWU detection. | FALSE - CarWakeUp not supported TRUE - CarWakeUp supported
        boolean NmComControlEnabled: set at pre-compile  # Pre-processor switch for enabling the Communication Control support.
        boolean NmCoordinatorSupportEnabled: set at pre-compile, default-value=false  # Pre-processor switch for enabling NM Coordinator support.
        boolean NmCoordinatorSyncSupport: set at link in variant link-time / pre-compile in variant pre-compile  # Enables/disables the coordinator synchronisation support.
        boolean NmDynamicPncToChannelMappingSupport: set at pre-compile  # Precompile time switch to enable the dynamic PNC-to-channel-mapping handling. Tags: atp.Status=draft | False: Dynamic PNC-to-channel-mapping is disabled True: Dynamic PNC-to-channel-mapping is enabled
        float NmGlobalCoordinatorTime [0..1]: 0..INF, multiplicity set at pre-compile, set at pre-compile  # This parameter defines the maximum shutdown time of a connected and coordinated NM-Cluster. | Note:This includes nested connections.
        boolean NmPartialNetworkSupportEnabled [0..1]: multiplicity set at link in variant link-time / pre-compile in variant pre-compile, set at link in variant link-time / pre-compile in variant pre-compile, default-value=false  # Pre-processor switch for enabling the Nm Partial Network support.
        boolean NmPduRxIndicationEnabled: set at pre-compile  # Pre-processor switch for enabling the PDU Rx Indication.
        boolean NmRemoteSleepIndEnabled: set at pre-compile  # Pre-processor switch for enabling Remote Sleep Indication support. This feature is required for a Gateway or Nm Coordinator functionality. | Note that this feature should not be used if all NM channels have Passive Mode enabled.
        boolean NmStateChangeIndEnabled: set at pre-compile  # Pre-processor switch for enabling the Network Management state change notification.
        boolean NmSynchronizedPncShutdownEnabled [0..1]: multiplicity set at link in variant link-time / pre-compile in variant pre-compile, set at link in variant link-time / pre-compile in variant pre-compile, default-value=false  # Enables or disables support of synchronized PNC shutdown. | FALSE: synchronized PNC shutdown is disabled TRUE: synchronized PNC shutdown is enabled
        boolean NmUserDataEnabled: set at pre-compile  # Pre-processor switch for enabling User Data support.
      container NmGlobalProperties
        float NmCycletimeMainFunction [0..1]: 0..INF, multiplicity set at link in variant link-time / pre-compile in variant pre-compile, set at link in variant link-time / pre-compile in variant pre-compile  # The period between successive calls to the Main Function of the NM Interface in seconds.
        boolean NmDevErrorDetect: set at pre-compile, default-value=false  # Switches the development error detection and notification on or off. | * true: detection and notification is enabled. * false: detection and notification is disabled.
        integer NmPncBitVectorOffset [0..1]: 0..63, scope=ECU, set at link in variant link-time / pre-compile in variant pre-compile, default-value=0  # Parameter to configure the offset in bytes of the PNC bit vector that contains the PNC requests, which is transmitted within NM PDU by the corresponding <Bus>Nm.
        boolean NmPnEiraCalcEnabled [0..1]: multiplicity set at link in variant link-time / pre-compile in variant pre-compile, set at link in variant link-time / pre-compile in variant pre-compile, default-value=false  # Specifies if NmIf calculates the PNC request information for internal and external requests (EIRA) | true: PN request are calculated false: PN request are not calculated Note: A PNC coordinator (NmPnEraCalcEnabled set to TRUE) has always set NmPnEiraCalcEnabled to TRUE.
        float NmPnResetTime [0..1]: 0.001..65535, multiplicity set at link in variant link-time / pre-compile in variant pre-compile, set at link in variant link-time / pre-compile in variant pre-compile  # Specifies the runtime of the reset time in seconds. This reset time is valid for the reset of PNC requests in the EIRA and in the ERA. The value shall be the same for every channel. Thus it is a global config parameter.
        float NmPnShutdownMessageRetransmissionDuration [0..1]: 0.001..65.535, multiplicity set at link in variant link-time / pre-compile in variant pre-compile, set at link in variant link-time / pre-compile in variant pre-compile  # Specifies the duration in seconds of the retransmission phase of a PN shutdown message. A retransmission shall be performed per affected NM channel, as long as the PN shutdown message could not be successfully sent and the retransmission timer is running. The value shall be a multiple integral NmMainFunctionPeriod.
        boolean NmVersionInfoApi: set at pre-compile, default-value=false  # Pre-processor switch for enabling Version Info API support.
