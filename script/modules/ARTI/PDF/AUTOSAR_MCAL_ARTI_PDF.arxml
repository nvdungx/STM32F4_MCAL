AUTOSAR XML (schema 00053)
package /AUTOSAR/EcucDefs
  ecuc definition collection AUTOSARParameterDefinition: module=Arti
  module definition Arti [0..1]: post-build-variant-support=true, variants link-time/post-build/pre-compile  # The Arti Module serves as a superordinate container collecting all information and parameters concerning ARTI.
    container ArtiGeneric [0..1]: multiplicity set at pre-compile  # The ArtiGeneric container contains definitions for generic objects, i.e. not belonging to a standard AUTOSAR module.
      container ArtiGenericComponentClass [0..*]: multiplicity set at pre-compile  # The class definition describes the layout of the object (similar to a "class" definition in C++).
        string ArtiGenericComponentClassName: scope=ECU, set at pre-compile  # Name of the class.
        container ArtiGenericComponentClassParameter [0..*]: multiplicity set at pre-compile  # Parameter definition of a class.
          string ArtiGenericComponentClassParameterName: scope=ECU, set at pre-compile  # Name of the parameter.
          reference ArtiGenericComponentClassParameterTypeMapRef [0..1]: scope=ECU, multiplicity set at pre-compile, set at pre-compile, destination=ArtiParameterTypeMap  # Refers to a parameter type to interpret the parameter value.
      container ArtiGenericComponentInstance [0..*]: multiplicity set at pre-compile  # The instance definition describes a specific instantiated object.
        string ArtiGenericComponentInstanceName: scope=ECU, set at pre-compile  # Name of the instance.
        reference ArtiGenericComponentInstanceClassRef: scope=ECU, set at pre-compile, destination=ArtiGenericComponentClass  # Refers to a ArtGenericClass of which this object is instantiated.
        container ArtiGenericComponentInstanceParameter [0..*]: multiplicity set at pre-compile  # Parameter definition of an instance.
          reference ArtiGenericComponentInstanceParameterClassParameterRef [0..*]: multiplicity set at pre-compile, set at pre-compile, destination=ArtiGenericComponentClassParameter  # Refers to an ArtiGenericComponentClassParameter that defines this parameter.
          reference ArtiGenericComponentInstanceParameterConstantRef [0..1]: multiplicity set at pre-compile, set at pre-compile, destination=ArtiConstant  # Refers to an ArtiConstant that represents the value of this parameter.
          reference ArtiGenericComponentInstanceParameterExpressionRef [0..1]: multiplicity set at pre-compile, set at pre-compile, destination=ArtiExpression  # Refers to an ArtiExpression that evaluates the value of this parameter.
          reference ArtiGenericComponentInstanceParameterHookRef [0..1]: multiplicity set at pre-compile, set at pre-compile, destination=ArtiHook  # Refers to a hook that records this parameter.
    container ArtiHardware [0..1]: multiplicity set at post-build in variant post-build / pre-compile in variant pre-compile, post-build-variant-multiplicity=true  # The ArtiHardware container contains ARTI extensions to the EcucHardware module.
      container ArtiHardwareCoreClass [0..1]: multiplicity set at post-build in variant post-build / pre-compile in variant pre-compile, post-build-variant-multiplicity=true  # Contains the layout of an ARTI "Core" object, extending the EcucCoreDefinition.
        reference ArtiHardwareCoreClassCurrentApplicationRef [0..1]: scope=ECU, multiplicity set at post-build in variant post-build / pre-compile in variant pre-compile, post-build-variant-multiplicity=true, post-build-variant-value=true, set at post-build in variant post-build / pre-compile in variant pre-compile, destination=ArtiObjectClassParameter  # Refers to the ArtiObjectClassParameter that defines the ArtiCurrentApplicationInstance parameter.
        reference ArtiHardwareCoreClassCurrentIsrRef [0..1]: scope=ECU, post-build-variant-value=true, set at post-build in variant post-build / pre-compile in variant pre-compile, destination=ArtiObjectClassParameter  # Refers to the ArtiObjectClassParameter that defines the ArtiCurrentIsrInstance parameter.
        reference ArtiHardwareCoreClassCurrentTaskRef: scope=ECU, post-build-variant-value=true, set at post-build in variant post-build / pre-compile in variant pre-compile, destination=ArtiObjectClassParameter  # Refers to the ArtiObjectClassParameter that defines the ArtiCurrentTaskInstance parameter.
        reference ArtiHardwareCoreClassGenericComponentRef [0..1]: scope=ECU, multiplicity set at post-build in variant post-build / pre-compile in variant pre-compile, post-build-variant-multiplicity=true, post-build-variant-value=true, set at post-build in variant post-build / pre-compile in variant pre-compile, destination=ArtiGenericComponentClass  # Refers to an ArtiGenericComponentClass that extends the core description.
        reference ArtiHardwareCoreClassLastErrorRef [0..1]: scope=ECU, multiplicity set at post-build in variant post-build / pre-compile in variant pre-compile, post-build-variant-multiplicity=true, post-build-variant-value=true, set at post-build in variant post-build / pre-compile in variant pre-compile, destination=ArtiObjectClassParameter  # Refers to the ArtiObjectClassParameter that defines the ArtiLastErrorInstance parameter.
        reference ArtiHardwareCoreClassRunningTaskPriorityRef [0..1]: scope=ECU, multiplicity set at post-build in variant post-build / pre-compile in variant pre-compile, post-build-variant-multiplicity=true, post-build-variant-value=true, set at post-build in variant post-build / pre-compile in variant pre-compile, destination=ArtiObjectClassParameter  # Refers to the ArtiObjectClassParameter that defines the ArtiHwCoreInstanceRunningTaskPriority parameter. This attribute specifies how to evaluate the current priority of the task referred by RUNNINGTASK. The current priority can be different from the static task priority as a result of priority ceiling protocol. This attribute differs from ArtiCurrentTask->ArtiOsTaskClassPriority as here is a single variable while in multiple tasks there is a single variable per task.
      container ArtiHardwareCoreInstance [0..*]: multiplicity set at post-build in variant post-build / pre-compile in variant pre-compile, post-build-variant-multiplicity=true  # Description: Represents an instance of an ARTI "Core" object, extending the EcucCoreDefinition. When using ARTI for debugging or hardware based tracing, this is mandatory (i.e. multiplicity 1..*), else optional.
        integer ArtiHardwareCoreInstanceCoreId: 0..18446744073709551615, scope=ECU, post-build-variant-value=true, set at post-build in variant post-build / pre-compile in variant pre-compile  # This parameter represents the "CoreID" as given by the OS, returned by GetCoreID().
        reference ArtiHardwareCoreInstanceCurrentApplicationRef: scope=ECU, post-build-variant-value=true, set at post-build in variant post-build / pre-compile in variant pre-compile, destination=ArtiObjectInstanceParameter  # Refers to the ArtiObjectInstanceParameter that contains the evaluation for the "current application" that is running on this core.
        reference ArtiHardwareCoreInstanceCurrentIsrRef [0..1]: scope=ECU, multiplicity set at post-build in variant post-build / pre-compile in variant pre-compile, post-build-variant-multiplicity=true, post-build-variant-value=true, set at post-build in variant post-build / pre-compile in variant pre-compile, destination=ArtiObjectInstanceParameter  # Refers to the ArtiObjectInstanceParameter that contains the evaluation for the "current ISR" that is running on this core.
        reference ArtiHardwareCoreInstanceCurrentTaskRef: scope=ECU, post-build-variant-value=true, set at post-build in variant post-build / pre-compile in variant pre-compile, destination=ArtiObjectInstanceParameter  # Refers to the ArtiObjectInstanceParameter that contains the evaluation for the "current task" that is running on this core.
        reference ArtiHardwareCoreInstanceEcucCoreRef: scope=ECU, post-build-variant-value=true, set at post-build in variant post-build / pre-compile in variant pre-compile, destination=EcucCoreDefinition  # Refers to the EcucCoreDefinition of this core.
        reference ArtiHardwareCoreInstanceGenericComponentRef [0..1]: scope=ECU, multiplicity set at post-build in variant post-build / pre-compile in variant pre-compile, post-build-variant-multiplicity=true, post-build-variant-value=true, set at post-build in variant post-build / pre-compile in variant pre-compile, destination=ArtiGenericComponentInstance  # Refers to an ArtiGenericComponentInstance that extends a core.
        reference ArtiHardwareCoreInstanceLastErrorRef [0..1]: scope=ECU, multiplicity set at post-build in variant post-build / pre-compile in variant pre-compile, post-build-variant-multiplicity=true, post-build-variant-value=true, set at post-build in variant post-build / pre-compile in variant pre-compile, destination=ArtiObjectInstanceParameter  # Refers to the ArtiObjectInstanceParameter that contains the evaluation for the "last error" that happened on this core.
        reference ArtiHardwareCoreInstanceRunningTaskPriorityRef [0..1]: scope=ECU, multiplicity set at post-build in variant post-build / pre-compile in variant pre-compile, post-build-variant-multiplicity=true, post-build-variant-value=true, set at post-build in variant post-build / pre-compile in variant pre-compile, destination=ArtiObjectInstanceParameter  # Refers to the ArtiObjectInstanceParameter that contains the evaluation for the "running task priority" that is on this core.
        reference ArtiHardwareCoreInstanceValidRef [0..1]: scope=ECU, multiplicity set at link in variant link-time / pre-compile in variant pre-compile, set at link in variant link-time / pre-compile in variant pre-compile, destination=ArtiObjectInstanceParameter  # Refers to the ArtiObjectInstanceParameter that contains the evaluation for the "validity" of this ArtiHwCoreInstance. Every object declaration may contain a VALID attribute telling the debugger whether the object's attributes are currently valid. It may have an integer type of any size. Its possible values are 0 (invalid) and non zero (object is valid).
    container ArtiOs [0..1]: multiplicity set at link in variant link-time / pre-compile in variant pre-compile, post-build-variant-multiplicity=true  # The ArtiOs container contains ARTI extensions to the EcucDefs/Os module.
      reference ArtiOsGenericComponentRef [0..*]: scope=ECU, multiplicity set at link in variant link-time / pre-compile in variant pre-compile, set at link in variant link-time / pre-compile in variant pre-compile, destination=ArtiGenericComponentClass  # Refers to an ArtiGenericComponentClass that relates to the OS.
      container ArtiOsAlarmClass [0..1]: multiplicity set at link in variant link-time / pre-compile in variant pre-compile  # Contains the layout of an ArtiOsAlarm object.
        reference ArtiOsAlarmClassGenericComponentClassRef [0..1]: scope=ECU, multiplicity set at link in variant link-time / pre-compile in variant pre-compile, set at link in variant link-time / pre-compile in variant pre-compile, destination=ArtiGenericComponentClass  # Refers to an ArtiGenericComponentClass that extends the ArtiOsAlarmClass.
        reference ArtiOsAlarmClassStateRef [0..1]: scope=ECU, multiplicity set at link in variant link-time / pre-compile in variant pre-compile, set at link in variant link-time / pre-compile in variant pre-compile, destination=ArtiObjectClassParameter  # Refers to the ArtiObjectClassParameter that declares the attribute ArtiOsAlarmStateRef in ArtiOsAlarmInstances. This attribute specifies if an alarm is "RUNNING" or "STOPPED". The refered ArtiObjectClassParameter does include the mapping from integer to human readable "RUNNING" or "STOPPED".
      container ArtiOsAlarmInstance [0..*]: multiplicity set at link in variant link-time / pre-compile in variant pre-compile  # Represents an instance of an ArtiOsAlarm object, extending the EcuC OsTaskAlarm.
        string ArtiOsAlarmInstanceAction [0..1]: scope=ECU, multiplicity set at link in variant link-time / pre-compile in variant pre-compile, set at link in variant link-time / pre-compile in variant pre-compile  # This attribute provides a string with a description of the action when the alarm expires, e.g. "ActivateTask TaskA".
        string ArtiOsAlarmInstanceCounter [0..1]: scope=ECU, multiplicity set at link in variant link-time / pre-compile in variant pre-compile, set at link in variant link-time / pre-compile in variant pre-compile  # This attribute provides a string containing the name of the counter used by this alarm.
        reference ArtiOsAlarmInstanceAlarmTimeRef [0..1]: scope=ECU, multiplicity set at link in variant link-time / pre-compile in variant pre-compile, set at link in variant link-time / pre-compile in variant pre-compile, destination=ArtiObjectInstanceParameter  # This attribute specifies how to evaluate the time until the alarm expires next. The time should be represented in seconds.
        reference ArtiOsAlarmInstanceCycleTimeRef [0..1]: scope=ECU, multiplicity set at link in variant link-time / pre-compile in variant pre-compile, set at link in variant link-time / pre-compile in variant pre-compile, destination=ArtiObjectInstanceParameter  # This attribute specifies how to evaluate the cycle time for cyclic alarms. The value of "cycle time" is 0 for non-cyclic alarms. The time should be represendet in seconds.
        reference ArtiOsAlarmInstanceEcuCRef [0..1]: scope=ECU, multiplicity set at link in variant link-time / pre-compile in variant pre-compile, set at link in variant link-time / pre-compile in variant pre-compile, destination=OsAlarm  # Refers to an EcuC OsAlarm that is beeing extended.
        reference ArtiOsAlarmInstanceGenericComponentInstanceRef [0..1]: scope=ECU, multiplicity set at link in variant link-time / pre-compile in variant pre-compile, set at link in variant link-time / pre-compile in variant pre-compile, destination=ArtiGenericComponentInstance  # Refers to an ArtiGenericComponentInstance that extends the ArtiOsAlarmInstance.
        reference ArtiOsAlarmInstanceStateRef [0..1]: scope=ECU, multiplicity set at link in variant link-time / pre-compile in variant pre-compile, set at link in variant link-time / pre-compile in variant pre-compile, destination=ArtiObjectInstanceParameter  # Refers to the ArtiObjectInstanceParameter that contains the evaluation for the "state" of this alarm. The result then is mapped with the typemap of the ArtiOsAlarmStateRef of the ArtiOsAlarmClass.
        reference ArtiOsAlarmInstanceValidRef [0..1]: scope=ECU, multiplicity set at link in variant link-time / pre-compile in variant pre-compile, set at link in variant link-time / pre-compile in variant pre-compile, destination=ArtiObjectInstanceParameter  # Refers to the ArtiObjectInstanceParameter that contains the evaluation for the "validity" of this alarm. Every object declaration may contain a VALID attribute telling the debugger whether the object's attributes are currently valid. It may have an integer type of any size. Its possible values are 0 (invalid) and non zero (object is valid).
      container ArtiOsClass [0..1]: multiplicity set at link in variant link-time / pre-compile in variant pre-compile  # Contains the layout of an ARTI "Os" object, extending the EcuC OsOS.
        reference ArtiOsClassAppModeRef: scope=ECU, set at link in variant link-time / pre-compile in variant pre-compile, destination=ArtiObjectClassParameter  # Refers to the ArtiObjectClassParameter that defines the ArtiOsAppModeInstance parameter.
        reference ArtiOsClassGenericComponentRef [0..1]: scope=ECU, multiplicity set at link in variant link-time / pre-compile in variant pre-compile, set at link in variant link-time / pre-compile in variant pre-compile, destination=ArtiGenericComponentClass  # Refers to an ArtiGenericComponentClass that extends the OS description.
        reference ArtiOsClassServiceTraceRef [0..1]: scope=ECU, multiplicity set at link in variant link-time / pre-compile in variant pre-compile, set at link in variant link-time / pre-compile in variant pre-compile, destination=ArtiObjectClassParameter  # Refers to the ArtiObjectClassParameter that defines the ArtiOsInstanceServiceTrace parameter. This attribute indicates the entry or exit of a service routine and the ID of this service routine. The value of this attribute must be evaluated from one single memory location.
      container ArtiOsContextClass [0..1]: multiplicity set at link in variant link-time / pre-compile in variant pre-compile  # Contains the layout of an ARTI "OsContext" object.
        reference ArtiOsContextClassGenericComponentClassRef [0..1]: scope=ECU, multiplicity set at link in variant link-time / pre-compile in variant pre-compile, set at link in variant link-time / pre-compile in variant pre-compile, destination=ArtiGenericComponentClass  # Refers to an ArtiGenericComponentClass that extends the ArtiOsContextClass.
      container ArtiOsContextInstance [0..*]: multiplicity set at link in variant link-time / pre-compile in variant pre-compile  # Represents an instance of an "ArtiContext" object.
        reference ArtiOsContextInstanceAddressRef [0..1]: scope=ECU, multiplicity set at link in variant link-time / pre-compile in variant pre-compile, set at link in variant link-time / pre-compile in variant pre-compile, destination=ArtiObjectInstanceParameter  # Refers to the ArtiObjectInstanceParameter that contains the evaluation for the "address" of this context.
        reference ArtiOsContextInstanceGenericComponentInstanceRef [0..1]: scope=ECU, multiplicity set at link in variant link-time / pre-compile in variant pre-compile, set at link in variant link-time / pre-compile in variant pre-compile, destination=ArtiGenericComponentInstance  # Refers to an ArtiGenericComponentInstance that extends the ArtiOsContext.
        reference ArtiOsContextInstanceSizeRef [0..1]: scope=ECU, multiplicity set at link in variant link-time / pre-compile in variant pre-compile, set at link in variant link-time / pre-compile in variant pre-compile, destination=ArtiObjectInstanceParameter  # Refers to the ArtiObjectInstanceParameter that contains the evaluation for the "size" of this context.
        reference ArtiOsContextInstanceValidRef [0..1]: scope=ECU, multiplicity set at link in variant link-time / pre-compile in variant pre-compile, set at link in variant link-time / pre-compile in variant pre-compile, destination=ArtiObjectInstanceParameter  # Refers to the ArtiObjectInstanceParameter that contains the evaluation for the "validity" of this context. Every object declaration may contain a VALID attribute telling the debugger whether the object's attributes are currently valid. It may have an integer type of any size. Its possible values are 0 (invalid) and non zero (object is valid).
      container ArtiOsInstance [0..1]: multiplicity set at link in variant link-time / pre-compile in variant pre-compile  # Represents an instance of an ARTI "Os" object, extending the EcuC OsOS.
        reference ArtiOsInstanceAppModeRef: scope=ECU, set at link in variant link-time / pre-compile in variant pre-compile, destination=ArtiObjectInstanceParameter  # Refers to the ArtiObjectInstanceParameter that contains the evaluation for the "application mode" of this OS.
        reference ArtiOsInstanceEcucRef: scope=ECU, set at link in variant link-time / pre-compile in variant pre-compile, destination=OsOS  # Refers to the EcucDefs/Os/OsOS of this OS.
        reference ArtiOsInstanceGenericComponentRef [0..1]: scope=ECU, multiplicity set at link in variant link-time / pre-compile in variant pre-compile, set at link in variant link-time / pre-compile in variant pre-compile, destination=ArtiGenericComponentInstance  # Refers to an ArtiGenericComponentInstance that extends the OS.
        reference ArtiOsInstanceHookRef [0..*]: scope=ECU, multiplicity set at link in variant link-time / pre-compile in variant pre-compile, set at link in variant link-time / pre-compile in variant pre-compile, destination=ArtiHook  # Refers to a hook defined in the OS.
        reference ArtiOsInstanceServiceTraceRef [0..1]: scope=ECU, multiplicity set at link in variant link-time / pre-compile in variant pre-compile, set at link in variant link-time / pre-compile in variant pre-compile, destination=ArtiObjectInstanceParameter  # Refers to a hook defined in the OS.
        reference ArtiOsInstanceValidRef [0..1]: scope=ECU, multiplicity set at link in variant link-time / pre-compile in variant pre-compile, set at link in variant link-time / pre-compile in variant pre-compile, destination=ArtiObjectInstanceParameter  # Refers to the ArtiObjectInstanceParameter that contains the evaluation for the "validity" of this ArtiOsInstance. Every object declaration may contain a VALID attribute telling the debugger whether the object's attributes are currently valid. It may have an integer type of any size. Its possible values are 0 (invalid) and non zero (object is valid).
      container ArtiOsIsrClass [0..1]: multiplicity set at link in variant link-time / pre-compile in variant pre-compile  # Contains the layout of an ARTI "OsIsr" object, extending the EcuC OsIsr.
        reference ArtiOsIsrClassGenericComponentRef [0..1]: scope=ECU, multiplicity set at link in variant link-time / pre-compile in variant pre-compile, set at link in variant link-time / pre-compile in variant pre-compile, destination=ArtiGenericComponentClass  # Refers to an optional ArtiGenericComponentClass that extends the OsIsr with additional parameters.
      container ArtiOsIsrInstance [0..*]: multiplicity set at link in variant link-time / pre-compile in variant pre-compile  # Represents an instance of an ARTI "OsIsr" object, extending the EcuC OsIsr.
        enumeration ArtiOsIsrInstanceCategory [0..1]: {CATEGORY_1, CATEGORY_2}, scope=ECU, multiplicity set at pre-compile, set at pre-compile  # Specifies category of this ISR. If omitted the instance is related to a CATEGORY_2.
        function name ArtiOsIsrInstanceFunction [0..1]: scope=ECU, multiplicity set at link in variant link-time / pre-compile in variant pre-compile, set at link in variant link-time / pre-compile in variant pre-compile  # This parameter represents the C function name of the ISR routine.
        integer ArtiOsIsrInstanceId: 0..18446744073709551615, scope=ECU, set at link in variant link-time / pre-compile in variant pre-compile  # This parameter represents the "ISRID" as given by the OS, returned by GetISRID().
        reference ArtiOsIsrInstanceEcucRef [0..1]: scope=ECU, multiplicity set at pre-compile, set at link in variant link-time / pre-compile in variant pre-compile, destination=OsIsr  # Refers to the EcucDefs/Os/OsIsr of this ISR.
        reference ArtiOsIsrInstanceGenericComponentRef [0..1]: scope=ECU, multiplicity set at link in variant link-time / pre-compile in variant pre-compile, set at link in variant link-time / pre-compile in variant pre-compile, destination=ArtiGenericComponentInstance  # Refers to an optional ArtiGenericComponentInstance that extends this OsIsr with additional parameters.
        reference ArtiOsIsrInstanceTimingProtectionLastTimeFrameRef [0..1]: scope=ECU, multiplicity set at pre-compile, set at pre-compile, destination=ArtiObjectInstanceParameter  # Refers to the ArtiObjectInstanceParameter that contains the evaluation for the last time frame related to the OsIsr/OsIsrTimingProtection configuration.
        reference ArtiOsIsrInstanceTimingProtectionUsedBudgetRef [0..1]: scope=ECU, multiplicity set at pre-compile, set at pre-compile, destination=ArtiObjectInstanceParameter  # Refers to the ArtiObjectInstanceParameter that contains the evaluation for the used budget related to the OsIsr/OsIsrTimingProtection configuration.
        reference ArtiOsIsrInstanceValidRef [0..1]: scope=ECU, multiplicity set at link in variant link-time / pre-compile in variant pre-compile, set at link in variant link-time / pre-compile in variant pre-compile, destination=ArtiObjectInstanceParameter  # Refers to the ArtiObjectInstanceParameter that contains the evaluation for the "validity" of this ArtiOsIsrInstance. Every object declaration may contain a VALID attribute telling the debugger whether the object's attributes are currently valid. It may have an integer type of any size. Its possible values are 0 (invalid) and non zero (object is valid).
      container ArtiOsMessageContainerClass [0..1]: multiplicity set at link in variant link-time / pre-compile in variant pre-compile  # Contains the layout of an ARTI "OsMessageContainer" object. The "OsMessageContainer" object represents an existing combination of OSEK messages.
        reference ArtiOsMessageContainerClassGenericComponentClassRef [0..1]: scope=ECU, multiplicity set at link in variant link-time / pre-compile in variant pre-compile, set at link in variant link-time / pre-compile in variant pre-compile, destination=ArtiGenericComponentClass  # Refers to an ArtiGenericComponentClass that extends the ArtiOsMessageContainerClass.
      container ArtiOsMessageContainerInstance [0..*]: multiplicity set at link in variant link-time / pre-compile in variant pre-compile  # Represents an instance of an "ArtiMessageContainer" object.
        string ArtiOsMessageContainerInstanceMsgName [0..1]: scope=ECU, multiplicity set at link in variant link-time / pre-compile in variant pre-compile, set at link in variant link-time / pre-compile in variant pre-compile  # This attribute provides the name of the message as defined in OIL file.
        string ArtiOsMessageContainerInstanceMsgType [0..1]: scope=ECU, multiplicity set at link in variant link-time / pre-compile in variant pre-compile, set at link in variant link-time / pre-compile in variant pre-compile  # This attribute provides the type of the message.
        reference ArtiOsMessageContainerInstanceFirstElementRef [0..1]: scope=ECU, multiplicity set at link in variant link-time / pre-compile in variant pre-compile, set at link in variant link-time / pre-compile in variant pre-compile, destination=ArtiObjectInstanceParameter  # Refers to the ArtiObjectInstanceParameter that contains the evaluation for the "firstelement" of this "ArtiOsMessageContainer". This attribute provides the formula for evaluation of address of first valid message. This message will be received next. If no message is in the queue the value is zero.
        reference ArtiOsMessageContainerInstanceGenericComponentInstanceRef [0..1]: scope=ECU, multiplicity set at link in variant link-time / pre-compile in variant pre-compile, set at link in variant link-time / pre-compile in variant pre-compile, destination=ArtiGenericComponentInstance  # Refers to an ArtiGenericComponentInstance that extends the ArtiOsMessageContainerInstance.
        reference ArtiOsMessageContainerInstanceQueueCountRef [0..1]: scope=ECU, multiplicity set at link in variant link-time / pre-compile in variant pre-compile, set at link in variant link-time / pre-compile in variant pre-compile, destination=ArtiObjectInstanceParameter  # Refers to the ArtiObjectInstanceParameter that contains the evaluation for the "queuecount" of this "ArtiOsMessageContainer". This attribute provides the number of valid messages in the queue and "1" for unqueued messages.
        reference ArtiOsMessageContainerInstanceQueueSizeRef [0..1]: scope=ECU, multiplicity set at link in variant link-time / pre-compile in variant pre-compile, set at link in variant link-time / pre-compile in variant pre-compile, destination=ArtiObjectInstanceParameter  # Refers to the ArtiObjectInstanceParameter that contains the evaluation for the "queuesize" of this "ArtiOsMessageContainer". This attribute provides the size of the queue for queued messages and "1" for unqueued messages.
        reference ArtiOsMessageContainerInstanceValidRef [0..1]: scope=ECU, multiplicity set at link in variant link-time / pre-compile in variant pre-compile, set at link in variant link-time / pre-compile in variant pre-compile, destination=ArtiObjectInstanceParameter  # Refers to the ArtiObjectInstanceParameter that contains the evaluation for the "validity" of this ArtiOsMessageContainerInstance. Every object declaration may contain a VALID attribute telling the debugger whether the object's attributes are currently valid. It may have an integer type of any size. Its possible values are 0 (invalid) and non zero (object is valid).
      container ArtiOsResourceClass [0..1]: multiplicity set at link in variant link-time / pre-compile in variant pre-compile  # Contains the layout of an ArtiOsResource object. The ArtiOsResource object represents an OSEK resource.
        reference ArtiOsResourceClassGenericComponentClassRef [0..1]: scope=ECU, multiplicity set at link in variant link-time / pre-compile in variant pre-compile, set at link in variant link-time / pre-compile in variant pre-compile, destination=ArtiGenericComponentClass  # Refers to an ArtiGenericComponentClass that extends the ArtiOsResourceClass.
        reference ArtiOsResourceClassLockerRef [0..1]: scope=ECU, multiplicity set at link in variant link-time / pre-compile in variant pre-compile, set at link in variant link-time / pre-compile in variant pre-compile, destination=ArtiObjectClassParameter  # Refers to the ArtiObjectClassParameter that declares the attribute ArtiOsResourceLockerRef in ArtiOsResourceInstances. This attribute indicates the locking ArtiOsTaskInstance or ArtiOsIsrInstance.
        reference ArtiOsResourceClassStateRef [0..1]: scope=ECU, multiplicity set at link in variant link-time / pre-compile in variant pre-compile, set at link in variant link-time / pre-compile in variant pre-compile, destination=ArtiObjectClassParameter  # Refers to the ArtiObjectClassParameter that declares the attribute ArtiOsResourceStateRef in ArtiOsResourceInstances. This attribute represents the state of a resource ("LOCKED"/"UNLOCKED"). The ArtiObjectClassParameter does include the mapping from integer to human readable "LOCKED" or "UNLOCKED".
      container ArtiOsResourceInstance [0..*]: multiplicity set at link in variant link-time / pre-compile in variant pre-compile  # Represents an instance of an ArtiOsResource object.
        string ArtiOsResourceInstancePriority [0..1]: scope=ECU, multiplicity set at link in variant link-time / pre-compile in variant pre-compile, set at link in variant link-time / pre-compile in variant pre-compile  # This attribute has two components that state: that the RESOURCE is used by TASKs only or by TASKs and ISRs, and the priority that will be used when locking the RESOURCE.
        reference ArtiOsResourceInstanceEcuCRef [0..1]: scope=ECU, multiplicity set at link in variant link-time / pre-compile in variant pre-compile, set at link in variant link-time / pre-compile in variant pre-compile, destination=OsResource  # Refers to an EcuC OsResource that is beeing extended.
        reference ArtiOsResourceInstanceGenericComponentInstanceRef [0..1]: scope=ECU, multiplicity set at link in variant link-time / pre-compile in variant pre-compile, set at link in variant link-time / pre-compile in variant pre-compile, destination=ArtiGenericComponentInstance  # Refers to an ArtiGenericComponentInstance that extends the ArtiOsResourceInstance.
        reference ArtiOsResourceInstanceLockerRef [0..1]: scope=ECU, multiplicity set at link in variant link-time / pre-compile in variant pre-compile, set at link in variant link-time / pre-compile in variant pre-compile, destination=ArtiObjectInstanceParameter  # Refers to the ArtiObjectInstanceParameter that contains the evaluation for the "locker" of this ArtiOsResource.
        reference ArtiOsResourceInstanceStateRef [0..1]: scope=ECU, multiplicity set at link in variant link-time / pre-compile in variant pre-compile, set at link in variant link-time / pre-compile in variant pre-compile, destination=ArtiObjectInstanceParameter  # Refers to the ArtiObjectInstanceParameter that contains the evaluation for the "state" of this ArtiOsResource.
        reference ArtiOsResourceInstanceValidRef [0..1]: scope=ECU, multiplicity set at link in variant link-time / pre-compile in variant pre-compile, set at link in variant link-time / pre-compile in variant pre-compile, destination=ArtiObjectInstanceParameter  # Refers to the ArtiObjectInstanceParameter that contains the evaluation for the "validity" of this ArtiOsResourceInstance. Every object declaration may contain a VALID attribute telling the debugger whether the object's attributes are currently valid. It may have an integer type of any size. Its possible values are 0 (invalid) and non zero (object is valid).
      container ArtiOsScheduleTableClass [0..1]  # Contains the layout of an ArtiOsScheduleTable object.
        reference ArtiOsScheduleTableClassCurrentStateRef [0..1]: multiplicity set at pre-compile, set at pre-compile, destination=ArtiObjectClassParameter  # Refers to the ArtiObjectClassParameter that defines the ArtiCurrentScheduleTableStateInstance parameter including the state mapping.
        reference ArtiOsScheduleTableClassGenericComponentClassRef [0..1]: multiplicity set at pre-compile, set at pre-compile, destination=ArtiGenericComponentClass  # Refers to an ArtiGenericComponentClass that extends the ArtiOsScheduleTableClass.
      container ArtiOsScheduleTableInstance [0..*]  # Represents an instance of an ArtiOsScheduleTable object, extending the EcuC OsScheduleTable.
        reference ArtiOsScheduleTableInstanceCoreRef [0..1]: multiplicity set at pre-compile, set at pre-compile, destination=ArtiHardwareCoreInstance  # Refers to the ArtiHardwareCoreInstance on which this OsScheduleTable runs.
        reference ArtiOsScheduleTableInstanceCounterValueRef [0..1]: multiplicity set at pre-compile, set at pre-compile, destination=ArtiObjectInstanceParameter  # Refers to the ArtiObjectInstanceParameter that contains the evaluation for the absolute counter value.
        reference ArtiOsScheduleTableInstanceCurrentStateRef [0..1]: multiplicity set at pre-compile, set at pre-compile, destination=ArtiObjectInstanceParameter  # Refers to the ArtiObjectInstanceParameter that contains the evaluation for the "current state" of this OsScheduleTable.
        reference ArtiOsScheduleTableInstanceEcucRef [0..1]: multiplicity set at pre-compile, set at pre-compile, destination=OsScheduleTable  # Refers to an EcuC OsScheduleTable that is beeing extended.
        reference ArtiOsScheduleTableInstanceExpiryTimeRef [0..1]: multiplicity set at pre-compile, set at pre-compile, destination=ArtiObjectInstanceParameter  # Refers to the ArtiObjectInstanceParameter that contains the evaluation for the expiry time.
        reference ArtiOsScheduleTableInstanceGenericComponentInstanceRef [0..1]: multiplicity set at pre-compile, set at pre-compile, destination=ArtiGenericComponentInstance  # Refers to an ArtiGenericComponentInstance that extends the ArtiOsScheduleTableInstance.
        reference ArtiOsScheduleTableInstanceNextEventRef [0..1]: multiplicity set at pre-compile, set at pre-compile, destination=ArtiObjectInstanceParameter  # Refers to the ArtiObjectInstanceParameter that contains the evaluation for the "next event".
        reference ArtiOsScheduleTableInstanceNextExpiryPointRef [0..1]: multiplicity set at pre-compile, set at pre-compile, destination=ArtiObjectInstanceParameter  # Refers to the ArtiObjectInstanceParameter that contains the evaluation for the "next expiry point".
        reference ArtiOsScheduleTableInstanceNextScheduleTableRef [0..1]: multiplicity set at pre-compile, set at pre-compile, destination=ArtiObjectInstanceParameter  # Refers to the ArtiObjectInstanceParameter that contains the evaluation for the "next schedule table".
      container ArtiOsSpinlockClass [0..1]  # Contains the layout of an ArtiOsSpinlock object.
        reference ArtiOsScheduleTableClassGenericComponentClassRef [0..1]: multiplicity set at pre-compile, set at pre-compile, destination=ArtiGenericComponentClass  # Refers to an ArtiGenericComponentClass that extends the ArtiOsSpinlockClass.
        reference ArtiOsSpinlockClassCurrentOwnerTypeRef [0..1]: multiplicity set at pre-compile, set at pre-compile, destination=ArtiObjectClassParameter  # Refers to the ArtiObjectClassParameter that defines the ArtiCurrentSpinlockOwnerTypeInstance parameter including the type mapping.
        reference ArtiOsSpinlockClassCurrentStateRef [0..1]: multiplicity set at pre-compile, set at pre-compile, destination=ArtiObjectClassParameter  # Refers to the ArtiObjectClassParameter that defines the ArtiCurrentSpinlockStateInstance parameter including the state mapping.
      container ArtiOsSpinlockInstance [0..*]  # Represents an instance of an ArtiOsSpinlock object, extending the EcuC OsSpinlock.
        reference ArtiOsSpinlockInstanceCurrentOwnerRef [0..1]: multiplicity set at pre-compile, set at pre-compile, destination=ArtiObjectInstanceParameter  # Refers to the ArtiObjectInstanceParameter that contains the evaluation for the owner ID (task or ISR2).
        reference ArtiOsSpinlockInstanceCurrentOwnerTypeRef [0..1]: multiplicity set at pre-compile, set at pre-compile, destination=ArtiObjectInstanceParameter  # Refers to the ArtiObjectInstanceParameter that contains the evaluation for the "current owner type" of this OsSpinlock.
        reference ArtiOsSpinlockInstanceCurrentStateRef [0..1]: multiplicity set at pre-compile, set at pre-compile, destination=ArtiObjectInstanceParameter  # Refers to the ArtiObjectInstanceParameter that contains the evaluation for the "current state" of this OsSpinlock.
        reference ArtiOsSpinlockInstanceEcuCRef [0..1]: multiplicity set at pre-compile, set at pre-compile, destination=OsSpinlock  # Refers to an EcuC OsSpinlock that is beeing extended.
        reference ArtiOsSpinlockInstanceGenericComponentInstanceRef [0..1]: multiplicity set at pre-compile, set at pre-compile, destination=ArtiGenericComponentInstance  # Refers to an ArtiGenericComponentInstance that extends the ArtiOsSpinlockInstance.
        reference ArtiOsSpinlockInstanceLockingCoreRef [0..1]: multiplicity set at pre-compile, set at pre-compile, destination=ArtiObjectInstanceParameter  # Refers to the ArtiObjectInstanceParameter that contains the evaluation for the current locking core.
      container ArtiOsStackClass [0..1]: multiplicity set at link in variant link-time / pre-compile in variant pre-compile  # Contains the layout of an ArtiOsStack object. The ArtiOsStack object defines the memory area of any stack in the system.
        reference ArtiOsStackClassGenericComponentClassRef [0..1]: scope=ECU, multiplicity set at link in variant link-time / pre-compile in variant pre-compile, set at link in variant link-time / pre-compile in variant pre-compile, destination=ArtiGenericComponentClass  # Refers to an ArtiGenericComponentClass that extends the ArtiOsStackClass.
      container ArtiOsStackInstance [0..*]: multiplicity set at link in variant link-time / pre-compile in variant pre-compile  # Represents an instance of an ArtiOsStack object.
        string ArtiOsStackInstanceDirection [0..1]: scope=ECU, multiplicity set at link in variant link-time / pre-compile in variant pre-compile, set at link in variant link-time / pre-compile in variant pre-compile  # This attribute specifies the direction of stack growth and may have either "UP" or "DOWN" as its value. UP means growing from lower to higher addresses. DOWN means growing from higher addresses to lower addresses.
        reference ArtiOsStackInstanceBaseAddressRef [0..1]: scope=ECU, multiplicity set at link in variant link-time / pre-compile in variant pre-compile, set at link in variant link-time / pre-compile in variant pre-compile, destination=ArtiObjectInstanceParameter  # Refers to the ArtiObjectInstanceParameter that contains the evaluation for the "baseaddress" of this ArtiOsStack. This attribute specifies the lowest address of stack memory area, regardless of the stack direction.
        reference ArtiOsStackInstanceFillPatternRef [0..1]: scope=ECU, multiplicity set at link in variant link-time / pre-compile in variant pre-compile, set at link in variant link-time / pre-compile in variant pre-compile, destination=ArtiObjectInstanceParameter  # Refers to the ArtiObjectInstanceParameter that contains the evaluation for the "fillpattern" of this ArtiOsStack. If the operating system fills the stack during initialisation, this attribute specifies with which pattern the stack area is initialised. This allows the debugger to evaluate the maximum stack usage. For "stackdirection" "DOWN" the pattern starts at "baseaddress". For "stackdirection" "UP" the pattern starts at "baseaddress" + "size". If no pattern is used, this attribute must be omitted.
        reference ArtiOsStackInstanceGenericComponentInstanceRef [0..1]: scope=ECU, multiplicity set at link in variant link-time / pre-compile in variant pre-compile, set at link in variant link-time / pre-compile in variant pre-compile, destination=ArtiGenericComponentInstance  # Refers to an ArtiGenericComponentInstance that extends the ArtiOsStackInstance.
        reference ArtiOsStackInstanceSizeRef [0..1]: scope=ECU, multiplicity set at link in variant link-time / pre-compile in variant pre-compile, set at link in variant link-time / pre-compile in variant pre-compile, destination=ArtiObjectInstanceParameter  # Refers to the ArtiObjectInstanceParameter that contains the evaluation for the "size" of this ArtiOsStack. This attribute represents the size (in bytes) of the memory area allocated for stack.
        reference ArtiOsStackInstanceValidRef [0..1]: scope=ECU, multiplicity set at link in variant link-time / pre-compile in variant pre-compile, set at link in variant link-time / pre-compile in variant pre-compile, destination=ArtiObjectInstanceParameter  # Refers to the ArtiObjectInstanceParameter that contains the evaluation for the "validity" of this ArtiOsStackInstance. Every object declaration may contain a VALID attribute telling the debugger whether the object's attributes are currently valid. It may have an integer type of any size. Its possible values are 0 (invalid) and non zero (object is valid).
      container ArtiOsTaskClass [0..1]: multiplicity set at link in variant link-time / pre-compile in variant pre-compile  # Contains the layout of an ARTI "OsTask" object, extending the EcuC OsTask.
        reference ArtiOsTaskClassClassGenericComponentRef [0..1]: scope=ECU, multiplicity set at link in variant link-time / pre-compile in variant pre-compile, set at link in variant link-time / pre-compile in variant pre-compile, destination=ArtiGenericComponentClass  # Refers to an ArtiGenericComponentClass that extends the OsTask.
        reference ArtiOsTaskClassContextRef [0..1]: scope=ECU, multiplicity set at link in variant link-time / pre-compile in variant pre-compile, set at link in variant link-time / pre-compile in variant pre-compile, destination=ArtiObjectClassParameter  # ArtiOsTaskContextRef in ArtiOsTaskInstances. This attribute contains a reference to the context object that the task is currently using.
        reference ArtiOsTaskClassCurrentTaskStateRef [0..1]: scope=ECU, multiplicity set at link in variant link-time / pre-compile in variant pre-compile, set at link in variant link-time / pre-compile in variant pre-compile, destination=ArtiObjectClassParameter  # Refers to the ArtiObjectClassParameter that defines the ArtiCurrentTaskStateInstance parameter including the task state mapping.
        reference ArtiOsTaskClassPriorityRef [0..1]: scope=ECU, multiplicity set at link in variant link-time / pre-compile in variant pre-compile, set at link in variant link-time / pre-compile in variant pre-compile, destination=ArtiObjectClassParameter  # Refers to the ArtiObjectClassParameter that declares the attribute ArtiOsTaskPriorityRef in ArtiOsTaskInstances. This attribute represents the current priority of the TASK object. The current priority can be different from the static task priority as a result of priority ceiling protocol. The priority displayed is the priority as defined in the OsTask.
        reference ArtiOsTaskClassStackRef [0..1]: scope=ECU, multiplicity set at link in variant link-time / pre-compile in variant pre-compile, set at link in variant link-time / pre-compile in variant pre-compile, destination=ArtiObjectClassParameter  # Refers to the ArtiObjectClassParameter that declares the attribute ArtiOsTaskStackRef in ArtiOsTaskInstances. This attribute contains a reference to the stack object that the task is currently using.
      container ArtiOsTaskInstance [0..*]: multiplicity set at link in variant link-time / pre-compile in variant pre-compile  # Represents an instance of an ARTI "OsTask" object, extending the EcuC OsTask.
        function name ArtiOsTaskInstanceFunction [0..1]: scope=ECU, multiplicity set at link in variant link-time / pre-compile in variant pre-compile, set at link in variant link-time / pre-compile in variant pre-compile  # This parameter represents the C function name of the task body.
        integer ArtiOsTaskInstanceId: 0..18446744073709551615, scope=ECU, set at link in variant link-time / pre-compile in variant pre-compile  # This parameter represents the "TaskID" as given by the OSEK OS, returned by GetTaskID().
        reference ArtiOsTaskInstanceContextRef [0..1]: scope=ECU, multiplicity set at link in variant link-time / pre-compile in variant pre-compile, set at link in variant link-time / pre-compile in variant pre-compile, destination=ArtiObjectInstanceParameter  # Refers to the ArtiObjectInstanceParameter that contains the evaluation for the ArtiOsContext of this ArtiOsTask.
        reference ArtiOsTaskInstanceCurrentActivationsRef [0..1]: scope=ECU, multiplicity set at link in variant link-time / pre-compile in variant pre-compile, set at link in variant link-time / pre-compile in variant pre-compile, destination=ArtiObjectInstanceParameter  # Refers to the ArtiObjectInstanceParameter that contains the evaluation for the "current activations" of this task. This attribute specifies the number of current activations for the task.
        reference ArtiOsTaskInstanceCurrentTaskStateRef [0..1]: scope=ECU, multiplicity set at link in variant link-time / pre-compile in variant pre-compile, set at link in variant link-time / pre-compile in variant pre-compile, destination=ArtiObjectInstanceParameter  # Refers to the ArtiObjectInstanceParameter that contains the evaluation for the "current state" of this task.
        reference ArtiOsTaskInstanceEcucRef: scope=ECU, set at link in variant link-time / pre-compile in variant pre-compile, destination=OsTask  # Refers to an ArtiGenericComponentInstance that extends the OsTask.
        reference ArtiOsTaskInstanceGenericComponentRef [0..1]: scope=ECU, multiplicity set at link in variant link-time / pre-compile in variant pre-compile, set at link in variant link-time / pre-compile in variant pre-compile, destination=ArtiGenericComponentInstance  # Refers to an ArtiGenericComponentInstance that extends the OsTask.
        reference ArtiOsTaskInstancePriorityRef [0..1]: scope=ECU, multiplicity set at link in variant link-time / pre-compile in variant pre-compile, set at link in variant link-time / pre-compile in variant pre-compile, destination=ArtiObjectInstanceParameter  # Refers to the ArtiObjectInstanceParameter that contains the evaluation for the "task priority" of this task.
        reference ArtiOsTaskInstanceStackRef [0..1]: scope=ECU, multiplicity set at link in variant link-time / pre-compile in variant pre-compile, set at link in variant link-time / pre-compile in variant pre-compile, destination=ArtiObjectInstanceParameter  # Refers to the ArtiObjectInstanceParameter that contains the evaluation for the ArtiOsStack of this ArtiOsTask.
        reference ArtiOsTaskInstanceTimingProtectionLastTimeFrameRef [0..1]: multiplicity set at pre-compile, set at pre-compile, destination=ArtiObjectInstanceParameter  # Refers to the ArtiObjectInstanceParameter that contains the evaluation for the last time frame related to the OsTask/OsTaskTimingProtection configuration.
        reference ArtiOsTaskInstanceTimingProtectionUsedBudgetRef [0..1]: multiplicity set at pre-compile, set at pre-compile, destination=ArtiObjectInstanceParameter  # Refers to the ArtiObjectInstanceParameter that contains the evaluation for the used budget related to the OsTask/OsTaskTimingProtection configuration.
        reference ArtiOsTaskInstanceValidRef [0..1]: scope=ECU, multiplicity set at link in variant link-time / pre-compile in variant pre-compile, set at link in variant link-time / pre-compile in variant pre-compile, destination=ArtiObjectInstanceParameter  # Refers to the ArtiObjectInstanceParameter that contains the evaluation for the "validity" of this ArtiOsTaskInstance. Every object declaration may contain a VALID attribute telling the debugger whether the object's attributes are currently valid. It may have an integer type of any size. Its possible values are 0 (invalid) and non zero (object is valid).
    container ArtiRte [0..1]: multiplicity set at link in variant link-time / pre-compile in variant pre-compile  # The ArtiRte Container contains all parameters for ARTI that are filled by the generators RTE.
      reference ArtiRteHookRef [0..*]: multiplicity set at link in variant link-time / pre-compile in variant pre-compile, set at link in variant link-time / pre-compile in variant pre-compile, destination=ArtiHook  # Refers to an arti hook which is called by the RTE.
      container ArtiRteRunnableClass [0..1]: multiplicity set at link in variant link-time / pre-compile in variant pre-compile  # Contains the layout of an ArtiRteRunnable object.
        reference ArtiRteRunnableClassGenericComponentClassRef [0..1]: multiplicity set at link in variant link-time / pre-compile in variant pre-compile, set at link in variant link-time / pre-compile in variant pre-compile, destination=ArtiGenericComponentClass  # Refers to an ArtiGenericComponentClass that extends the ArtiRteRunnableClass.
        reference ArtiRteRunnableIdRef: set at link in variant link-time / pre-compile in variant pre-compile, destination=ArtiObjectClassParameter  # Refers to the ArtiObjectClassParameter that declares the attribute ArtiRteRunnableIdRef in ArtiRteRunnableEntityInstances. This attribute specifies the idOf(reName) mapping.
      container ArtiRteRunnableInstance [0..1]: multiplicity set at link in variant link-time / pre-compile in variant pre-compile  # Represents an instance of an ArtiRteRunnable object, extending the BswM RunnableEntity.
        string ArtiRteRunnableInstanceSymbol [0..1]: scope=ECU, multiplicity set at link in variant link-time / pre-compile in variant pre-compile, set at link in variant link-time / pre-compile in variant pre-compile  # Specifies the symbol / function name that implements the runnable.
        foreign reference ArtiRteRunnableInstanceBswRef [0..1]: multiplicity set at link in variant link-time / pre-compile in variant pre-compile, set at link in variant link-time / pre-compile in variant pre-compile, destination-type=RUNNABLE-ENTITY  # Refers to an Rte Runnable that is beeing extended.
        reference ArtiRteRunnableInstanceGenericComponentInstanceRef [0..1]: multiplicity set at link in variant link-time / pre-compile in variant pre-compile, set at link in variant link-time / pre-compile in variant pre-compile, destination=ArtiGenericComponentInstance  # Refers to an ArtiGenericComponentInstance that extends the ArtiRteRunnableInstance.
      container ArtiRteSchedulableClass [0..1]: multiplicity set at link in variant link-time / pre-compile in variant pre-compile  # Contains the layout of an ArtiRteSchedulable object.
        reference ArtiRteSchedulableClassGenericComponentClassRef [0..1]: multiplicity set at link in variant link-time / pre-compile in variant pre-compile, set at link in variant link-time / pre-compile in variant pre-compile, destination=ArtiGenericComponentClass  # Refers to an ArtiGenericComponentClass that extends the ArtiRteSchedulableClass.
        reference ArtiRteSchedulableIdRef: set at link in variant link-time / pre-compile in variant pre-compile, destination=ArtiObjectClassParameter  # Refers to the ArtiObjectClassParameter that declares the attribute ArtiRteSchmEntityIdRef in ArtiRteSchedulableInstances. This attribute specifies the idOf(entityName) mapping.
      container ArtiRteSchedulableInstance [0..1]: multiplicity set at link in variant link-time / pre-compile in variant pre-compile  # Represents an instance of an ArtiRteSchedulable object, extending the Rte Schedulable Entity.
        string ArtiRteSchedulableInstanceSymbol [0..1]: scope=ECU, multiplicity set at link in variant link-time / pre-compile in variant pre-compile, set at link in variant link-time / pre-compile in variant pre-compile  # Specifies the symbol / function name that implements the schedulable.
        foreign reference ArtiRteSchedulableInstanceBswRef [0..1]: multiplicity set at link in variant link-time / pre-compile in variant pre-compile, set at link in variant link-time / pre-compile in variant pre-compile, destination-type=BSW-SCHEDULABLE-ENITIY  # Refers to an Rte Schedulable that is beeing extended.
        reference ArtiRteSchedulableInstanceGenericComponentInstanceRef [0..1]: multiplicity set at link in variant link-time / pre-compile in variant pre-compile, set at link in variant link-time / pre-compile in variant pre-compile, destination=ArtiGenericComponentInstance  # Refers to an ArtiGenericComponentInstance that extends the ArtiRteSchedulableInstance.
      container ArtiRteVfbTraceHooks  # This container defines the parent container to which all trace hook containers are added.
        container RteVfbTraceHooks: destination-uri=RteVfbTraceHooksClient  # This container defines the parent container to which all trace hook containers are added.
          container RteVfbTraceHook [0..*]: multiplicity set at pre-compile  # This container represents a specific VFB Trace hook. Its ShortName equals the hook function's C symbol.
            function name RteVfbTraceHookApi [0..1]: multiplicity set at pre-compile  # In case of a BSW Scheduler API Trace hook or RTE API Trace hook the value of this parameter is the API name part of the VFB Trace hook ( in SWS_Rte).
            enumeration RteVfbTraceHookType: {BSW_SCHEDULABLE_ENTITY_INVOCATION, BSW_SCHEDULABLE_ENTITY_TERMINATION, COM_SIGNAL_CALLBACK, COM_SIGNAL_GROUP_INVALIDATION, COM_SIGNAL_INVALIDATION, COM_SIGNAL_RECEPTION, COM_SIGNAL_TRANSMISSION, OS_RECEIVED_EVENT, OS_SET_EVENT, OS_TASK_ACTIVATION, OS_TASK_DISPATCH, OS_TASK_TERMINATION, OS_WAIT_EVENT, RPT_RECEPTION, RPT_TRANSMISSION, RTE_API_RETURN, RTE_API_START, RUNNABLE_ENTITY_INVOCATION, RUNNABLE_ENTITY_TERMINATION, SCHM_API_RETURN, SCHM_API_START}, set at pre-compile  # This specifies the type of the hook.
            function name RteVfbTraceHookVendorApiInfix [0..1]: multiplicity set at pre-compile  # In case of a BSW Scheduler API Trace hook or BSW Schedulable Entities Trace hook the value of this parameter is the optional VendorApiInfix name part of the VFB Trace hook ( in SWS_Rte).
            integer RteVfbTraceHookVendorId [0..1]: 0..65535, multiplicity set at pre-compile  # In case of a BSW Scheduler API Trace hook or BSW Schedulable Entities Trace hook the optional VendorId name part of the VFB Trace hook (<vi> in SWS_Rte) is defined.
            foreign reference RteVfbTraceHookEntryRef: set at pre-compile, destination-type=BSW-MODULE-ENTRY  # Reference to the BswModuleEntry of this VFB Trace hook in the BSWMD of the generated RTE
            container RteVfbTraceHookAccessPoint [0..1]: multiplicity set at pre-compile  # In case of an RTE API Trace hook the ShortName of this container is the Access Point name part of the VFB Trace hook (<ap> in SWS_Rte).
              foreign reference RteVfbTraceHookAccessPointElementRef [1..*]: multiplicity set at pre-compile, set at pre-compile, destination-type=IDENTIFIABLE  # Reference to the elements from which the Access Point was derived. Number and type of the referenced objects depend on the API.
            container RteVfbTraceHookBswSchedulerNamePrefix [0..1]: multiplicity set at pre-compile  # In case of a BSW Scheduler API Trace hook or BSW Schedulable Entities Trace hook the ShortName of this container is the BSW Scheduler Name Prefix name part of the VFB Trace hook (<bsnp> in SWS_Rte).
              foreign reference RteVfbTraceHookBswImplementationRef: set at pre-compile, destination-type=BSW-IMPLEMENTATION  # Reference to the BswImplementation from which the BSW Scheduler Name Prefix was derived
            container RteVfbTraceHookComHookEvent [0..1]: multiplicity set at pre-compile  # In case of a COM Trace hook the ShortName of this container is the COM hook event part of the VFB Trace hook (<Event> in SWS_Rte).
            container RteVfbTraceHookComponentTypeSymbol [0..1]: multiplicity set at pre-compile  # In case of an RTE API Trace hook, Runnable Entity Trace hook or RPT Trace hook the ShortName of this container is the component type symbol name part of the VFB Trace hook (<cts> in SWS_Rte).
              foreign reference RteVfbTraceHookSwComponentTypeRef: set at pre-compile, destination-type=SW-COMPONENT-TYPE  # Reference to the SwComponentType from which the component type symbol was derived
            container RteVfbTraceHookExecutableEntityName [0..1]: multiplicity set at pre-compile  # In case of a Runnable Entity Trace hook or BSW Schedulable Entities Trace hook the ShortName of this container is the Executable Entity name part of the VFB Trace hook (<reName> or <entityName> in SWS_Rte).
              foreign reference RteVfbTraceHookExecutableEntityRef: set at pre-compile, destination-type=EXECUTABLE-ENTITY  # Reference to the Executable Entity from which the Runnable Entity or BSW Schedulable Entitiy name was derived
            container RteVfbTraceHookName [0..1]: multiplicity set at pre-compile  # In case of a BSW Scheduler API Trace hook the ShortName of this container is the "Name provided by the API" name part of the VFB Trace hook (<name> in SWS_Rte).
              foreign reference RteVfbTraceHookNameElementRef [1..*]: multiplicity set at pre-compile, set at pre-compile, destination-type=IDENTIFIABLE  # Reference to the elements from which the "Name provided by the API" was derived. Number and type of the referenced objects depend on the API.
            container RteVfbTraceHookOsApplication [0..1]: multiplicity set at pre-compile  # In case of an OS Trace hook the ShortName of this container is the application name part of the VFB Trace hook (<application> in SWS_Rte).
              reference RteVfbTraceHookOsApplicationRef: set at pre-compile, destination=OsApplication  # Reference to the OsApplication from which the application name was derived
            container RteVfbTraceHookSignal [0..1]: multiplicity set at pre-compile  # In case of a COM Trace hook the ShortName of this container is the COM signal name part of the VFB Trace hook (<signalName> in SWS_Rte).
              reference RteVfbTraceHookSignalRef: set at pre-compile, destination=ComSignal  # Reference to the ComSignal from which the signal name was derived
            container RteVfbTraceHookSignalGroup [0..1]: multiplicity set at pre-compile  # In case of a COM Trace hook the ShortName of this container is the COM signal group name part of the VFB Trace hook (<signalGroupName> in SWS_Rte).
              reference RteVfbTraceHookSignalGroupRef: set at pre-compile, destination=ComSignalGroup  # Reference to the ComSignalGroup from which the signal group name was derived
            container RteVfbTraceHookTask [0..1]: multiplicity set at pre-compile  # In case of an OS Trace hook the ShortName of this container is the task name part of the VFB Trace hook (<task> in SWS_Rte).
              reference RteVfbTraceHookTaskRef: set at pre-compile, destination=OsTask  # Reference to the OsTask from which the task name was derived
            container RteVfbTraceHookVariable [0..1]: multiplicity set at pre-compile  # In case of an RPT Trace hook the ShortName of this container is the "identifying name of the RP global buffer" name part of the VFB Trace hook (<var> in SWS_Rte).
              foreign reference RteVfbTraceHookVariableElementRef [1..*]: multiplicity set at pre-compile, set at pre-compile, destination-type=IDENTIFIABLE  # Reference to the elements from which the "identifying name of the RP global buffer" was derived. Number and type of the referenced objects depend on the API.
    container ArtiValues [0..*]: multiplicity set at pre-compile  # The ArtiValues container collects all parameter values for ARTI that are filled by the generators (OS, RTE, ...)
      container ArtiConstant [0..*]: multiplicity set at pre-compile  # This container holds a constant value.
        string ArtiConstantString: scope=ECU, set at pre-compile  # This is the constant value for a specific parameter.
      container ArtiExpression [0..*]: multiplicity set at pre-compile  # This container holds a C like expression that a debugger can evaluate. This is similar to what is already done in ORTI.
        string ArtiExpressionString: scope=ECU, post-build-variant-value=true, set at pre-compile  # This string represents a C like expression that a debugger can evaluate.
      container ArtiHook [0..*]: multiplicity set at pre-compile  # This container represents an ARTI hook that is present in the module.
        function name ArtiHookAssociatedFunction [0..1]: multiplicity set at pre-compile, set at pre-compile  # Name of the C function that is associated with this hook.
        string ArtiHookClass: scope=ECU, set at pre-compile  # Name of the (schedule) class of macros. Classes can be one of the predefined classes or user defined.
        string ArtiHookContext: scope=ECU, set at pre-compile  # Name of the execution context. One of NOSUSP, SPRVSR, or USER. | See also chapter "ARTI Tracing Macro".
        string ArtiHookEventName: scope=ECU, set at pre-compile  # The name of the event as defined for a particular class, or an arbitrary name for generic classes.
        string ArtiHookFileName [0..1]: scope=ECU, multiplicity set at pre-compile, set at pre-compile  # File name (possibly with path) where this ArtiHook is implemented.
        string ArtiHookInstance: scope=ECU, set at pre-compile  # Name of an instance of the (schedule) class.
        foreign reference ArtiHookEntryRef [0..1]: multiplicity set at pre-compile, set at pre-compile, destination-type=BSW-MODULE-ENTRY  # Reference to the BswModuleEntry that describes the parameters of this hook.
        reference ArtiHookEventParameterTypeRef [0..1]: scope=ECU, multiplicity set at pre-compile, set at pre-compile, destination=ArtiParameterTypeMap  # Refers to a parameter type to interpret the hook event number.
        reference ArtiHookInstanceParameterTypeRef [0..1]: scope=ECU, multiplicity set at pre-compile, set at pre-compile, destination=ArtiParameterTypeMap  # Refers to a parameter type to interpret the hook instance number.
      container ArtiObjectClassParameter [0..*]: multiplicity set at pre-compile  # This container represents a parameter of an Arti object class definition.
        reference ArtiObjectClassParameterTypeMapRef [0..1]: scope=ECU, multiplicity set at pre-compile, set at pre-compile, destination=ArtiParameterTypeMap  # Refers to a parameter type to interpret the instance parameter value.
      container ArtiObjectInstanceParameter [0..*]: multiplicity set at pre-compile  # This container represents a parameter of an Arti object instance.
        reference ArtiObjectInstanceParameterConstantRef [0..1]: scope=ECU, multiplicity set at pre-compile, set at pre-compile, destination=ArtiConstant  # Refers to a constant representing the value of this parameter.
        reference ArtiObjectInstanceParameterExpressionRef [0..1]: scope=ECU, multiplicity set at pre-compile, set at pre-compile, destination=ArtiExpression  # Refers to an expression that evaluates the value of this parameter.
        reference ArtiObjectInstanceParameterHookRef [0..1]: scope=ECU, multiplicity set at pre-compile, set at pre-compile, destination=ArtiHook  # Refers to a hook that records this parameter.
      container ArtiParameterTypeMap [0..*]: multiplicity set at pre-compile  # A map of key/value pairs to map a parameter value to a display string and/or an Arti or EcuC object.
        container ArtiParameterTypeMapPair [1..*]: multiplicity set at pre-compile  # A key/value pair to map a parameter value to a display string and/or an Arti or EcuC object.
          integer ArtiParameterTypeMapPairInput [0..1]: 0..18446744073709551615, scope=ECU, multiplicity set at pre-compile, set at pre-compile  # The numerical value given by a parameter to translate. | When used with ArtiHooks, this parameter is mandatory (multiplicity 1) and its value is limited to the range of 0..65535. This parameter may be used to map the values given by "instanceParameter" and/or the "eventParameter" of the ARTI_TRACE macro.
          string ArtiParameterTypeMapPairOutput [0..1]: scope=ECU, multiplicity set at pre-compile, set at pre-compile  # The string to display for the Input value.
          reference ArtiParameterTypeMapPairInputExpressionRef [0..1]: scope=ECU, multiplicity set at pre-compile, set at pre-compile, destination=ArtiExpression  # Refers to an expression that evaluates to a numerical value to translate.
          choice reference ArtiParameterTypeMapPairOutputRef [0..1]: scope=ECU, multiplicity set at pre-compile, set at pre-compile, destination=[ArtiOsContextInstance, ArtiOsIsrInstance, ArtiOsStackInstance, ArtiOsTaskInstance, ArtiStatesScheduleTableState, ArtiStatesSpinlockOwnerType, ArtiStatesSpinlockState, ArtiStatesTaskState, OsAppMode]  # Choice Reference to ArtiOsTaskInstance, ArtiOsIsrInstance, ArtiStatesTaskState, OsAppMode, ArtiOsContextInstance, or ArtiOsStackInstance.
      container ArtiStates [0..*]: multiplicity set at pre-compile  # This container contains all states of tasks, isrs... that the EcuC uses.
        boolean ArtiStatesTaskEnhanced: set at pre-compile  # Set to true, if the OS provides an "enhanced" state model with "READY" split to "Activated", "Preempted", "Released".
        container ArtiStatesScheduleTableState [0..*]: multiplicity set at pre-compile  # Each state used by the OsScheduleTable has to be listed as ArtiStatesScheduleTableState parameter with a choice of the states.
          enumeration ArtiStatesScheduleTableStateEnum: {ArtiScheduleTableStateNext, ArtiScheduleTableStateRunning, ArtiScheduleTableStateRunningAndSynchronous, ArtiScheduleTableStateStopped, ArtiScheduleTableStateWaiting}, set at pre-compile  # ArtiStatesScheduleTableState choice of the states.
        container ArtiStatesSpinlockOwnerType [0..*]: multiplicity set at pre-compile  # Each owner type used by the OsSpinlock has to be listed as ArtiStatesSpinlockOwnerType parameter with a choice of the states.
          enumeration ArtiStatesSpinlockOwnerTypeEnum: {ArtiSpinlockOwnerTypeIsr2, ArtiSpinlockOwnerTypeTask}, set at pre-compile  # ArtiStatesSpinlockOwnerType choice of the states.
        container ArtiStatesSpinlockState [0..*]: multiplicity set at pre-compile  # Each state used by the OsSpinlock has to be listed as ArtiStatesSpinlockState parameter with a choice of the states.
          enumeration ArtiStatesSpinlockStateEnum: {ArtiSpinlockStateLocked, ArtiSpinlockStateUnlocked}, set at pre-compile  # ArtiStatesSpinlockState choice of the states.
        container ArtiStatesTaskState [0..*]: multiplicity set at pre-compile  # Each state used by the OS has to be listed as ArtiStatesTaskState Parameter with a choice of the states.
          enumeration ArtiStatesTaskStateEnum: {ArtiTaskStateActivated, ArtiTaskStatePreempted, ArtiTaskStateReady, ArtiTaskStateReleased, ArtiTaskStateRunning, ArtiTaskStateSuspended, ArtiTaskStateWaiting}, set at pre-compile  # ArtiStatesTaskState choice of the states.
