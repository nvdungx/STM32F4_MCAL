AUTOSAR XML (schema 00046)
package /AUTOSAR/EcucDefs
  ecuc definition collection AUTOSARParameterDefinition: module=Arti
  module definition Arti [0..1]: post-build-variant-support=true, variants post-build/pre-compile  # The Arti Module contains all parameters for ARTI that are filled by the generators (OS, RTE, ...). Tags: atp.Status=draft
    container ArtiConstant [0..*]: multiplicity set at pre-compile  # This container holds a constant value. Tags: atp.Status=draft
      string ArtiConstantString: scope=ECU, set at pre-compile  # This is the constant value for a specific parameter. Tags: atp.Status=draft
    container ArtiExpression [0..*]: multiplicity set at pre-compile  # This container holds a C like expression that a debugger can evaluate. This is similar to what is already done in ORTI. Tags: atp.Status=draft
      string ArtiExpressionString: scope=ECU, post-build-variant-value=true, set at pre-compile  # This string represents a C like expression that a debugger can evaluate. Tags: atp.Status=draft
    container ArtiHook [0..*]: multiplicity set at pre-compile  # This container represents an ARTI hook that is present in the module. Tags: atp.Status=draft
      string ArtiHookClass: scope=ECU, set at pre-compile  # Name of the (schedule) class of macros. Classes can be one of the predefined classes or user defined. Tags: atp.Status=draft
      string ArtiHookEventName: scope=ECU, set at pre-compile  # The name of the event as defined for a particular class, or an arbitrary name for generic classes. Tags: atp.Status=draft
      string ArtiHookInstance: scope=ECU, set at pre-compile  # Name of an instance of the (schedule) class. Tags: atp.Status=draft
      reference ArtiHookEventParameterTypeRef [0..1]: scope=ECU, multiplicity set at pre-compile, set at pre-compile, destination=ArtiParameterTypeMap  # Refers to a parameter type to interpret the hook event number. Tags: atp.Status=draft
      reference ArtiHookInstanceParameterTypeRef [0..1]: scope=ECU, multiplicity set at pre-compile, set at pre-compile, destination=ArtiParameterTypeMap  # Refers to a parameter type to interpret the hook instance number. Tags: atp.Status=draft
    container ArtiObjectClassParameter [0..*]: multiplicity set at pre-compile  # This container represents a parameter of an Arti object class definition. Tags: atp.Status=draft
      reference ArtiParameterTypeMapRef [0..1]: scope=ECU, multiplicity set at pre-compile, set at pre-compile, destination=ArtiParameterTypeMap  # Refers to a parameter type to interpret the instance parameter value. Tags: atp.Status=draft
    container ArtiObjectInstanceParameter [0..*]: multiplicity set at pre-compile  # This container represents a parameter of an Arti object instance. Tags: atp.Status=draft
      reference ArtiConstantRef [0..1]: scope=ECU, multiplicity set at pre-compile, set at pre-compile, destination=ArtiConstant  # Refers to a constant representing the value of this parameter. Tags: atp.Status=draft
      reference ArtiExpressionRef [0..1]: scope=ECU, multiplicity set at pre-compile, set at pre-compile, destination=ArtiExpression  # Refers to an expression that evaluates the value of this parameter. Tags: atp.Status=draft
      reference ArtiHookRef [0..1]: scope=ECU, multiplicity set at pre-compile, set at pre-compile, destination=ArtiHook  # Refers to a hook that records this parameter. Tags: atp.Status=draft
    container ArtiParameterTypeMap [0..*]: multiplicity set at pre-compile  # This container represents a map of key/value pairs to map a parameter value to a display string. Tags: atp.Status=draft
      container ArtiParameterTypeMapPair [1..*]: multiplicity set at pre-compile  # A key/value pair to map a parameter value to a display string. Tags: atp.Status=draft
        string ArtiParameterTypeMapPairInput: scope=ECU, set at pre-compile  # The value given by a parameter to translate. Tags: atp.Status=draft
        string ArtiParameterTypeMapPairOutput: scope=ECU, set at pre-compile  # The string to display for the Input value. Tags: atp.Status=draft
