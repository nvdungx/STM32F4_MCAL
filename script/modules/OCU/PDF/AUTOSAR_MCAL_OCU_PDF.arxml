AUTOSAR XML (schema 00053)
package /AUTOSAR/EcucDefs
  ecuc definition collection AUTOSARParameterDefinition: module=Ocu
  module definition Ocu [0..1]: post-build-variant-support=true, variants post-build/pre-compile  # Configuration of Ocu (Output Compare Unit) module.
    container OcuConfigSet  # This container is the base of a Configuration Set, which contains the configured OCU channels. This way, different configuration sets can be defined for post-build process.
      enumeration OcuCountdirection [0..1]: {OCU_DOWNCOUNTING, OCU_UPCOUNTING}, multiplicity set at post-build in variant post-build / pre-compile in variant pre-compile, post-build-variant-multiplicity=true, post-build-variant-value=true, set at post-build in variant post-build / pre-compile in variant pre-compile, default-value=OCU_UPCOUNTING  # This parameter indicates the count direction for the whole OCU driver.
      container OcuChannel [1..*]  # Configuration of an individual OCU channel.
        integer OcuAssignedHardwareChannel: 0..255, post-build-variant-value=true, set at post-build in variant post-build / pre-compile in variant pre-compile  # The physical hardware channel that is assigned to this logical channel.
        integer OcuChannelId: 0..65535, set at pre-compile, symbolic-name-value=true  # Channel Id of the OCU channel. This value will be assigned to the symbolic name derived from the OcuChannel container short name. It defines the assignment of the channel to the physical OCU hardware channel.
        integer OcuChannelTickDuration: 1..32768, post-build-variant-value=true, set at post-build in variant post-build / pre-compile in variant pre-compile  # Specifies the number of input clock edges (rising or falling edges) required to increase the channel counter by one (i.e. one counter tick). The value range depends on the used HW, not all values may be relevant
        integer OcuDefaultThreshold: 0..4294967295, post-build-variant-value=true, set at post-build in variant post-build / pre-compile in variant pre-compile  # Value of comparison threshold used for Initialization.
        integer OcuHardwareTriggeredAdc [0..1]: 0..255, multiplicity set at post-build in variant post-build / pre-compile in variant pre-compile, post-build-variant-multiplicity=true, post-build-variant-value=true, set at post-build in variant post-build / pre-compile in variant pre-compile, default-value=0  # This parameter is used to allow the OCU channel to trigger an ADC channel upon compare match, if this is supported by hardware. The value of the parameter represents the ADC physical channel to trigger.
        integer OcuHardwareTriggeredDMA [0..1]: 0..255, multiplicity set at post-build in variant post-build / pre-compile in variant pre-compile, post-build-variant-multiplicity=true, post-build-variant-value=true, set at post-build in variant post-build / pre-compile in variant pre-compile, default-value=0  # This parameter is used to allow the OCU channel to trigger a DMA channel upon compare match, if this is supported by hardware. The value of the parameter represents the DMA physical channel to trigger.
        integer OcuMaxCounterValue: 1..4294967295, post-build-variant-value=true, set at post-build in variant post-build / pre-compile in variant pre-compile  # Maximum value in ticks, the counter of the OCU channel is able to count.
        function name OcuNotification [0..1]: multiplicity set at post-build in variant post-build / pre-compile in variant pre-compile, post-build-variant-multiplicity=true, post-build-variant-value=true, set at post-build in variant post-build / pre-compile in variant pre-compile  # Definition of a function pointer to a Callback function.
        enumeration OcuOutputPinDefaultState [0..1]: {OCU_HIGH, OCU_LOW}, multiplicity set at post-build in variant post-build / pre-compile in variant pre-compile, post-build-variant-multiplicity=true, post-build-variant-value=true, set at post-build in variant post-build / pre-compile in variant pre-compile  # The parameter OcuOutputPinDefaultState represents the state that a pin associated with a channel shall be set to after initialisation.
        boolean OcuOutputPinUsed: set at pre-compile  # Information about the usage of an output pin on this channel. | True: the channel uses an output pin. False: the channel does not use an output pin.
        reference OcuChannelEcucPartitionRef [0..*]: scope=ECU, multiplicity set at pre-compile, post-build-variant-multiplicity=true, post-build-variant-value=true, set at pre-compile, destination=EcucPartition  # Maps an OCU channel to zero or multiple ECUC partitions to limit the access to this channel. The ECUC partitions referenced are a subset of the ECUC partitions where the OCU driver is mapped to.
        reference OcuHWSpecificSettingsRef [0..1]: multiplicity set at pre-compile, post-build-variant-multiplicity=true, post-build-variant-value=true, set at pre-compile, destination=OcuHWSpecificSettings  # Reference to the OcuHWSpecificSettings used by the OcuChannel.
      container OcuHWSpecificSettings [0..*]  # This container contains Ocu-specific parameters for selecting the clock source and setting optional prescalers if supported by hardware. | Implementation is defined vendor specific.
        enumeration OcuClockSource [0..1]: multiplicity set at post-build in variant post-build / pre-compile in variant pre-compile, post-build-variant-multiplicity=true, post-build-variant-value=true, set at post-build in variant post-build / pre-compile in variant pre-compile  # The OCU driver specific clock input for the unit can statically be configured to select different clock sources if provided by hardware. Enumeration literals are defined vendor specific.
        enumeration OcuPrescale [0..1]: multiplicity set at post-build in variant post-build / pre-compile in variant pre-compile, post-build-variant-multiplicity=true, post-build-variant-value=true, set at post-build in variant post-build / pre-compile in variant pre-compile  # Optional OCU driver specific clock prescale factor, if supported by hardware. Implementation is defined vendor specific.
    container OcuConfigurationOfOptionalApis  # Configuration of optional APIs.
      boolean OcuDeInitApi: set at pre-compile  # Adds / removes the service Ocu_DeInit() from the code.
      boolean OcuGetCounterApi: set at pre-compile  # Adds / removes the service Ocu_GetCounter() from the code.
      boolean OcuNotificationSupported: set at pre-compile  # Adds / removes the services Ocu_EnableNotification() and Ocu_DisableNotification() from the code.
      boolean OcuSetAbsoluteThresholdApi: set at pre-compile  # Adds / removes the service Ocu_SetAbsoluteThreshold() from the code.
      boolean OcuSetPinActionApi: set at pre-compile  # Adds / removes the service Ocu_SetPinAction() from the code.
      boolean OcuSetPinStateApi: set at pre-compile  # Adds / removes the service Ocu_SetPinState() from the code.
      boolean OcuSetRelativeThresholdApi: set at pre-compile  # Adds / removes the service Ocu_SetRelativeThreshold() from the code.
      boolean OcuVersionInfoApi: set at pre-compile, default-value=false  # Switch to indicate that the Ocu_GetVersionInfo() is supported.
    container OcuGeneral  # This container contains the module-wide configuration parameters of the OCU Driver.
      boolean OcuDevErrorDetect: set at pre-compile, default-value=false  # Switches the development error detection and notification on or off. | * true: detection and notification is enabled. * false: detection and notification is disabled.
      reference OcuEcucPartitionRef [0..*]: scope=ECU, multiplicity set at pre-compile, post-build-variant-multiplicity=true, post-build-variant-value=true, set at pre-compile, destination=EcucPartition  # Maps the OCU driver to zero or multiple ECUC partitions to make the driver API available in the according partition.
      reference OcuKernelEcucPartitionRef [0..1]: scope=ECU, multiplicity set at pre-compile, post-build-variant-multiplicity=true, post-build-variant-value=true, set at pre-compile, destination=EcucPartition  # Maps the OCU kernel to zero or one ECUC partitions to assign the driver kernel to a certain core. The ECUC partition referenced is a subset of the ECUC partitions where the OCU driver is mapped to.
