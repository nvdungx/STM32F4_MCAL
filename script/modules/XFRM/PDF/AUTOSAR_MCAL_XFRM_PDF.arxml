AUTOSAR XML (schema 00053)
package /AUTOSAR/EcucDefs
  ecuc definition collection AUTOSARParameterDefinition: module=Xfrm
  module definition Xfrm [0..*]: variants pre-compile  # Configuration of the Xfrm module.
    container XfrmGeneral  # Contains the general configuration parameters of the module.
      boolean XfrmDevErrorDetect: set at pre-compile, default-value=false  # Switches the development error detection and notification on or off. | * true: detection and notification is enabled. * false: detection and notification is disabled.
      integer XfrmInstanceId: 0..255, set at pre-compile  # Specifies the InstanceId of this module instance. If only one instance is present it shall have the Id 0.
      boolean XfrmVersionInfoApi: set at pre-compile, default-value=false  # Activate/Deactivate the version information API. | * true: version information API activated * false: version information API deactivated
    container XfrmImplementationMapping [1..*]  # For each transformer (TransformationTechnology) in a transformer chain (DataTransformation) which is applied to an ISignal it is necessary to specify the BswModuleEntry which implements it. This is the container to hold these mappings.
      enumeration XfrmTransformerClassExtractProtocolHeaderFields [0..1]: {SAFETY, SECURITY, SERIALIZER}, multiplicity set at pre-compile, set at pre-compile  # Defines the transformerClass of the TransformationTechnology containing information in its protocol header that is required to distinguish between requests vs. responses and normal vs. error responses in C/S communication. Usually this shall be the TransformationTechnology with transformerClass equal to "serializer". | Setting this parameter basically instructs the RTE to pass a pointer to the Mip_ExtractProtocolHeaderFields() function of the respective transformer as an additional argument to the called transformer function. E.g., if the serializing transformer in the transformer chain is SomeIpXf and this parameter is set to SERIALIZER, then SomeIpXf_ExtractProtocolHeaderFields() will be passed as additional argument.
      foreign reference XfrmCSTransactionHandleImplementationDataTypeRef [0..1]: multiplicity set at pre-compile, set at pre-compile, destination-type=IMPLEMENTATION-DATA-TYPE  # Reference to the ImplementationDataType with category STRUCTURE which defines the type of the C/S transaction handle. Setting this parameter basically instructs the RTE to pass a reference to a variable of exactly this ImplementationDataType as an additional argument to the called transformer function.
      foreign reference XfrmInvTransformerBswModuleEntryRef [0..1]: multiplicity set at pre-compile, set at pre-compile, destination-type=BSW-MODULE-ENTRY  # Reference to the BswModuleEntry which implements the referenced inverse transformer on the receiving/called side.
      foreign reference XfrmTransformationTechnologyRef: set at pre-compile, destination-type=TRANSFORMATION-TECHNOLOGY  # Reference to the TransformationTechnology in the DataTransformation of the system description for which the implementation (BswModuleEntry) shall be mapped.
      foreign reference XfrmTransformerBswModuleEntryRef [0..1]: multiplicity set at pre-compile, set at pre-compile, destination-type=BSW-MODULE-ENTRY  # Reference to the BswModuleEntry which implements the referenced transformer on the sending/calling side.
      instance reference XfrmVariableDataPrototypeInstanceRef [0..1]: multiplicity set at pre-compile, set at pre-compile, destination-context=SW-COMPONENT-PROTOTYPE PORT-PROTOTYPE, destination-type=VARIABLE-DATA-PROTOTYPE  # Instance Reference to a VariableDataPrototype in case a dedicated transformer BswModuleEntry is required per VariableDataPrototype access.
      container XfrmDemEventParameterRefs [0..1]  # Container for the references to DemEventParameter elements which shall be invoked using the API Dem_SetEventStatus in case the corresponding error occurs. The EventId is taken from the referenced DemEventParameter's DemEventId symbolic value. The standardized errors are provided in this container and can be extended by vendor-specific error references.
        reference XFRM_E_MALFORMED_MESSAGE [0..1]: multiplicity set at pre-compile, set at pre-compile, requires-symbolic-name-value=true, destination=DemEventParameter  # Reference to configured DEM event to report if malformed messages were received by the transformer.
      container XfrmSignal [0..1]  # Reference to the signal in the system description that transports the transformed data.
        choice container XfrmSignalChoice  # Choice whether an ISignal or an ISignalGroup shall be referenced.
          container XfrmISignalGroupRefChoice [0..1]  # Reference to the ISignalGroup in the system description that transports the transformed data.
            foreign reference XfrmISignalGroupRef: set at pre-compile, destination-type=I-SIGNAL-GROUP  # Reference to the ISignalGroup in the system description that transports the transformed data.
          container XfrmISignalRefChoice [0..1]  # Reference to the ISignal in the system description that transports the transformed data.
            foreign reference XfrmISignalRef: set at pre-compile, destination-type=I-SIGNAL  # Reference to the ISignal in the system description that transports the transformed data.
