AUTOSAR XML (schema 00053)
package /AUTOSAR/EcucDefs
  ecuc definition collection AUTOSARParameterDefinition: module=CanTSyn
  module definition CanTSyn [0..1]: post-build-variant-support=true, variants pre-compile  # Configuration of the Synchronized Time-base Manager (StbM) module with respect to global time handling on CAN.
    container CanTSynGeneral  # This container holds the general parameters of the CAN-specific Synchronized Time-base Manager
      boolean CanTSynDevErrorDetect: set at pre-compile, default-value=false  # Switches the development error detection and notification on or off. | * true: detection and notification is enabled. * false: detection and notification is disabled.
      boolean CanTSynEnableSecurityEventReporting: set at pre-compile, default-value=false  # Switches the reporting of security events to the IdsM: | - true: reporting is enabled. - false: reporting is disabled.
      boolean CanTSynHardwareTimestampSupport: set at pre-compile  # Activate/Deactivate the hardware time stamping functionality of the CAN hardware. Tags: atp.Status=draft | True: Timestamp is retrieved from the CAN hardware False: Timestamp is retrieved from the StbM
      float CanTSynMainFunctionPeriod: 0..INF, set at pre-compile  # Schedule period of the main function CanTSyn_MainFunction. Unit: [s].
      integer CanTSynSyncTransmissionsPerCycle [0..1]: 0..255, multiplicity set at pre-compile, set at pre-compile, default-value=0  # Maximum number of SYNC message transmissions within one CanTSyn_MainFunction Tags: atp.Status=draft
      boolean CanTSynTimeValidationSupport: set at pre-compile, default-value=false  # Switches support for Time Validation on or off. | * true: Time Validation is enabled. * false: Time Validation is disabled
      boolean CanTSynVersionInfoApi: set at pre-compile, default-value=false  # Activate/Deactivate the version information API (CanTSyn_GetVersionInfo). True: version information API activated False: version information API deactivated.
      container CanTSynSecurityEventRefs [0..1]: multiplicity set at pre-compile  # Container for the references to IdsMEvent elements representing the security events that the CanTSyn module shall report to the IdsM in case the coresponding security related event occurs (and if | CanTSynEnableSecurityEventReporting is set to "true"). The standardized security events in this container can be extended by vendor-specific security events.
        reference SEV_TSYN_CAN_FRESHNESS_NOT_AVAILABLE [0..1]: multiplicity set at pre-compile, set at pre-compile, requires-symbolic-name-value=true, destination=IdsMEvent  # FV not available from FVM. Context data provides the respective domain ID.
        reference SEV_TSYN_CAN_ICV_GENERATION_FAILED [0..1]: multiplicity set at pre-compile, set at pre-compile, requires-symbolic-name-value=true, destination=IdsMEvent  # ICV generation for Follow_Up message failed. Context data provides the respective domain ID
        reference SEV_TSYN_CAN_ICV_VERIFICATION_FAILED [0..1]: multiplicity set at pre-compile, set at pre-compile, requires-symbolic-name-value=true, destination=IdsMEvent  # ICV verification for Follow_Up message failed. Context data provides the respective domain ID.
        reference SEV_TSYN_CAN_MSG_SEQUENCE_ERROR [0..1]: multiplicity set at pre-compile, set at pre-compile, requires-symbolic-name-value=true, destination=IdsMEvent  # Failed to receive correct sequence of SYNC and FUP from the TimeMaster within (CanTSynGlobalTimeFollowUpTimeout).
    container CanTSynGlobalTimeDomain [1..*]  # This represents the existence of a global time domain on CAN. The CanTSyn module can administrate several global time domains at the same time that in itself form a hierarchy of domains and sub-domains. | If the CanTSyn exists it is assumed that at least one global time domain exists.
      boolean CanTSynEnableTimeValidation [0..1]: set at pre-compile  # Enables/disables time recording for Time Validation for a specific Time Domain.
      integer CanTSynGlobalTimeDomainId: 0..15, set at pre-compile  # The global time domain ID.
      integer CanTSynGlobalTimeNetworkSegmentId [0..1]: 0..255, multiplicity set at pre-compile, post-build-variant-value=true, set at pre-compile  # This represents the numerical identifier of the network on system level scope where this Global Time has been communicated on.
      boolean CanTSynUseExtendedMsgFormat: set at pre-compile, default-value=false  # Switches support for 16 Byte Timesync messages on or off (for CAN FD only) | * true: CAN FD support is active: use at least 16 byte for Timesync messages (depending on configuration) * false: Classic CAN support is active: use always 8 byte for Timesync messages
      reference CanTSynSynchronizedTimeBaseRef: set at pre-compile, requires-symbolic-name-value=true, destination=StbMSynchronizedTimeBase  # Mandatory reference to the required synchronized time-base.
      container CanTSynGlobalTimeFupDataIDList [0..1]: multiplicity set at pre-compile, post-build-variant-multiplicity=true  # The DataIDList for FUP messages ensures the identification of data elements due to CRC calculation and message authentication process.
        container CanTSynGlobalTimeFupDataIDListElement [16..16]  # Element of the DataIDList for FUP messages ensures the identification of data elements due to CRC calculation and message authentication process.
          integer CanTSynGlobalTimeFupDataIDListIndex: 0..15, post-build-variant-value=true, set at pre-compile  # Index of the DataIDList for FUP messages ensures the identification of data elements due to CRC calculation and message authentication process.
          integer CanTSynGlobalTimeFupDataIDListValue: 0..255, post-build-variant-value=true, set at pre-compile  # Value of the DataIDList for FUP messages ensures the identification of data elements due to CRC calculation and message authentication process.
      container CanTSynGlobalTimeMaster [0..1]: multiplicity set at pre-compile, post-build-variant-multiplicity=true  # Configuration of a Time Master for a Time Domain (refer to parent container). If CanTSynGlobalTimeMaster container exists, the local ECU acts as a Time Master for the Time Domain.
        float CanTSynCyclicMsgResumeTime: 0..INF, post-build-variant-value=true, set at pre-compile  # Defines the time where the 1st regular cycle time based message transmission takes place, after an immediate transmission before. Unit: seconds
        float CanTSynGlobalTimeDebounceTime: 0..4, post-build-variant-value=true, set at pre-compile  # This represents the configuration of a TX debounce time for SYNC and FUP messages compared to a message before with the same PDU. Unit: seconds
        enumeration CanTSynGlobalTimeTxCrcSecured: {CRC_NOT_SUPPORTED, CRC_SUPPORTED}, post-build-variant-value=true, set at pre-compile  # This represents the configuration of whether or not CRC is supported.
        enumeration CanTSynGlobalTimeTxIcvSecured: set at pre-compile, default-value=ICV_NOT_SUPPORTED  # This parameter controls whether or not ICV generation shall be supported. Tags: atp.Status=draft
          ICV_NOT_SUPPORTED  # Tags: atp.Status=draft
          ICV_SUPPORTED  # Tags: atp.Status=draft
        float CanTSynGlobalTimeTxPeriod: 0..INF, post-build-variant-value=true, set at pre-compile  # This represents configuration of the TX period. Unit: seconds
        boolean CanTSynImmediateTimeSync: post-build-variant-value=true, set at pre-compile  # Enables/Disables the cyclic polling of StbM_GetTimeBaseUpdateCounter() within CanTSyn_MainFunction().
        container CanTSynGlobalTimeMasterPdu  # This container encloses the configuration of the PDU that is supposed to contain the global time information.
          integer CanTSynGlobalTimeMasterConfirmationHandleId: 0..65535, set at pre-compile, symbolic-name-value=true, with-auto=true  # This represents the handle ID of the PDU that contains the global time information.
          reference CanTSynGlobalTimePduRef: post-build-variant-value=true, set at pre-compile, destination=Pdu  # This represents the reference to the Pdu taken to transmit the global time information. The global time master of a global time domain acts as the sender of the Pdu while all the time slaves are supposed to receive the Pdu.
        container CanTSynGlobalTimeTxIcvGeneration [0..1]: multiplicity set at pre-compile  # This container collects configuration that shall be used for ICV generation.
          enumeration CanTSynIcvGenerationBase: {ICV_MAC, ICV_SIGNATURE}, set at pre-compile  # Symmetric or asymmetric cryptography selection for the ICV generation
          float CanTSynIcvGenerationTimeout: 0..INF, set at pre-compile  # Timeout of ICV generation (respective CSM job completion in asynchronous behavior). A value of 0 disables the ICV timeout monitoring. Unit: Seconds
          integer CanTSynIcvTxLength: 0..54, set at pre-compile  # Length of ICV to be transmitted within Follow_Up Message on the bus (in bytes).
          integer CanTSynTxAuthenticationBuildAttempts: 0..65535, set at pre-compile, default-value=0  # This parameter specifies the number of authentication build attempts that are to be carried out when the generation of the ICV failed for a given FUP message. If zero is set, then only one ICV build attempt is done.
          reference CanTSynIcvGenerationFvIdRef [0..1]: multiplicity set at pre-compile, set at pre-compile, requires-symbolic-name-value=true, destination=StbMFreshnessValue  # This represents the reference to the FV taken to generate the ICV generation.
          reference CanTSynIcvGenerationJobRef: set at pre-compile, requires-symbolic-name-value=true, destination=CsmJob  # This represents the reference to the CSM job to fetch the CSM job ID.
      container CanTSynGlobalTimeSlave [0..1]: multiplicity set at pre-compile, post-build-variant-multiplicity=true  # Configuration of a Time Slave for a Time Domain (refer to parent container). If CanTSynGlobalTimeSlave container exists, the local ECU acts as a Time Slave for the Time Domain.
        float CanTSynGlobalTimeFollowUpTimeout: 0..INF, post-build-variant-value=true, set at pre-compile  # Rx timeout for the follow-up message. This is only relevant for selected bus systems Unit:seconds
        float CanTSynGlobalTimeRxDebounceTime: 0..4, post-build-variant-value=true, set at pre-compile  # This represents the configuration of a RX debounce time for the Sync and FUP. Unit: seconds
        integer CanTSynGlobalTimeSequenceCounterHysteresis: 0..15, post-build-variant-value=true, set at pre-compile, default-value=0  # CanTSynGlobalTimeSequenceCounterHysteresis specifies the number of consecutive valid message pairs that are required by the Time Slave while being in Timeout state until a Time Tuple is forwarded to the StbM.
        integer CanTSynGlobalTimeSequenceCounterJumpWidth: 0..15, post-build-variant-value=true, set at pre-compile, default-value=0  # The SequenceCounterJumpWidth specifies the maximum allowed gap of the Sequence Counter between two SYNC messages.
        enumeration CanTSynRxCrcValidated: {CRC_IGNORED, CRC_NOT_VALIDATED, CRC_OPTIONAL, CRC_VALIDATED}, post-build-variant-value=true, set at pre-compile  # Definition of whether or not validation of the CRC is supported.
        enumeration CanTSynRxIcvVerificationType: {ICV_IGNORED, ICV_NOT_VERIFIED, ICV_OPTIONAL, ICV_VERIFIED}, set at pre-compile  # This parameter controls whether or not ICV verification shall be supported.
        container CanTSynGlobalTimeRxIcvVerification [0..1]: multiplicity set at pre-compile  # This container collects configuration required for ICV verification.
          integer CanTSynIcvRxLength: 0..54, set at pre-compile  # Length of ICV to be used for verification of received ICV within FUP Message in Bytes.
          integer CanTSynIcvVerificationAttempts: 0..65535, set at pre-compile, default-value=0  # This parameter specifies the number of ICV verification attempts that are to be carried out when the verification of the ICV failed for a given FUP message. If zero is set, then only one ICV verification attempt is | done.
          enumeration CanTSynIcvVerificationBase: {ICV_MAC, ICV_SIGNATURE}, set at pre-compile  # Symmetric or asymmetric cryptography selection for the ICV generation
          float CanTSynIcvVerificationTimeout: 0..INF, set at pre-compile  # Timeout of ICV generation (respective CSM job completion in asynchronous behavior). A value of 0 disables the ICV timeout monitoring. Unit: Seconds
          integer CanTSynRxAuthenticationBuildAttempts: 0..65535, set at pre-compile, default-value=0  # This parameter specifies the number of authentication build attempts that are to be carried out when the verification of the ICV failed for a given FUP message. If zero is set, then only one ICV verification attempt is done.
          reference CanTSynIcvVerificationFvIdRef [0..1]: multiplicity set at pre-compile, set at pre-compile, requires-symbolic-name-value=true, destination=StbMFreshnessValue  # This represents the reference to the FV taken to generate the ICV generation.
          reference CanTSynIcvVerificationJobRef: set at pre-compile, requires-symbolic-name-value=true, destination=CsmJob  # This represents the reference to the CSM job to fetch the CSM job ID.
        container CanTSynGlobalTimeSlavePdu  # This container encloses the configuration of the PDU that is supposed to contain the global time information. | Supported MetaData entry: TIMETUPLE_TYPE_PTR
          float CanTSynGlobalTimePropagationDelay: 0..1, post-build-variant-value=true, set at pre-compile, default-value=0  # Physical Layer specific propagation delay of a SYNC message to be compensated upon SYNC reception. Unit: seconds.
          integer CanTSynGlobalTimeSlaveHandleId: 0..65535, set at pre-compile, symbolic-name-value=true, with-auto=true  # This represents the handle ID of the PDU that contains the global time information.
          reference CanTSynGlobalTimePduRef: post-build-variant-value=true, set at pre-compile, destination=Pdu  # This represents the reference to the Pdu taken to transmit the global time information. The global time master of a global time domain acts as the sender of the Pdu while all the time slaves are supposed to receive the Pdu.
      container CanTSynGlobalTimeSyncDataIDList [0..1]: multiplicity set at pre-compile, post-build-variant-multiplicity=true  # The DataIDList for SYNC messages ensures the identification of data elements due to CRC calculation and message authentication process.
        container CanTSynGlobalTimeSyncDataIDListElement [16..16]  # Element of the DataIDList for SYNC messages ensures the identification of data elements due to CRC calculation and message authentication process.
          integer CanTSynGlobalTimeSyncDataIDListIndex: 0..15, post-build-variant-value=true, set at pre-compile  # Index for the DataIDList for SYNC messages ensures the identification of data elements due to CRC calculation and message authentication process.
          integer CanTSynGlobalTimeSyncDataIDListValue: 0..255, post-build-variant-value=true, set at pre-compile  # Value of the DataIDList for SYNC messages ensures the identification of data elements due to CRC calculation and message authentication process.
