AUTOSAR XML (schema 00053)
package /AUTOSAR/EcucDefs
  ecuc definition collection AUTOSARParameterDefinition: module=LSduR
  module definition LSduR [0..1]: post-build-variant-support=true, variants link-time/post-build/pre-compile  # Configuration of the LSduR module. Tags: atp.Status=draft
    container LSduRBswModules [0..*]: multiplicity set at pre-compile  # Each container describes a specific BSW module (upper/CDD/lower/IEEE1722Tp) that the Tags: atp.Status=draft | L-SDU Router shall interface to. The reason to have it as own configuration container instead of implication of the routing path is to be able to configure CDDs properly and to force modules to be used in a post-build situation even though no routing is made to/from this module (future configurations may include these modules).
      boolean LSduRLowerModule: scope=ECU, set at pre-compile  # The LSduRLowerModule will decide who will call the APIs and who will implement the APIs. Tags: atp.Status=draft | For example, if the EthIf module is referenced then the L-SDU Router module will implement the LSduR_EthIfRxIndication API and the L-SDU Router module will call the EthIf_Transmit API. Other APIs are of course also covered. An upper module can also be an lower module (e.g. the IEEE1722Tp module).
      boolean LSduRProvideTxBuffer: scope=ECU, set at pre-compile  # Specifies if BSW module supports the (IF) ProvideTxBuffer API or not. Value true the API is supported. Tags: atp.Status=draft
      boolean LSduRReleaseRxBuffer: scope=ECU, set at pre-compile  # Specifies if BSW module supports the ReleaseRxBuffer API or not. Value true the API is supported. Tags: atp.Status=draft
      boolean LSduRRxIndication: scope=ECU, set at pre-compile  # Specifies if BSW module supports the RxIndication API or not. Value true the API is supported. Tags: atp.Status=draft
      boolean LSduRTransmit: scope=ECU, set at pre-compile  # Specifies if BSW module supports the (IF) Transmit API or not. Value true the API is supported. Tags: atp.Status=draft
      boolean LSduRTxConfirmation: scope=ECU, set at pre-compile  # Specifies if the BSW module supports the TxConfirmation API or not. Value true the API is supported. Tags: atp.Status=draft
      boolean LSduRUpperModule: scope=ECU, set at pre-compile  # The LSduRUpperModule will decide who will call the APIs and who will implement the APIs. Tags: atp.Status=draft | For example, if the IEEE1722Tp module is referenced then the L-SDU Router module will implement the LSduR_Transmit API and the L-SDU Router module will call the IEEE1722_RxIndication API. Other APIs are of course also covered. An upper module can also be an lower module (e.g. the IEEE1722Tp module).
      foreign reference LSduRBswModuleRef: scope=ECU, set at pre-compile, destination-type=ECUC-MODULE-CONFIGURATION-VALUES  # This is a reference to one BSW module's configuration (i.e. not the ECUC parameter definition template). Tags: atp.Status=draft | Example, there could be several configurations of EthIf and this reference selects one of them.
    container LSduRConfig  # This container contains the configuration parameters and sub containers of the AUTOSAR LSduR module. Tags: atp.Status=draft
      container LSduRPath [0..*]: multiplicity set at link in variant link-time / post-build in variant post-build / pre-compile in variant pre-compile, post-build-variant-multiplicity=true  # This container defines a LSduR path (1:1 or 1:n) for one source Pdu to 1 or n destination Pdus. Tags: atp.Status=draft
        container LSduRPathDestinationPdu [1..*]: multiplicity set at link in variant link-time / post-build in variant post-build / pre-compile in variant pre-compile, post-build-variant-multiplicity=true  # This container defines the EcuC Pdu representing one or more destinations of the routing path. Tags: atp.Status=draft
          integer LSduRPathDestinationPduId [0..1]: 0..65535, scope=ECU, multiplicity set at pre-compile, post-build-variant-value=true, set at link in variant link-time / post-build in variant post-build / pre-compile in variant pre-compile, symbolic-name-value=true, with-auto=true  # Definition of the Handle Pdu Id representing the destination of the routing path. Tags: atp.Status=draft
          reference LSduRPathDestinationPduRef: scope=ECU, post-build-variant-value=true, set at link in variant link-time / post-build in variant post-build / pre-compile in variant pre-compile, destination=Pdu  # Reference to the EcuC Pdu representing one destination of the routing path. Tags: atp.Status=draft
        container LSduRPathSourcePdu  # This container defines the EcuC Pdu representing the source of the routing path. Tags: atp.Status=draft
          integer LSduRPathSourcePduId [0..1]: 0..65535, scope=ECU, multiplicity set at pre-compile, post-build-variant-value=true, set at link in variant link-time / post-build in variant post-build / pre-compile in variant pre-compile, symbolic-name-value=true, with-auto=true  # Definition of the Handle Pdu Id representing the source of the routing path. Tags: atp.Status=draft
          reference LSduRPathSourcePduRef: scope=ECU, post-build-variant-value=true, set at link in variant link-time / post-build in variant post-build / pre-compile in variant pre-compile, destination=Pdu  # Reference to the EcuC Pdu representing the source of the routing path. Tags: atp.Status=draft
    container LSduRGeneral  # Specifies the general configuration parameters of the LSduR. Tags: atp.Status=draft
      boolean LSduRDevErrorDetect: set at pre-compile, default-value=false  # Switches the development error detection and notification on or off. Tags: atp.Status=draft | * true: detection and notification is enabled. * false: detection and notification is disabled.
      boolean LSduRMetaDataSupport: set at pre-compile  # Enable support for MetaData handling. The MetaData is defined by the referenced MetaDataType of the global PDU definitions. This feature may be used for efficient forwarding of frame attributes (e.g. EtherType), where the MetaData contains the EtherType. Tags: atp.Status=draft
      boolean LSduRVersionInfoApi: set at pre-compile, default-value=false  # If true the LSduR_GetVersionInfo API is available. Tags: atp.Status=draft
      boolean LSduRZeroCostOperation: set at pre-compile  # If set, the LSduR configuration generator will report an error if zero-cost-operation cannot be fulfilled. This parameter shall be seen as an input requirement to the configuration generator. Tags: atp.Status=draft
