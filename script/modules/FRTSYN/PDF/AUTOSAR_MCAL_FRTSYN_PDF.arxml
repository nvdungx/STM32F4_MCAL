AUTOSAR XML (schema 00046)
package /AUTOSAR/EcucDefs
  ecuc definition collection AUTOSARParameterDefinition: module=FrTSyn
  module definition FrTSyn [0..1]: post-build-variant-support=true, variants pre-compile  # This represents the specific configuration variant for the TSyn on Flexray.
    container FrTSynGeneral  # This container holds the general parameters of the Flexray-specific Synchronized Time-base Manager
      boolean FrTSynDevErrorDetect: set at pre-compile, default-value=false  # Switches the development error detection and notification on or off. | * true: detection and notification is enabled. * false: detection and notification is disabled.
      float FrTSynMainFunctionPeriod: 0..Inf, set at pre-compile  # Schedule period of the main function FrTSyn_MainFunction. Unit: [s].
      boolean FrTSynVersionInfoApi: set at pre-compile, default-value=false  # Activate/Deactivate the version information API (FrTSyn_GetVersionInfo). True: version information API activated False: version information API deactivated.
    container FrTSynGlobalTimeDomain [1..*]  # This represents the existence of a global time domain on Flexray. The FrTSyn module can administrate several global time domains at the same time that in itself form a hierarchy of domains and sub-domains. | If the FrTSyn exists it is assumed that at least one global time domain exists.
      integer FrTSynGlobalTimeDomainId: 0..31, set at pre-compile  # The global time domain ID.
      integer FrTSynGlobalTimeSecureTmacLength: 0..16, set at pre-compile, default-value=0  # Represents the number of bytes for the used Truncated Message Authentication Code (TMAC). If 0, no message authentication will be used. Tags: atp.Status=draft
      boolean FrTSynUseExtendedMsgFormat: set at pre-compile, default-value=false  # * true: use at least 32 byte for Timesync messages (depending on configuration) Tags: atp.Status=draft | * false: use always 16 byte for Timesync messages
      reference FrTSynSynchronizedTimeBaseRef: set at pre-compile, requires-symbolic-name-value=true, destination=StbMSynchronizedTimeBase  # Mandatory reference to the required synchronized time-base.
      container FrTSynGlobalTimeMaster [0..1]: multiplicity set at pre-compile, post-build-variant-multiplicity=true  # Configuration of the global time master. Each global time domain is required to have exactly one global time master. This master may or may not exist on the configured ECU.
        float FrTSynCyclicMsgResumeTime: 0..Inf, post-build-variant-value=true, set at pre-compile  # Defines the time where the 1st regular cycle time based message transmission takes place, after an immediate transmission before. Unit: seconds
        float FrTSynGlobalTimeDebounceTime: 0..Inf, post-build-variant-value=true, set at pre-compile  # This represents the configuration of a TX debounce time for SYNC and OFS messages compared to a message before with the same PDU. Unit: seconds
        enumeration FrTSynGlobalTimeTxCrcSecured: {CRC_NOT_SUPPORTED, CRC_SUPPORTED}, post-build-variant-value=true, set at pre-compile  # This represents the configuration of whether or not CRC is supported.
        float FrTSynGlobalTimeTxPeriod: 0..Inf, post-build-variant-value=true, set at pre-compile  # This represents the TX period. Unit: seconds
        boolean FrTSynImmediateTimeSync: post-build-variant-value=true, set at pre-compile  # Enables/Disables the cyclic polling of StbM_GetTimeBaseUpdateCounter() within FrTSyn_MainFunction().
        enumeration FrTSynTxTmacCalculated: {TMAC_CALCULATED, TMAC_NOT_CALCULATED}, post-build-variant-value=true, set at pre-compile  # This parameter controls whether or not TMAC calculation shall be supported. Tags: atp.Status=draft
        container FrTSynGlobalTimeMasterPdu  # This container carries all properties required to configure the PDU sent by the global time master for the given global time domain.
          integer FrTSynGlobalTimeMasterHandleId: 0..65535, post-build-variant-value=true, set at pre-compile, symbolic-name-value=true  # This represents the handle ID of the PDU that contains the global time information.
          reference FrTSynGlobalTimePduRef: post-build-variant-value=true, set at pre-compile, destination=Pdu  # This represents the reference to the Pdu taken to transmit the global time information. The global time master of a global time domain acts as the sender of the Pdu while all the time slaves are supposed to receive the Pdu.
      container FrTSynGlobalTimeOfsDataIDList [0..1]: multiplicity set at pre-compile, post-build-variant-multiplicity=true  # The DataIDList for OFS messages ensures the identification of data elements due to CRC calculation and message authentication process.
        container FrTSynGlobalTimeOfsDataIDListElement [16..16]  # Element of the DataIDList for OFS messages ensures the identification of data elements due to CRC calculation and message authentication process.
          integer FrTSynGlobalTimeOfsDataIDListIndex: 0..15, post-build-variant-value=true, set at pre-compile  # Index of the DataIDList for OFS messages ensures the identification of data elements due to CRC calculation and message authentication process.
          integer FrTSynGlobalTimeOfsDataIDListValue: 0..255, post-build-variant-value=true, set at pre-compile  # Value of the DataIDList for OFS messages ensures the identification of data elements due to CRC calculation and message authentication process.
      container FrTSynGlobalTimeSlave [0..1]: multiplicity set at pre-compile, post-build-variant-multiplicity=true  # This represents the time slave for the enclosing global time domain.
        float FrTSynGlobalTimeMinMsgGap: 0..Inf, post-build-variant-value=true, set at pre-compile, default-value=0  # This parameter represents the configuration of a minimum message gap time for received SYNC and OFS messages compared to a message before with the same PDU. If PDUs are received more often in between than this parameter allows, they shall be ignored. Tags: atp.Status=draft | Unit: seconds
        integer FrTSynGlobalTimeSequenceCounterJumpWidth: 1..15, post-build-variant-value=true, set at pre-compile  # The SequenceCounterJumpWidth specifies the maximum allowed gap of the Sequence Counter between two SYNC resp. two OFS messages.
        float FrTSynGlobalTimeTmacTimeout: 0..Inf, post-build-variant-value=true, set at pre-compile, default-value=0  # Rx timeout for the TMAC message. Tags: atp.Status=draft | Unit:seconds
        enumeration FrTSynRxCrcValidated: {CRC_IGNORED, CRC_NOT_VALIDATED, CRC_OPTIONAL, CRC_VALIDATED}, post-build-variant-value=true, set at pre-compile  # This parameter controls whether or not CRC validation shall be supported.
        enumeration FrTSynRxTmacValidated: {TMAC_NOT_VALIDATED, TMAC_VALIDATED}, post-build-variant-value=true, set at pre-compile  # This parameter controls whether or not TMAC validation shall be supported. Tags: atp.Status=draft
        container FrTSynGlobalTimeSlavePdu  # This container carries all properties required to configure the PDU received by the time slave for the given global time domain.
          integer FrTSynGlobalTimeSlaveHandleId: 0..65535, post-build-variant-value=true, set at pre-compile, symbolic-name-value=true  # This represents the handle ID of the PDU that contains the global time information.
          reference FrTSynGlobalTimePduRef: post-build-variant-value=true, set at pre-compile, destination=Pdu  # This represents the reference to the Pdu taken to transmit the global time information. The global time master of a global time domain acts as the sender of the Pdu while all the time slaves are supposed to receive the Pdu.
      container FrTSynGlobalTimeSyncDataIDList [0..1]: multiplicity set at pre-compile, post-build-variant-multiplicity=true  # The DataIDList for SYNC messages ensures the identification of data elements due to CRC calculation and message authentication process.
        container FrTSynGlobalTimeSyncDataIDListElement [16..16]  # Element of the DataIDList for SYNC messages ensures the identification of data elements due to CRC calculation and message authentication process.
          integer FrTSynGlobalTimeSyncDataIDListIndex: 0..15, post-build-variant-value=true, set at pre-compile  # Index of the DataIDList for SYNC messages ensures the identification of data elements due to CRC calculation and message authentication process.
          integer FrTSynGlobalTimeSyncDataIDListValue: 0..255, post-build-variant-value=true, set at pre-compile  # Value of the DataIDList for SYNC messages ensures the identification of data elements due to CRC calculation and message authentication process.
