AUTOSAR XML (schema 00053)
package /AUTOSAR/EcucDefs
  ecuc definition collection AUTOSARParameterDefinition: module=StbM
  module definition StbM [0..1]: post-build-variant-support=true, variants pre-compile  # Configuration of the Synchronized Time-base Manager (StbM) module.
    container StbMFreshnessValueInformation  # Container with the Freshness Value configurations
      function name StbMGetRxFreshnessValueFuncName [0..1]: multiplicity set at pre-compile, set at pre-compile  # Function pointer to call within StbM_GetRxFreshness() context.
      function name StbMGetTxConfFreshnessValueFuncName [0..1]: multiplicity set at pre-compile, set at pre-compile  # Function pointer to call within StbM_SPduTxConfirmation() context.
      function name StbMGetTxFreshnessValueFuncName [0..1]: multiplicity set at pre-compile, set at pre-compile  # Function pointer to call within StbM_GetTxFreshness() context.
      function name StbMGetTxTruncFreshnessValueFuncName [0..1]: multiplicity set at pre-compile, set at pre-compile  # Function pointer to call within StbM_GetTxFreshnessTruncData() context.
      enumeration StbMQueryFreshnessValue: {CFUNC, NONE, SERVICE}, set at pre-compile, default-value=NONE  # This parameter specifies if the freshness value shall be determined through a C-function (CD) or a software component (SW-C).
      container StbMFreshnessValue [0..*]: multiplicity set at pre-compile  # Container with the Freshness Value configurations
        integer StbMFreshnessValueId: 0..65535, set at pre-compile, symbolic-name-value=true  # This parameter defines the Id of the Freshness Value. The Freshness Value might be a normal counter or a time value.
        integer StbMFreshnessValueLength: 0..64, set at pre-compile  # This parameter defines the complete length in bits of the Freshness Value. As long as the key doesn't change the counter shall not overflow. The length of the counter shall be determined based on the expected life time of the corresponding key and frequency of usage of the counter.
        integer StbMFreshnessValueTruncLength: 0..64, set at pre-compile  # This parameter defines the length in bits of the Freshness Value to be included in the payload of the Secured Time Synchronization Messages. This length is specific to the least significant bits of the complete Freshness Counter. If the parameter is 0 no Freshness Value is included in the Secured Time Synchronization Messages.
        boolean StbMProvideTxTruncatedFreshnessValue: set at pre-compile, default-value=false  # This parameter specifies if the FVM shall provide the truncated freshness value directly or if the FV shall be truncated by the StbM.
    container StbMGeneral  # This container holds the general parameters of the Synchronized Time-base Manager
      boolean StbMDevErrorDetect: set at pre-compile, default-value=false  # Switches the development error detection and notification on or off. | * true: detection and notification is enabled. * false: detection and notification is disabled.
      float StbMMainFunctionPeriod: 0..INF, set at pre-compile  # Schedule period of the main function StbM_MainFunction. Unit: [s].
      boolean StbMTimeRecordingSupport: set at pre-compile  # Enables/Disables the usage of the recording functionality for Synchronized Time Bases for Global Time precision measurement purpose.
      float StbMTimerStartThreshold [0..1]: 0..INF, multiplicity set at pre-compile, set at pre-compile  # This interval defines, when a GPT Timer shall be started for Time Notification Customers for which the corresponding Customer Timer is running [unit: seconds].
      boolean StbMVersionInfoApi: set at pre-compile, default-value=false  # Activate/Deactivate the version information API (StbM_GetVersionInfo). True: version information API activated False: version information API deactivated.
      reference StbMEcucPartitionRef [0..1]: multiplicity set at pre-compile, set at pre-compile, destination=EcucPartition  # Reference to EcucPartition, where StbM module is assigned to.
      reference StbMGptTimerRef [0..1]: multiplicity set at pre-compile, set at pre-compile, requires-symbolic-name-value=true, destination=GptChannelConfiguration  # This represents an optional sub-container in case any Time Notification Customer is configured. | The designated GPT timer has to be configured to have a tick duration of one micro second.
    container StbMSynchronizedTimeBase [1..*]: multiplicity set at pre-compile  # Synchronized time.base collects the information about a specific time-base provider within the system.
      boolean StbMAllowSystemWideGlobalTimeMaster [0..1]: multiplicity set at pre-compile, set at pre-compile  # For postbuild variant of the StbM this parameter has to be set to true for a Global Time Master that may act as a system-wide source of time. Otherwise no corresponding service ports/interfaces is provided. | The Global Time Master functionality behind the service ports/interfaces has to be enabled/disabled separately via parameter StbMIsSystemWideGlobalTimeMaster.
      integer StbMClearTimeleapCount [0..1]: 1..65535, multiplicity set at pre-compile, set at pre-compile, default-value=1  # This attribute describes the required number of updates to the Time Base where the time difference to the previous value has to remain below StbMTimeLeapPastThreshold/StbMTimeLeapFutureThreshold until the TIMELEAP_PAST/TIMELEAP_FUTURE bit within timeBaseStatus of the Time Base is cleared.
      float StbMCyclicBackupInterval [0..1]: 0..65535, multiplicity set at pre-compile, set at pre-compile  # Time interval to calculate the "backup" time to be stored in NvM [unit: seconds].
      boolean StbMIsSystemWideGlobalTimeMaster: post-build-variant-value=true, set at pre-compile  # This parameter shall be set to true for a Global Time Master that acts as a system-wide source of time information with respect to Global Time. | It is possible that several Global Time Masters exist that have set this parameter set to true because the Global Time Masters exist once per Global Time Domain and one ECU may own several Global Time Domains on different buses it is connected to.
      float StbMMaxProgressionMismatchThreshold: 0..INF, multiplicity set at pre-compile, post-build-variant-multiplicity=true, set at pre-compile  # This represents the maximum allowed difference between local time and fallback time of the time base [unit: seconds]. Tags: atp.Status=draft
      enumeration StbMNotificationInterface: {CALLBACK, CALLBACK_AND_SR_INTERFACE, NO_NOTIFICATION, SR_INTERFACE}, multiplicity set at pre-compile, set at pre-compile  # The parameter defines what type of interface shall be used to notify a customer of a status event.
      function name StbMStatusNotificationCallback [0..1]: multiplicity set at pre-compile, set at pre-compile  # Name of the customer specific status notification callback function, which shall be called, if a non-masked status event occurs.
      integer StbMStatusNotificationMask [0..1]: 0..4294967295, multiplicity set at pre-compile, set at pre-compile, default-value=0  # The parameter defines the initial value for NotificationMask mask, which defines the events for which the event notification callback function shall be called.
      enumeration StbMStoreTimebaseNonVolatile [0..1]: {NO_STORAGE, STORAGE}, multiplicity set at pre-compile, set at pre-compile  # This allows for specifying that the Time Base shall be stored in the NvRam.
      integer StbMSynchronizedTimeBaseIdentifier: 0..65535, set at pre-compile, symbolic-name-value=true  # Identification of a Synchronized Time Base via a unique identifier. | Range: * 0 .. 127: Synchronized Time Bases and Pure Local Time Bases * 128 .. 65535: Reserved
      enumeration StbMSynchronizedTimeBaseType: set at pre-compile, default-value=TBTYPE_SYNCHRONIZED  # Definition of the type of a Time Base. Tags: atp.Status=draft
        TBTYPE_PURELOCAL  # Tags: atp.Status=draft
        TBTYPE_SYNCHRONIZED  # Tags: atp.Status=draft
      float StbMSyncLossTimeout [0..1]: 0..INF, multiplicity set at pre-compile, set at pre-compile  # This attribute describes the timeout for the situation that the time synchronization gets lost in the scope of the time domain. Unit: seconds
      float StbMTimeLeapFutureThreshold [0..1]: 0..INF, multiplicity set at pre-compile, set at pre-compile  # This represents the maximum allowed positive difference between a newly received Global Time Base value and the current Local Time Base value [unit: seconds].
      float StbMTimeLeapPastThreshold [0..1]: 0..INF, multiplicity set at pre-compile, set at pre-compile  # This represents the maximum allowed negative difference between the current Local Time Base value and a newly received Global Time Base value [unit: seconds].
      reference StbMSourceTimeBase [0..1]: multiplicity set at pre-compile, set at pre-compile, destination=StbMSynchronizedTimeBase  # This is a reference to a Time Base, which the current Time Base is cloned from. This makes the referenced Time Base the source Time Base for cloning and the current Time the destination Time Base for cloning.
      container StbMDisciplinedClock [0..1]: multiplicity set at pre-compile  # This container holds parameters relevant for the adjustable/disciplined hardware clock of this Synchronized Time Base. Tags: atp.Status=draft
        reference StbMDisciplinedClockHardwareRef: scope=ECU, set at pre-compile, destination=EthTSynGlobalTimeDomain  # Reference to the adjustable/disciplined hardware clock. Tags: atp.Status=draft
      container StbMFallbackTimeClock [0..1]: multiplicity set at pre-compile  # References the hardware reference clock of this Synchronized Time Base for fallback time feature. Tags: atp.Status=draft
        integer StbMFallbackTimeClockFrequency [0..1]: 0..4294967295, multiplicity set at pre-compile, set at pre-compile  # Represents the frequency [Hz] of the HW reference clock used by the StbM. Tags: atp.Status=draft
        integer StbMFallbackTimeClockPrescaler [0..1]: 0..4294967295, multiplicity set at pre-compile, set at pre-compile  # Represents the prescaler to calculate the resulting frequency of the HW reference clock used by the StbM. Tags: atp.Status=draft
        choice reference StbMFallbackTimeHardware: multiplicity set at pre-compile, set at pre-compile, destination=[CanTSynGlobalTimeDomain, EthTSynGlobalTimeDomain, GptChannelConfiguration, OsCounter]  # Reference to the local time hardware. Tags: atp.Status=draft
      container StbMLocalTimeClock [0..1]: multiplicity set at pre-compile  # References the hardware reference clock of this Synchronized Time Base.
        integer StbMClockFrequency [0..1]: 0..4294967295, set at pre-compile  # Represents the frequency [Hz] of the HW reference clock used by the StbM.
        integer StbMClockPrescaler [0..1]: 0..4294967295, set at pre-compile  # Represents the prescaler to calculate the resulting frequency of the HW reference clock used by the StbM.
        choice reference StbMLocalTimeHardware: multiplicity set at pre-compile, set at pre-compile, destination=[CanTSynGlobalTimeDomain, EthTSynGlobalTimeDomain, GptChannelConfiguration, OsCounter]  # Reference to the local time hardware.
      container StbMNotificationCustomer [0..*]: multiplicity set at pre-compile  # This container holds the configuration of a notification customer, which is notified is informed about the occurance of a Time-base related event.
        integer StbMNotificationCustomerId: 0..65535, set at pre-compile, symbolic-name-value=true  # Identification of a event notification customer.
        function name StbMTimeNotificationCallback [0..1]: set at pre-compile  # Name of the customer specific notification callback function, which shall be called, if the time previously set by the customer is reached.
      container StbMTimeCorrection [0..1]: multiplicity set at pre-compile  # Collects the information relevant for the rate- and offset correction of a Time Base.
        boolean StbMAllowMasterRateCorrection [0..1]: multiplicity set at pre-compile, set at pre-compile, default-value=false  # This attribute describes whether the rate correction value of a Time Base can be set by StbM_SetRateCorrection(): | * false: the rate correction value can not be set by StbM_SetRateCorrection() * true: the rate correction value can be set by StbM_SetRateCorrection()
        integer StbMMasterRateDeviationMax [0..1]: 0..32000, multiplicity set at pre-compile, set at pre-compile, default-value=0  # This attribute describes the maximum allowed absolute value of the rate deviation value to be set by StbM_SetRateCorrection() [unit: ppm].
        float StbMOffsetCorrectionAdaptionInterval [0..1]: 0..INF, multiplicity set at pre-compile, set at pre-compile  # Defines the interval during which the adaptive rate correction cancels out the rate- and time deviation [unit: seconds].
        float StbMOffsetCorrectionJumpThreshold [0..1]: 0..INF, multiplicity set at pre-compile, set at pre-compile  # Threshold for the correction method. Deviations below this value will be corrected by a linear reduction over a defined timespan. Values equal- and greater than this value will be corrected by immediately setting the correct time- and rate in form of a jump [unit: seconds].
        float StbMRateCorrectionMeasurementDuration [0..1]: 0..INF, multiplicity set at pre-compile, set at pre-compile, default-value=1  # Definition of the time span [s] which is used to calculate the rate deviation.
        integer StbMRateCorrectionsPerMeasurementDuration [0..1]: 1..65535, multiplicity set at pre-compile, set at pre-compile, default-value=1  # Number of simultaneous rate measurements to determine the current rate deviation.
        integer StbMRateCorrectionThreshold [0..1]: 0..32000, multiplicity set at pre-compile, set at pre-compile, default-value=0  # Threshold for rate correction calculation to determine whether the absolute value of the calculated rate deviation exceeds the accepted range. A value of 0 deactivates the check.
        enumeration StbMRateSource [0..1]: {RATE_SOURCE_STBM, RATE_SOURCE_TIMESYNC_MODULE}, scope=ECU, multiplicity set at pre-compile, post-build-variant-multiplicity=true, set at pre-compile  # Selects which module does the rate measurement. Tags: atp.Status=draft
      container StbMTimeRecording [0..1]: multiplicity set at pre-compile  # Collects the information relevant for configuration of the precision measurement of a Time Base.
        function name StbMSyncTimeRecordBlockCallback [0..1]: multiplicity set at pre-compile, set at pre-compile  # Name of the customer specific callback function, which shall be called, if a measurement data for a Synchronized Time Base are available.
        integer StbMSyncTimeRecordTableBlockCount: 0..65535, set at pre-compile  # Represents the number of Blocks used for queing time measurement events for the Synchronized Time Base Record Table.
      container StbMTimeValidation [0..1]: multiplicity set at pre-compile  # Container with Time Validation configuration for Time Base.
        float StbMPdelayValidationThreshold [0..1]: 0..INF, multiplicity set at pre-compile, set at pre-compile  # This represents the maximum allowed threshold of the Pdelay value of the time base [unit: seconds].
        float StbMRateJitterThreshold [0..1]: 0..INF, multiplicity set at pre-compile, set at pre-compile  # This represents the maximum allowed threshold for rate jitter.
        integer StbMRateWanderIntervalWindow [0..1]: 0..255, multiplicity set at pre-compile, set at pre-compile  # This represents the window to take sample for calculation of rate wander.
        float StbMRateWanderThreshold [0..1]: 0..INF, multiplicity set at pre-compile, set at pre-compile  # This represents the maximum allowed threshold for rate wander.
        integer StbMTimeValidationRecordTableBlockCount: 0..65535, set at pre-compile  # Size of record table for Time Validation (number of blocks).
    container StbMTriggeredCustomer [0..*]: multiplicity set at pre-compile  # The triggered customer is directly triggered by the Synchronized Time-base Manager by getting synchronized with the current (global) definition of time and passage of time.
      integer StbMTriggeredCustomerPeriod: 0..4294967295, set at pre-compile  # The triggering period of the triggered customer, called by the StbM_MainFunction. | The period is documented in microseconds.
      reference StbMOSScheduleTableRef: set at pre-compile, destination=OsScheduleTable  # Mandatory reference to synchronized OS ScheduleTable, which will be explicitly synchronized by the StbM.
      reference StbMSynchronizedTimeBaseRef: set at pre-compile, destination=StbMSynchronizedTimeBase  # Mandatory reference to the required synchronized time-base.
