AUTOSAR XML (schema 00053)
package /AUTOSAR/EcucDefs
  ecuc definition collection AUTOSARParameterDefinition: module=BndM
  module definition BndM [0..1]: variants pre-compile  # Configuration of the BulkNvDataManager module.
    container BndMBlockDescriptor [0..*]  # Each container defines a Bulk NV Block which can be individually accessed.
      integer BndMBlockIdentifier: 0..65535, set at pre-compile, symbolic-name-value=true  # Unique identification of the block.
      foreign reference BndMBlockDescriptor: set at pre-compile, destination-type=IMPLEMENTATION-DATA-TYPE  # This parameter defines the data structure of the block.
      reference BndMCallbackRef [0..1]: multiplicity set at pre-compile, set at pre-compile, destination=BndMCallbackBlock  # Reference to the block-specific callback function.
      reference BndMDeviceIndex [0..1]: multiplicity set at pre-compile, set at pre-compile, requires-symbolic-name-value=true, destination=FlsGeneral  # Reference to the FLS device this block is stored in. Tags: atp.Status=obsolete
    container BndMCallbackBlock [0..*]  # This container contains the block-specific callbacks.
      function name BndMWriteBlockFinishFnc: set at pre-compile  # Callback function for the WriteBlockFinish callback.
    container BndMCallbackGeneral [0..1]  # This container contains the general callbacks
      function name BndMWriteFinalizeFinishFnc: set at pre-compile  # Callback function for the WriteFinalizeFinish callback.
      function name BndMWriteStartFinishFnc: set at pre-compile  # Callback function for the WriteStartFinish callback.
    container BndMGeneral  # Container for common configuration options.
      boolean BndMDevErrorDetect: set at pre-compile, default-value=false  # Switches the development error detection and notification on or off. | * true: detection and notification is enabled. * false: detection and notification is disabled.
      float BndMMainFunctionPeriod: 0..INF, scope=ECU, set at pre-compile  # The period between successive calls to the main function in seconds.
      boolean BndMVersionInfoApi: set at pre-compile, default-value=false  # Pre-processor switch to enable / disable the API to read out the modules version information. | true: Version info API enabled. false: Version info API disabled.
