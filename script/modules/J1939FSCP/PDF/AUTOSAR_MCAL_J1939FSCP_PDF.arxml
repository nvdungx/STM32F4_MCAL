AUTOSAR XML (schema 00053)
package /AUTOSAR/EcucDefs
  ecuc definition collection AUTOSARParameterDefinition: module=J1939Fscp
  module definition J1939Fscp [0..1]: variants link-time/post-build/pre-compile  # The J1939 Functional Safety Communication Protocol covers the handling of SHM and SDM messages for E2E protected communication according to SAE J1939-76. Tags: atp.Status=draft
    container J1939FscpConfigSet  # Configuration parameters and sub containers of the J1939Fscp module. Tags: atp.Status=draft
      container J1939FscpRxChannel [0..*]: multiplicity set at link in variant link-time / post-build in variant post-build / pre-compile in variant pre-compile, post-build-variant-multiplicity=true  # Physical CAN channel used for reception by J1939Fscp. Tags: atp.Status=draft
        reference J1939FscpRxChannelComMNetworkHandleRef: set at link in variant link-time+post-build / pre-compile in variant pre-compile, requires-symbolic-name-value=true, destination=ComMChannel  # Reference to the ComMChannel which corresponds to the J1939FscpRxChannel. This parameter is useful for the validation of the J1939Fscp configuration. Tags: atp.Status=draft
        container J1939FscpRxPg [1..*]: multiplicity set at link in variant link-time / post-build in variant post-build / pre-compile in variant pre-compile, post-build-variant-multiplicity=true  # Contains the configuration of the received SDM and of the upper layer PDU. Tags: atp.Status=draft
          integer J1939FscpRxInstances: 0..64009, multiplicity set at link in variant link-time / post-build in variant post-build / pre-compile in variant pre-compile, post-build-variant-multiplicity=true, set at link in variant link-time+post-build / pre-compile in variant pre-compile  # Configures the maximum number of SDGs that can be received in parallel with the same PGN. This parameter is only relevant if MetaData is configured for the J1939FscpSdgRxPdu. Tags: atp.Status=draft
          float J1939FscpRxSrvt: 0..INF, post-build-variant-value=true, set at link in variant link-time / post-build in variant post-build / pre-compile in variant pre-compile  # This parameter sets the maximum for the Safety-Relevant Validation Time (SRVT_Maximum), which is used to determine a timeout of the corresponding SDM message after reception of an SHM message. After this timeout, the whole SDG is dropped. Tags: atp.Status=draft
          container J1939FscpSdgRxPdu  # Contains the configuration of the PDU used to forward the received SDG to the upper layer. Tags: atp.Status=draft | This PDU can produce a meta data item of type CAN_ID_32.
            integer J1939FscpSdgRxPduId: 0..65535, scope=ECU, set at pre-compile, symbolic-name-value=true, with-auto=true  # The PDU identifier used for RxIndication to PduR. Tags: atp.Status=draft
            reference J1939FscpSdgRxPduRef: set at link in variant link-time+post-build / pre-compile in variant pre-compile, destination=Pdu  # Reference to the global PDU. Tags: atp.Status=draft
          container J1939FscpSdmRxPdu  # Contains the configuration of the PDU used to receive the SDM PG. Tags: atp.Status=draft | This PDU can consume a meta data item of type CAN_ID_32.
            integer J1939FscpSdmRxPduId: 0..65535, scope=ECU, symbolic-name-value=true, with-auto=true  # The PDU identifier used for RxIndication from PduR. Tags: atp.Status=draft
            reference J1939FscpSdmRxPduRef: set at link in variant link-time+post-build / pre-compile in variant pre-compile, destination=Pdu  # Reference to the global PDU. Tags: atp.Status=draft
        container J1939FscpShmRxPdu  # Contains the configuration of the PDU used to receive the SHM PG. Tags: atp.Status=draft | This PDU consumes a meta data item of type CAN_ID_32.
          integer J1939FscpShmRxPduId: 0..65535, scope=ECU, set at pre-compile, symbolic-name-value=true, with-auto=true  # The PDU identifier used for RxIndication from PduR. Tags: atp.Status=draft
          reference J1939FscpShmRxPduRef: set at link in variant link-time+post-build / pre-compile in variant pre-compile, destination=Pdu  # Reference to the global PDU. Tags: atp.Status=draft
      container J1939FscpTxChannel [0..*]: multiplicity set at link in variant link-time / post-build in variant post-build / pre-compile in variant pre-compile, post-build-variant-multiplicity=true  # Physical CAN channel used for transmission by J1939Fscp. Tags: atp.Status=draft
        reference J1939FscpTxChannelComMNetworkHandleRef: set at link in variant link-time+post-build / pre-compile in variant pre-compile, requires-symbolic-name-value=true, destination=ComMChannel  # Reference to the ComMChannel which corresponds to the J1939FscpTxChannel. This parameter is useful for the validation of the J1939Fscp configuration. Tags: atp.Status=draft
        container J1939FscpShmTxPdu  # Contains the configuration of the PDU used to transmit the SHM PG. Tags: atp.Status=draft | This PDU produces a meta data item of type CAN_ID_32.
          integer J1939FscpShmTxPduId: 0..65535, scope=ECU, set at pre-compile, symbolic-name-value=true, with-auto=true  # The PDU identifier used for TxConfirmation to PduR. Tags: atp.Status=draft
          reference J1939FscpShmTxPduRef: set at link in variant link-time+post-build / pre-compile in variant pre-compile, destination=Pdu  # Reference to the global PDU. Tags: atp.Status=draft
        container J1939FscpTxPg [1..*]: multiplicity set at link in variant link-time / post-build in variant post-build / pre-compile in variant pre-compile, post-build-variant-multiplicity=true  # Contains the configuration of the transmitted SDM and of the upper layer PDU. Tags: atp.Status=draft
          integer J1939FscpShmTxPriority [0..1]: 0..7, multiplicity set at link in variant link-time / post-build in variant post-build / pre-compile in variant pre-compile, post-build-variant-multiplicity=true, post-build-variant-value=true, set at link in variant link-time / post-build in variant post-build / pre-compile in variant pre-compile  # Configures the priority to be used for transmission of the SHM message. This parameter can be used to override the priority provided with MetaData from the J1939FscpSdgTxPdu. Tags: atp.Status=draft
          float J1939FscpTxSrvt: 0..INF, post-build-variant-value=true, set at link in variant link-time / post-build in variant post-build / pre-compile in variant pre-compile  # This parameter sets the maximum for the Safety-Relevant Validation Time (SRVT_Maximum), which is used to determine a time limit for the transmission of the corresponding SDM message after transmission of an SHM message. After this time, the SDM is dropped. Tags: atp.Status=draft
          container J1939FscpSdgTxPdu  # Contains the configuration of the PDU used to accept the transmitted SDG from the upper layer. Tags: atp.Status=draft | This PDU can consume a meta data item of type CAN_ID_32.
            integer J1939FscpSdgTxPduId: 0..65535, scope=ECU, set at pre-compile, symbolic-name-value=true, with-auto=true  # The PDU identifier used for Transmit from PduR. Tags: atp.Status=draft
            reference J1939FscpSdgTxPduRef: set at link in variant link-time+post-build / pre-compile in variant pre-compile, destination=Pdu  # Reference to the global PDU. Tags: atp.Status=draft
          container J1939FscpSdmTxPdu  # Contains the configuration of the PDU used to transmit the SDM PG. Tags: atp.Status=draft | This PDU can produce a meta data item of type CAN_ID_32.
            integer J1939FscpSdmTxPduId: 0..65535, scope=ECU, set at pre-compile, symbolic-name-value=true, with-auto=true  # The PDU identifier used for TxConfirmation to PduR. Tags: atp.Status=draft
            reference J1939FscpSdmTxPduRef: set at link in variant link-time+post-build / pre-compile in variant pre-compile, destination=Pdu  # Reference to the global PDU. Tags: atp.Status=draft
    container J1939FscpGeneral  # General configuration parameters of the J1939Fscp module. Tags: atp.Status=draft
      boolean J1939FscpDevErrorDetect: set at pre-compile, default-value=false  # Enables/disables the development error detection. Tags: atp.Status=draft
      float J1939FscpMainFunctionPeriod: 0..INF, scope=ECU, set at pre-compile  # Execution cycle of J1939Fscp_MainFunction. Tags: atp.Status=draft
      boolean J1939FscpVersionInfoApi: set at pre-compile, default-value=false  # Enables/disables the function J1939Fscp_GetVersionInfo() to get major, minor and patch version information. Tags: atp.Status=draft
