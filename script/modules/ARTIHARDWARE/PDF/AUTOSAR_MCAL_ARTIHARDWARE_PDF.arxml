AUTOSAR XML (schema 00046)
package /AUTOSAR/EcucDefs
  ecuc definition collection AUTOSARParameterDefinition: module=ArtiHardware
  module definition ArtiHardware [0..1]: post-build-variant-support=true, variants post-build/pre-compile  # The ArtiHardware Module contains ARTI extensions to the EcucHardware module. Tags: atp.Status=draft
    container ArtiHwCoreClass [0..1]: multiplicity set at post-build in variant post-build / pre-compile in variant pre-compile, post-build-variant-multiplicity=true  # Contains the layout of an ARTI "Core" object, extending the EcucCoreDefinition. Tags: atp.Status=draft
      reference ArtiCurrentApplicationClassRef: scope=ECU, post-build-variant-value=true, set at post-build in variant post-build / pre-compile in variant pre-compile, destination=ArtiObjectClassParameter  # Refers to the ArtiObjectClassParameter that defines the ArtiCurrentApplicationInstance parameter. Tags: atp.Status=draft
      reference ArtiCurrentTaskClassRef: scope=ECU, post-build-variant-value=true, set at post-build in variant post-build / pre-compile in variant pre-compile, destination=ArtiObjectClassParameter  # Refers to the ArtiObjectClassParameter that defines the ArtiCurrentTaskInstance parameter. Tags: atp.Status=draft
      reference ArtiLastErrorClassRef [0..1]: scope=ECU, multiplicity set at post-build in variant post-build / pre-compile in variant pre-compile, post-build-variant-multiplicity=true, post-build-variant-value=true, set at post-build in variant post-build / pre-compile in variant pre-compile, destination=ArtiObjectClassParameter  # Refers to the ArtiObjectClassParameter that defines the ArtiLastErrorInstance parameter. Tags: atp.Status=draft
    container ArtiHwCoreInstance [1..*]: multiplicity set at post-build in variant post-build / pre-compile in variant pre-compile, post-build-variant-multiplicity=true  # Represents an instance of an ARTI "Core" object, extending the EcucCoreDefinition. Tags: atp.Status=draft
      reference ArtiCurrentApplicationInstanceRef: scope=ECU, post-build-variant-value=true, set at post-build in variant post-build / pre-compile in variant pre-compile, destination=ArtiObjectInstanceParameter  # Refers to the ArtiObjectInstanceParameter that contains the evaluation for the "current application" that is running on this core. Tags: atp.Status=draft
      reference ArtiCurrentTaskInstanceRef: scope=ECU, post-build-variant-value=true, set at post-build in variant post-build / pre-compile in variant pre-compile, destination=ArtiObjectInstanceParameter  # Refers to the ArtiObjectInstanceParameter that contains the evaluation for the "current task" that is running on this core. Tags: atp.Status=draft
      reference ArtiEcucCoreRef: scope=ECU, post-build-variant-value=true, set at post-build in variant post-build / pre-compile in variant pre-compile, destination=EcucCoreDefinition  # Refers to the EcucCoreDefinition of this core.</L-2> Tags: atp.Status=draft
      reference ArtiLastErrorInstanceRef [0..1]: scope=ECU, multiplicity set at post-build in variant post-build / pre-compile in variant pre-compile, post-build-variant-multiplicity=true, post-build-variant-value=true, set at post-build in variant post-build / pre-compile in variant pre-compile, destination=ArtiObjectInstanceParameter  # Refers to the ArtiObjectInstanceParameter that contains the evaluation for the "last error" that happened on this core. Tags: atp.Status=draft
