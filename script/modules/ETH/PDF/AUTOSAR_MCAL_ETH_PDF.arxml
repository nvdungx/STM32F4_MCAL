AUTOSAR XML (schema 00053)
package /AUTOSAR/EcucDefs
  ecuc definition collection AUTOSARParameterDefinition: module=Eth
  module definition Eth [0..*]: post-build-variant-support=true, variants link-time/post-build/pre-compile  # Configuration of the Eth (Ethernet Driver) module.
    container EthConfigSet  # This container contains the configuration parameters and sub containers of the AUTOSAR Eth module.
      container EthCtrlConfig [1..*]  # Configuration of the individual controller
        integer EthCtrEgressHardwareSupportedDataTransferThreshold: 0..65535, set at pre-compile, default-value=0  # EthCtrEgressHardwareSupportedDataTransferThreshold define a threshold in bytes, if data, which is requested to be transmitted, shall be transferred with an hardware supported instruction (e.g. DMA) or via CPU copying process. Tags: atp.Status=draft | If given data length for transmission exceeds the configured threshold, then the Eth driver shall initiate a hardware supported data transfer from the given source address(es) to the used egress queue entry (e.g. via DMA instruction). Otherwise the Eth driver shall perform a CPU driven copy of data to the used egress queue entry to the corresponding egress queue (e.g. via DMA instruction).
        boolean EthCtrlConfigSwBufferHandling: set at pre-compile  # Enables / Disables SW buffer management
        boolean EthCtrlEnableEgressHardwareSupportedDataTransfer: set at pre-compile, default-value=false  # Eth driver shall use hardware supported data transfer form the upper layers to the corresponding egress queue (e.g. via DMA instruction) Tags: atp.Status=draft | true: hardware supported data transfer is enabled false: hardware supported data transfer is disabled
        boolean EthCtrlEnableMii: set at pre-compile  # Enables / Disables Media Independent Interface (MII) for transceiver access. | Note: In case a MACPHY (external Ethernet controller) is use this parameter has to be enabled to ensure the existence of Eth_WriteMii and Eth_ReadMii. Within the function call of Eth_WriteMii and Eth_ReadMii, the register access is transformed to an SPI command.
        boolean EthCtrlEnableMmd: set at pre-compile, default-value=false  # Enables/Disables Clause 45 Media Independent Interface (MII) for transceiver access
        boolean EthCtrlEnableRxInterrupt: set at pre-compile  # Enables / Disables receive interrupt. | Note: If this parameter is set to TRUE, then all ingress queues are handled in interrupt mode. If specific ingress queue need to be handled in interrupt mode, then this global parameter need to be set to FALSE and the specific ingress queue parameter EthCtrlEnableIngressQueueInterrupt need to be set to TRUE.
        boolean EthCtrlEnableSpiInterface [0..1]: post-build-variant-value=true, set at pre-compile, default-value=false  # This optional parameter enables the processing of control data and Ethernet frames over the SPI interface specific for MACPHY device. The use of this parameter implies the respect of the SPI protocol described in TC6 [26].
        boolean EthCtrlEnableTxInterrupt: set at pre-compile  # Enables / Disables transmit interrupt
        boolean EthCtrlFramePreemptionEnable: set at pre-compile, default-value=false  # Configures whether frame preemption for this Ethernet controller is enabled. Tags: atp.Status=draft | If this parameter is set to TRUE and the Ethernet controller hardware supports frame preemption, then frame preemption for this Ethernet controller is enabled.
        integer EthCtrlIdx: 0..255, scope=ECU, set at pre-compile, symbolic-name-value=true, with-auto=true  # Specifies the instance ID of the configured controller.
        integer EthCtrlInterPacketGap [0..1]: 0..10000, multiplicity set at pre-compile, set at pre-compile, default-value=12  # This parameter defines the transmit Inter-Packet Gap (IPG) (also called interframe gap (IFG)) between transmitted Ethernet packets in "byte times". This parameter can only exist if the hardware and driver support setting the IPG.
        enumeration EthCtrlMacLayerSpeed [0..1]: {ETH_MAC_LAYER_SPEED_100M, ETH_MAC_LAYER_SPEED_10G, ETH_MAC_LAYER_SPEED_10M, ETH_MAC_LAYER_SPEED_1G, ETH_MAC_LAYER_SPEED_2500M, ETH_MAC_LAYER_SPEED_5G}, scope=ECU, multiplicity set at link in variant link-time / post-build in variant post-build / pre-compile in variant pre-compile, post-build-variant-multiplicity=true, post-build-variant-value=true, set at link in variant link-time / post-build in variant post-build / pre-compile in variant pre-compile  # Defines the baud rate of the MAC layer.
        enumeration EthCtrlMacLayerSubType [0..1]: {REDUCED, REVERSED, SERIAL, STANDARD, UNIVERSAL_SERIAL}, scope=ECU, multiplicity set at link in variant link-time / post-build in variant post-build / pre-compile in variant pre-compile, post-build-variant-multiplicity=true, post-build-variant-value=true, set at link in variant link-time / post-build in variant post-build / pre-compile in variant pre-compile  # Defines the MAC layer subtype of a switch port
        enumeration EthCtrlMacLayerType: {ETH_MAC_LAYER_TYPE_XGMII, ETH_MAC_LAYER_TYPE_XMII, ETH_MAC_LAYER_TYPE_XXGMII}, scope=ECU, post-build-variant-value=true, set at link in variant link-time / post-build in variant post-build / pre-compile in variant pre-compile  # Defines the physical MAC/PHY Ethernet Interface type of the ethernet controller.
        string EthCtrlPhyAddress [0..1]: multiplicity set at link in variant link-time / post-build in variant post-build / pre-compile in variant pre-compile, post-build-variant-multiplicity=true, post-build-variant-value=true, set at link in variant link-time / post-build in variant post-build / pre-compile in variant pre-compile, max-length=17, min-length=17, regular-expression=([0-9a-fA-F]\{2}:)\{5}[0-9a-fA-F]\{2}  # Specifies the unique 48-bit physical address (MAC address) of the controller in network byte order.
        reference EthCtrlEcucPartitionRef [0..1]: scope=ECU, multiplicity set at pre-compile, post-build-variant-multiplicity=true, post-build-variant-value=true, set at pre-compile, destination=EcucPartition  # Maps the Ethernet controller to zero or one ECUC partitions. The ECUC partition referenced is a subset of the ECUC partitions where the Ethernet driver is mapped to.
        container EthClkUnit [0..*]: multiplicity set at pre-compile  # This container contains the configuration of HW clock unit in the Ethernet Controller, which encapsulates a HW clock for ingress/egress timestamping and optionally an adjustable HW clock to follow the PTP time. Tags: atp.Status=draft
          enumeration EthClkUnitCrossTimestampingSupport: scope=ECU, set at pre-compile, default-value=NO_XTIMESTAMPING  # Defines the type of cross-timestamping between 2 HW clocks in the Ethernet Controller. Tags: atp.Status=draft
            HW_XTIMESTAMPING  # Tags: atp.Status=draft
            NO_XTIMESTAMPING  # Tags: atp.Status=draft
            SW_XTIMESTAMPING  # Tags: atp.Status=draft
          integer EthClkUnitIdx: 0..255, scope=ECU, set at pre-compile, symbolic-name-value=true, with-auto=true  # Zero-based consecutive index of the HW clock units in the Ethernet Controller. Upper layer BSW modules and the Eth itself use this index to identify a clock in the Ethernet Controller. Tags: atp.Status=draft
          reference EthClkUnitTimePhcRef [0..1]: scope=ECU, multiplicity set at pre-compile, set at pre-compile, destination=EthCtrlClk  # Reference to a HW clock in the Ethernet controller, which can be configured as PTP hardware clock (PHC). Tags: atp.Status=draft
          reference EthClkUnitTimeStampingRef: scope=ECU, set at pre-compile, destination=EthCtrlClk  # Reference to a HW clock in the Ethernet controller, which is used by the Ethernet Controller for ingress/egrees timestamping of frames. Tags: atp.Status=draft
        container EthCtrlClk [0..*]: multiplicity set at pre-compile  # This container contains the configuration of a HW clock in the Ethernet Controller. Tags: atp.Status=draft | Please note: It is recommended to always use the same hardware clock tree of the used platform for Ethernet hardware clocks which refer to the same EthClkUnit, otherwise cross-timestamping is needed.
          boolean EthCtrlClkAdjustmentEnable: scope=ECU, set at pre-compile, default-value=false  # Defines whether clock adjustment is enabled for this EthCtrlClk. Tags: atp.Status=draft
          integer EthCtrlClkIdx: 0..255, scope=ECU, set at pre-compile  # Zero-based consecutive index of the HW clocks in the Ethernet Controller. Upper layer BSW modules and the Eth itself use this index to identify a clock in the Ethernet Controller. Tags: atp.Status=draft
        container EthCtrlConfigEgress  # Configuration of one Ethernet controler egress behavior.
          reference EthCtrlConfigEgressLastSchedulerRef: set at pre-compile, destination=EthCtrlConfigScheduler  # Reference to the scheduler which is the last in the egress structure.
          container EthCtrlConfigEgressFifo [0..*]: multiplicity set at link in variant link-time / post-build in variant post-build / pre-compile in variant pre-compile, post-build-variant-multiplicity=true  # Represents a Fifo at the egress side. Tags: atp.Status=obsolete
            integer EthCtrlConfigEgressFifoBufLenByte: 0..65535, post-build-variant-value=true, set at link in variant link-time / post-build in variant post-build / pre-compile in variant pre-compile  # Length of Fifo elements in bytes. Tags: atp.Status=obsolete
            integer EthCtrlConfigEgressFifoBufTotal: 0..65535, post-build-variant-value=true, set at link in variant link-time / post-build in variant post-build / pre-compile in variant pre-compile  # Fifo buffer count. Tags: atp.Status=obsolete
            integer EthCtrlConfigEgressFifoIdx: 0..255, post-build-variant-value=true, set at link in variant link-time / post-build in variant post-build / pre-compile in variant pre-compile  # Egress Fifo index. Tags: atp.Status=obsolete
            integer EthCtrlConfigEgressFifoPriorityAssignment [0..*]: 0..7, multiplicity set at link in variant link-time / post-build in variant post-build / pre-compile in variant pre-compile, post-build-variant-multiplicity=true, post-build-variant-value=true, set at link in variant link-time / post-build in variant post-build / pre-compile in variant pre-compile  # Message egress prority assignment. Tags: atp.Status=obsolete
          container EthCtrlConfigEgressQueue [1..*]: multiplicity set at link in variant link-time / post-build in variant post-build / pre-compile in variant pre-compile, post-build-variant-multiplicity=true, requires-index=true  # Represents a queue at the egress side. Tags: atp.Status=draft
            integer EthCtrlConfigEgressQueueBufLenByte: 0..65535, post-build-variant-value=true, set at link in variant link-time / post-build in variant post-build / pre-compile in variant pre-compile  # Defines the length of one queue element in bytes. Tags: atp.Status=draft
            integer EthCtrlConfigEgressQueueBufTotal: 0..65535, post-build-variant-value=true, set at link in variant link-time / post-build in variant post-build / pre-compile in variant pre-compile  # Defines the count of queue elements for one queue. Tags: atp.Status=draft
            integer EthCtrlConfigEgressQueueIdx: 0..255, post-build-variant-value=true, set at link in variant link-time / post-build in variant post-build / pre-compile in variant pre-compile, symbolic-name-value=true, with-auto=true  # Defines the queue index. Tags: atp.Status=draft
            container EthCtrlConfigEgressQueueSortingType [0..1]: multiplicity set at pre-compile  # Defines the sorting filter for the queue. Optional if only one queue is available. Tags: atp.Status=draft
              container EthCtrlConfigEgressQueueSortingEntry [1..*]: multiplicity set at link in variant link-time / post-build in variant post-build / pre-compile in variant pre-compile, post-build-variant-multiplicity=true  # Defines a field of the sorting filter. Tags: atp.Status=draft
                integer EthCtrlConfigEgressQueueSortingKey: 0..18446744073709551615, set at link in variant link-time / post-build in variant post-build / pre-compile in variant pre-compile  # Defines the value the masked filtered field has to match. Tags: atp.Status=draft
                integer EthCtrlConfigEgressQueueSortingMask: 0..18446744073709551615, set at link in variant link-time / post-build in variant post-build / pre-compile in variant pre-compile  # Defines the mask for matching the filtered field. Tags: atp.Status=draft
                integer EthCtrlConfigEgressQueueSortingOffset: 0..47, set at link in variant link-time / post-build in variant post-build / pre-compile in variant pre-compile  # Defines the offset of the filtered field in bytes, where 0 denotes the position of the destination MAC address. Tags: atp.Status=draft
                enumeration EthCtrlConfigEgressQueueSortingSize: set at link in variant link-time / post-build in variant post-build / pre-compile in variant pre-compile  # Defines the size of the filtered field. Tags: atp.Status=draft
                  UINT16  # Tags: atp.Status=draft
                  UINT32  # Tags: atp.Status=draft
                  UINT64  # Tags: atp.Status=draft
                  UINT8  # Tags: atp.Status=draft
            container EthCtrlConfigEgressQueueTransmissionSelection  # Represents the transmission selection of a queue at the egress side. Tags: atp.Status=draft
              enumeration EthCtrlConfigEgressQueueTransmissionSelectionAlgorithm: post-build-variant-value=true, set at link in variant link-time / post-build in variant post-build / pre-compile in variant pre-compile, default-value=ETH_TRANSMISSION_SELECTION_UNSHAPED  # Represents the transmission selection of a queue at the egress side. Tags: atp.Status=draft
                ETH_TRANSMISSION_SELECTION_ATS  # Tags: atp.Status=draft
                ETH_TRANSMISSION_SELECTION_CBS  # Tags: atp.Status=draft
                ETH_TRANSMISSION_SELECTION_ETS  # Tags: atp.Status=draft
                ETH_TRANSMISSION_SELECTION_UNSHAPED  # Tags: atp.Status=draft
              container EthCtrlConfigEgressQueueTransmissionSelectionCBSConfig [0..1]: multiplicity set at link in variant link-time / post-build in variant post-build / pre-compile in variant pre-compile, post-build-variant-multiplicity=true  # Represents the configuration of a credit based shaper transmission selection algorithm for an queue at the egress side. Tags: atp.Status=draft | This configuration is used if the EthCtrlConfigEgressQueueTransmissionSelectionAlgorithm is set to ETH_TRANSMISSION_SELECTION_CBS.
                integer EthCtrlConfigEgressQueueCreditBasedShaperMaxCredit [0..1]: 0..18446744073709551615, multiplicity set at pre-compile, post-build-variant-value=true, set at link in variant link-time / post-build in variant post-build / pre-compile in variant pre-compile  # Defines the maximum amount of credits that can be accumulated for a queue. Tags: atp.Status=draft
                integer EthCtrlConfigEgressQueueCreditBasedShaperMinCredit [0..1]: 0..18446744073709551615, multiplicity set at pre-compile, post-build-variant-value=true, set at link in variant link-time / post-build in variant post-build / pre-compile in variant pre-compile  # Defines the minimum amount of credits that can be accumulated for a queue. Tags: atp.Status=draft
                integer EthCtrlConfigEgressQueueCreditBasedShaperSendSlope [0..1]: 0..18446744073709551615, multiplicity set at pre-compile, post-build-variant-value=true, set at link in variant link-time / post-build in variant post-build / pre-compile in variant pre-compile  # Defines the send slope of queue at egress side. Tags: atp.Status=draft
              container EthCtrlConfigEgressQueueTransmissionSelectionETS [0..1]: multiplicity set at pre-compile  # Represents the configuration of an enhanced transmission selection algorithm of an egress queue. This configuration is used if the EthCtrlConfigEgressQueueTransmissionSelection is set to ETH_SCHEDULER_ENHANCED_TRAFFIC_SHAPER. The subordinated configuration parameters allow to configure the ETS in different variants to support commonly used scheduler algorithms (e.g. weighted round robin). Tags: atp.Status=draft
                integer EthCtrlETSConfigAvailableBandwidthInPercent [0..1]: 0..100, multiplicity set at pre-compile, set at pre-compile, default-value=30  # Represents the configuration of an enhanced transmission selection algorithm for one egress queue, where the available bandwidth is configured in percent. The percent value represents the available bandwidth for emission opportunities to transmit Ethernet frames calculated in bits. Tags: atp.Status=draft | The resolution is 1%.
                integer EthCtrlETSConfigAvailableBandwidthInWeightValue [0..1]: 1..255, multiplicity set at pre-compile, set at pre-compile, default-value=1  # Represents the configuration of an enhanced transmission selection algorithm of an egress queue, where the available bandwidth is configured as weight value. The weight value represents the number of emission opportunities to transmit Ethernet frames. Tags: atp.Status=draft
          container EthCtrlConfigScheduler [1..*]  # Represents a Scheduler on the egress side.
            enumeration EthCtrlConfigSchedulerAlgorithm: {ETH_SCHEDULER_ENHANCED_TRAFFIC_SHAPER, ETH_SCHEDULER_STRICT_PRIORITY}, post-build-variant-value=true, set at link in variant link-time / post-build in variant post-build / pre-compile in variant pre-compile  # Defines the scheduler algorithm.
            container EthCtrlConfigSchedulerPredecessor [1..*]  # Defines an ordered list of predecessors for this scheduler.
              integer EthCtrlConfigSchedulerPredecessorOrder: 0..18446744073709551615, post-build-variant-value=true, set at link in variant link-time / post-build in variant post-build / pre-compile in variant pre-compile  # Defines the order of the scheduler predecessors.
              choice reference EthCtrlConfigSchedulerPredecessorRef: set at pre-compile, destination=[EthCtrlConfigEgressFifo, EthCtrlConfigEgressQueue, EthCtrlConfigScheduler, EthCtrlConfigShaper]  # Choice reference to the scheduler predecessor.
          container EthCtrlConfigShaper [0..*]  # Represents a Shaper an the egress side. Tags: atp.Status=obsolete
            integer EthCtrlConfigShaperIdleSlope [0..1]: 0..18446744073709551615, post-build-variant-value=true, set at link in variant link-time / post-build in variant post-build / pre-compile in variant pre-compile  # Defines the increase of credit in bits per second for the AVB shaper. Tags: atp.Status=obsolete
            integer EthCtrlConfigShaperMaxCredit: 0..18446744073709551615, post-build-variant-value=true, set at link in variant link-time / post-build in variant post-build / pre-compile in variant pre-compile  # Maximum amount of credits that can be accumulated for a queue. Tags: atp.Status=obsolete
            integer EthCtrlConfigShaperMinCredit: 0..18446744073709551615, post-build-variant-value=true, set at link in variant link-time / post-build in variant post-build / pre-compile in variant pre-compile  # Minimum amount of credits in bytes that can be accumulated for a queue. Tags: atp.Status=obsolete
            reference EthCtrlConfigShaperPredecessorFifoRef: set at pre-compile, destination=EthCtrlConfigEgressFifo  # Reference to the fifo which is the predecessor for this shaper. Tags: atp.Status=obsolete
        container EthCtrlConfigIngress  # Configuration of one Ethernet controler ingress behavior.
          container EthCtrlConfigIngressFifo [0..*]: multiplicity set at link in variant link-time / post-build in variant post-build / pre-compile in variant pre-compile, post-build-variant-multiplicity=true  # Represents a Fifo at the ingress side. Tags: atp.Status=obsolete
            integer EthCtrlConfigIngressFifoBufLenByte: 0..65535, post-build-variant-value=true, set at link in variant link-time / post-build in variant post-build / pre-compile in variant pre-compile  # Length of Fifo elements in bytes. Tags: atp.Status=obsolete
            integer EthCtrlConfigIngressFifoBufTotal: 0..65535, post-build-variant-value=true, set at link in variant link-time / post-build in variant post-build / pre-compile in variant pre-compile  # Fifo buffer count. Tags: atp.Status=obsolete
            integer EthCtrlConfigIngressFifoIdx: 0..255, post-build-variant-value=true, set at link in variant link-time / post-build in variant post-build / pre-compile in variant pre-compile, symbolic-name-value=true, with-auto=true  # Ingress Fifo index. Tags: atp.Status=obsolete
            integer EthCtrlConfigIngressFifoPriorityAssignment [0..*]: 0..7, multiplicity set at link in variant link-time / post-build in variant post-build / pre-compile in variant pre-compile, post-build-variant-multiplicity=true, post-build-variant-value=true, set at link in variant link-time / post-build in variant post-build / pre-compile in variant pre-compile  # Message ingress prority assignment. Tags: atp.Status=obsolete
          container EthCtrlConfigIngressQueue [0..*]: multiplicity set at link in variant link-time / post-build in variant post-build / pre-compile in variant pre-compile, post-build-variant-multiplicity=true  # Represents a queue at the ingress side. Tags: atp.Status=draft
            integer EthCtrlConfigIngressQueueBufLenByte: 0..65535, post-build-variant-value=true, set at link in variant link-time / post-build in variant post-build / pre-compile in variant pre-compile  # Defines the length of one queue element in bytes. Tags: atp.Status=draft
            integer EthCtrlConfigIngressQueueBufTotal: 0..65535, post-build-variant-value=true, set at link in variant link-time / post-build in variant post-build / pre-compile in variant pre-compile  # Defines the count of queue elements for one queue. Tags: atp.Status=draft
            function name EthCtrlConfigIngressQueueHandlerFunction [0..1]: multiplicity set at pre-compile, set at pre-compile  # Specifies ingress queue handler function. Tags: atp.Status=draft
            integer EthCtrlConfigIngressQueueIdx: 0..255, post-build-variant-value=true, set at link in variant link-time / post-build in variant post-build / pre-compile in variant pre-compile, symbolic-name-value=true, with-auto=true  # Defines the queue index. Tags: atp.Status=draft
            boolean EthCtrlConfigIngressQueueOverwriteEnabled: set at pre-compile, default-value=false  # Defines the handling if all ingress queue elements are occupied and the Ethernet controller needs to enqueue a further Ethernet frame. Tags: atp.Status=draft | FALSE: Overwrite of the eldest available (i.e. not locked by a reception process) ingress queue element disabled. Enqueueing of further Ethernet frames is rejected. TRUE: Overwrite of the eldest available (i.e. not locked by an repetion process) ingress queue element enabled.
            boolean EthCtrlEnableIngressQueueInterrupt: set at pre-compile  # Enables / Disables receive interrupt of this specific queue. Tags: atp.Status=draft | Please note: This would enable an interrupt for this specific ingress queue upon reception of an Ethernet frame. Some ingress queue may be handled interrupt mode and some in polling mode. Therefore the global parameter EthCtrlEnableRxInterrupt, where all ingress queues are handled in interrupt mode, need to be set to FALSE.
            container EthCtrlConfigIngressQueueSortingType [0..1]: multiplicity set at pre-compile  # Defines one out of 4 possible sorting criteria for this ingress queue. Tags: atp.Status=draft
              integer EthCtrlIngressQueueSortingEtherTypeAssignment [0..1]: 0..65535, multiplicity set at pre-compile, set at pre-compile  # Defines that the EtherType shall be used to assign frames to this ingress queue. Tags: atp.Status=draft
              string EthCtrlIngressQueueSortingMacDestinationAssignment [0..1]: multiplicity set at pre-compile, set at pre-compile, max-length=17, min-length=17, regular-expression=([0-9a-fA-F]\{2}:)\{5}[0-9a-fA-F]\{2}  # Defines that the Destination MAC Address shall be used to assign frames to this ingress queue. Tags: atp.Status=draft
              integer EthCtrlIngressQueueSortingVlanIdAssignment [0..1]: 0..65535, multiplicity set at pre-compile, set at pre-compile  # Defines that the VLAN ID shall be used to assign frames to this ingress queue. Tags: atp.Status=draft
              integer EthCtrlIngressQueueSortingVlanPriorityAssignment [0..8]: 0..7, multiplicity set at pre-compile, set at pre-compile  # Defines that the VLAN priority shall be used to assign frames to this ingress queue. Tags: atp.Status=draft
          container EthCtrlConfigIngressQueueSortingPriority [0..1]: multiplicity set at pre-compile  # Defines the sorting priority of Ethernet frame attributes (priority, MacDstAddr, VlanId). Tags: atp.Status=draft | If an Ethernet frame is received and several ingress queues of the same EthCtrl have different EthCtrlConfigIngressQueueSortingTypes configured, then the Ethernet frames shall be sorted regarding the EthCtrlConfigIngressQueueSortingType set to the highest priority. If no matching queue was found, proceed in decending order with the next sorting EthCtrlConfigIngressQueueSortingType. If Ethernet frame could not be sorted in any ingress queue, then drop this Ethernet frame.
            integer SortingPriorityEtherTypeAssignment: 0..3, post-build-variant-value=true, set at link in variant link-time / post-build in variant post-build / pre-compile in variant pre-compile  # Defines the sorting priority for EtherType assignment. Tags: atp.Status=draft | 0 has the highest priority.
            integer SortingPriorityMacDestinationAssignment: 0..3, post-build-variant-value=true, set at link in variant link-time / post-build in variant post-build / pre-compile in variant pre-compile  # Defines the sorting priority for MAC destination assignment. Tags: atp.Status=draft | 0 has the highest priority.
            integer SortingPriorityVlanIdAssignment: 0..3, post-build-variant-value=true, set at link in variant link-time / post-build in variant post-build / pre-compile in variant pre-compile  # Defines the sorting priority for VLAN ID assignment. Tags: atp.Status=draft | 0 has the highest priority.
            integer SortingPriorityVlanPriorityAssignment: 0..3, post-build-variant-value=true, set at link in variant link-time / post-build in variant post-build / pre-compile in variant pre-compile  # Defines the sorting priority for VLAN priority assignment. Tags: atp.Status=draft | 0 has the highest priority.
        container EthCtrlConfigSpiConfiguration [0..*]  # SPI Interface configuration of one Ethernet controller (MACPHY use). Tags: atp.Status=draft | Configured only if EthCtrlEnableSpiInterface is set to TRUE.
          integer EthCtrlConfigSpiChunkPayloadSize: 8..64, post-build-variant-value=true, set at link in variant link-time / post-build in variant post-build / pre-compile in variant pre-compile, default-value=64  # Configures the size of the payload chunks which will be transferred over the SPI interface. Tags: atp.Status=draft | Note: The chunk is the basic element for data transaction over the SPI which can be a section of an Ethernet frame or management command. The configured value has to be a multiple of 8.
          integer EthCtrlConfigSpiCommRetries: 0..255, post-build-variant-value=true, set at link in variant link-time / post-build in variant post-build / pre-compile in variant pre-compile  # Indicates the maximum number of communication retries in case of a failed SPI communication (applies both to timed out communication and to errors/NACK in the response data). If configured value is '0', no retry is allowed (communication is expected to succeed at first try). Tags: atp.Status=draft
          float EthCtrlConfigSpiCommTimeout: 0..0.1, multiplicity set at link in variant link-time / post-build in variant post-build, post-build-variant-value=true, set at link in variant link-time / post-build in variant post-build / pre-compile in variant pre-compile  # Indicates the maximum time allowed to the Ethernet controller for replying (either positively or negatively) to a SPI command. Timeout is configured in seconds. Timeout value of '0' means that no specific timeout is to be used by Ethernet controller and the communication is executed at the best of the SPI HW capacity. Tags: atp.Status=draft
          boolean EthCtrlConfigSpiEnableControlDataProtection: set at pre-compile, default-value=false  # Enables the control data protection. Tags: atp.Status=draft | When set, all control data written to and read from the MACPHY will be transferred with its complement for detection of bit errors as defined in OA TC6 [26]. FALSE: Control data read/write protection is disabled (unprotected). TRUE: Control data read/write rotection is enabled (protected).
          boolean EthCtrlConfigSpiEnableRxCSAlign: post-build-variant-value=true, set at link in variant link-time / post-build in variant post-build / pre-compile in variant pre-compile, default-value=false  # Configures the CSn Align Receive frame. Tags: atp.Status=draft | TRUE: all received Ethernet frames data shall start at the beginning of the first receive data chunk payload following CSn assertion FALSE: received frames may begin within any receive data chunk of the transaction when this bit is clear.
          boolean EthCtrlConfigSpiEnableRxCutThrough [0..1]: multiplicity set at link in variant link-time / post-build in variant post-build / pre-compile in variant pre-compile, post-build-variant-multiplicity=true, post-build-variant-value=true, set at link in variant link-time / post-build in variant post-build / pre-compile in variant pre-compile, default-value=false  # When supported by the HW, enables the cut through mode of frame from the network to the SPI host. Tags: atp.Status=draft
          boolean EthCtrlConfigSpiEnableRxZeroAlign: post-build-variant-value=true, set at link in variant link-time / post-build in variant post-build / pre-compile in variant pre-compile, default-value=false  # Configures the zero-align receive frame. Tags: atp.Status=draft | TRUE: all received Ethernet frames data shall be aligned to start at the beginning of any receive data chunk payload. FALSE: Received frames may begin anywhere within the receive data chunk payload.
          boolean EthCtrlConfigSpiEnableTransmitDataHdrSequence [0..1]: multiplicity set at link in variant link-time / post-build in variant post-build / pre-compile in variant pre-compile, post-build-variant-multiplicity=true, post-build-variant-value=true, set at link in variant link-time / post-build in variant post-build / pre-compile in variant pre-compile, default-value=false  # When supported by the HW, enables the transmit data sequence monitoring. Tags: atp.Status=draft | FALSE: transmit data header sequence bit monitoring disabled. TRUE: transmit data header sequence bit monitoring enabled.
          boolean EthCtrlConfigSpiEnableTxChecksum [0..1]: multiplicity set at link in variant link-time / post-build in variant post-build / pre-compile in variant pre-compile, post-build-variant-multiplicity=true, post-build-variant-value=true, set at link in variant link-time / post-build in variant post-build / pre-compile in variant pre-compile, default-value=false  # When supported by the HW, enables the transmit frame check sequence validation. Tags: atp.Status=draft | * TRUE: the final 4 octets of all Ethernet frames received will be validated as an Ethernet FCS. * FALSE : validation deactivated. Note: additionnally the MAC must be configured to expect the SPI host to pad frames to the minimum frame size and append the FCS to the frame. The MAC should also be configured to pass the FCS to the SPI host with the received FCS for validation.
          boolean EthCtrlConfigSpiEnableTxCutThrough [0..1]: multiplicity set at pre-compile, set at pre-compile, default-value=false  # When supported by the HW, enables the cut through mode of frame from SPI host to the network. Tags: atp.Status=draft
          boolean EthCtrlConfigSpiSelectTimeStamp [0..1]: multiplicity set at link in variant link-time / post-build in variant post-build / pre-compile in variant pre-compile, post-build-variant-multiplicity=true, post-build-variant-value=true, set at link in variant link-time / post-build in variant post-build / pre-compile in variant pre-compile, default-value=false  # When timestamp supported by the HW, selects size and format of the timestamps. Tags: atp.Status=draft | FALSE: 32-bits timestamps TRUE: 64-bit timestamps
          integer EthCtrlConfigSpiTransmitCreditThreshold: 0..3, post-build-variant-value=true, set at link in variant link-time / post-build in variant post-build / pre-compile in variant pre-compile, default-value=0  # Configures the minimum of available transmit credit before the writing IRQn is asserted. Tags: atp.Status=draft | As per OA TC6, this information is notified by the TXC field. 0 = 1 credit 1 = 4 credits 2 = 8 credits 3 = 16 credits
          container EthCtrlConfigSpiSequence [0..*]  # Container gives Ethernet controller driver information about one SPI sequence. One SPI sequence used by Ethernet controller driver is in exclusive use for it. No other driver is allowed to access this sequence. Ethernet controller driver may use one sequence to access n Ethernet controller hardwares chips of the same type or n sequences are used to access one single Ethernet controller hardware chip. If a Ethernet controller hardware has no SPI interface, there is no instance of this container. Tags: atp.Status=draft
            boolean EthCtrlConfigSpiAccessSynchronous [0..1]: multiplicity set at link in variant link-time / post-build in variant post-build / pre-compile in variant pre-compile, post-build-variant-multiplicity=true, post-build-variant-value=true, set at link in variant link-time / post-build in variant post-build / pre-compile in variant pre-compile, default-value=false  # This parameter is used to define whether the access to the Spi sequence is synchronous or asynchronous. Tags: atp.Status=draft | true: SPI access is synchronous. false: SPI access is asynchronous.
            reference EthCtrlConfigSpiSequenceName [0..*]: multiplicity set at pre-compile, set at pre-compile, requires-symbolic-name-value=true, destination=SpiSequence  # Reference to a Spi sequence configuration container. Tags: atp.Status=draft
        container EthCtrlPulsePerSecondConfig [0..1]: multiplicity set at pre-compile  # This container contains the configuration of a HW Pulse per Second (PPS) feature. If not defined the PPS feature is not used. Tags: atp.Status=draft
          integer EthCtrlPulsePerSecondDutyCycle: 0..100, set at pre-compile  # Configuration how long each Pulse shall be defined in percent. Tags: atp.Status=draft
          integer EthCtrlPulsePerSecondFrequency: 0..100, set at pre-compile  # Configuration how many Pulse per Second pulses shall be created per second. Tags: atp.Status=draft
          enumeration EthCtrlPulsePerSecondStartEnum: set at pre-compile  # Defines whether the pulse starts with a rising or a falling edge. Tags: atp.Status=draft
            FALLING_EDGE  # Tags: atp.Status=draft
            RISING_EDGE  # Tags: atp.Status=draft
          reference EthCtrlPulsePerSecondClockRef [0..1]: multiplicity set at pre-compile, set at pre-compile, destination=EthCtrlClk  # Reference to a HW clock in the Ethernet controller, which is taken as the source for the PPS (Pulse Per Second). Tags: atp.Status=draft
        container EthDemEventParameterRefs [0..1]  # Container for the references to DemEventParameter elements which shall be invoked using the API Dem_SetEventStatus in case the corresponding error occurs. The EventId is taken from the referenced DemEventParameter's DemEventId symbolic value. The standardized errors are provided in this container and can be extended by vendor-specific error references.
          reference ETH_E_ACCESS [0..1]: multiplicity set at link in variant link-time / post-build in variant post-build / pre-compile in variant pre-compile, post-build-variant-multiplicity=true, post-build-variant-value=true, set at link in variant link-time / post-build in variant post-build / pre-compile in variant pre-compile, requires-symbolic-name-value=true, destination=DemEventParameter  # Reference to the DemEventParameter which shall be issued when the error "Controller access failed" has occured.
          reference ETH_E_ALIGNMENT [0..1]: multiplicity set at link in variant link-time / post-build in variant post-build / pre-compile in variant pre-compile, post-build-variant-multiplicity=true, post-build-variant-value=true, set at link in variant link-time / post-build in variant post-build / pre-compile in variant pre-compile, requires-symbolic-name-value=true, destination=DemEventParameter  # Reference to the DemEventParameter which shall be issued when the error "Alignment Error" has occured.
          reference ETH_E_CRC [0..1]: multiplicity set at link in variant link-time / post-build in variant post-build / pre-compile in variant pre-compile, post-build-variant-multiplicity=true, post-build-variant-value=true, set at link in variant link-time / post-build in variant post-build / pre-compile in variant pre-compile, requires-symbolic-name-value=true, destination=DemEventParameter  # Reference to the DemEventParameter which shall be issued when the error "CRC Failure" has occured.
          reference ETH_E_LATECOLLISION [0..1]: multiplicity set at link in variant link-time / post-build in variant post-build / pre-compile in variant pre-compile, post-build-variant-multiplicity=true, post-build-variant-value=true, set at link in variant link-time / post-build in variant post-build / pre-compile in variant pre-compile, requires-symbolic-name-value=true, destination=DemEventParameter  # Reference to the DemEventParameter which shall be issued when the error "Late Collisions" has occured.
          reference ETH_E_MULTIPLECOLLISION [0..1]: multiplicity set at link in variant link-time / post-build in variant post-build / pre-compile in variant pre-compile, post-build-variant-multiplicity=true, post-build-variant-value=true, set at link in variant link-time / post-build in variant post-build / pre-compile in variant pre-compile, requires-symbolic-name-value=true, destination=DemEventParameter  # Reference to the DemEventParameter which shall be issued when the error "Multiple Collisions" has occured.
          reference ETH_E_OVERSIZEFRAME [0..1]: multiplicity set at link in variant link-time / post-build in variant post-build / pre-compile in variant pre-compile, post-build-variant-multiplicity=true, post-build-variant-value=true, set at link in variant link-time / post-build in variant post-build / pre-compile in variant pre-compile, requires-symbolic-name-value=true, destination=DemEventParameter  # Reference to the DemEventParameter which shall be issued when the error "Oversized Frame" has occured.
          reference ETH_E_RX_FRAMES_LOST [0..1]: multiplicity set at link in variant link-time / post-build in variant post-build / pre-compile in variant pre-compile, post-build-variant-multiplicity=true, post-build-variant-value=true, set at link in variant link-time / post-build in variant post-build / pre-compile in variant pre-compile, requires-symbolic-name-value=true, destination=DemEventParameter  # Reference to the DemEventParameter which shall be issued when the error "receive frames lost" has occured.
          reference ETH_E_SINGLECOLLISION [0..1]: multiplicity set at link in variant link-time / post-build in variant post-build / pre-compile in variant pre-compile, post-build-variant-multiplicity=true, post-build-variant-value=true, set at link in variant link-time / post-build in variant post-build / pre-compile in variant pre-compile, requires-symbolic-name-value=true, destination=DemEventParameter  # Reference to the DemEventParameter which shall be issued when the error "Single Collisions" has occured.
          reference ETH_E_UNDERSIZEFRAME [0..1]: multiplicity set at link in variant link-time / post-build in variant post-build / pre-compile in variant pre-compile, post-build-variant-multiplicity=true, post-build-variant-value=true, set at link in variant link-time / post-build in variant post-build / pre-compile in variant pre-compile, requires-symbolic-name-value=true, destination=DemEventParameter  # Reference to the DemEventParameter which shall be issued when the error "Undersized Frame" has occured.
    container EthGeneral  # General configuration of Ethernet Driver module
      boolean EthDevErrorDetect: set at pre-compile, default-value=false  # Switches the development error detection and notification on or off. | * true: detection and notification is enabled. * false: detection and notification is disabled.
      boolean EthGetCounterValuesApi: set at pre-compile  # Enables / Disables Eth_GetCounterValues API.
      boolean EthGetRxStatsApi: set at pre-compile, default-value=false  # Enables/Disables Eth_GetRxStats API.
      boolean EthGetTxErrorCounterValuesApi: set at pre-compile, default-value=false  # Enables/Disables Eth_GetTxErrorCounterValues API.
      boolean EthGetTxStatsApi: set at pre-compile, default-value=false  # Enables/Disables Eth_GetTxStats API.
      boolean EthGlobalTimeSupport: set at pre-compile  # Enables/Disables the GlobalTime APIs used amongst others by Global Time Synchronization over Ethernet.
      integer EthIndex: 0..255, set at pre-compile  # Specifies the InstanceId of this module instance. If only one instance is present it shall have the Id 0.
      float EthMainFunctionPeriod: 0..INF, set at pre-compile  # Specifies the period of main function Eth_MainFunction in seconds. Ethernet driver does not require this information but the BSW scheduler.
      boolean EthPhcSupport: set at pre-compile  # Enables/Disables the PTP HW Clock (PHC). Tags: atp.Status=draft
      boolean EthVersionInfoApi: set at pre-compile, default-value=false  # Enables / Disables version info API
      reference EthEcucPartitionRef [0..*]: scope=ECU, multiplicity set at pre-compile, post-build-variant-multiplicity=true, post-build-variant-value=true, set at pre-compile, destination=EcucPartition  # Maps the Ethernet driver to zero or multiple ECUC partitions to make the modules API available in this partition.
      container EthCtrlOffloading  # Configuration of hardware offloading features.
        boolean EthCtrlEnableOffloadChecksumICMP: set at pre-compile  # Enables / Disables hardware offloading for ICMP checksums.
        boolean EthCtrlEnableOffloadChecksumIPv4: set at pre-compile  # Enables / Disables hardware offloading for IPv4 checksums.
        boolean EthCtrlEnableOffloadChecksumTCP: set at pre-compile  # Enables / Disables hardware offloading for TCP checksums.
        boolean EthCtrlEnableOffloadChecksumUDP: set at pre-compile  # Enables / Disables hardware offloading for UDP checksums.
