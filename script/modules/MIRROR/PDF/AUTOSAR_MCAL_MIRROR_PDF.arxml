AUTOSAR XML (schema 00053)
package /AUTOSAR/EcucDefs
  ecuc definition collection AUTOSARParameterDefinition: module=Mirror
  module definition Mirror [0..1]: post-build-variant-support=true, variants link-time/post-build/pre-compile  # Configuration of the Bus Mirroring module.
    container MirrorConfigSet  # Contains the configuration parameters and sub containers of the Bus Mirroring module.
      reference MirrorInitialDestNetworkRef: post-build-variant-value=true, set at link in variant link-time / post-build in variant post-build / pre-compile in variant pre-compile, destination=MirrorDestNetwork  # Reference to the destination bus that is selected after initialization of the Bus Mirroring module.
      choice container MirrorDestNetwork [1..*]: multiplicity set at link in variant link-time / post-build in variant post-build / pre-compile in variant pre-compile, post-build-variant-multiplicity=true  # Destination bus to which frames are sent by the Bus Mirroring module.
        container MirrorDestNetworkCan [0..1]: multiplicity set at link in variant link-time / post-build in variant post-build / pre-compile in variant pre-compile, post-build-variant-multiplicity=true  # Destination bus representing a CAN network.
          integer MirrorDestQueueSize: 1..65535, set at link in variant link-time+post-build / pre-compile in variant pre-compile, default-value=20  # Number of frames that can be stored in the output queue for the destination bus.
          integer MirrorNetworkId: 0..255, scope=ECU, post-build-variant-value=true, set at link in variant link-time / post-build in variant post-build / pre-compile in variant pre-compile, symbolic-name-value=true  # Network ID of the bus.
          integer MirrorStatusCanId [0..1]: 0..4294967295, post-build-variant-value=true, set at link in variant link-time / post-build in variant post-build / pre-compile in variant pre-compile  # CAN ID of the CAN status frame. | If configured, a status frame will be sent on the CAN destination bus that contains the state of all active source buses.
          reference MirrorComMNetworkHandleRef: set at link in variant link-time / post-build in variant post-build / pre-compile in variant pre-compile, requires-symbolic-name-value=true, destination=ComMChannel  # Reference to the ComMChannel that represents the bus.
          container MirrorDestPdu: multiplicity set at link in variant link-time / post-build in variant post-build / pre-compile in variant pre-compile, post-build-variant-multiplicity=true  # I-PDU used for transmission of the mirrored frames on the destination bus.
            integer MirrorDestPduId: 0..65535, scope=ECU, set at pre-compile, symbolic-name-value=true, with-auto=true  # I-PDU identifier used for TxConfirmation from PduR.
            boolean MirrorDestPduUsesTriggerTransmit: post-build-variant-value=true, set at link in variant link-time / post-build in variant post-build / pre-compile in variant pre-compile  # Switches transmission via TriggerTransmit. | * true: The I-PDU is transmitted using TriggerTransmit. * false: The I-PDU is transmitted directly with the Transmit call.
            reference MirrorDestPduRef: set at link in variant link-time+post-build / pre-compile in variant pre-compile, destination=Pdu  # Reference to the Pdu object representing the I-PDU.
        container MirrorDestNetworkCanFD [0..1]: multiplicity set at link in variant link-time / post-build in variant post-build / pre-compile in variant pre-compile, post-build-variant-multiplicity=true  # Destination bus representing a CAN FD network. Mirroring can be configured to either direct (MirrorDestProtocolType == MIRROR_PT_NONE) or serialized (MirrorDestProtocolType != MIRROR_PT_NONE).
          enumeration MirrorDestProtocolType: {MIRROR_PT_NONE, MIRROR_PT_VERSION_1}, post-build-variant-value=true, set at link in variant link-time / post-build in variant post-build / pre-compile in variant pre-compile, default-value=MIRROR_PT_NONE  # Protocol type to use for the transmission on the destination bus. If set to MIRROR_PT_NONE, source frames are mirrored as single frames to the destination. Otherwise, they are serialized according to the chosen protocol
          integer MirrorDestQueueSize: 1..65535, set at link in variant link-time+post-build / pre-compile in variant pre-compile, default-value=20  # Number of frames that can be stored in the output queue for the destination bus.
          float MirrorDestTransmissionDeadline [0..1]: 0.001..0.655, multiplicity set at link in variant link-time / post-build in variant post-build / pre-compile in variant pre-compile, post-build-variant-multiplicity=true, post-build-variant-value=true, set at link in variant link-time / post-build in variant post-build / pre-compile in variant pre-compile, default-value=0.1  # Time in seconds after which the collection of source frames into the destination frame stopped and the frame is sent at the latest. | If omitted, destination frames are only sent when full or when the time stamp overflows after 655.35ms.
          integer MirrorNetworkId: 0..255, scope=ECU, post-build-variant-value=true, set at link in variant link-time / post-build in variant post-build / pre-compile in variant pre-compile, symbolic-name-value=true  # Network ID of the bus.
          integer MirrorStatusCanId [0..1]: 0..4294967295, post-build-variant-value=true, set at link in variant link-time / post-build in variant post-build / pre-compile in variant pre-compile  # CAN ID of the CAN status frame. | If configured, a status frame will be sent on the CAN destination bus that contains the state of all active source buses.
          reference MirrorComMNetworkHandleRef: set at link in variant link-time / post-build in variant post-build / pre-compile in variant pre-compile, requires-symbolic-name-value=true, destination=ComMChannel  # Reference to the ComMChannel that represents the bus.
          container MirrorDestPdu: multiplicity set at link in variant link-time / post-build in variant post-build / pre-compile in variant pre-compile, post-build-variant-multiplicity=true  # I-PDU used for transmission of the mirrored frames on the destination bus.
            integer MirrorDestPduId: 0..65535, scope=ECU, set at pre-compile, symbolic-name-value=true, with-auto=true  # I-PDU identifier used for TxConfirmation from PduR.
            boolean MirrorDestPduUsesTriggerTransmit: post-build-variant-value=true, set at link in variant link-time / post-build in variant post-build / pre-compile in variant pre-compile  # Switches transmission via TriggerTransmit. | * true: The I-PDU is transmitted using TriggerTransmit. * false: The I-PDU is transmitted directly with the Transmit call.
            reference MirrorDestPduRef: set at link in variant link-time+post-build / pre-compile in variant pre-compile, destination=Pdu  # Reference to the Pdu object representing the I-PDU.
        container MirrorDestNetworkCanXL [0..1]: multiplicity set at link in variant link-time / post-build in variant post-build / pre-compile in variant pre-compile, post-build-variant-multiplicity=true  # Destination bus representing a CAN XL network.
          integer MirrorDestQueueSize: 1..65535, set at link in variant link-time+post-build / pre-compile in variant pre-compile, default-value=20  # Number of frames that can be stored in the output queue for the destination bus.
          float MirrorDestTransmissionDeadline [0..1]: 0.001..0.655, multiplicity set at link in variant link-time / post-build in variant post-build / pre-compile in variant pre-compile, post-build-variant-multiplicity=true, post-build-variant-value=true, set at link in variant link-time / post-build in variant post-build / pre-compile in variant pre-compile, default-value=0.1  # Time in seconds after which the collection of source frames into the destination frame stopped and the frame is sent at the latest. | If omitted, destination frames are only sent when full or when the time stamp overflows after 655.35ms.
          integer MirrorNetworkId: 0..255, scope=ECU, post-build-variant-value=true, set at link in variant link-time / post-build in variant post-build / pre-compile in variant pre-compile, symbolic-name-value=true  # Network ID of the bus.
          reference MirrorComMNetworkHandleRef: set at link in variant link-time / post-build in variant post-build / pre-compile in variant pre-compile, requires-symbolic-name-value=true, destination=ComMChannel  # Reference to the ComMChannel that represents the bus.
          container MirrorDestPdu: multiplicity set at link in variant link-time / post-build in variant post-build / pre-compile in variant pre-compile, post-build-variant-multiplicity=true  # I-PDU used for transmission of the mirrored frames on the destination bus.
            integer MirrorDestPduId: 0..65535, scope=ECU, set at pre-compile, symbolic-name-value=true, with-auto=true  # I-PDU identifier used for TxConfirmation from PduR.
            boolean MirrorDestPduUsesTriggerTransmit: post-build-variant-value=true, set at link in variant link-time / post-build in variant post-build / pre-compile in variant pre-compile  # Switches transmission via TriggerTransmit. | * true: The I-PDU is transmitted using TriggerTransmit. * false: The I-PDU is transmitted directly with the Transmit call.
            reference MirrorDestPduRef: set at link in variant link-time+post-build / pre-compile in variant pre-compile, destination=Pdu  # Reference to the Pdu object representing the I-PDU.
        container MirrorDestNetworkCdd [0..1]: multiplicity set at link in variant link-time / post-build in variant post-build / pre-compile in variant pre-compile, post-build-variant-multiplicity=true  # Destination bus representing a user defined network.
          integer MirrorDestQueueSize: 1..65535, set at link in variant link-time+post-build / pre-compile in variant pre-compile, default-value=20  # Number of frames that can be stored in the output queue for the destination bus.
          float MirrorDestTransmissionDeadline [0..1]: 0.001..0.655, multiplicity set at link in variant link-time / post-build in variant post-build / pre-compile in variant pre-compile, post-build-variant-multiplicity=true, post-build-variant-value=true, set at link in variant link-time / post-build in variant post-build / pre-compile in variant pre-compile, default-value=0.1  # Time in seconds after which the collection of source frames into the destination frame stopped and the frame is sent at the latest. | If omitted, destination frames are only sent when full or when the time stamp overflows after 655.35ms.
          integer MirrorNetworkId: 0..255, scope=ECU, post-build-variant-value=true, set at link in variant link-time / post-build in variant post-build / pre-compile in variant pre-compile, symbolic-name-value=true  # Network ID of the bus.
          reference MirrorComMNetworkHandleRef: set at link in variant link-time / post-build in variant post-build / pre-compile in variant pre-compile, requires-symbolic-name-value=true, destination=ComMChannel  # Reference to the ComMChannel that represents the bus.
          container MirrorDestPdu: multiplicity set at link in variant link-time / post-build in variant post-build / pre-compile in variant pre-compile, post-build-variant-multiplicity=true  # I-PDU used for transmission of the mirrored frames on the destination bus.
            integer MirrorDestPduId: 0..65535, scope=ECU, set at pre-compile, symbolic-name-value=true, with-auto=true  # I-PDU identifier used for TxConfirmation from PduR.
            boolean MirrorDestPduUsesTriggerTransmit: post-build-variant-value=true, set at link in variant link-time / post-build in variant post-build / pre-compile in variant pre-compile  # Switches transmission via TriggerTransmit. | * true: The I-PDU is transmitted using TriggerTransmit. * false: The I-PDU is transmitted directly with the Transmit call.
            reference MirrorDestPduRef: set at link in variant link-time+post-build / pre-compile in variant pre-compile, destination=Pdu  # Reference to the Pdu object representing the I-PDU.
        container MirrorDestNetworkFlexRay [0..1]: multiplicity set at link in variant link-time / post-build in variant post-build / pre-compile in variant pre-compile, post-build-variant-multiplicity=true  # Destination bus representing a FlexRay network.
          integer MirrorDestQueueSize: 1..65535, set at link in variant link-time+post-build / pre-compile in variant pre-compile, default-value=20  # Number of frames that can be stored in the output queue for the destination bus.
          float MirrorDestTransmissionDeadline [0..1]: 0.001..0.655, multiplicity set at link in variant link-time / post-build in variant post-build / pre-compile in variant pre-compile, post-build-variant-multiplicity=true, post-build-variant-value=true, set at link in variant link-time / post-build in variant post-build / pre-compile in variant pre-compile, default-value=0.1  # Time in seconds after which the collection of source frames into the destination frame stopped and the frame is sent at the latest. | If omitted, destination frames are only sent when full or when the time stamp overflows after 655.35ms.
          integer MirrorNetworkId: 0..255, scope=ECU, post-build-variant-value=true, set at link in variant link-time / post-build in variant post-build / pre-compile in variant pre-compile, symbolic-name-value=true  # Network ID of the bus.
          reference MirrorComMNetworkHandleRef: set at link in variant link-time / post-build in variant post-build / pre-compile in variant pre-compile, requires-symbolic-name-value=true, destination=ComMChannel  # Reference to the ComMChannel that represents the bus.
          container MirrorDestPduFlexRay [1..*]: multiplicity set at link in variant link-time / post-build in variant post-build / pre-compile in variant pre-compile, post-build-variant-multiplicity=true  # I-PDU used for transmission of the mirrored frames on the destination bus. For FlexRay, an arbitrary number of I-PDUs can be configured.
            integer MirrorDestPduId: 0..65535, scope=ECU, set at pre-compile, symbolic-name-value=true, with-auto=true  # I-PDU identifier used for TxConfirmation from PduR.
            boolean MirrorDestPduUsesTriggerTransmit: post-build-variant-value=true, set at link in variant link-time / post-build in variant post-build / pre-compile in variant pre-compile  # Switches transmission via TriggerTransmit. | * true: The I-PDU is transmitted using TriggerTransmit. * false: The I-PDU is transmitted directly with the Transmit call.
            reference MirrorDestPduRef: set at link in variant link-time+post-build / pre-compile in variant pre-compile, destination=Pdu  # Reference to the Pdu object representing the I-PDU.
        container MirrorDestNetworkIp [0..1]: multiplicity set at link in variant link-time / post-build in variant post-build / pre-compile in variant pre-compile, post-build-variant-multiplicity=true  # Destination bus representing an IP network.
          integer MirrorDestQueueSize: 1..65535, set at link in variant link-time+post-build / pre-compile in variant pre-compile, default-value=20  # Number of frames that can be stored in the output queue for the destination bus.
          float MirrorDestTransmissionDeadline [0..1]: 0.001..0.655, multiplicity set at link in variant link-time / post-build in variant post-build / pre-compile in variant pre-compile, post-build-variant-multiplicity=true, post-build-variant-value=true, set at link in variant link-time / post-build in variant post-build / pre-compile in variant pre-compile, default-value=0.1  # Time in seconds after which the collection of source frames into the destination frame stopped and the frame is sent at the latest. | If omitted, destination frames are only sent when full or when the time stamp overflows after 655.35ms.
          integer MirrorNetworkId: 0..255, scope=ECU, post-build-variant-value=true, set at link in variant link-time / post-build in variant post-build / pre-compile in variant pre-compile, symbolic-name-value=true  # Network ID of the bus.
          reference MirrorComMNetworkHandleRef: set at link in variant link-time / post-build in variant post-build / pre-compile in variant pre-compile, requires-symbolic-name-value=true, destination=ComMChannel  # Reference to the ComMChannel that represents the bus.
          container MirrorDestPdu: multiplicity set at link in variant link-time / post-build in variant post-build / pre-compile in variant pre-compile, post-build-variant-multiplicity=true  # I-PDU used for transmission of the mirrored frames on the destination bus.
            integer MirrorDestPduId: 0..65535, scope=ECU, set at pre-compile, symbolic-name-value=true, with-auto=true  # I-PDU identifier used for TxConfirmation from PduR.
            boolean MirrorDestPduUsesTriggerTransmit: post-build-variant-value=true, set at link in variant link-time / post-build in variant post-build / pre-compile in variant pre-compile  # Switches transmission via TriggerTransmit. | * true: The I-PDU is transmitted using TriggerTransmit. * false: The I-PDU is transmitted directly with the Transmit call.
            reference MirrorDestPduRef: set at link in variant link-time+post-build / pre-compile in variant pre-compile, destination=Pdu  # Reference to the Pdu object representing the I-PDU.
      choice container MirrorSourceNetwork [1..*]: multiplicity set at link in variant link-time / post-build in variant post-build / pre-compile in variant pre-compile, post-build-variant-multiplicity=true  # Source bus from which frames are received by the Bus Mirroring module.
        container MirrorSourceNetworkCan [0..1]: multiplicity set at link in variant link-time / post-build in variant post-build / pre-compile in variant pre-compile, post-build-variant-multiplicity=true  # Source bus representing a CAN network.
          integer MirrorNetworkId: 0..255, scope=ECU, post-build-variant-value=true, set at link in variant link-time / post-build in variant post-build / pre-compile in variant pre-compile, symbolic-name-value=true  # Network ID of the bus.
          integer MirrorSourceMaxDynamicFilters: 0..255, set at link in variant link-time+post-build / pre-compile in variant pre-compile, default-value=5  # Maximum number of filters that can be dynamically added using Mirror_AddXxxFilter().
          reference MirrorComMNetworkHandleRef: set at link in variant link-time / post-build in variant post-build / pre-compile in variant pre-compile, requires-symbolic-name-value=true, destination=ComMChannel  # Reference to the ComMChannel that represents the bus.
          choice container MirrorSourceCanFilter [0..255]: multiplicity set at link in variant link-time / post-build in variant post-build / pre-compile in variant pre-compile, post-build-variant-multiplicity=true  # Pre-configured filter for CAN frames.
            container MirrorSourceCanFilterMask [0..1]: multiplicity set at link in variant link-time / post-build in variant post-build / pre-compile in variant pre-compile, post-build-variant-multiplicity=true  # Pre-configured mask based filter for CAN frames.
              integer MirrorSourceCanFilterCanIdCode: 0..4294967295, post-build-variant-value=true, set at link in variant link-time / post-build in variant post-build / pre-compile in variant pre-compile  # Value to match masked CAN IDs.
              integer MirrorSourceCanFilterCanIdMask: 0..4294967295, post-build-variant-value=true, set at link in variant link-time / post-build in variant post-build / pre-compile in variant pre-compile  # Mask applied to CAN IDs before comparison.
              integer MirrorSourceCanFilterId: 0..255, scope=ECU, post-build-variant-value=true, set at link in variant link-time / post-build in variant post-build / pre-compile in variant pre-compile, symbolic-name-value=true  # Unique identifier of the pre-configured CAN filter.
            container MirrorSourceCanFilterRange [0..1]: multiplicity set at link in variant link-time / post-build in variant post-build / pre-compile in variant pre-compile, post-build-variant-multiplicity=true  # Pre-configured range filter for CAN frames.
              integer MirrorSourceCanFilterId: 0..255, scope=ECU, post-build-variant-value=true, set at link in variant link-time / post-build in variant post-build / pre-compile in variant pre-compile, symbolic-name-value=true  # Unique identifier of the pre-configured CAN filter.
              integer MirrorSourceCanFilterLower: 0..4294967295, post-build-variant-value=true, set at link in variant link-time / post-build in variant post-build / pre-compile in variant pre-compile  # Lowest CAN ID that is accepted by the filter.
              integer MirrorSourceCanFilterUpper: 0..4294967295, post-build-variant-value=true, set at link in variant link-time / post-build in variant post-build / pre-compile in variant pre-compile  # Highest CAN ID that is accepted by the filter.
          container MirrorSourceCanMaskBasedIdMapping [0..*]: multiplicity set at link in variant link-time / post-build in variant post-build / pre-compile in variant pre-compile, post-build-variant-multiplicity=true  # Rule for remapping a set of CAN IDs.
            integer MirrorSourceCanMaskBasedIdMappingDestBaseId: 0..4294967295, post-build-variant-value=true, set at link in variant link-time / post-build in variant post-build / pre-compile in variant pre-compile  # Base ID merged with the masked parts of the original CAN ID to form the mapped CAN ID.
            integer MirrorSourceCanMaskBasedIdMappingSourceCanIdCode: 0..4294967295, post-build-variant-value=true, set at link in variant link-time / post-build in variant post-build / pre-compile in variant pre-compile  # Value to match masked original CAN IDs.
            integer MirrorSourceCanMaskBasedIdMappingSourceCanIdMask: 0..4294967295, post-build-variant-value=true, set at link in variant link-time / post-build in variant post-build / pre-compile in variant pre-compile  # Mask applied to original CAN IDs before comparison.
          container MirrorSourceCanSingleIdMapping [0..*]: multiplicity set at link in variant link-time / post-build in variant post-build / pre-compile in variant pre-compile, post-build-variant-multiplicity=true  # Rule for remapping a single CAN ID.
            integer MirrorSourceCanSingleIdMappingDestCanId: 0..4294967295, post-build-variant-value=true, set at link in variant link-time / post-build in variant post-build / pre-compile in variant pre-compile  # Mapped CAN ID.
            integer MirrorSourceCanSingleIdMappingSourceCanId: 0..4294967295, post-build-variant-value=true, set at link in variant link-time / post-build in variant post-build / pre-compile in variant pre-compile  # Original CAN ID.
        container MirrorSourceNetworkCanFD [0..1]: multiplicity set at link in variant link-time / post-build in variant post-build / pre-compile in variant pre-compile, post-build-variant-multiplicity=true  # Source bus representing a CAN FD network.
          integer MirrorNetworkId: 0..255, scope=ECU, post-build-variant-value=true, set at link in variant link-time / post-build in variant post-build / pre-compile in variant pre-compile, symbolic-name-value=true  # Network ID of the bus.
          integer MirrorSourceMaxDynamicFilters: 0..255, set at link in variant link-time+post-build / pre-compile in variant pre-compile, default-value=5  # Maximum number of filters that can be dynamically added using Mirror_AddXxxFilter().
          reference MirrorComMNetworkHandleRef: set at link in variant link-time / post-build in variant post-build / pre-compile in variant pre-compile, requires-symbolic-name-value=true, destination=ComMChannel  # Reference to the ComMChannel that represents the bus.
          choice container MirrorSourceCanFilter [0..255]: multiplicity set at link in variant link-time / post-build in variant post-build / pre-compile in variant pre-compile, post-build-variant-multiplicity=true  # Pre-configured filter for CAN frames.
            container MirrorSourceCanFilterMask [0..1]: multiplicity set at link in variant link-time / post-build in variant post-build / pre-compile in variant pre-compile, post-build-variant-multiplicity=true  # Pre-configured mask based filter for CAN frames.
              integer MirrorSourceCanFilterCanIdCode: 0..4294967295, post-build-variant-value=true, set at link in variant link-time / post-build in variant post-build / pre-compile in variant pre-compile  # Value to match masked CAN IDs.
              integer MirrorSourceCanFilterCanIdMask: 0..4294967295, post-build-variant-value=true, set at link in variant link-time / post-build in variant post-build / pre-compile in variant pre-compile  # Mask applied to CAN IDs before comparison.
              integer MirrorSourceCanFilterId: 0..255, scope=ECU, post-build-variant-value=true, set at link in variant link-time / post-build in variant post-build / pre-compile in variant pre-compile, symbolic-name-value=true  # Unique identifier of the pre-configured CAN filter.
            container MirrorSourceCanFilterRange [0..1]: multiplicity set at link in variant link-time / post-build in variant post-build / pre-compile in variant pre-compile, post-build-variant-multiplicity=true  # Pre-configured range filter for CAN frames.
              integer MirrorSourceCanFilterId: 0..255, scope=ECU, post-build-variant-value=true, set at link in variant link-time / post-build in variant post-build / pre-compile in variant pre-compile, symbolic-name-value=true  # Unique identifier of the pre-configured CAN filter.
              integer MirrorSourceCanFilterLower: 0..4294967295, post-build-variant-value=true, set at link in variant link-time / post-build in variant post-build / pre-compile in variant pre-compile  # Lowest CAN ID that is accepted by the filter.
              integer MirrorSourceCanFilterUpper: 0..4294967295, post-build-variant-value=true, set at link in variant link-time / post-build in variant post-build / pre-compile in variant pre-compile  # Highest CAN ID that is accepted by the filter.
          container MirrorSourceCanMaskBasedIdMapping [0..*]: multiplicity set at link in variant link-time / post-build in variant post-build / pre-compile in variant pre-compile, post-build-variant-multiplicity=true  # Rule for remapping a set of CAN IDs.
            integer MirrorSourceCanMaskBasedIdMappingDestBaseId: 0..4294967295, post-build-variant-value=true, set at link in variant link-time / post-build in variant post-build / pre-compile in variant pre-compile  # Base ID merged with the masked parts of the original CAN ID to form the mapped CAN ID.
            integer MirrorSourceCanMaskBasedIdMappingSourceCanIdCode: 0..4294967295, post-build-variant-value=true, set at link in variant link-time / post-build in variant post-build / pre-compile in variant pre-compile  # Value to match masked original CAN IDs.
            integer MirrorSourceCanMaskBasedIdMappingSourceCanIdMask: 0..4294967295, post-build-variant-value=true, set at link in variant link-time / post-build in variant post-build / pre-compile in variant pre-compile  # Mask applied to original CAN IDs before comparison.
          container MirrorSourceCanSingleIdMapping [0..*]: multiplicity set at link in variant link-time / post-build in variant post-build / pre-compile in variant pre-compile, post-build-variant-multiplicity=true  # Rule for remapping a single CAN ID.
            integer MirrorSourceCanSingleIdMappingDestCanId: 0..4294967295, post-build-variant-value=true, set at link in variant link-time / post-build in variant post-build / pre-compile in variant pre-compile  # Mapped CAN ID.
            integer MirrorSourceCanSingleIdMappingSourceCanId: 0..4294967295, post-build-variant-value=true, set at link in variant link-time / post-build in variant post-build / pre-compile in variant pre-compile  # Original CAN ID.
        container MirrorSourceNetworkFlexRay [0..1]: multiplicity set at link in variant link-time / post-build in variant post-build / pre-compile in variant pre-compile, post-build-variant-multiplicity=true  # Source bus representing a FlexRay network.
          integer MirrorNetworkId: 0..255, scope=ECU, post-build-variant-value=true, set at link in variant link-time / post-build in variant post-build / pre-compile in variant pre-compile, symbolic-name-value=true  # Network ID of the bus.
          integer MirrorSourceMaxDynamicFilters: 0..255, set at link in variant link-time+post-build / pre-compile in variant pre-compile, default-value=5  # Maximum number of filters that can be dynamically added using Mirror_AddXxxFilter().
          reference MirrorComMNetworkHandleRef: set at link in variant link-time / post-build in variant post-build / pre-compile in variant pre-compile, requires-symbolic-name-value=true, destination=ComMChannel  # Reference to the ComMChannel that represents the bus.
          container MirrorSourceFlexRayFilter [0..255]: multiplicity set at link in variant link-time / post-build in variant post-build / pre-compile in variant pre-compile, post-build-variant-multiplicity=true  # Pre-configured filter for FlexRay frames.
            enumeration MirrorSourceFlexRayFilterChannelAssignment: {MIRROR_FR_CHANNEL_A, MIRROR_FR_CHANNEL_AB, MIRROR_FR_CHANNEL_B}, post-build-variant-value=true, set at link in variant link-time / post-build in variant post-build / pre-compile in variant pre-compile  # FlexRay channels accepted by the filter.
            integer MirrorSourceFlexRayFilterCycleRepetition: 1..64, post-build-variant-value=true, set at link in variant link-time / post-build in variant post-build / pre-compile in variant pre-compile  # Cycle repetition of accepted cycles.
            integer MirrorSourceFlexRayFilterId: 0..255, scope=ECU, post-build-variant-value=true, set at link in variant link-time / post-build in variant post-build / pre-compile in variant pre-compile, symbolic-name-value=true  # Unique identifier of the pre-configured FlexRay filter.
            integer MirrorSourceFlexRayFilterLowerBaseCycle: 0..63, post-build-variant-value=true, set at link in variant link-time / post-build in variant post-build / pre-compile in variant pre-compile  # Lowest base cycle number that is accepted by the filter.
            integer MirrorSourceFlexRayFilterLowerSlot: 1..2047, post-build-variant-value=true, set at link in variant link-time / post-build in variant post-build / pre-compile in variant pre-compile  # Lowest slot ID that is accepted by the filter.
            integer MirrorSourceFlexRayFilterUpperBaseCycle: 0..63, post-build-variant-value=true, set at link in variant link-time / post-build in variant post-build / pre-compile in variant pre-compile  # Highest base cycle number that is accepted by the filter.
            integer MirrorSourceFlexRayFilterUpperSlot: 1..2047, post-build-variant-value=true, set at link in variant link-time / post-build in variant post-build / pre-compile in variant pre-compile  # Highest slot ID that is accepted by the filter.
        container MirrorSourceNetworkLin [0..1]: multiplicity set at link in variant link-time / post-build in variant post-build / pre-compile in variant pre-compile, post-build-variant-multiplicity=true  # Source bus representing a LIN network.
          integer MirrorNetworkId: 0..255, scope=ECU, post-build-variant-value=true, set at link in variant link-time / post-build in variant post-build / pre-compile in variant pre-compile, symbolic-name-value=true  # Network ID of the bus.
          integer MirrorSourceLinToCanBaseId: 0..4294967295, post-build-variant-value=true, set at link in variant link-time / post-build in variant post-build / pre-compile in variant pre-compile  # Base ID merged with the LIN frame ID to form the CAN ID.
          integer MirrorSourceMaxDynamicFilters: 0..255, set at link in variant link-time+post-build / pre-compile in variant pre-compile, default-value=5  # Maximum number of filters that can be dynamically added using Mirror_AddXxxFilter().
          reference MirrorComMNetworkHandleRef: set at link in variant link-time / post-build in variant post-build / pre-compile in variant pre-compile, requires-symbolic-name-value=true, destination=ComMChannel  # Reference to the ComMChannel that represents the bus.
          choice container MirrorSourceLinFilter [0..255]: multiplicity set at link in variant link-time / post-build in variant post-build / pre-compile in variant pre-compile, post-build-variant-multiplicity=true  # Pre-configured filter for LIN frames.
            container MirrorSourceLinFilterMask [0..1]: multiplicity set at link in variant link-time / post-build in variant post-build / pre-compile in variant pre-compile, post-build-variant-multiplicity=true  # Pre-configured mask based filter for LIN frames.
              integer MirrorSourceLinFilterId: 0..255, scope=ECU, post-build-variant-value=true, set at link in variant link-time / post-build in variant post-build / pre-compile in variant pre-compile, symbolic-name-value=true  # Unique identifier of the pre-configured LIN filter.
              integer MirrorSourceLinFilterLinIdCode: 0..63, post-build-variant-value=true, set at link in variant link-time / post-build in variant post-build / pre-compile in variant pre-compile  # Value to match masked frame IDs.
              integer MirrorSourceLinFilterLinIdMask: 0..63, post-build-variant-value=true, set at link in variant link-time / post-build in variant post-build / pre-compile in variant pre-compile  # Mask applied to frame IDs before comparison.
            container MirrorSourceLinFilterRange [0..1]: multiplicity set at link in variant link-time / post-build in variant post-build / pre-compile in variant pre-compile, post-build-variant-multiplicity=true  # Pre-configured range filter for LIN frames.
              integer MirrorSourceLinFilterId: 0..255, scope=ECU, post-build-variant-value=true, set at link in variant link-time / post-build in variant post-build / pre-compile in variant pre-compile, symbolic-name-value=true  # Unique identifier of the pre-configured LIN filter.
              integer MirrorSourceLinFilterLower: 0..63, post-build-variant-value=true, set at link in variant link-time / post-build in variant post-build / pre-compile in variant pre-compile  # Lowest frame ID that is accepted by the filter.
              integer MirrorSourceLinFilterUpper: 0..63, post-build-variant-value=true, set at link in variant link-time / post-build in variant post-build / pre-compile in variant pre-compile  # Highest frame ID that is accepted by the filter.
          container MirrorSourceLinToCanIdMapping [0..*]: multiplicity set at link in variant link-time / post-build in variant post-build / pre-compile in variant pre-compile, post-build-variant-multiplicity=true  # Rule for mapping a LIN frame ID to a special CAN ID.
            integer MirrorSourceLinToCanIdMappingCanId: 0..4294967295, post-build-variant-value=true, set at link in variant link-time / post-build in variant post-build / pre-compile in variant pre-compile  # CAN ID which lies outside of the range mapping.
            integer MirrorSourceLinToCanIdMappingLinId: 0..63, post-build-variant-value=true, set at link in variant link-time / post-build in variant post-build / pre-compile in variant pre-compile  # Frame ID which is excluded from the range mapping.
    container MirrorGeneral  # Contains the general configuration parameters of the module.
      boolean MirrorDevErrorDetect: set at pre-compile, default-value=false  # Switches the development error detection and notification on or off. | * true: detection and notification is enabled. * false: detection and notification is disabled.
      boolean MirrorVersionInfoApi: set at pre-compile, default-value=false  # Pre-processor switch for enabling version info API support.
      reference MirrorEcucPartitionRef [0..1]: multiplicity set at pre-compile, set at pre-compile, destination=EcucPartition  # Reference to EcucPartition, where BusMirroring module is assigned to.
      reference MirrorStbRef [0..1]: set at pre-compile, requires-symbolic-name-value=true, destination=StbMSynchronizedTimeBase  # Reference to the StbM time base to use for acquiring the time stamps used in the mirroring protocol. | This reference is not required if all destination buses are CAN.
      container MirrorMainFunction [1..*]: multiplicity set at pre-compile  # Each element of this container defines one instance of Mirror_MainFunction.
        float MirrorMainFunctionPeriod: 0..INF, set at pre-compile, default-value=0.05  # Execution cycle of the respective Mirror_MainFunction instance in seconds.
        reference MirrorMainPartitionRef: set at pre-compile, destination=EcucPartition  # Reference to EcucPartition, where the according Mirror_MainFunction instance is assigned to.
