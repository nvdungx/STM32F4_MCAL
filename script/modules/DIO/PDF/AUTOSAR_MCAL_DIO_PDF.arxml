AUTOSAR XML (schema 00046)
package /AUTOSAR/EcucDefs
  ecuc definition collection AUTOSARParameterDefinition: module=Dio
  module definition Dio [0..1]: variants link-time/pre-compile  # Configuration of the Dio (Digital IO) module.
    container DioConfig  # This container contains the configuration parameters and sub containers of the AUTOSAR DIO module.
      container DioPort [1..*]  # Configuration of individual DIO ports, consisting of channels and possible channel groups. | Note that this container definition does not explicitly define a symbolic name parameter. Instead, the container's short name will be used in the Ecu Configuration Description to specify the symbolic name of the port.
        integer DioPortId: 0..4294967295, scope=ECU, set at pre-compile, symbolic-name-value=true  # Numeric identifier of the DIO port. Not all MCU ports may be used for DIO, thus there may be "gaps" in the list of all IDs. This value will be | assigned to the DIO port symbolic name (i.e. the SHORT-NAME of the DioPort container).
        reference DioPortEcucPartitionRef [0..*]: scope=ECU, multiplicity set at pre-compile, set at pre-compile, destination=EcucPartition  # Maps the DIO ports to zero or multiple ECUC partitions. The ECUC partitions referenced are a subset of the ECUC partitions where the DIO driver is mapped to. Tags: atp.Status=draft
        container DioChannel [0..*]  # Configuration of an individual DIO channel.
          integer DioChannelId: 0..4294967295, scope=ECU, set at pre-compile, symbolic-name-value=true  # Channel Id of the DIO channel. This value will be assigned to the symbolic names.
          reference DioChannelEcucPartitionRef [0..*]: scope=ECU, multiplicity set at pre-compile, set at pre-compile, destination=EcucPartition  # Maps a DIO channel to zero or multiple ECUC partitions. The ECUC partitions referenced are a subset of the ECUC partitions where the related DIO port is mapped to. Tags: atp.Status=draft
        container DioChannelGroup [0..*]  # Definition and configuration of DIO channel groups. A channel group represents several adjoining DIO channels represented by a logical group. | Note that this container definition does not explicitly define a symbolic name parameter. Instead, the container's short name will be used in the Ecu Configuration Description to specify the symbolic name of the channel group.
          string DioChannelGroupIdentification: scope=ECU, set at pre-compile, symbolic-name-value=true  # The DIO channel group is identified in DIO API by a pointer to a data structure (of type Dio_ChannelGroupType). That data structure contains the channel group information. | This parameter contains the code fragment that has to be inserted in the API call of the calling module to get the address of the variable in memory which holds the channel group information. Example values are "&MyDioGroup1" or "&MyDioGroupArray[0]"
          integer DioPortMask: 0..4294967295, set at link in variant link-time / pre-compile in variant pre-compile  # This shall be the mask which defines the positions of the channel | group. The channels shall consist of adjoining bits in the same port. The data type depends on the port width.
          integer DioPortOffset: 0..31, set at link in variant link-time / pre-compile in variant pre-compile  # The position of the Channel Group on the port, counted | from the LSB. This value can be derived from DioPortMask. calculationFormula = Position of the first bit of DioPortMask which is set to '1' counted from LSB
          reference DioChannelGroupEcucPartitionRef [0..*]: scope=ECU, multiplicity set at pre-compile, set at pre-compile, destination=EcucPartition  # Maps a DIO channel group to zero or multiple ECUC partitions. The ECUC partitions referenced are a subset of the ECUC partitions where the related DIO port is mapped to. Tags: atp.Status=draft
    container DioGeneral  # General DIO module configuration parameters.
      boolean DioDevErrorDetect: set at pre-compile, default-value=false  # Switches the development error detection and notification on or off. | * true: detection and notification is enabled. * false: detection and notification is disabled.
      boolean DioFlipChannelApi: set at pre-compile  # Adds / removes the service Dio_FlipChannel() from the code.
      boolean DioMaskedWritePortApi: set at pre-compile, default-value=false  # Adds / removes the service Dio_MaskedWritePort() from the code.
      boolean DioVersionInfoApi: set at pre-compile, default-value=false  # Adds / removes the service Dio_ GetVersionInfo() from the code.
      reference DioEcucPartitionRef [0..*]: scope=ECU, multiplicity set at pre-compile, set at pre-compile, destination=EcucPartition  # Maps the DIO driver to zero or multiple ECUC partitions to make the modules API available in this partition. Tags: atp.Status=draft
