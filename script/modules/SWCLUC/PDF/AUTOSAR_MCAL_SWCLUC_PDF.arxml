AUTOSAR XML (schema 00053)
package /AUTOSAR/EcucDefs
  ecuc definition collection AUTOSARParameterDefinition: module=SwCluC
  module definition SwCluC [0..1]: post-build-variant-support=true, variants post-build/pre-compile  # Module to collect Software Cluster Connection specific configuration information.
    container SwCluCBManif [0..1]  # Configuration of the Binary Manifest of the Software Cluster Connection
      integer SwCluCBManifImmutableTablesChecksum: 0..4294967295, scope=ECU, multiplicity set at pre-compile, set at pre-compile  # This parameter defines the initialization value of the Immutable Tables Checksum. | If the Binary Manifest code generator already calculates the checksum, the value can be stored here (withAuto == true).
      integer SwCluCBManifSubscribedInterfaceValidityMarker: 0..4294967295, scope=ECU, multiplicity set at pre-compile, set at pre-compile  # This parameter defines the initialization value of the Subscribed Interface Validity Marker. The init value should be set to the erased value of the flash memory.
      container SwCluCBManifProvideResourceEntryGroup [0..*]  # Describes a group of provided resources in the Binary Manifest. | The belonging handles are put into the Binary Manifest's tables into an consecutive order which supports an array based access.
        string SwCluCBManifHeaderInclude [0..*]: multiplicity set at pre-compile, set at pre-compile  # Defines the header file(s) where the owner of the SwCluCBManifProvideResourceEntryGroup / SwCluCBManifRequireResourceEntryGroup has the declarations of the symbols for the handle initialization.
        enumeration SwCluCBManifMultipleNotifierSupport: {MULTIPLE_NOTIFIER_SETS, SINGLE_NOTIFIER_SET}, multiplicity set at pre-compile, set at pre-compile, default-value=SINGLE_NOTIFIER_SET  # SwCluCBManifMultipleNotifierSupport defines whether multiple Software Cluster can register on the notifier handles. | For each possible connection a set of notifier handles is allocated.
        reference SwCluCBManifResourceTypeRef: destination=SwCluCBManifResourceType  # Defines the resource type for all SwCluCBManifProvideResourceEntry / SwCluCBManifRequireResourceEntry
        container SwCluCBManifProvideResourceEntry [0..*]  # Describes a single entry for a provided resource in the Binary Manifest.
          string SwCluCBManifDefaultNotifierSymbol [0..*]: requires-index=true  # SwCluCBManifDefaultNotifierSymbol set the default value of a Notifier Handle put into the Modifiable Interface. | The number and order of SwCluCBManifDefaultNotifierSymbol needs to match the number and order of SwCluCBManifNotifierHandle in the referenced SwCluCBManifResourceType. The parameter is defined as string in order to support the usage of symbols as initialize. Values have to be set as string in a C supported number format, e.g. 0xC001CAFE. In case the provide handle holds a pointer the address operator is part of the string, e.g. &myExampleFunction
          integer SwCluCBManifMaxNumberOfNotifierSets [0..1]: 0..255, multiplicity set at pre-compile, set at pre-compile  # SwCluCBManifMaxNumberOfNotifierSets defines the maximum number of possible required resources using notifier handles. | It is required in case SwCluCBManifMultipleNotifierSupport is set to MULTIPLE_NOTIFIER_SETS.
          string SwCluCBManifProvideSymbol [0..*]: requires-index=true  # SwCluCBManifProvideSymbol set the value of a Provide Handle put into the Immutable Interface. | The number and order of SwCluCBManifProvideSymbols needs to match the number and order of SwCluCBManifProvideHandle in the referenced SwCluCBManifResourceType. The parameter is defined as string in order to support the usage of symbols as initialize. Values have to be set as string in a C supported number format, e.g. 0xC001CAFE. In case the provide handle holds a pointer the address operator is part of the string, e.g. &myExampleFunction
          integer SwCluCBManifResourceGuardValue: 0..4294967295  # SwCluCBManifResourceGuardValue provides guarding information checked by the Software Cluster connector. A provided resources and required resources of Software Clusters can only be connected, if the resource guarding values of provider and requester are equal.
          foreign reference SwCluCBManifResourceRef [0..1]: destination-type=CP-SOFTWARE-CLUSTER-RESOURCE  # Reference to the CpSoftwareClusterResource determining the global resource Id. If the reference is not set, the global resource Id in the Binary Manifest will be set to 0 for this resource entry in order to indicate an invalid resource.
      container SwCluCBManifRequireResourceEntryGroup [0..*]  # Describes a group of required resources in the Binary Manifest. | The belonging handles are put into the Binary Manifest's tables into an consecutive order which supports an array based access.
        string SwCluCBManifHeaderInclude [0..*]: multiplicity set at pre-compile, set at pre-compile  # Defines the header file(s) where the owner of the SwCluCBManifProvideResourceEntryGroup / SwCluCBManifRequireResourceEntryGroup has the declarations of the symbols for the handle initialization.
        reference SwCluCBManifResourceTypeRef: destination=SwCluCBManifResourceType  # Defines the resource type for all SwCluCBManifProvideResourceEntry / SwCluCBManifRequireResourceEntry
        container SwCluCBManifRequireResourceEntry [1..*]  # Describes a single entry for a required resource in the Binary Manifest.
          string SwCluCBManifDefaultProvideSymbol [0..*]: requires-index=true  # SwCluCBManifDefaultProvideSymbol set the default value of a Provide Handle put into the Modifiable Interface. | The number and order of SwCluCBManifDefaultProvideSymbols needs to match the number and order of SwclCBManifProvideHandles in the referenced SwCluCBManifResourceType. The parameter is defined as string in order to support the usage of symbols as initialize. Values have to be set as string in a C supported number format, e.g. 0xC001CAFE. In case the provide handle holds a pointer the address operator is part of the string, e.g. &myExampleFunction
          boolean SwCluCBManifIsMandatory  # SwCluCBManifIsMandatoryindicates, that the resource is mandatory to operate this Software Cluster. | If the resource is not provided on the machine the connection process for this Software Cluster requiring this resource gets aborted.
          string SwCluCBManifNotifierSymbol [0..*]: requires-index=true  # SwCluCBManifNotifierSymbol set the value of a Notifier Handle put into the Immutable Interface. | The number and order of SwCluCBManifNotifierSymbol needs to match the number and order of SwclCBManifNotifierHandles in the referenced SwCluCBManifResourceType. The parameter is defined as string in order to support the usage of symbols as initialize. Values have to be set as string in a C supported number format, e.g. 0xC001CAFE. In case the provide handle holds a pointer the address operator is part of the string, e.g. &myExampleFunction
          integer SwCluCBManifResourceGuardValue: 0..4294967295  # SwCluCBManifResourceGuardValue provides guarding information checked by the Software Cluster connector. A provided resources and required resources of Software Clusters can only be connected, if the resource guarding values of provider and requester are equal.
          foreign reference SwCluCBManifResourceRef [0..1]: destination-type=CP-SOFTWARE-CLUSTER-RESOURCE  # Reference to the CpSoftwareClusterResource determining the global resource Id. If the reference is not set, the global resource Id in the Binary Manifest will be set to 0 for this resource entry in order to indicate an invalid resource.
      container SwCluCBManifResourceType [0..*]: multiplicity set at pre-compile  # This container defines the structure of a resource type in the Binary Manifest.
        integer SwCluCBManifResourceId: 0..255, scope=ECU, multiplicity set at pre-compile, set at pre-compile  # Unique number of the resource type.
        container SwCluCBManifNotifierHandle [0..*]: requires-index=true  # Defines a Notifier Handle and its properties for this resource type.
          boolean SwCluCBManifIsOptional: set at pre-compile, default-value=false  # Indicates that this handle is optional and may not always exist for each Provide Resource Entry or Require Resource Entry.
          enumeration SwCluCBManifNativeHandleType: {DATA_REFERENCE, FUNCTION_REFERENCE, VALUE}, multiplicity set at pre-compile, set at pre-compile, default-value=DATA_REFERENCE  # This paramter determines the unterlying native type of the handle which can be | * pointer to variable * value * pointer to function This information is required to correctly initialize the handle in the Immutable Interface or Modifiable Interface.
          foreign reference SwCluCBManifHandleImpleTypeRef [0..1]: set at pre-compile, destination-type=IMPLEMENTATION-DATA-TYPE  # Reference to the ImplementationDataType of the handle. | This type can be additionally configured to get a correct casting of the native handle type to the returned handel type.
        container SwCluCBManifProvideHandle [0..*]: requires-index=true  # Defines a Provide Handle and its properties for this resource type.
          boolean SwCluCBManifIsOptional: set at pre-compile, default-value=false  # Indicates that this handle is optional and may not always exist for each Provide Resource Entry or Require Resource Entry.
          enumeration SwCluCBManifNativeHandleType: {DATA_REFERENCE, FUNCTION_REFERENCE, VALUE}, multiplicity set at pre-compile, set at pre-compile, default-value=DATA_REFERENCE  # This paramter determines the unterlying native type of the handle which can be | * pointer to variable * value * pointer to function This information is required to correctly initialize the handle in the Immutable Interface or Modifiable Interface.
          foreign reference SwCluCBManifHandleImpleTypeRef [0..1]: set at pre-compile, destination-type=IMPLEMENTATION-DATA-TYPE  # Reference to the ImplementationDataType of the handle. | This type can be additionally configured to get a correct casting of the native handle type to the returned handel type.
    container SwCluCBaseConfigurationCheck [0..*]: multiplicity set at pre-compile  # Configuration of the base configuration check of Software Cluster Connection. | This configuration places a mandatory entry in the Binary Manifest where the guard value is used to proof if the general setup of the Application Software Cluster is compatible to the general setup of the Host Software Cluster. For each Application Software Cluster an individual base configuration check should be defined.
      multiline string SwCluCAutoBaseConfigDescriptor [0..*]: scope=ECU, multiplicity set at pre-compile, set at pre-compile  # A machine determined string which represent the basic configuration assumption. | Multiple SwCluCAutoBaseConfigDescriptor values can be added to support that different tools contribute to the checksum. For instance Software Cluster Connection Tool, Compiler, Link, or Locate tooling. isAuto shall be set to true since tool chain adds its collected values automatically.
      multiline string SwCluCUserBaseConfigDescriptor [0..1]: scope=ECU, multiplicity set at pre-compile, set at pre-compile  # A user determined string which represent the basic configuration assumption.
      foreign reference SwCluCResourceRef: scope=ECU, destination-type=CP-SOFTWARE-CLUSTER-SERVICE-RESOURCE  # Reference to the CpSoftwareClusterServiceResource.
    container SwCluCDefinitionSet  # Definition of a set of Software Clusters
      container SwCluCDefinition [1..*]: multiplicity set at pre-compile  # Definition of the general properties of the Software Cluster. | The defintions are separated in a set of defintions in order to enable an holistic view about all exsiting Software Cluster Definitions.
        enumeration SwCluCBManifDescriptorTreatment: {EMBED_DESCRIPTORS, OMIT_DESCRIPTORS}, scope=ECU, multiplicity set at pre-compile, set at pre-compile, default-value=EMBED_DESCRIPTORS  # Configures the existence of the Interface Descriptor Table in the Binary Object of the Software Cluster.
        enumeration SwCluCBManifOnBoardConnectorControl [0..1]: {DISABLE_ON_ECU_CONNECTOR, ENABLE_ON_ECU_CONNECTOR}, scope=ECU, multiplicity set at pre-compile, set at pre-compile, default-value=ENABLE_ON_ECU_CONNECTOR  # SwCluCBManifOnBoardConnectorControl enables or disables the onECU execution of the Software Cluster Connector. | This setting is only applicable for the Host Software Cluster.
        integer SwCluCMachineId: 0..254, scope=ECU, multiplicity set at pre-compile, set at pre-compile  # Unique number of the (virtual or physical) machine to which the Software Cluster belongs.
        integer SwCluCSoftwareClusterId: 0..239, scope=ECU, multiplicity set at pre-compile, set at pre-compile  # Unique number of the Software Cluster | Numbers >= 0xFE are reserved to indicate special values or the unconnected state.
        enumeration SwCluCSoftwareClusterType: {APPLICATION_SW_CLUSTER, HOST_SW_CLUSTER, SUBSTITUTION_SW_CLUSTER}, scope=ECU, multiplicity set at pre-compile, set at pre-compile, default-value=APPLICATION_SW_CLUSTER  # The type of the Software Cluster
        foreign reference SwCluCSoftwareClusterRef [0..1]: scope=ECU, multiplicity set at pre-compile, set at pre-compile, destination-type=CP-SOFTWARE-CLUSTER  # Reference to the CpSoftwareCluster to define the link to the Software Cluster description in the System.
    container SwCluCGeneral: multiplicity set at pre-compile  # General configuration of the Software Cluster Connection
      reference SwCluCDefinitionSelection: multiplicity set at pre-compile, set at pre-compile, destination=SwCluCDefinition  # This reference selects the Software Cluster Definition which is applied for this Software Cluster.
    container SwCluCProxies: multiplicity set at pre-compile  # General configuration of the Proxy Modules of Software Cluster Connection
      enumeration SwCluCProxyGenerationCom: {HIGH_PROXY, LOW_PROXY, PROXY_DISABLED}, scope=ECU, multiplicity set at pre-compile, set at pre-compile  # Defines whether the Com Proxy code and models are generated.
      enumeration SwCluCProxyGenerationDcm: {HIGH_PROXY, LOW_PROXY, PROXY_DISABLED}, scope=ECU, multiplicity set at pre-compile, set at pre-compile  # Defines whether the Dcm Proxy code and models are generated.
      enumeration SwCluCProxyGenerationDem: {HIGH_PROXY, LOW_PROXY, PROXY_DISABLED}, scope=ECU, multiplicity set at pre-compile, set at pre-compile  # Defines whether the Dem Proxy code and models are generated.
      enumeration SwCluCProxyGenerationFiM: {HIGH_PROXY, LOW_PROXY, PROXY_DISABLED}, scope=ECU, multiplicity set at pre-compile, set at pre-compile  # Defines whether the FiM Proxy code and models are generated.
      enumeration SwCluCProxyGenerationLdCom: {HIGH_PROXY, LOW_PROXY, PROXY_DISABLED}, scope=ECU, multiplicity set at pre-compile, set at pre-compile  # Defines whether the LdCom Proxy code and models are generated.
      enumeration SwCluCProxyGenerationNvM: {HIGH_PROXY, LOW_PROXY, PROXY_DISABLED}, scope=ECU, multiplicity set at pre-compile, set at pre-compile  # Defines whether the NvM Proxy code and models are generated.
      enumeration SwCluCProxyGenerationOs: {HIGH_PROXY, LOW_PROXY, PROXY_DISABLED}, scope=ECU, multiplicity set at pre-compile, set at pre-compile  # Defines whether the Os Proxy code and models are generated.
      container SwCluCComProxy [0..1]: multiplicity set at pre-compile  # LdCom Proxy specific parameters.
        boolean SwCluCComProxyDevErrorDetect: set at pre-compile, default-value=false  # Switches the development error detection and notification on or off. | * true: detection and notification is enabled. * false: detection and notification is disabled.
        container SwCluCComProxyBaseSocket [1..*]: multiplicity set at pre-compile  # This container configures how many EcucPartitions specific API links are required for the Com Proxy and to which cluster resource the API set belongs. | In the Com Low Proxy all offered API sets (incl callbacks) needs to be configured. In the Com High Proxy only the ones are configured which are offered inside this Application Software Cluster. The reference SwCluCProxyEcucPartitionRef denotes the EcucPartition on which the API set is provided. The ComUserModuleCnf is only applicable in the Host Software Cluster and shall not be configured in the scope of a Application Software Cluster. One ComUserModuleCnf instance can either server for ComSignals and ComSignalGroups on multiple EcucPartitions or exactly one EcucPartition. How many ComUser instances an Rte in an related Application Software Cluster requires is vendor specific.
          boolean SwCluCNativeBswApi [0..1]: scope=ECU, multiplicity set at pre-compile, set at pre-compile, default-value=false  # Defines if the native C-API without pre or suffixes is offered in the Application Software Cluster on this EcucPartition.
          reference SwCluCComProxyUsedSatelliteRef [0..1]: scope=ECU, multiplicity set at pre-compile, set at pre-compile, destination=SwCluCComProxyBaseSocket  # Reference to the SwCluCComBaseSocket which has access to a satellite of the Com. The owning SwCluCComBaseSocket uses the Com satellite of the referenced SwCluCComBaseSocket.
          reference SwCluCProxyEcucPartitionRef [1..*]: scope=ECU, multiplicity set at pre-compile, set at pre-compile, destination=EcucPartition  # Reference to the EcucPartition.
          foreign reference SwCluCResourceRef: scope=ECU, destination-type=CP-SOFTWARE-CLUSTER-SERVICE-RESOURCE  # Reference to the CpSoftwareClusterServiceResource.
          container ComUserModuleCnf [0..1]: destination-uri=ComUser, multiplicity set at pre-compile  # Contains the configuration parameters of the Com user module.
            string ComUserHeaderInclude [0..1]: set at pre-compile  # Defines the header file where the Com user provides the function declarations for configured callbacks.
            container ComUserCallback [0..*]: multiplicity set at link in variant post-build / pre-compile in variant pre-compile, post-build-variant-multiplicity=true  # This container defines a Com callback function for signals and signal groups.
              function name ComUserCallbackName: scope=ECU, multiplicity set at link in variant post-build / pre-compile in variant pre-compile, set at link in variant post-build / pre-compile in variant pre-compile  # The name of the callback function to be called.
              enumeration ComUserCallbackType: {COM_RX_ACK, COM_RX_INV, COM_RX_TOUT, COM_TX_ACK, COM_TX_ERR, COM_TX_TOUT}, scope=ECU, multiplicity set at link in variant post-build / pre-compile in variant pre-compile, set at link in variant post-build / pre-compile in variant pre-compile  # The type of the Com callback
            container ComUserSignal [0..*]: multiplicity set at post-build in variant post-build / pre-compile in variant pre-compile, post-build-variant-multiplicity=true  # Contains the configuration parameters of a signal inside a Com user module. | Please note that it is valid to define ComUserSignal without any callback function.
              integer ComUserCbkHandleId [0..1]: 0..65535, scope=ECU, multiplicity set at pre-compile, set at pre-compile, symbolic-name-value=true  # The numerical value used as the Com user callback handle Id. | This ID identifies signals and signal groups in the COM callbacks using ComUserCbkHandleId parameter respectively.
              reference ComUserCallbackRef [0..*]: scope=ECU, multiplicity set at post-build in variant post-build / pre-compile in variant pre-compile, post-build-variant-multiplicity=true, post-build-variant-value=true, set at link in variant post-build / pre-compile in variant pre-compile, destination=ComUserCallback  # Reference(s) to all callback(s) of this signal or signal group.
              foreign reference ComUserSystemTemplateSystemSignalRef [0..1]: scope=ECU, multiplicity set at post-build in variant post-build / pre-compile in variant pre-compile, post-build-variant-multiplicity=true, post-build-variant-value=true, set at post-build in variant post-build / pre-compile in variant pre-compile, destination-type=I-SIGNAL-TO-I-PDU-MAPPING  # Reference to the ISignalToIPduMapping that contains a reference to the ISignal (System Template) which this ComUserSignal (or ComUserGroupSignal) represents.
            container ComUserSignalGroup [0..*]: multiplicity set at post-build in variant post-build / pre-compile in variant pre-compile, post-build-variant-multiplicity=true  # Contains the configuration parameters of a signal group inside a Com user module. | Please note that it is valid to define ComUserSignalGroup without any callback function.
              integer ComUserCbkHandleId [0..1]: 0..65535, scope=ECU, multiplicity set at pre-compile, set at pre-compile, symbolic-name-value=true  # The numerical value used as the Com user callback handle Id. | This ID identifies signals and signal groups in the COM callbacks using ComUserCbkHandleId parameter respectively.
              reference ComUserCallbackRef [0..*]: scope=ECU, multiplicity set at post-build in variant post-build / pre-compile in variant pre-compile, post-build-variant-multiplicity=true, post-build-variant-value=true, set at link in variant post-build / pre-compile in variant pre-compile, destination=ComUserCallback  # Reference(s) to all callback(s) of this signal or signal group.
              foreign reference ComUserSystemTemplateSignalGroupRef [0..1]: scope=ECU, multiplicity set at post-build in variant post-build / pre-compile in variant pre-compile, post-build-variant-multiplicity=true, post-build-variant-value=true, set at post-build in variant post-build / pre-compile in variant pre-compile, destination-type=I-SIGNAL-TO-I-PDU-MAPPING  # Reference to the ISignalToIPduMapping that contains a reference to the ISignalGroup (SystemTemplate) which this ComUserSignalGroup represents.
      container SwCluCDcmProxy [0..1]: multiplicity set at pre-compile  # Dcm Proxy specific parameters.
        boolean SwCluCDcmProxyDevErrorDetect: set at pre-compile, default-value=false  # Switches the development error detection and notification on or off. | * true: detection and notification is enabled. * false: detection and notification is disabled.
        container SwCluCDcmProxyBaseSocket [1..*]: multiplicity set at pre-compile  # This container configures how many EcucPartitions specific API links are required for the Dcm Proxy and to which cluster resource the API set belongs. | In the Dcm Low Proxy all offered API sets needs to be configured. In the Dcm High Proxy only the ones are configured which are offered inside this Application Software Cluster. The reference SwCluCProxyEcucPartitionRef denotes the EcucPartition on which the API set is provided.
          boolean SwCluCNativeBswApi [0..1]: scope=ECU, multiplicity set at pre-compile, set at pre-compile, default-value=false  # Defines if the native C-API without pre or suffixes is offered in the Application Software Cluster on this EcucPartition.
          reference SwCluCDcmProxyUsedSatelliteRef [0..1]: scope=ECU, multiplicity set at pre-compile, set at pre-compile, destination=SwCluCDcmProxyBaseSocket  # Reference to the SwCluCDemBaseSocket which has access to a satellite of the Dcm. The owning SwCluCDemBaseSocket uses the Dcm satellite of the referenced SwCluCDemBaseSocket.
          reference SwCluCProxyEcucPartitionRef: scope=ECU, multiplicity set at pre-compile, set at pre-compile, destination=EcucPartition  # Reference to the EcucPartition.
          foreign reference SwCluCResourceRef: scope=ECU, destination-type=CP-SOFTWARE-CLUSTER-SERVICE-RESOURCE  # Reference to the CpSoftwareClusterServiceResource.
        container SwCluCDcmProxyDiagnosticData [0..*]: multiplicity set at pre-compile  # Configures a Diagnostic Data proxy for a DID or PID or IOControl.
          choice reference SwCluCDcmProxyDataRef [0..*]: scope=ECU, destination=[DcmDspData, DcmDspDid, DcmDspPidService01, DemDataElementClass]  # Reference to the diagnostic data of Dcm which can either be a DcmDspData, or a DcmDspPidService01, or a DcmDspDid. | The DcmDspDid reference is only applicable in the Application Software Cluster if the DID has exactly one Diagnostic Data Element requiring the DID based interface. The reference is mandatory in the Application Software Cluster and can be used in the Host Software Cluster to identify the related diagnostic data in the Dcm configuration.
          foreign reference SwCluCDextDiagnosticDataElementRef [0..1]: scope=ECU, destination-type=DIAGNOSTIC-DATA-ELEMENT  # Reference to the DiagnosticDataElement in DEXT for back-tracing in case of DEXT based configuration approaches
          reference SwCluCProxyEcucPartitionRef: scope=ECU, multiplicity set at pre-compile, set at pre-compile, destination=EcucPartition  # Reference to the EcucPartition.
          foreign reference SwCluCResourceRef: scope=ECU, destination-type=CP-SOFTWARE-CLUSTER-SERVICE-RESOURCE  # Reference to the CpSoftwareClusterServiceResource.
        container SwCluCDcmProxyRoutineControl [0..*]: multiplicity set at pre-compile  # Configures a Routine Control proxy.
          reference SwCluCDcmProxyRoutineRef [0..1]: scope=ECU, destination=DcmDspRoutine  # Reference to the routine configuration of Dcm. | The reference is mandatory in the Application Software Cluster and can be used in the Host Software Cluster to identify the related routine control in the Dcm configuration.
          foreign reference SwCluCDextRoutineSubfunctionRef [0..1]: scope=ECU, destination-type=DIAGNOSTIC-ROUTINE-SUBFUNCTION  # Reference to the Routine Subfunction in DEXT for back-tracing in case of DEXT based configuration approaches
          reference SwCluCProxyEcucPartitionRef: scope=ECU, multiplicity set at pre-compile, set at pre-compile, destination=EcucPartition  # Reference to the EcucPartition.
          foreign reference SwCluCResourceRef: scope=ECU, destination-type=CP-SOFTWARE-CLUSTER-SERVICE-RESOURCE  # Reference to the CpSoftwareClusterServiceResource.
        container SwCluCDcmProxyServiceRequestNotification [0..*]: multiplicity set at pre-compile  # Configures a Service Request Notification proxy.
          choice reference SwCluCDcmProxyNotificationRef [0..1]: scope=ECU, destination=[DcmDsdServiceRequestManufacturerNotification, DcmDsdServiceRequestSupplierNotification]  # Reference to the Service Request Notifcation configuration of Dcm which can either be a DcmDsdServiceRequestSupplierNotification or DcmDsdServiceRequestManufacturerNotification | The reference is mandatory in the Application Software Cluster and can be used in the Host Software Cluster to identify the related notification in the Dcm configuration.
          reference SwCluCProxyEcucPartitionRef: scope=ECU, multiplicity set at pre-compile, set at pre-compile, destination=EcucPartition  # Reference to the EcucPartition.
          foreign reference SwCluCResourceRef: scope=ECU, destination-type=CP-SOFTWARE-CLUSTER-SERVICE-RESOURCE  # Reference to the CpSoftwareClusterServiceResource.
      container SwCluCDemProxy [0..1]: multiplicity set at pre-compile  # DemProxy specific parameters.
        boolean SwCluCDemProxyDevErrorDetect: set at pre-compile, default-value=false  # Switches the development error detection and notification on or off. | * true: detection and notification is enabled. * false: detection and notification is disabled.
        container SwCluCDemProxyBaseSocket [1..*]: multiplicity set at pre-compile  # This container configures how many EcucPartitions specific API links are required for the Dem Proxy and to which cluster resource the API set belongs. | In the Dem Low Proxy all offered API sets needs to be configured. In the Dem High Proxy only the ones are configured which are offered inside this Application Software Cluster. The reference SwCluCProxyEcucPartitionRef denotes the EcucPartition on which the API set is provided.
          boolean SwCluCNativeBswApi [0..1]: scope=ECU, multiplicity set at pre-compile, set at pre-compile, default-value=false  # Defines if the native C-API without pre or suffixes is offered in the Application Software Cluster on this EcucPartition.
          reference SwCluCDemProxyUsedSatelliteRef [0..1]: scope=ECU, multiplicity set at pre-compile, set at pre-compile, destination=SwCluCDemProxyBaseSocket  # Reference to the SwCluCDemBaseSocket which has access to a satellite of the Dem. The owning SwCluCDemBaseSocket uses the Dem satellite of the referenced SwCluCDemBaseSocket.
          reference SwCluCProxyEcucPartitionRef: scope=ECU, multiplicity set at pre-compile, set at pre-compile, destination=EcucPartition  # Reference to the EcucPartition.
          foreign reference SwCluCResourceRef: scope=ECU, destination-type=CP-SOFTWARE-CLUSTER-SERVICE-RESOURCE  # Reference to the CpSoftwareClusterServiceResource.
        container SwCluCDemProxyDiagnosticEvent [0..*]: multiplicity set at pre-compile  # Configures a Diagnostic Event proxy.
          reference SwCluCDemProxyEventRef: scope=ECU, destination=DemEventParameter  # Reference to the diagnostic event of Dem
          foreign reference SwCluCDextDiagnosticEventRef [0..1]: scope=ECU, destination-type=DIAGNOSTIC-EVENT  # Reference to the Diagnostic Event in DEXT for back-tracing in case of DEXT based configuration approaches
          reference SwCluCProxyEcucPartitionRef: scope=ECU, multiplicity set at pre-compile, set at pre-compile, destination=EcucPartition  # Reference to the EcucPartition.
          foreign reference SwCluCResourceRef: scope=ECU, destination-type=CP-SOFTWARE-CLUSTER-SERVICE-RESOURCE  # Reference to the CpSoftwareClusterServiceResource.
      container SwCluCFiMProxy [0..1]: multiplicity set at pre-compile  # FiM Proxy specific parameters.
        boolean SwCluCFiMProxyDevErrorDetect: set at pre-compile, default-value=false  # Switches the development error detection and notification on or off. | * true: detection and notification is enabled. * false: detection and notification is disabled.
        container SwCluCFiMProxyBaseSocket [1..*]: multiplicity set at pre-compile  # This container configures how many EcucPartitions specific API links are required for the FiM Proxy and to which cluster resource the API set belongs. | In the FiM Low Proxy all offered API sets needs to be configured. In the FiM High Proxy only the ones are configured which are offered inside this Application Software Cluster. The reference SwCluCProxyEcucPartitionRef denotes the EcucPartition on which the API set is provided.
          boolean SwCluCNativeBswApi [0..1]: scope=ECU, multiplicity set at pre-compile, set at pre-compile, default-value=false  # Defines if the native C-API without pre or suffixes is offered in the Application Software Cluster on this EcucPartition.
          reference SwCluCFiMProxyUsedSatelliteRef [0..1]: scope=ECU, multiplicity set at pre-compile, set at pre-compile, destination=SwCluCFiMProxyBaseSocket  # Reference to the SwCluCFiMBaseSocket which has access to a satellite of the FiM. The owning SwCluCFiMBaseSocket uses the FiM satellite of the referenced SwCluCFiMBaseSocket.
          reference SwCluCProxyEcucPartitionRef: scope=ECU, multiplicity set at pre-compile, set at pre-compile, destination=EcucPartition  # Reference to the EcucPartition.
          foreign reference SwCluCResourceRef: scope=ECU, destination-type=CP-SOFTWARE-CLUSTER-SERVICE-RESOURCE  # Reference to the CpSoftwareClusterServiceResource.
        container SwCluCFiMProxyFID [0..*]: multiplicity set at pre-compile  # Configures a Function Inhibition proxy.
          foreign reference SwCluCDextDiagnosticFunctionIdentifierRef [0..1]: scope=ECU, destination-type=DIAGNOSTIC-FUNCTION-IDENTIFIER  # Reference to the DiagnosticFunctionIdentifier in DEXT for back-tracing in case of DEXT based configuration approaches
          reference SwCluCFiMProxyFIDRef: scope=ECU, destination=FiMFID  # Reference to the FIMFID
          reference SwCluCProxyEcucPartitionRef: scope=ECU, multiplicity set at pre-compile, set at pre-compile, destination=EcucPartition  # Reference to the EcucPartition.
          foreign reference SwCluCResourceRef: scope=ECU, destination-type=CP-SOFTWARE-CLUSTER-SERVICE-RESOURCE  # Reference to the CpSoftwareClusterServiceResource.
      container SwCluCLdComProxy [0..1]: multiplicity set at pre-compile  # LdCom Proxy specific parameters.
        boolean SwCluCLdComProxyDevErrorDetect: set at pre-compile, default-value=false  # Switches the development error detection and notification on or off. | * true: detection and notification is enabled. * false: detection and notification is disabled.
        container SwCluCLdComProxyBaseSocket [1..*]: multiplicity set at pre-compile  # This container configures how many EcucPartitions specific API links are required for the LdCom Proxy and to which cluster resource the API set belongs. | In the LdCom Low Proxy all offered API sets (incl. callbacks) needs to be configured. In the LdCom High Proxy only the ones are configured which are offered inside this Application Software Cluster. The reference SwCluCProxyEcucPartitionRef denotes the EcucPartition on which the API set is provided. The LdComUserModuleCnf is only applicable in the Host Software Cluster and shall not be configured in the scope of a Application Software Cluster. One LdComUserModuleCnf instance can either server for LdComIPdus on multiple EcucPartitons or exactly one EcucPartiton. How many LdComUser instances an Rte in an related Application Software Cluster requires is vendor specific.
          boolean SwCluCNativeBswApi [0..1]: scope=ECU, multiplicity set at pre-compile, set at pre-compile, default-value=false  # Defines if the native C-API without pre or suffixes is offered in the Application Software Cluster on this EcucPartition.
          reference SwCluCLdComProxyUsedSatelliteRef [0..1]: scope=ECU, multiplicity set at pre-compile, set at pre-compile, destination=SwCluCLdComProxyBaseSocket  # Reference to the SwCluCLdComBaseSocket which has access to a satellite of the LdCom. The owning SwCluCLdComBaseSocket uses the LdCom satellite of the referenced SwCluCLdComBaseSocket.
          reference SwCluCProxyEcucPartitionRef [1..*]: scope=ECU, multiplicity set at pre-compile, set at pre-compile, destination=EcucPartition  # Reference to the EcucPartition.
          foreign reference SwCluCResourceRef: scope=ECU, destination-type=CP-SOFTWARE-CLUSTER-SERVICE-RESOURCE  # Reference to the CpSoftwareClusterServiceResource.
          container LdComUserModuleCnf [0..1]: destination-uri=LdComUser, multiplicity set at pre-compile  # Contains the configuration parameters of the LdCom user module.
            string LdComUserHeaderInclude [0..1]: multiplicity set at pre-compile, set at pre-compile  # Defines the header file where the LdLom user provides the function declarations for configured callbacks.
            container LdComUserCallback [0..*]: multiplicity set at link in variant post-build / pre-compile in variant pre-compile, post-build-variant-multiplicity=true  # This container defines a LdCom callback function for a LdComIPdu.
              function name LdComUserCallbackName: scope=ECU, multiplicity set at link in variant post-build / pre-compile in variant pre-compile, set at link in variant post-build / pre-compile in variant pre-compile  # The name of the callback function to be called.
              enumeration LdComUserCallbackType: {LDCOM_RX_INDICATION, LDCOM_RX_START_OF_RECEPTION, LDCOM_TP_COPY_RX_DATA, LDCOM_TP_COPY_TX_DATA, LDCOM_TP_RX_INDICATION, LDCOM_TP_TX_CONFIRMATION, LDCOM_TX_CONFIRMATION, LDCOM_TX_TRIGGER_TRANSMIT}, scope=ECU, multiplicity set at link in variant post-build / pre-compile in variant pre-compile, set at link in variant post-build / pre-compile in variant pre-compile  # The type of the LdCom callback
            container LdComUserIPdu [0..*]: multiplicity set at post-build in variant post-build / pre-compile in variant pre-compile, post-build-variant-multiplicity=true  # Contains the configuration parameters for the LdCom's signal (LdComIPdu) inside a LdCom user module.
              integer LdComUserCbkHandleId: 0..65535, scope=ECU, set at pre-compile, symbolic-name-value=true  # The numerical value used as the LdCom user callback handle Id. | This is the ID used by LdCom to invoke callbacks of a LdCom user (Rte, ScCluC LdCom Low Proxy or CDDs) using LdComUserCbkHandleId parameter respectively. A corresponding symbolic name reference is created, which may be used for the invocations of the user.
              reference LdComUserCallbackRef [0..*]: scope=ECU, multiplicity set at post-build in variant post-build / pre-compile in variant pre-compile, post-build-variant-multiplicity=true, post-build-variant-value=true, set at link in variant post-build / pre-compile in variant pre-compile, destination=LdComUserCallback  # Reference(s) to all callback(s) of this LdComIPdu.
              foreign reference LdComUserSystemTemplateSignalRef: scope=ECU, multiplicity set at post-build in variant post-build / pre-compile in variant pre-compile, post-build-variant-multiplicity=true, post-build-variant-value=true, set at post-build in variant post-build / pre-compile in variant pre-compile, destination-type=I-SIGNAL-TO-I-PDU-MAPPING  # Reference to the ISignalToIPduMapping that contains a reference to the ISignal (System Template).
      container SwCluCNvMProxy [0..1]: multiplicity set at pre-compile  # NvM Proxy specific parameters.
        boolean SwCluCNvMProxyDevErrorDetect: set at pre-compile, default-value=false  # Switches the development error detection and notification on or off. | * true: detection and notification is enabled. * false: detection and notification is disabled.
        integer SwCluCNvMProxyNvBlockFillValue [0..1]: 0..255, scope=ECU, multiplicity set at pre-compile, set at pre-compile, default-value=255  # Defines the default value used to fill unused bytes in NvBlock space in case NvBlock length in Application Software Cluster < NvBlock length configured in NvM of Host Software Cluster. | Dependent on NvM Proxy implementation this parameter is only relevant for NvM Low Proxy or NvM High Proxy
        container SwCluCNvMBaseSocket [1..*]: multiplicity set at pre-compile  # This container configures how many EcucPartitions specific API links are required for the NvM Proxy and to which cluster resource the API set belongs. | In the NvM Low Proxy all offered API sets needs to be configured. In the NvM High Proxy only the ones are configured which are offered inside this Application Software Cluster. The reference SwCluCProxyEcucPartitionRef denotes the EcucPartition on which the API set is provided.
          boolean SwCluCNativeBswApi [0..1]: scope=ECU, multiplicity set at pre-compile, set at pre-compile, default-value=false  # Defines if the native C-API without pre or suffixes is offered in the Application Software Cluster on this EcucPartition.
          reference SwCluCNvMProxyUsedSatelliteRef: scope=ECU, multiplicity set at pre-compile, set at pre-compile, destination=SwCluCNvMBaseSocket  # Reference to the SwCluCNvMBaseSocket which has access to a satellite of the NvM. The owning SwCluCNvMBaseSocket uses the NvM satellite of the referenced SwCluCNvMBaseSocket.
          reference SwCluCProxyEcucPartitionRef: scope=ECU, multiplicity set at pre-compile, set at pre-compile, destination=EcucPartition  # Reference to the EcucPartition.
          foreign reference SwCluCResourceRef: scope=ECU, destination-type=CP-SOFTWARE-CLUSTER-SERVICE-RESOURCE  # Reference to the CpSoftwareClusterServiceResource.
        container SwCluCNvMConfigIDProxyNvBlock [0..*]: multiplicity set at pre-compile  # Describes a Configuration ID block of an Application Software Cluster and maps it to | * a CpSoftwareClusterServiceResource describing the NvBlock resource in the clustered system * a EcucPartition * a NvMBlockDescriptor (only in the context of the Host Software Cluster) In the scope of an Application Software Cluster at most one SwCluCNvMConfigIDProxyNvBlock container can exist. In the scope of a Host Software Cluster multiple SwCluCNvMConfigIDProxyNvBlock container can exist, one for each Configuration ID block of Application Software Clusters.
          reference SwCluCNvMProxyHostNvMBlockDescriptorRef [0..1]: scope=ECU, multiplicity set at pre-compile, set at pre-compile, destination=NvMBlockDescriptor  # Reference to the NvMBlockDescriptor of the NvM module in Host Software Cluster. | This reference is only applicable in the context of a Host Software Cluster.
          reference SwCluCNvMProxyNvBlockEcucPartitionRef: scope=ECU, multiplicity set at pre-compile, set at pre-compile, destination=EcucPartition  # Reference to the EcucPartition on which the NvM Proxy offers the NvBlock access (call of APIfunctions, callback functions and Ports on the Service Software Component)
          foreign reference SwCluCResourceRef: scope=ECU, destination-type=CP-SOFTWARE-CLUSTER-SERVICE-RESOURCE  # Reference to the CpSoftwareClusterServiceResource.
        container SwCluCNvMProxyNvBlock [1..*]: multiplicity set at pre-compile  # Maps a NvMBlockDescriptor to the CpSoftwareClusterServiceResource describing the NvBlock resource in the clustered system.
          integer SwCluCNvMProxyNvBlockMaxLength: 1..65535, scope=ECU, multiplicity set at pre-compile, set at pre-compile  # Defines the maximum NV block data length in bytes.
          reference SwCluCNvMProxyNvBlockEcucPartitionRef: scope=ECU, multiplicity set at pre-compile, set at pre-compile, destination=EcucPartition  # Reference to the EcucPartition on which the NvM Proxy offers the NvBlock access (call of APIfunctions, callback functions and Ports on the Service Software Component)
          reference SwCluCNvMProxyNvMBlockDescriptorRef: scope=ECU, destination=NvMBlockDescriptor  # Reference to the NvMBlockDescriptor
          foreign reference SwCluCResourceRef: scope=ECU, destination-type=CP-SOFTWARE-CLUSTER-SERVICE-RESOURCE  # Reference to the CpSoftwareClusterServiceResource.
      container SwCluCOsProxy [0..1]: multiplicity set at pre-compile  # Os Proxy specific parameters.
        boolean SwCluCOsProxyIdTranslationEnabled: set at pre-compile, default-value=false  # Enables the translation of core IDs and application IDs between Host SW Cluster and Application SW Cluster | - true: IDs translation from HOST into Application SW Cluster specific ones is enabled. - false: IDs translation from HOST into Application SW Cluster specific ones is disabled.
        container SwCluCOsProxyFunctionDispatcher [0..*]: multiplicity set at pre-compile  # This container configures a function dispatcher. | In the Os High Proxy this configuration puts a function as a Dispatch Entry Point in the Binary Manifest which can be called by the Os Low Proxy. In the Os Low Proxy this configuration provides the Dispatcher Function (and according resource Entry in the Binary Manifest) which is able to call the MaxNumberOfCallee Dispatch Entry Points of Os High Proxies.
          function name SwCluCOsProxyDispatchEntryPointFunction [0..1]: scope=ECU, multiplicity set at pre-compile, set at pre-compile  # Name of the function which is put into the Binary Manifest as Dispatch Entry Point. | In the Os High Proxy this configuration parameter is mandatory
          foreign reference SwCluCResourceRef: scope=ECU, destination-type=CP-SOFTWARE-CLUSTER-SERVICE-RESOURCE  # Reference to the CpSoftwareClusterServiceResource.
        container SwCluCOsProxyOsApplication [0..*]: multiplicity set at pre-compile  # Maps a OsApplication to the CpSoftwareClusterServiceResource describing the OsApplication resource in the clustered system.
          reference SwCluCOsProxyOsApplicationRef: scope=ECU, destination=OsApplication  # Reference to the OsApplication
          foreign reference SwCluCResourceRef: scope=ECU, destination-type=CP-SOFTWARE-CLUSTER-SERVICE-RESOURCE  # Reference to the CpSoftwareClusterServiceResource.
        container SwCluCOsProxyOsBaseSocket [0..*]: multiplicity set at pre-compile  # Maps a OsBaseSocket to the CpSoftwareClusterServiceResource describing the OsBaseSocket resource in the clustered system.
          foreign reference SwCluCResourceRef: scope=ECU, destination-type=CP-SOFTWARE-CLUSTER-SERVICE-RESOURCE  # Reference to the CpSoftwareClusterServiceResource.
        container SwCluCOsProxyOsResource [0..*]: multiplicity set at pre-compile  # Maps a OsResource to the CpSoftwareClusterServiceResource describing the OsResource resource in the clustered system.
          reference SwCluCOsProxyOsResourceRef: scope=ECU, destination=OsResource  # Reference to the OsResource
          foreign reference SwCluCResourceRef: scope=ECU, destination-type=CP-SOFTWARE-CLUSTER-SERVICE-RESOURCE  # Reference to the CpSoftwareClusterServiceResource.
        container SwCluCOsProxyOsSpinlock [0..*]: multiplicity set at pre-compile  # Maps a OsSpinlock to the CpSoftwareClusterServiceResource describing the OsSpinlock resource in the clustered system.
          reference SwCluCOsProxyOsSpinlockRef: scope=ECU, destination=OsSpinlock  # Reference to the OsSpinlock
          foreign reference SwCluCResourceRef: scope=ECU, destination-type=CP-SOFTWARE-CLUSTER-SERVICE-RESOURCE  # Reference to the CpSoftwareClusterServiceResource.
        container SwCluCOsProxyOsTask [0..*]: multiplicity set at pre-compile  # Maps a OsTask to the CpSoftwareClusterServiceResource describing the OsTask resource in the clustered system.
          enumeration SwCluCOsProxyTaskActivation: {OMIT_TASK_ACTIVATION, PASS_TASK_ACTIVATION}, scope=ECU, multiplicity set at pre-compile, set at pre-compile, default-value=OMIT_TASK_ACTIVATION  # Configures for this particular OsTask whether ActivateTask is passed to the Host Software Cluster or not.
          reference SwCluCOsProxyOsTaskRef: scope=ECU, destination=OsTask  # Reference to the OsTask
          foreign reference SwCluCResourceRef: scope=ECU, destination-type=CP-SOFTWARE-CLUSTER-SERVICE-RESOURCE  # Reference to the CpSoftwareClusterServiceResource.
          container SwCluCOsProxyOsTaskDispatcher [0..*]: multiplicity set at pre-compile  # This container defines a task dispatcher for the owning proxy task. | In the Os High Proxy this configuration provides the OS Task body function as a Dispatch Entry Point in the Binary manifest which can be called by the Os Low Proxy. In the HIGH_PROXY configuration at most one SwCluCOsProxyOsTaskDispatcher can be owned by a SwCluCOsProxyOsTask In the Os Low Proxy this configuration provides the Dispatcher Runnable (and according resource Entry in the Binary Manifest) which is able to call the MaxNumberOfCallee Dispatch Entry Points of Os High Proxies. In the LOW_PROXY configuration multiple SwCluCOsProxyOsTaskDispatcher can be owned by a SwCluCOsProxyOsTask. If none of the SwCluCOsProxyDispatcher<xxx>Event containers is configured it's up to the integrator to model the appropriate RTEEvent.
            integer SwCluCOsProxyMaxNumberOfCallee [0..1]: 1..255, scope=ECU  # Defines how many Dispatch Entry Points the dispatcher of the Os Low Proxy is able to call at most. | In the Os Low Proxy this configuration parameter is mandatory.
            float SwCluCOsProxyMinimumStartInterval [0..1]: 0..INF, scope=ECU, default-value=0  # Specifies the time in seconds by which two consecutive starts of an dispatcher Runnable are guaranteed to be separated.
            reference SwCluCOsProxyEcucPartitionRef [0..1]: scope=ECU, multiplicity set at pre-compile, set at pre-compile, destination=EcucPartition  # If the reference is not provided, the task dispatcher is provided on the EcuPartition to which the OsApplication of the OsTask related to the owning SwCluCOsProxyOsTask belongs. | If the reference is provided, the task dispatcher is provided on the referenced EcuPartition. In this case the task dispatcher is scheduled in the OsTask related to the owning SwCluCOsProxyOsTask but is changing its partition before the task dispatcher schedules proxy tasks in the Application Software Cluster.
            foreign reference SwCluCResourceRef: scope=ECU, destination-type=CP-SOFTWARE-CLUSTER-SERVICE-RESOURCE  # Reference to the CpSoftwareClusterServiceResource.
            container SwCluCOsProxyDispatcherBackgroundEvent [0..*]: multiplicity set at pre-compile  # Configures a BackgroundEvent starting the owing Dispatcher Runnable.
              instance reference SwCluCOsProxyDisabledModeInstanceRef [0..*]: scope=ECU, destination-context=SW-COMPONENT-PROTOTYPE P-PORT-PROTOTYPE MODE-DECLARATION-GROUP-PROTOTYPE, destination-type=MODE-DECLARATION  # Reference to the Mode instance in a PPortPrototype that disable the Event.
            container SwCluCOsProxyDispatcherExternalTriggerOccurredEvent [0..*]: multiplicity set at pre-compile  # Configures a ExternalTriggerOccurredEvent starting the owing Dispatcher Runnable.
              instance reference SwCluCOsProxyDisabledModeInstanceRef [0..*]: scope=ECU, destination-context=SW-COMPONENT-PROTOTYPE P-PORT-PROTOTYPE MODE-DECLARATION-GROUP-PROTOTYPE, destination-type=MODE-DECLARATION  # Reference to the Mode instance in a PPortPrototype that disable the Event.
              instance reference SwCluCOsProxyTriggerInstanceRef: scope=ECU, destination-context=SW-COMPONENT-PROTOTYPE P-PORT-PROTOTYPE, destination-type=TRIGGER  # Reference to the Trigger instances in a PPortPrototype that raise the trigger.
            container SwCluCOsProxyDispatcherInitEvent [0..*]: multiplicity set at pre-compile  # Configures an InitEvent starting the owing Dispatcher Runnable.
            container SwCluCOsProxyDispatcherModeSwitchEvent [0..*]: multiplicity set at pre-compile  # Configures a ModeSwitchEvent starting the owing Dispatcher Runnable.
              enumeration SwCluCOsProxyDispatcherActivation: {ON_ENTRY, ON_EXIT, ON_TRANSITION}, scope=ECU, multiplicity set at pre-compile, set at pre-compile  # Specifies if the event is activated on entering or exiting the referenced Mode instance.
              instance reference SwCluCOsProxyDisabledModeInstanceRef [0..*]: scope=ECU, destination-context=SW-COMPONENT-PROTOTYPE P-PORT-PROTOTYPE MODE-DECLARATION-GROUP-PROTOTYPE, destination-type=MODE-DECLARATION  # Reference to the Mode instance in a PPortPrototype that disable the Event.
              instance reference SwCluCOsProxyModeInstanceRef [1..2]: scope=ECU, destination-context=SW-COMPONENT-PROTOTYPE P-PORT-PROTOTYPE MODE-DECLARATION-GROUP-PROTOTYPE, destination-type=MODE-DECLARATION  # Reference to one or two Mode instances in a PPortPrototype that that initiate the mode switch.
            container SwCluCOsProxyDispatcherTimingEvent [0..*]: multiplicity set at pre-compile  # Configures a TimingEvent starting the owing Dispatcher Runnable.
              float SwCluCOsProxyTimingEventPeriod [0..1]: 0..INF, scope=ECU  # Period of timing event in seconds. The value of this attribute shall be greater than zero.
              instance reference SwCluCOsProxyDisabledModeInstanceRef [0..*]: scope=ECU, destination-context=SW-COMPONENT-PROTOTYPE P-PORT-PROTOTYPE MODE-DECLARATION-GROUP-PROTOTYPE, destination-type=MODE-DECLARATION  # Reference to the Mode instance in a PPortPrototype that disable the Event.
    container SwCluCXcc [0..1]  # Configuration of the Binary Manifest of the Software Cluster Connection
      enumeration SwCluCXccDefaultDataHandling: {DEFAULTS_AS_CALPRMS, DEFAULTS_AS_CONSTANTS}, multiplicity set at pre-compile, set at pre-compile, default-value=DEFAULTS_AS_CONSTANTS  # SwCluCXccDefaultDataHandling defines whether the default data for unconnected RPortPrototypes of a Software Cluster are instantiated as fixed constants or as calibration parameter.
      enumeration SwCluCXccScheduleIntegration: {BASIC_SW_MODULE, SERVICE_SOFTWARE_COMPONENT}, set at pre-compile, default-value=SERVICE_SOFTWARE_COMPONENT  # Defines whether the SwCluC_Xcc_MainFunction is integrated via a Service Software Component with RunnableEntity or a Basic Software Module Description with SchedulableEntity.
      container RteRipsPluginProps: destination-uri=RteRipsPlugin  # This container defines the identity of the Rte Implementation Plug-in and provides the RTE relevant parameters of the Rte Implementation Plug-in. | The shortName of the container defines the name of the Rte Implementation Plug-in used for the API infixes.
        boolean RtePluginSupportsIReadIWrite: set at pre-compile, default-value=false  # Denotes if or if not the plug-in supports the Rte_Rips_IRead/IWrite macros for primitive data.
        enumeration RteRipsGlobalCopyInstantiationPolicy: {RTE_RIPS_INSTANTIATION_BY_PLUGIN, RTE_RIPS_INSTANTIATION_BY_RTE}, set at pre-compile, default-value=RTE_RIPS_INSTANTIATION_BY_RTE  # Select whether for the relevant communication graph a RIPS plugin should instantiate the associated global copies itself or use global copies which have been instantiated by the RTE.
        enumeration RteRipsPluginCommunicationScope [0..1]: {RTE_RIPS_CROSS_SW_CLUSTER_COM, RTE_RIPS_LOCAL_SW_CLUSTER_COM}, set at pre-compile, default-value=RTE_RIPS_LOCAL_SW_CLUSTER_COM  # Defines the communication scope for which the Rte Implementation Plug-Ins (RIPS) serves. If this parameter is not set, the default behavior RTE_RIPS_LOCAL_SW_CLUSTER_COM applies.
        container RteRipsPluginCommunicationTypeSupport [0..1]: multiplicity set at pre-compile  # This container defines the different elements of communication graphs that the plugin is responsible for. Tags: atp.Status=draft
          enumeration RteRipsPluginCommunicationType [1..*]: scope=ECU, multiplicity set at pre-compile, set at pre-compile  # The type of the communication. Tags: atp.Status=draft
            INTER_ECU  # Tags: atp.Status=draft
            INTER_PARTITION  # Tags: atp.Status=draft
            INTRA_PARTITION  # Tags: atp.Status=draft
      container SwCluCXccBaseSocket [0..1]  # Maps a XccBaseSocket to the CpSoftwareClusterServiceResource describing the XccBaseSocket resource in the clustered system. | Maps a XccBaseSocket to a specific EcucPartition on which the XccBaseSocket is working.
        foreign reference SwCluCResourceRef: scope=ECU, destination-type=CP-SOFTWARE-CLUSTER-SERVICE-RESOURCE  # Reference to the CpSoftwareClusterServiceResource.
        reference SwCluCXccEcucPartitionRef: scope=ECU, multiplicity set at pre-compile, set at pre-compile, destination=EcucPartition  # Reference to the EcucPartition on which the XccBaseSocket is available.
      container SwCluCXccMainFunction [0..*]: multiplicity set at pre-compile  # Defines the existence and properties of a SwCluC_Xcc_MainFunction.
        enumeration SwCluCXccClientAssignment: {DEFAULT_FOR_ECUC_PARTITION, ONLY_EXPLICIT_ASSIGNED_CLIENTS}, set at pre-compile, default-value=DEFAULT_FOR_ECUC_PARTITION  # Defines if the SwCluC_Xcc_MainFunction is used as default main function for all clients which are not referenced explicitly by a SwCluCXccClientInstanceRef on this EcucPartition
        float SwCluCXccMainTimeBase: 0..INF, set at pre-compile  # The period between successive calls to according instance of SwCluC_Xcc_MainFunction in seconds. This parameter may be used by the SwCluC generator to transform the given timeout values to internal implementation specific counter or tick values.
        instance reference SwCluCXccClientInstanceRef [0..*]: multiplicity set at pre-compile, set at pre-compile, destination-context=ROOT-SW-COMPOSITION-PROTOTYPE SW-COMPONENT-PROTOTYPE, destination-type=ASYNCHRONOUS-SERVER-CALL-POINT  # Reference to an AsynchronousServerCallPoint
        reference SwCluCXccMainPartitionRef: set at pre-compile, destination=EcucPartition  # Reference to EcucPartition, where the according SwCluC_Xcc_MainFunction instance is assigned to.
