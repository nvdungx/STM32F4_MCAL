AUTOSAR XML (schema 00053)
package /AUTOSAR/EcucDefs
  ecuc definition collection AUTOSARParameterDefinition: module=EthSM
  module definition EthSM [0..1]: variants pre-compile  # Configuration of the Ethernet State Manager
    container EthSMGeneral  # This container contains the global parameter of the Ethernet State Manager.
      boolean EthSMDataLinkInfoApi: set at pre-compile, default-value=false  # Enables and disables the API: ISO15118Chrg_DataLinkIndication Tags: atp.Status=draft
      boolean EthSMDevErrorDetect: set at pre-compile, default-value=false  # Switches the development error detection and notification on or off. | * true: detection and notification is enabled. * false: detection and notification is disabled.
      boolean EthSMDummyMode: set at pre-compile  # Disables the API to the EthIf. The API to the ComM is available but the functionality is deactivated. The function calls from the ComM will be answered with the return value E_OK.
      float EthSMMainFunctionPeriod: 0..INF, set at pre-compile  # Specifies the period in seconds that the MainFunction has to be triggered with.
      boolean EthSMVersionInfoApi: set at pre-compile, default-value=false  # Enables and disables the version info API.
    container EthSMNetwork [1..*]  # This container contains the Ethernet network-specific parameters of each Ethernet network. It also contains the reference to combination of controller and transceiver assigned to an Ethernet network.
      boolean EthSMForwardSilentCommunicationEnabled: set at pre-compile, default-value=false  # Specifies if a request COMM_SILENT_COMMUNICATION shall be forwarded to the corresponding EthIfController. | If the parameter is set to TRUE and EthSM in called with COMM_SILENT_COMMUNICATION, then EthSM call the corresponding EthIfController with ETH_MODE_ACTIVE_TX_OFFLINE to reject any transmission request. Therefore, only reception handling of Ethernet frames is performed. If the parameter is set to FALSE and EthSM in called with COMM_SILENT_COMMUNICATION, then EthSM will NOT forward the call to EthIf. Therefore, transmission AND reception handling of Ethernet frames is performed.
      boolean EthSMTcpIpUsed: set at pre-compile, default-value=true  # Specifies if the interaction with a TcpIp module is enabled or disabled for the EthSMNetwork
      boolean EthSMWakeupSleepOnDatalineEnabled: set at pre-compile, default-value=false  # Specifies if an active communication request shall be forwarded to the lower layer to trigger a wake-up on the Ethernet network, e.g. trigger a wake-up on dataline if OA TC10 compliant Ethernet hardware is used. | If the parameter is set to TRUE and EthSM in called with COMM_FULL_COMMUNICATION_WITH_WAKEUP_REQUEST, then EthSM call the corresponding EthIfController everytime with ETH_MODE_ACTIVE_WITH_WAKEUP_REQUEST to trigger an wake-up request in the lower layer.
      reference EthSMComMNetworkHandleRef: set at pre-compile, requires-symbolic-name-value=true, destination=ComMChannel  # Unique handle to identify one certain Ethernet network. Reference to one of the network handles configured for the ComM.
      reference EthSMEthIfControllerRef: set at pre-compile, requires-symbolic-name-value=true, destination=EthIfController  # Reference to EthIfCtrl container where a ETH controller and | transceiver (optional) combination is configured.
      container EthSMDemEventParameterRefs [0..1]  # Container for the references to DemEventParameter elements which shall be invoked using the API Dem_SetEventStatus in case the corresponding error occurs. The EventId is taken from the referenced DemEventParameter's DemEventId symbolic value. The standardized errors are provided in this container and can be extended by vendor-specific error references.
        reference ETHSM_E_LINK_DOWN [0..1]: multiplicity set at pre-compile, set at pre-compile, requires-symbolic-name-value=true, destination=DemEventParameter  # Reference to configured DEM event to report bus off errors for this Eth network.
