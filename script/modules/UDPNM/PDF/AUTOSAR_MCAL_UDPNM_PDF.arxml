AUTOSAR XML (schema 00053)
package /AUTOSAR/EcucDefs
  ecuc definition collection AUTOSARParameterDefinition: module=UdpNm
  module definition UdpNm [0..1]: post-build-variant-support=true, variants link-time/pre-compile  # Configuration of the UdpNm module.
    container UdpNmGlobalConfig  # This container contains all global configuration parameters of UDP NM. The parameters and the parameters of the sub containers shall be mapped to the C data type UdpNm_ConfigType (for parameters where it is possible) which is passed to the UdpNm_Init function.
      boolean UdpNmBusSynchronizationEnabled: set at pre-compile  # Pre-processor switch for enabling bus synchronization support. | This feature is required for gateway nodes only. It must not be defined if UdpNmPassiveModeEnabled==true. This parameter shall be derived from NmBusSynchronizationEnabled.
      boolean UdpNmComControlEnabled: set at pre-compile  # Pre-processor switch for enabling the Communication Control support.
      boolean UdpNmComUserDataSupport: set at pre-compile  # Enable/disable the user data support.
      boolean UdpNmCoordinatorSyncSupport: set at pre-compile  # Enables/disables the coordinator synchronization support.
      boolean UdpNmDevErrorDetect: set at pre-compile, default-value=false  # Switches the development error detection and notification on or off. | * true: detection and notification is enabled. * false: detection and notification is disabled.
      boolean UdpNmDynamicPncToChannelMappingSupport: scope=ECU, set at pre-compile  # Precompile time switch to enable the dynamic PNC-to-channel-mapping handling. Tags: atp.Status=draft | False: Dynamic PNC-to-channel-mapping is disabled True: Dynamic PNC-to-channel-mapping is enabled
      boolean UdpNmImmediateRestartEnabled: set at pre-compile  # Pre-processor switch for enabling the immediate transmission of a NM PACKET upon bus-communication request in Prepare-Bus-Sleep mode. | Must not be defined if UdpNmPassiveModeEnabled== true.
      integer UdpNmNumberOfChannels: 1..255, set at pre-compile  # Number of NM channels allowed within one ECU.
      boolean UdpNmPassiveModeEnabled: set at pre-compile  # Pre-processor switch for enabling support of the Passive Mode.
      boolean UdpNmPduRxIndicationEnabled: set at pre-compile  # Pre-processor switch for enabling the PDU Rx Indication. | This parameter shall be derived from NmPduRxIndicationEnabled.
      boolean UdpNmRemoteSleepIndEnabled: set at pre-compile  # Pre-processor switch for enabling remote sleep indication support. | This feature is required for gateway nodes only. It must not be defined if UdpNmPassiveModeEnabled==true. This parameter shall be derived from NmRemoteSleepIndEnabled.
      boolean UdpNmStateChangeIndEnabled: set at pre-compile  # Pre-processor switch for enabling the UDP NM state change notification. | This parameter shall be derived from NmStateChangeIndEnabled.
      boolean UdpNmUserDataEnabled: set at pre-compile  # Pre-processor switch for enabling user data support. | This parameter shall be derived from NmUserDataEnabled.
      boolean UdpNmVersionInfoApi: set at pre-compile, default-value=false  # Pre-processor switch for enabling version info API support.
      container UdpNmChannelConfig [1..*]  # This container contains the channel-specific configuration parameters of the UdpNm.
        boolean UdpNmActiveWakeupBitEnabled [0..1]: multiplicity set at link in variant link-time / pre-compile in variant pre-compile, set at link in variant link-time / pre-compile in variant pre-compile, default-value=false  # Enables/Disables the handling of the Active Wakeup Bit in the UdpNm module.
        boolean UdpNmAllNmMessagesKeepAwake [0..1]: multiplicity set at link in variant link-time / pre-compile in variant pre-compile, set at link in variant link-time / pre-compile in variant pre-compile, default-value=false  # Specifies if UdpNm drops irrelevant NM PDUs. | false: Only NM PDUs with a PNI bit = true and containing a PN request for this ECU triggers the standard RX indication handling true: Every NM PDU triggers the standard RX indication handling
        integer UdpNmCarWakeUpBitPosition [0..1]: 0..7, multiplicity set at link in variant link-time / pre-compile in variant pre-compile, set at link in variant link-time / pre-compile in variant pre-compile  # Specifies the Bit position of the CWU within the NM PDU.
        integer UdpNmCarWakeUpBytePosition [0..1]: 0..7, multiplicity set at link in variant link-time / pre-compile in variant pre-compile, set at link in variant link-time / pre-compile in variant pre-compile  # Specifies the Byte position of the CWU within the NM PDU.
        boolean UdpNmCarWakeUpFilterEnabled [0..1]: multiplicity set at link in variant link-time / pre-compile in variant pre-compile, set at link in variant link-time / pre-compile in variant pre-compile, default-value=false  # If CWU filtering is supported, only the CWU bit within the NM PDU with source node identifier UdpNmCarWakeUpFilterNodeId is considered as CWU request. | FALSE - CWU filtering is not supported TRUE - CWU filtering is supported.
        integer UdpNmCarWakeUpFilterNodeId [0..1]: 0..255, multiplicity set at link in variant link-time / pre-compile in variant pre-compile, set at link in variant link-time / pre-compile in variant pre-compile  # Source node identifier for CWU filtering. If CWU filtering is supported, only the CWU bit within the NM PDU with source node identifier UdpNmCarWakeUpFilterNodeId is considered as CWU request.
        boolean UdpNmCarWakeUpRxEnabled: scope=ECU, set at link in variant link-time / pre-compile in variant pre-compile, default-value=false  # Enables or disables support of CarWakeUp bit evaluation in received NM PDUs. | FALSE - CarWakeUp not supported. TRUE - CarWakeUp supported.
        boolean UdpNmDynamicPncToChannelMappingEnabled [0..1]: set at link in variant link-time / pre-compile in variant pre-compile, default-value=false  # Channel-specific parameter to enable the dynamic PNC-to-channel-mapping feature. Tags: atp.Status=draft | False: Dynamic PNC-to-channel-mapping is disabled True: Dynamic PNC-to-channel-mapping is enabled
        float UdpNmImmediateNmCycleTime [0..1]: 0.001..65.535, multiplicity set at link in variant link-time / pre-compile in variant pre-compile, set at link in variant link-time / pre-compile in variant pre-compile  # Defines the immediate NM PDU cycle time in seconds which is used for UdpNmImmediateNmTransmissions NM PDU transmissions.
        integer UdpNmImmediateNmTransmissions: 0..255, set at link in variant link-time / pre-compile in variant pre-compile  # Defines the number of immediate NM PDUs which shall be transmitted. If the value is zero no immediate NM PDUs are transmitted. The cycle time of immeditate NM PDUs is defined by UdpNmImmediateNmCycleTime.
        float UdpNmMainFunctionPeriod: 0..INF, set at link in variant link-time / pre-compile in variant pre-compile  # Call cycle of UdpNm_MainFunction_x for the respective instance in [s].
        float UdpNmMsgCycleOffset: 0..65.535, post-build-variant-value=true, set at link in variant link-time / pre-compile in variant pre-compile  # Time offset in the periodic transmission node. It determines the start delay of the transmission. | < UdpNmMsgCycleTime This parameter is only valid if UdpNmPassiveModeEnabled is disabled.
        float UdpNmMsgCycleTime: 0.001..65.535, scope=ECU, set at link in variant link-time / pre-compile in variant pre-compile  # Period of a NM-message. It determines the periodic rate and is the basis for transmit scheduling. | NmTimeoutTime = n * UdpNmMsgCycleTime This parameter is only valid if UdpNmPassiveModeEnabled is disabled.
        boolean UdpNmNodeDetectionEnabled: set at link in variant link-time / pre-compile in variant pre-compile  # Pre-processor switch for enabling the node detection support. | This parameter shall be derived from NmNodeDetectionEnabled. This parameter shall only be enabled if UdpNmNodeIdEnabled == true. If(UdpNmPduCbvPosition != UDPNM_PDU_OFF) then Equal(NmNodeDetectionEnabled) else Equal(False).
        integer UdpNmNodeId [0..1]: 0..255, set at link in variant link-time / pre-compile in variant pre-compile  # Node identifier of local node.
        boolean UdpNmNodeIdEnabled: set at link in variant link-time / pre-compile in variant pre-compile  # Pre-processor switch for enabling the source node identifier. | This parameter shall be derived from NmNodeIdEnabled.
        enumeration UdpNmPduCbvPosition: {UDPNM_PDU_BYTE_0, UDPNM_PDU_BYTE_1, UDPNM_PDU_OFF}, set at link in variant link-time / pre-compile in variant pre-compile  # Defines the position of the control bit vector within the NM PACKET. | The value of the parameter represents the location of the control bit vector in the NM PACKET (UDPNM_PDU_BYTE_0 means byte 0, UDPNM_PDU_BYTE_1 means byte 1, UDPNM_PDU_OFF means the control bit vector is not part of the NM PACKET) See also UdpNmPduNidPosition if (UdpNmPduCbvPosition != UDPNM_PDU_OFF && UdpNmPduNidPosition != UDPNM_PDU_OFF) then UdpNmPduCbvPosition != UdpNmPduNidPosition if (UdpNmPduCbvPosition != UDPNM_PDU_OFF && UdpNmPduNidPosition == UDPNM_PDU_OFF) then UdpNmPduCbvPosition = UDPNM_PDU_BYTE0
        enumeration UdpNmPduNidPosition: {UDPNM_PDU_BYTE_0, UDPNM_PDU_BYTE_1, UDPNM_PDU_OFF}, set at link in variant link-time / pre-compile in variant pre-compile  # Defines the position of the source node identifier within the NM PACKET. | ImplementationType: UdpNm_PduPositionType The value of the parameter represents the location of the source node identifier in the NM PACKET (UDPNM_PDU_BYTE_0 means byte 0, UDPNM_PDU_BYTE_1 means byte 1, UDPNM_PDU_OFF means source node identifier is not part of the NM PACKET) See also UdpNmPduCbvPosition if (UdpNmPduNidPosition!= UDPNM_PDU_OFF && UdpNmPduCbvPosition != UDPNM_PDU_OFF) then UdpNmPduNidPosition != UdpNmPduCbvPosition if (UdpNmPduNidPosition != UDPNM_PDU_OFF && UdpNmPduCbvPosition == UDPNM_PDU_OFF) then UdpNmPduNidPosition = UDPNM_PDU_BYTE0
        boolean UdpNmPnEnabled [0..1]: multiplicity set at link in variant link-time / pre-compile in variant pre-compile, set at link in variant link-time / pre-compile in variant pre-compile, default-value=false  # Enables or disables support of partial networking. | false: Partial networking Range not supported true: Partial networking supported
        boolean UdpNmPnHandleMultipleNetworkRequests [0..1]: multiplicity set at link in variant link-time / pre-compile in variant pre-compile, set at link in variant link-time / pre-compile in variant pre-compile, default-value=false  # false: UdpNm_NetworkRequest is ignored in NO. | true: UdpNm_NetworkRequest triggers a change from NO to RM.
        float UdpNmRemoteSleepIndTime: 0.001..65.535, set at link in variant link-time / pre-compile in variant pre-compile  # Timeout for Remote Sleep Indication. | It defines the time in [s] how long it shall take to recognize that all other nodes are ready to sleep. Typically it should be equal to: n * UdpNmMsgCycleTime, where n denotes the number of NM packets that are normally sent before Remote Sleep Indication is detected. The value of n decremented by one determines the amount of lost NM packets that can be tolerated by the Remote Sleep Indication procedure.
        float UdpNmRepeatMessageTime: 0..65.535, set at link in variant link-time / pre-compile in variant pre-compile  # Timeout for Repeat Message State. | It defines the time in seconds how long the NM shall stay in the Repeat Message State.
        boolean UdpNmRepeatMsgIndEnabled: set at link in variant link-time / pre-compile in variant pre-compile  # Enable/disable the notification that a RepeatMessageRequest bit has been received.
        boolean UdpNmRetryFirstMessageRequest [0..1]: multiplicity set at link in variant link-time / pre-compile in variant pre-compile, set at link in variant link-time / pre-compile in variant pre-compile  # Specifies if first message request in UdpNm is repeated until accepted by SoAd.
        boolean UdpNmStayInPbsEnabled: set at link in variant link-time / pre-compile in variant pre-compile, default-value=false  # If this parameter is disabled Prepare Bus-Sleep Mode is left after UdpNmWaitBusSleepTime. If this parameter is enabled Prepare Bus-Sleep Mode can only be left if ECU is powered off or any restart reason applies.
        boolean UdpNmSynchronizedPncShutdownEnabled [0..1]: multiplicity set at link in variant link-time / pre-compile in variant pre-compile, set at link in variant link-time / pre-compile in variant pre-compile, default-value=false  # Specifies if UdpNm handle PN shutdown messages to support a synchronized PNC shutdown across a PN topology. This is only used for ECUs in the role of a top-level PNC coordinator or intermediate PNC coordinator. Thus, the PNC gateway functionality is enabled and therefore ERA calculation is used. | FALSE: synchronized PNC shutdown is disabled TRUE: synchronized PNC shutdown is enabled
        float UdpNmTimeoutTime: 0.002..65.535, scope=ECU, set at link in variant link-time / pre-compile in variant pre-compile  # Network Timeout for NM packets. | It denotes the time in [s] how long the NM shall stay in the Network Mode before transition into Prepare Bus-Sleep Mode shall take place. It shall be equal for all nodes in the cluster. It shall be greater than UdpNmMsgCycleTime. Typically, it should be equal to: x * UdpNmMsgCycleTime, where n denotes the number of NM PACKET cycle times in the Ready Sleep State before transition into the Bus-Sleep Mode is initiated. The value of n decremented by one determines the amount of lost NM packets that can be tolerated by the coordination algorithm.
        float UdpNmWaitBusSleepTime [0..1]: 0.001..65.535, set at link in variant link-time / pre-compile in variant pre-compile  # Timeout for bus calm down phase. | It denotes the time in [s] how long the NM shall stay in the Prepare Bus-Sleep Mode before transition into Bus-Sleep Mode shall take place. It shall be equal for all nodes in the cluster. It shall be long enough to empty all Tx-buffer empty.
        reference UdpNmComMNetworkHandleRef: scope=ECU, post-build-variant-value=true, set at link in variant link-time / pre-compile in variant pre-compile, requires-symbolic-name-value=true, destination=ComMChannel  # This reference points to the unique channel defined by the ComMChannel and provides access to the unique channel index value in ComMChannelId.
        container UdpNmRxPdu [1..*]  # This container describes the UdpNm RX PDU's.
          integer UdpNmRxPduId: 0..4294967296, post-build-variant-value=true, set at pre-compile, symbolic-name-value=true, with-auto=true  # ID of the RxPdu that will be used by a RxIndication of the lower layer.
          reference UdpNmRxPduRef: set at link in variant link-time / pre-compile in variant pre-compile, destination=Pdu  # The reference to a PDU in the global PDU structure described in the AUTOSAR ECU Configuration Specification. This reference will be used by the UdpNm module to derive the PDU Id.
        container UdpNmTxPdu [0..1]  # This container describes the UdpNm TX PDU's.
          integer UdpNmTxConfirmationPduId: 0..4294967296, post-build-variant-value=true, set at pre-compile, symbolic-name-value=true, with-auto=true  # Id of the TxPdu that will be used by a TxConfirmation from the lower layer.
          reference UdpNmTxPduRef: post-build-variant-value=true, set at link in variant link-time / pre-compile in variant pre-compile, destination=Pdu  # The reference to a PDU in the global PDU structure described in the AUTOSAR ECU Configuration Specification. This reference will be used by the UdpNm module to derive the PDU Id.
        container UdpNmUserDataTxPdu [0..1]  # Preprocessor switch for enabling the Tx path of Com User Data. | Use case: Setting of NMUserData via SWC.
          integer UdpNmTxUserDataPduId: 0..65535, set at pre-compile, symbolic-name-value=true, with-auto=true  # This parameter defines the Handle ID of the NM User Data I-PDU.
          reference UdpNmTxUserDataPduRef: set at link in variant link-time / pre-compile in variant pre-compile, destination=Pdu  # Reference to the NM User Data I-PDU in the global PDU collection.
