AUTOSAR XML (schema 00053)
package /AUTOSAR/EcucDefs
  ecuc definition collection AUTOSARParameterDefinition: module=CnV2xSec
  module definition CnV2xSec [0..1]: variants pre-compile  # Configuration of the CnV2xSec module. Tags: atp.Status=draft
    container CnV2xSecGeneral  # This container contains the configuration parameters of the security module CnV2xSec. Tags: atp.Status=draft
      reference CnV2xSecHashConfigRef: set at pre-compile, requires-symbolic-name-value=true, destination=CsmJob  # Select Csm service configuration that is used for hash. Tags: atp.Status=draft
      reference CnV2xSecNvMBlockDescriptorLongTermCertificateRef: set at pre-compile, requires-symbolic-name-value=true, destination=NvMBlockDescriptor  # Reference to NVRAM block containing the none volatile data of long term certificates Tags: atp.Status=draft
      reference CnV2xSecNvMBlockDescriptorPseudonymCertificateRef: set at pre-compile, requires-symbolic-name-value=true, destination=NvMBlockDescriptor  # Reference to NVRAM block containing the none volatile data of pseudonym certificates. Tags: atp.Status=draft
      reference CnV2xSecNvMBlockDescriptorRef: set at pre-compile, requires-symbolic-name-value=true, destination=NvMBlockDescriptor  # Reference to NVRAM block containing the none volatile data. Tags: atp.Status=draft
      reference CnV2xSecSignatureGenerationConfigRef: set at pre-compile, requires-symbolic-name-value=true, destination=CsmJob  # Select Csm service configuration that is used for signature generation. Tags: atp.Status=draft
      reference CnV2xSecSignatureVerifyConfigRef: set at pre-compile, requires-symbolic-name-value=true, destination=CsmJob  # Select Csm service configuration that is used for signature verification Tags: atp.Status=draft
