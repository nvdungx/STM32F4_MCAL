AUTOSAR XML (schema 00053)
package /AUTOSAR/EcucDefs
  ecuc definition collection AUTOSARParameterDefinition: module=EcuC
  module definition EcuC [0..1]: post-build-variant-support=true, variants post-build/pre-compile  # Virtual module to collect ECU Configuration specific / global configuration information.
    container EcucConfigSet [0..1]  # This container contains the configuration parameters and sub containers of the global PduCollection.
      container EcucPduCollection [0..1]  # Collection of all Pdu objects flowing through the Com-Stack.
        enumeration PduIdTypeEnum: {UINT16, UINT8}  # The PduIdType is used within the entire AUTOSAR Com Stack except for bus drivers. The size of this global type depends on the maximum number of PDUs used within one software module. If no software module deals with more PDUs that 256, this type can be set to uint8. If at least one software module handles more than 256 PDUs, this type shall be set to uint16. See AUTOSAR_SWS_CommunicationStackTypes for more details.
        enumeration PduLengthTypeEnum: {UINT16, UINT32, UINT8}  # The PduLengthType is used within the entire AUTOSAR Com Stack except for bus drivers. The size of this global type depends on the maximum length of PDUs to be sent by an ECU. If no segmentation is used the length depends on the maximum payload size of a frame of the underlying communication system (for FlexRay maximum size is 255 bytes, therefore uint8). If segmentation is used it depends on the maximum length of a segmented N-SDU (in general uint16 is used). See AUTOSAR_SWS_CommunicationStackTypes for more details.
        container MetaDataType [0..*]: multiplicity set at pre-compile  # Meta data serves to transport information through the AUTOSAR layers. It is transported by the PduInfoType structure via a separate pointer to a byte array alongside the length of and a pointer to the payload of the PDU. This container defines the content of the meta data.
          container MetaDataItem [1..*]: multiplicity set at pre-compile, requires-index=true  # The content of meta data in a Pdu consists of an ordered list of meta data items. | This container represents a meta data item that is contained in meta data of a Pdu.
            integer MetaDataItemLength: 1..64, set at pre-compile  # This parameter defines the length of a meta data item in bytes.
            enumeration MetaDataItemType: set at pre-compile  # This parameter defines the type of a meta data item.
              ACCEPTANCEFIELD_32
              ADDRESS_EXTENSION_8
              BROADCAST_8  # Tags: atp.Status=draft
              CAN_ID_32
              CAN_ID_PROPS_8  # Tags: atp.Status=draft
              ETHERNET_MAC_64
              FILTER_RULE_ID_16  # Tags: atp.Status=draft
              IEEE1722TP_COMMON_STREAM_HEADER_PTR  # Tags: atp.Status=draft
              IEEE1722TP_RX_AAF_AES3_PTR  # Tags: atp.Status=draft
              IEEE1722TP_RX_AAF_PCM_PTR  # Tags: atp.Status=draft
              IEEE1722TP_RX_CRF_PTR  # Tags: atp.Status=draft
              IEEE1722TP_RX_IEC68133_CIP_NO_SPH_PTR  # Tags: atp.Status=draft
              IEEE1722TP_RX_IEC68133_CIP_WITH_SPH_PTR  # Tags: atp.Status=draft
              IEEE1722TP_RX_IEC68133_IIDC_PTR  # Tags: atp.Status=draft
              IEEE1722TP_RX_IEC68133_PTR  # Tags: atp.Status=draft
              IEEE1722TP_RX_RVF_PTR  # Tags: atp.Status=draft
              IEEE1722TP_TX_AAF_AES3_PTR  # Tags: atp.Status=draft
              IEEE1722TP_TX_AAF_PCM_PTR  # Tags: atp.Status=draft
              IEEE1722TP_TX_CRF_PTR  # Tags: atp.Status=draft
              IEEE1722TP_TX_IEC68133_CIP_NO_SPH_PTR  # Tags: atp.Status=draft
              IEEE1722TP_TX_IEC68133_CIP_WITH_SPH_PTR  # Tags: atp.Status=draft
              IEEE1722TP_TX_IEC68133_IIDC_PTR  # Tags: atp.Status=draft
              IEEE1722TP_TX_IEC68133_PTR  # Tags: atp.Status=draft
              IEEE1722TP_TX_RVF_PTR  # Tags: atp.Status=draft
              LIN_NAD_8
              LISTELEM_PTR  # Tags: atp.Status=draft
              MESSAGE_TIMESTAMP_64  # Tags: atp.Status=draft
              MESSAGE_TIMESTAMP_VALID_8  # Tags: atp.Status=draft
              PRIORITY_16
              PRIORITY_8
              SDUTYPE_8
              SOCKET_CONNECTION_ID_16
              SOURCE_ADDRESS_16
              TARGET_ADDRESS_16
              TIMETUPLE_TYPE_PTR  # Tags: atp.Status=draft
              VLAN_16
        container Pdu [0..*]: multiplicity set at post-build in variant post-build / pre-compile in variant pre-compile, post-build-variant-multiplicity=true  # One Pdu flowing through the COM-Stack. | This Pdu is used by all Com-Stack modules to agree on referencing the same Pdu.
          boolean DynamicLength [0..1]: multiplicity set at post-build in variant post-build / pre-compile in variant pre-compile, post-build-variant-multiplicity=true, post-build-variant-value=true, set at post-build in variant post-build / pre-compile in variant pre-compile  # This parameter defines whether the Pdu has dynamic length (true) or not (false). Please note that the usage of this attribute is restricted by [constr_3448].
          boolean J1939Requestable [0..1]: multiplicity set at post-build in variant post-build / pre-compile in variant pre-compile, post-build-variant-multiplicity=true, post-build-variant-value=true, set at post-build in variant post-build / pre-compile in variant pre-compile  # Pdu can be triggered by the J1939 request message.
          boolean KeepLocalPduBuffer [0..1]: multiplicity set at pre-compile, set at pre-compile, default-value=false  # This parameter defines whether a module that handles the PDU would keep a temporary local buffer Tags: atp.Status=draft | * until a confirmation or release-rx-buffer function call arrives (KeepLocalPduBuffer = TRUE) or * if a temporary local buffer is released after transmission or rx indication return (KeepLocalPduBuffer = FALSE).
          integer PduBufferAlignment [0..1]: 1..8, scope=ECU, multiplicity set at pre-compile, set at pre-compile, default-value=2  # This parameter defines the byte alignment of temporary local buffers that is required by the hardware. Using this parameter, a configuration can ensure that an upper layer module is aware of the alignment requirements of a driver. Tags: atp.Status=draft | Unit: Byte
          integer PduLength: 0..4294967295, post-build-variant-value=true, set at post-build in variant post-build / pre-compile in variant pre-compile  # Length of the Pdu in bytes. It should be noted that in former AUTOSAR releases (Rel 2.1, Rel 3.0, Rel 3.1, Rel 4.0 Rev. 1) this parameter was defined in bits.
          reference EcucPduDefaultPartitionRef [0..1]: multiplicity set at pre-compile, set at pre-compile, destination=EcucPartition  # Reference to EcucPartition, where the according Pdu is assigned to.
          reference MetaDataTypeRef [0..1]: set at pre-compile, destination=MetaDataType  # Reference to meta data that is transported in the Pdu through the AUTOSAR layers.
          foreign reference SysTPduToFrameTriggeringRef [0..1]: multiplicity set at post-build in variant post-build / pre-compile in variant pre-compile, post-build-variant-multiplicity=true, post-build-variant-value=true, set at post-build in variant post-build / pre-compile in variant pre-compile, destination-type=FRAME-TRIGGERING  # Reference to the FrameTriggering from the SystemTemplate which this Pdu belongs to. | SysTPduToFrameTriggeringRef shall be used for UserDefinedPdus, NmPdus and NPdus which are not going through the Pdu Router. This reference shall not be used if SysTPduToPduTriggeringRef exists.
          foreign reference SysTPduToPduTriggeringRef [0..1]: multiplicity set at post-build in variant post-build / pre-compile in variant pre-compile, post-build-variant-multiplicity=true, post-build-variant-value=true, set at post-build in variant post-build / pre-compile in variant pre-compile, destination-type=PDU-TRIGGERING  # Reference to the PduTriggering from the SystemTemplate which this Pdu represents. | SysTPduToPduTriggeringRef shall be used for all Pdus except UserDefinedPdus, NmPdus and NPdus which are not going through the Pdu Router. For these Pdus, SysTPduToFrameTriggeringRef shall be used.
          container EcucPduDedicatedPartition [0..*]: multiplicity set at pre-compile, post-build-variant-multiplicity=true  # Module specific container for Pdu to partition assignment.
            foreign reference EcucPduDedicatedPartitionBswModuleRef: set at pre-compile, destination-type=ECUC-MODULE-CONFIGURATION-VALUES  # Reference to BSW module, for which the according dedicated Pdu assignment is valid.
            reference EcucPduDedicatedPartitionRef: set at pre-compile, destination=EcucPartition  # Module specific reference to EcucPartition, where the according Pdu is assigned to. The dedicated partition reference shall overrule the default partition reference for the respective module.
    container EcucHardware  # Hardware definition of this Ecu.
      container EcucCoreDefinition [1..*]  # Definition of one Core on this Ecu.
        integer EcucCoreId: 0..65535, set at pre-compile  # ID of the core.
        foreign reference EcucCoreHwRef [0..1]: multiplicity set at pre-compile, set at pre-compile, destination-type=HW-ELEMENT  # Optional reference to the HwElement of HwCategory ProcessingUnit that represents this Core in the ECU Resource Template.
    container EcucPartitionCollection [0..1]  # Collection of Partitions defined for this ECU.
      container EcucPartition [0..*]: multiplicity set at pre-compile  # Definition of one Partition on this ECU. | One Partition will be implemented using one Os-Application.
        integer EcucPartitionId: 0..65535, scope=ECU, set at pre-compile  # ID of the partition.
        foreign reference EcucEcuPartitionRef [0..1]: scope=ECU, multiplicity set at pre-compile, set at pre-compile, destination-type=ECU-PARTITION  # Reference to the EcuPartition to define the link to the partition described in the System description. Tags: atp.Status=draft
        foreign reference EcucPartitionBswModuleDistinguishedPartition [0..*]: multiplicity set at pre-compile, set at pre-compile, destination-type=BSW-DISTINGUISHED-PARTITION  # This maps the abstract partition of the Bsw Module to a concrete Partition existing in the ECU.
        reference EcucPartitionCoreRef: scope=ECU, multiplicity set at pre-compile, set at pre-compile, destination=EcucCoreDefinition  # Reference to the core definition. This reference is used to describe to which core the EcucPartition is bound.
        instance reference EcucPartitionSoftwareComponentInstanceRef [0..*]: multiplicity set at pre-compile, set at pre-compile, destination-context=ROOT-SW-COMPOSITION-PROTOTYPE, destination-type=SW-COMPONENT-PROTOTYPE  # References the SW Component instances from the Ecu Extract that shall be executed in this partition.
    container EcucPostBuildVariants [0..1]  # Collection of toplevel PostBuildSelectable variants. The PredefinedVariants linked inside this container will determine how many PostBuildSelectableVariants exist. If this container exist the name pattern for initialization of BSW modules will be <Mip>_Config_<PredefinedVariant.shortName>. If this container does not exist the name pattern for initialization of BSW modlues will be <Mip>_Config.
      foreign reference EcucPostBuildVariantRef [1..*]: multiplicity set at pre-compile, set at pre-compile, destination-type=PREDEFINED-VARIANT  # Reference to a PredefinedVariant that defines one toplevel postBuild configuration set (covering all post-build capable BSW modules). PredefinedVariants that are referenced here shall contain only PostBuildVariantCriterionValueSets.
    container EcucUnitGroupAssignment [0..1]  # Collection of UnitGroup references to support the generation of ASAM MCD file.
      foreign reference EcucUnitGroupRef [1..*]: multiplicity set at pre-compile, set at pre-compile, destination-type=UNIT-GROUP  # Optional reference to the UnitGroup to support the generation of ASAM MCD file. These UnitGroups are selecting a set of units for a specific country.
    container EcucVariationResolver [0..1]  # Collection of PredefinedVariant elements containing definition of values for SwSystemconst which shall be applied when resolving the variability during ECU Configuration.
      foreign reference PredefinedVariantRef [1..*]: multiplicity set at pre-compile, set at pre-compile, destination-type=PREDEFINED-VARIANT
