[part 2 of 2: package /AUTOSAR/EcucDefs]
AUTOSAR XML (schema 00053)
package /AUTOSAR/EcucDefs  (continued)
  module definition Dcm [0..1]: post-build-variant-support=true, variants link-time/post-build/pre-compile  (continued)
    container DcmGeneral  # Contains general configuration parameters valid for the entire Dcm module.
      boolean DcmDDDIDStorage [0..1]: multiplicity set at pre-compile, set at pre-compile, default-value=false  # This configuration switch defines, whether DDDID definition is stored non-volatile or not. | true: DDDID are stored non-volatile false: DDDID are only maintained volatile
      boolean DcmDevErrorDetect: set at pre-compile, default-value=false  # Switches the development error detection and notification on or off. | * true: detection and notification is enabled. * false: detection and notification is disabled.
      boolean DcmEnableSecurityEventReporting: scope=ECU, set at pre-compile, default-value=false  # Switches the reporting of security events to the IdsM: Tags: atp.Status=draft | - true: reporting is enabled. - false: reporting is disabled.
      string DcmHeaderFileInclusion [0..*]: scope=ECU, multiplicity set at pre-compile, set at pre-compile, regular-expression=[a-zA-Z0-9_]([a-zA-Z0-9\._])*  # Name of the header file(s) to be included by the Dcm module containing the used C-callback declarations.
      boolean DcmRespondAllRequest: scope=ECU, set at pre-compile  # If set to FALSE the Dcm will not respond to diagnostic request that contains a service ID which is in the range from 0x40 to 0x7F or in the range from 0xC0 to 0xFF (Response IDs).
      float DcmS3ServerTimeoutOverwrite [0..1]: 5..INF, scope=ECU, multiplicity set at pre-compile, set at pre-compile  # Time for the server to keep a diagnostic session other than the defaultSession active while not receiving any diagnostic request message. This parameter overwrites the 5s recommend value of the S3server timeout in ISO 14229-2. | The parameter value is defined in seconds.
      float DcmTaskTime: 0..INF, set at link in variant link-time / pre-compile in variant post-build+pre-compile  # Allow to configure the time for the periodic cyclic task. Please note: This configuration value shall be equal to the value in the RTE module. | The AUTOSAR configuration standard is to use SI units, so this parameter is defined as float value in seconds. Dcm configuration tools must convert this float value to the appropriate value format for the use in the software implementation of Dcm. min: A negative value and zero is not allowed. upperMultiplicity: Exactly one TaskTime must be specified per configuration. lowerMultiplicity: Exactly one TaskTime must be specified per configuration.
      boolean DcmVersionInfoApi: set at pre-compile, default-value=false  # Preprocessor switch to enable or disable the output Version info of the functionality.
      reference DcmVinRef [0..1]: multiplicity set at pre-compile, set at pre-compile, destination=DcmDspDid  # Reference to the Did containing the VIN Information. | This parameter is needed for function Dcm_GetVin
      container DcmSecureCoding [0..1]: multiplicity set at pre-compile  # Contains references to diagnostic elements that are used for the secure coding process.
        integer DcmSecureCodingDataBufferSize: 0..4294967295, scope=ECU, set at pre-compile  # Provides the size of the Dcm internal buffer to store data during the secure coding sequence.
        reference DcmSecureCodingAuthenticationJobRef: set at pre-compile, requires-symbolic-name-value=true, destination=CsmJob  # Reference to a CsmJob used to verify the authentication of the secure coding data in the Csm.
        reference DcmSecureCodingDataIdentifier [1..*]: multiplicity set at pre-compile, set at pre-compile, destination=DcmDspDid  # Refers to a writeable data identifier that requires the secure coding process to write the data.
        reference DcmSecureCodingValidationRoutine: set at pre-compile, destination=DcmDspRoutine  # Refers to a routine control that triggers the secure coding validation and data update process.
      container DcmSecurityEventRefs [0..1]: multiplicity set at pre-compile  # Container for the references to IdsMEvent elements representing the security events that the Dcm module shall report to the IdsM in case the coresponding security related event occurs (and if DcmEnableSecurityEventReporting is set to "true"). The standardized security events in this container can be extended by vendor-specific security events. Tags: atp.Status=draft
        reference SEV_UDS_AUTHENTICATION_FAILED [0..1]: multiplicity set at pre-compile, set at pre-compile, requires-symbolic-name-value=true, destination=IdsMEvent  # Authentication (via Authentication SID 0x29) failed
        reference SEV_UDS_AUTHENTICATION_NEEDED [0..1]: multiplicity set at pre-compile, set at pre-compile, requires-symbolic-name-value=true, destination=IdsMEvent  # A diagnostic request was received while the required authentication to execute this service is not given. NRC 0x34 (authenticationRequired) was returned.
        reference SEV_UDS_AUTHENTICATION_SUCCESSFUL [0..1]: multiplicity set at pre-compile, set at pre-compile, requires-symbolic-name-value=true, destination=IdsMEvent  # Succesfully authenticated (via Authentication SID 0x29)
        reference SEV_UDS_CLEAR_DTC_FAILED [0..1]: multiplicity set at pre-compile, set at pre-compile, requires-symbolic-name-value=true, destination=IdsMEvent  # Clearing DTC information has been requested by SID 0x14 ClearDiagnosticInformation, but failed
        reference SEV_UDS_CLEAR_DTC_SUCCESSFUL [0..1]: multiplicity set at pre-compile, set at pre-compile, requires-symbolic-name-value=true, destination=IdsMEvent  # DTC information has been cleared by SID 0x14 ClearDiagnosticInformation
        reference SEV_UDS_COMMUNICATION_CONTROL_FAILED [0..1]: multiplicity set at pre-compile, set at pre-compile, requires-symbolic-name-value=true, destination=IdsMEvent  # The control of a communication has been requested by service SID 0x28 CommunicationControl, but failed
        reference SEV_UDS_COMMUNICATION_CONTROL_SUCCESSFUL [0..1]: multiplicity set at pre-compile, set at pre-compile, requires-symbolic-name-value=true, destination=IdsMEvent  # The control of a communication has been requested by service SID 0x28 CommunicationControl successfully
        reference SEV_UDS_CONTROL_DTC_SETTING_FAILED [0..1]: multiplicity set at pre-compile, set at pre-compile, requires-symbolic-name-value=true, destination=IdsMEvent  # Control of DTC setting has been requested by service SID 0x85 ControlDTCSetting, but failed
        reference SEV_UDS_CONTROL_DTC_SETTING_SUCCESSFUL [0..1]: multiplicity set at pre-compile, set at pre-compile, requires-symbolic-name-value=true, destination=IdsMEvent  # The control of a DTC setting has been requested by service SID 0x85 ControlDTCSetting successfully
        reference SEV_UDS_ECU_RESET_FAILED [0..1]: multiplicity set at pre-compile, set at pre-compile, requires-symbolic-name-value=true, destination=IdsMEvent  # ECU Reset has been requested by SID 0x11 ECUReset, but failed
        reference SEV_UDS_ECU_RESET_SUCCESSFUL [0..1]: multiplicity set at pre-compile, set at pre-compile, requires-symbolic-name-value=true, destination=IdsMEvent  # ECU has been reset by SID 0x11 ECUReset
        reference SEV_UDS_IO_CONTROL_FAILED [0..1]: multiplicity set at pre-compile, set at pre-compile, requires-symbolic-name-value=true, destination=IdsMEvent  # IOControl operation has been requested by service SID 0x2F InputOutputControlByIdentifier, but failed
        reference SEV_UDS_IO_CONTROL_SUCCESSFUL [0..1]: multiplicity set at pre-compile, set at pre-compile, requires-symbolic-name-value=true, destination=IdsMEvent  # IOControl operation has been requested by service SID 0x2F InputOutputControlByIdentifier successfully
        reference SEV_UDS_REQUEST_FILE_TRANSFER_FAILED [0..1]: multiplicity set at pre-compile, set at pre-compile, requires-symbolic-name-value=true, destination=IdsMEvent  # A file transfer sequence has been requested with SID 0x38, but failed
        reference SEV_UDS_REQUEST_FILE_TRANSFER_SUCCESSFUL [0..1]: multiplicity set at pre-compile, set at pre-compile, requires-symbolic-name-value=true, destination=IdsMEvent  # A file transfer sequence has been requested successfully with SID 0x38
        reference SEV_UDS_REQUEST_UP_DOWNLOAD_FAILED [0..1]: multiplicity set at pre-compile, set at pre-compile, requires-symbolic-name-value=true, destination=IdsMEvent  # An upload / download sequence has been requested with SID 0x34 or SID 0x35, but failed
        reference SEV_UDS_REQUEST_UP_DOWNLOAD_SUCCESSFUL [0..1]: multiplicity set at pre-compile, set at pre-compile, requires-symbolic-name-value=true, destination=IdsMEvent  # An upload / download sequence has been requested successfully with SID 0x34 or SID 0x35
        reference SEV_UDS_ROUTINE_CONTROL_FAILED [0..1]: multiplicity set at pre-compile, set at pre-compile, requires-symbolic-name-value=true, destination=IdsMEvent  # The control of a routine has been requested by service SID 0x31 RoutineControl, but failed
        reference SEV_UDS_ROUTINE_CONTROL_SUCCESSFUL [0..1]: multiplicity set at pre-compile, set at pre-compile, requires-symbolic-name-value=true, destination=IdsMEvent  # The control of a routine has been requested by service SID 0x31 RoutineControl successfully
        reference SEV_UDS_SECURITY_ACCESS_FAILED [0..1]: multiplicity set at pre-compile, set at pre-compile, requires-symbolic-name-value=true, destination=IdsMEvent  # Unlocking of the ECU (via Security Access SID 0x27) failed
        reference SEV_UDS_SECURITY_ACCESS_NEEDED [0..1]: multiplicity set at pre-compile, set at pre-compile, requires-symbolic-name-value=true, destination=IdsMEvent  # Tester has sent a diagnostic request without meeting the server's security level requirements for that service. NRC 0x33 (securityAccessDenied) was returned.
        reference SEV_UDS_SECURITY_ACCESS_SUCCESSFUL [0..1]: multiplicity set at pre-compile, set at pre-compile, requires-symbolic-name-value=true, destination=IdsMEvent  # Successful unlocked the ECU (via Security Access SID 0x27)
        reference SEV_UDS_WRITE_DATA_FAILED [0..1]: multiplicity set at pre-compile, set at pre-compile, requires-symbolic-name-value=true, destination=IdsMEvent  # Change of Diagnostic data identifier has been requested by SID 0x2E WriteDataByIdentifier, but failed
        reference SEV_UDS_WRITE_DATA_SUCCESSFUL [0..1]: multiplicity set at pre-compile, set at pre-compile, requires-symbolic-name-value=true, destination=IdsMEvent  # Diagnostic data identifier has been written by SID 0x2E WriteDataByIdentifier
        reference SEV_UDS_WRITE_MEMORY_FAILED [0..1]: multiplicity set at pre-compile, set at pre-compile, requires-symbolic-name-value=true, destination=IdsMEvent  # Writting of Data into memory has been requested by SID 0x3D WriteMemoryByAddress, but failed
        reference SEV_UDS_WRITE_MEMORY_SUCCESSFUL [0..1]: multiplicity set at pre-compile, set at pre-compile, requires-symbolic-name-value=true, destination=IdsMEvent  # Data has been written into memory by SID 0x3D WriteMemoryByAddress
