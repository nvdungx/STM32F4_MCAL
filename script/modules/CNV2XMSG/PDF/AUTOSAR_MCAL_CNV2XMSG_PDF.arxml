AUTOSAR XML (schema 00053)
package /AUTOSAR/EcucDefs
  ecuc definition collection AUTOSARParameterDefinition: module=CnV2xMsg
  module definition CnV2xMsg [0..1]: variants pre-compile  # Configuration of the CnV2xMsg module. Tags: atp.Status=draft
    container CnV2xMsgConfig  # This container contains the configuration parameters of the BSW module CnV2xMsg. Tags: atp.Status=draft
      boolean CnV2xMsgV2xDmServiceConfig: set at pre-compile, default-value=false  # Enable/disables the messages reception service via V2xDm. | - true: enabled (ON) - false: disabled (OFF)
      container CnV2xMsgDmMsgConfig [1..*]: multiplicity set at pre-compile  # This container contains the configuration of all messages that are passed on to the V2x Data Manager. Tags: atp.Status=draft
        enumeration CnV2xMsgDmAid [0..*]: multiplicity set at pre-compile, set at pre-compile  # When message is processed by the V2X Data Manager Tags: atp.Status=draft | (CnV2xMsgV2xDmServiceConfig is enabled), this configuration is used to indicate the type of message.
          CNV2XMSG_AID_DYNAMIC_RSI  # Tags: atp.Status=draft
          CNV2XMSG_AID_EMERGENCY_EVENTTRIGGERED_BSM  # Tags: atp.Status=draft
          CNV2XMSG_AID_EMERGENCY_REGULAR_BSM  # Tags: atp.Status=draft
          CNV2XMSG_AID_MAP  # Tags: atp.Status=draft
          CNV2XMSG_AID_NONEMERGENCY_EVENTTRIGGERED_BSM  # Tags: atp.Status=draft
          CNV2XMSG_AID_NONEMERGENCY_REGULAR_BSM  # Tags: atp.Status=draft
          CNV2XMSG_AID_RSM  # Tags: atp.Status=draft
          CNV2XMSG_AID_SEMIDYNAMIC_RSI  # Tags: atp.Status=draft
          CNV2XMSG_AID_SPAT  # Tags: atp.Status=draft
          CNV2XMSG_AID_STATIC_RSI  # Tags: atp.Status=draft
          CNV2XMSG_AID_V2X_TERMINAL_AFTERMARKET  # Tags: atp.Status=draft
    container CnV2xMsgGeneral  # This container contains the general configuration parameters of the AUTOSAR CnV2xMsg module. Tags: atp.Status=draft
      float CnV2xMsgBsmBsMainFunction: 0..1, set at pre-compile, default-value=0.1  # This parameter defines the schedule period of CnV2xMsg_BsmBs_MainFunction.Unit:[s] Tags: atp.Status=draft
      float Cnv2xMsgCRsiSMainFunction: 0..INF, set at pre-compile, default-value=0.1  # This parameter defines the schedule period of CnV2xMsg_RsiS_MainFunction.Unit:[s] Tags: atp.Status=draft
      boolean CnV2xMsgDevErrorDetect: set at pre-compile, default-value=false  # Switches the Default Error Tracer (Det) detection and notification ON or OFF. Tags: atp.Status=draft | - true: enabled (ON) - false: disabled (OFF)
      float CnV2xMsgMapSMainFunction: 0..INF, set at pre-compile, default-value=0.1  # This parameter defines the schedule period of CnV2xMsg_MapS_MainFunction.Unit:[s] Tags: atp.Status=draft
      float CnV2xMsgMgtMainFunction: 0..1, set at pre-compile, default-value=0.1  # This parameter defines the schedule period of CnV2xMsg_Mgt_MainFunction.Unit:[s] Tags: atp.Status=draft
      float CnV2xMsgRsmSMainFunction: 0..INF, set at pre-compile, default-value=0.1  # This parameter defines the schedule period of CnV2xMsg_RsmS_MainFunction.Unit:[s] Tags: atp.Status=draft
      float CnV2xMsgSpatSMainFunction: 0..INF, set at pre-compile, default-value=0.1  # This parameter defines the schedule period of CnV2xMsg_SpatS_MainFunction.Unit:[s] Tags: atp.Status=draft
      enumeration CnV2xMsgVehicleClass: set at pre-compile, default-value=CNV2XMSG_VC_UNKNOWN  # This configuration value defines the Vehicle Class information, Road Side Unit not supported by AUTOSAR. Tags: atp.Status=draft
        CNV2XMSG_VC_BUS  # Tags: atp.Status=draft
        CNV2XMSG_VC_EM_AMBULANCE  # Tags: atp.Status=draft
        CNV2XMSG_VC_EM_ENGINEERING  # Tags: atp.Status=draft
        CNV2XMSG_VC_EM_FIRETRUCK_HEAVY  # Tags: atp.Status=draft
        CNV2XMSG_VC_EM_FIRETRUCK_LIGHT  # Tags: atp.Status=draft
        CNV2XMSG_VC_EM_NURSING  # Tags: atp.Status=draft
        CNV2XMSG_VC_EM_POLICE_HEAVY  # Tags: atp.Status=draft
        CNV2XMSG_VC_EM_POLICE_LIGHT  # Tags: atp.Status=draft
        CNV2XMSG_VC_GOODS_LIGHT  # Tags: atp.Status=draft
        CNV2XMSG_VC_GOODS_SEMITRAILER  # Tags: atp.Status=draft
        CNV2XMSG_VC_PASSENGER  # Tags: atp.Status=draft
        CNV2XMSG_VC_SPECIAL  # Tags: atp.Status=draft
        CNV2XMSG_VC_UNKNOWN  # Tags: atp.Status=draft
      boolean CnV2xMsgVersionInfoApi: set at pre-compile, default-value=false  # Enable/disables the API for reading the version information of the CnV2xMsg Module. Tags: atp.Status=draft | - true: enabled (ON) - false: disabled (OFF)
      integer CnV2xMsgvMaxCurveRadius: 0..18446744073709551615, set at pre-compile, default-value=2500  # The maximum Curve Radius Tags: atp.Status=draft
      integer CnV2xMsgvMaxPHistDistance: 0..18446744073709551615, set at pre-compile, default-value=300  # The Maximum distance between the first and last path history point along the vehicle path), Unit:[m] Tags: atp.Status=draft
      integer CnV2xMsgvMaxPHistPoints: 0..18446744073709551615, set at pre-compile, default-value=15  # Maximum number of path history points in a BSM packet Tags: atp.Status=draft
      integer CnV2xMsgvMinCurveRadius: 0..18446744073709551615, set at pre-compile, default-value=100  # The minimum Curve Radius Tags: atp.Status=draft
      integer CnV2xMsgvMinPHistDistance: 0..18446744073709551615, set at pre-compile, default-value=200  # The Minimum distance between the first and last path history point along the vehicle path), Unit:[m] Tags: atp.Status=draft
      integer CnV2xMsgvPathPerpendicularDist: 0..18446744073709551615, set at pre-compile, default-value=200  # The perpendicular distance between any point on the vehicle path and the straight line connecting two adjacent path history points, unit:[m] Tags: atp.Status=draft
      integer CnV2xMsgvPPredRadiusError: 0..100, set at pre-compile, default-value=2  # The error from the actual radius, Unit:[%] Tags: atp.Status=draft
      float CnV2xMsgvPPredTransitionTime: set at pre-compile, default-value=4  # The transition time from a constant radius of curvature (R1) to a new constant radius of curvature (R2), unit: [s] Tags: atp.Status=draft
      integer CnV2xMsgvStationarySpeedThresh: 0..18446744073709551615, set at pre-compile, default-value=1  # The threshold of vehicle speed, unit:[m/s] Tags: atp.Status=draft
