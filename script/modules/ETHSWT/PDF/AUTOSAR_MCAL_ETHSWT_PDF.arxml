AUTOSAR XML (schema 00053)
package /AUTOSAR/EcucDefs
  ecuc definition collection AUTOSARParameterDefinition: module=EthSwt
  module definition EthSwt [0..*]: post-build-variant-support=true, variants link-time/post-build/pre-compile  # Configuration of the EthSwt (Ethernet Switch Driver) module.
    container EthSwtConfig [1..*]: multiplicity set at link in variant link-time / post-build in variant post-build / pre-compile in variant pre-compile, post-build-variant-multiplicity=true  # Configuration of one Ethernet Switch.
      float EthSwtArlTableEntryTimeout [0..1]: 1..65535, multiplicity set at pre-compile, set at pre-compile, default-value=300  # If present, this parameter specifies the timeout in seconds for removing unused entries from the ARL table of the Ethernet switch. If the parameter is not configured, entries are not removed automatically.
      boolean EthSwtClockSynchronizationSupport: post-build-variant-value=true, set at link in variant link-time / post-build in variant post-build / pre-compile in variant pre-compile, default-value=false  # This parameter defines, if a Ethernet switch shall enable clock synchronization with another Ethernet switch to which it is connected via uplink port. | If this parameter is set to TRUE the clock synchronization between connected Ethernet switches is activated and the clocks of the Ethernet switches are synchronized. If this parameter is set to FALSE the clock synchronization between connected Ethernet switches is deactivated. This parameter shall only be set to TRUE if the Ethernet switch hardware supports clock synchronization.
      boolean EthSwtDropDoubleTagged: post-build-variant-value=true, set at link in variant link-time / post-build in variant post-build / pre-compile in variant pre-compile, default-value=false  # This parameter defines if a switch shall drop double tagged (Q in Q) frames. | If this parameter is set to TRUE double tagged frames are dropped at all ports. If this parameter is set to FALSE, then double tagged frames are forwarded. If double tagging is used as a feature, this parameter must be set to FALSE. This parameter shall only be set to TRUE when Switch-HW supports the filtering of double tagged frames as filtering by SW is NOT possible!
      integer EthSwtIdx: 0..255, scope=ECU, set at pre-compile, symbolic-name-value=true, with-auto=true  # Specifies the instance ID of the configured Ethernet Switch.
      enumeration EthSwtMacAddressLearningMode: {IVL, SVL}, set at pre-compile, default-value=SVL  # Defines the MAC address learning mode specified by [7, IEEE802.1Q] either shared VLAN learning (SVL) or independent VLAN learning (IVL).
      integer EthSwtUsedInternalPriorityUpperValue: 0..4294967295, set at pre-compile, default-value=7  # Configure the upper value of the used internal priority range in the Ethernet switch. Tags: atp.Status=draft | The range of used internal priority values is defined from 0 to EthSwtUsedInternalPriorityUpperValue, where zero is the lowest and EthSwtUsedInternalPriorityUpperValue the highest internal priority value. Each priority is mapped to at least one traffic class.
      integer EthSwtUsedTrafficClassUpperValue: 0..65535, set at pre-compile, default-value=7  # Configure the upper value of the used traffic class range in the Ethernet switch. Tags: atp.Status=draft | The range of used traffic classes is defined from 0 to EthSwtUsedTrafficClassUpperValue. A traffic class is associated with exactly one egress queue at an egress port.
      reference EthSwtConfigEcucPartitionRef [0..1]: scope=ECU, multiplicity set at pre-compile, post-build-variant-multiplicity=true, post-build-variant-value=true, set at pre-compile, destination=EcucPartition  # Maps the configuration of one single Ethernet switch to zero or one ECUC partitions. The ECUC partition referenced is a subset of the ECUC partitions where the Ethernet switch driver is mapped to.
      reference EthSwtManagementEthCtrlRef [0..1]: multiplicity set at pre-compile, set at pre-compile, requires-symbolic-name-value=true, destination=EthCtrlConfig  # Reference to the Ethernet controller connected to the management port where the management frames will be transmitted/received.
      reference EthSwtManagementPortRef [0..1]: multiplicity set at pre-compile, set at pre-compile, destination=EthSwtPort  # Reference to the port where the management CPU is connected to.
      container EthSwtAtsGroupInstanceTable [0..1]: multiplicity set at link in variant link-time / post-build in variant post-build / pre-compile in variant pre-compile, post-build-variant-multiplicity=true  # Collection of AtsGroupInstanceEntrys. Tags: atp.Status=draft
        container EthSwtAtsGroupInstanceEntry [0..*]: multiplicity set at link in variant link-time / post-build in variant post-build / pre-compile in variant pre-compile, post-build-variant-multiplicity=true  # AtsGroupInstanceEntry. Tags: atp.Status=draft
          float EthSwtAtsGroupMaximumResidenceTime: 0..INF, post-build-variant-value=true, set at link in variant link-time / post-build in variant post-build / pre-compile in variant pre-compile  # The parameter defines the maximum duration limit for which frames can reside in a bridge in seconds. Tags: atp.Status=draft
      container EthSwtDemEventParameterRefs [0..1]: multiplicity set at pre-compile, post-build-variant-multiplicity=true  # Container for the references to DemEventParameter elements which shall be invoked using the API Dem_SetEventStatus in case the corresponding error occurs. The EventId is taken from the referenced DemEventParameter's DemEventId symbolic value. The standardized errors are provided in this container and can be extended by vendor-specific error references.
        reference ETHSWT_E_ACCESS [0..1]: multiplicity set at link in variant link-time / post-build in variant post-build / pre-compile in variant pre-compile, post-build-variant-multiplicity=true, post-build-variant-value=true, set at link in variant link-time / post-build in variant post-build / pre-compile in variant pre-compile, requires-symbolic-name-value=true, destination=DemEventParameter  # Reference to the DemEventParameter which shall be issued when the error "Ethernet Switch Access Failure" has occurred.
        reference ETHSWT_E_SYNCPORT2PHY [0..1]: multiplicity set at link in variant link-time / post-build in variant post-build / pre-compile in variant pre-compile, post-build-variant-multiplicity=true, post-build-variant-value=true, set at link in variant link-time / post-build in variant post-build / pre-compile in variant pre-compile, requires-symbolic-name-value=true, destination=DemEventParameter  # Reference to the DemEventParameter which shall be issued when the error "Ethernet switch port and the referenced Ethernet transceiver are in contradicting modes" has occurred.
      container EthSwtMacForwardingTable [0..*]: multiplicity set at link in variant link-time / post-build in variant post-build / pre-compile in variant pre-compile, post-build-variant-multiplicity=true  # Represents a MAC forwarding table.
        string EthSwtPredefinedMacAddress: scope=ECU, post-build-variant-value=true, set at link in variant link-time / post-build in variant post-build / pre-compile in variant pre-compile, max-length=17, min-length=17, regular-expression=([0-9a-fA-F]\{2}:)\{5}[0-9a-fA-F]\{2}  # Specifies a 48-bit physical addresses (MAC addresses) network byte order, which can be reached via the referenced port and if available via the referenced VLAN . Note that further addresses can be learned during runtime.
        reference EthSwtMacForwardingTablePortRef [1..255]: scope=ECU, multiplicity set at link in variant link-time / post-build in variant post-build / pre-compile in variant pre-compile, post-build-variant-multiplicity=true, post-build-variant-value=true, set at link in variant link-time / post-build in variant post-build / pre-compile in variant pre-compile, destination=EthSwtPort  # References the ports the MAC shall be assigned to.
        reference EthSwtVlanMembershipRef [0..4095]: multiplicity set at link in variant link-time / post-build in variant post-build / pre-compile in variant pre-compile, post-build-variant-multiplicity=true, post-build-variant-value=true, set at link in variant link-time / post-build in variant post-build / pre-compile in variant pre-compile, destination=EthSwtVlanMembership  # References the VLAN-IDs the MAC address shall be assigned to. Please note, this reference is used if EthSwtMacAddressLearningMode is set to IVL (independent VLAN learning).
      container EthSwtNvm [0..1]: multiplicity set at pre-compile, post-build-variant-multiplicity=true  # Configuration of one Ethernet Switch Nvm usage in case the module requires non volatile memory in the Ecu to store switch configuration.
        reference EthSwtConfigurationNvmBlockDescriptorRef: set at pre-compile, requires-symbolic-name-value=true, destination=NvMBlockDescriptor  # Reference to the Nvm block description in the Nvm module configuration to store e.g. the port mirror configurations
        reference EthSwtTableNvmBlockDescriptorRef: scope=ECU, post-build-variant-value=true, set at pre-compile, requires-symbolic-name-value=true, destination=NvMBlockDescriptor  # Reference to the Nvm block description in the Nvm module configuration to store e.g. the learned ARL table
      container EthSwtPSCM [0..1]: multiplicity set at link in variant link-time / post-build in variant post-build / pre-compile in variant pre-compile, post-build-variant-multiplicity=true  # Per stream classification and metering. Tags: atp.Status=draft
        container EthSwtAtsInstanceTable [0..1]: multiplicity set at pre-compile  # EthSwtAtsInstanceTable Tags: atp.Status=draft
          container EthSwtAtsInstanceEntry [0..*]: multiplicity set at link in variant link-time / post-build in variant post-build / pre-compile in variant pre-compile, post-build-variant-multiplicity=true  # Configuration of an Asynchronous Traffic Scheduler configuration in the scope of the PSFP. Tags: atp.Status=draft
            integer EthSwtPortATSCommitedBurstSize: 0..18446744073709551615, post-build-variant-value=true, set at link in variant link-time / post-build in variant post-build / pre-compile in variant pre-compile  # Maximum token capacity of the token bucket. Tags: atp.Status=draft
            integer EthSwtPortATSCommitedInformationRate: 0..18446744073709551615, post-build-variant-value=true, set at link in variant link-time / post-build in variant post-build / pre-compile in variant pre-compile  # Defines the rate at which the token bucket is refilled with tokens. Tags: atp.Status=draft
            reference EthSwtPortAtsSchedulerGroupRef: post-build-variant-value=true, set at link in variant link-time / post-build in variant post-build / pre-compile in variant pre-compile, destination=EthSwtAtsGroupInstanceEntry  # Defines to which ATS scheduler group this ATS scheduler belongs to. Tags: atp.Status=draft
        container EthSwtPSFP [0..1]: multiplicity set at pre-compile  # Configuration of Per-stream Filtering and Policing (PSFP). Tags: atp.Status=draft
          container EthSwtFilterMaxSduSizeTable [0..1]: multiplicity set at pre-compile  # EthSwtFilterMaxSduSizeTable represents a table of sdu size values, where each value (table entry) could be referenced by a EthSwtStreamFilterEntry. Tags: atp.Status=draft
            container EthSwtFilterMaxSduSizeEntry [1..*]: multiplicity set at link in variant link-time / post-build in variant post-build / pre-compile in variant pre-compile, post-build-variant-multiplicity=true  # EthSwtFilterMaxSduSizeEntry defines the maximum SDU size (size of an Ethernet packet) which is acceptable to be processed by the Ethernet switch. Tags: atp.Status=draft | The value of EthSwtFilterMaxSduSizeEntry consider the size of the following parts of an Ethernet packet: * Preamble (7 byte) * SFD (start of frame delimiter) (1 byte) * Ethernet frame (Dst MAC,Src MAC, VLAN-tag, TypeField, Payload, CRC Checksum) * Minimum IPG (inter package gap) (12 byte times).
              integer EthSwtFilterMaxSduSize: 84..2020, post-build-variant-value=true, set at link in variant link-time / post-build in variant post-build / pre-compile in variant pre-compile  # Max Sdu size. Tags: atp.Status=draft
          container EthSwtFlowMeteringTable [0..1]: multiplicity set at pre-compile  # EthSwtFlowMeteringTable represents a table of flowmeter configurations, where each flowmeter configuration (table entry) could be referenced by a EthSwtStreamFilterEntry. Tags: atp.Status=draft
            container EthSwtFlowMeteringEntry [1..*]: multiplicity set at link in variant link-time / post-build in variant post-build / pre-compile in variant pre-compile, post-build-variant-multiplicity=true  # Configuration of a flow metering. Tags: atp.Status=draft
              boolean EthSwtFlowMeterCF: post-build-variant-value=true, set at link in variant link-time / post-build in variant post-build / pre-compile in variant pre-compile  # Coupling Flag that defines if unused "green" tokens in the first bucket are transferred to the second bucket as "yellow" tokens. Tags: atp.Status=draft | Note: this parameter maps to IEEE802.1Q parameter "ieee8021PSFPFlowMeterCF".
              integer EthSwtFlowMeteringCBS: 0..255, post-build-variant-value=true, set at link in variant link-time / post-build in variant post-build / pre-compile in variant pre-compile  # Committed Burst Size (accepted burst size in green token bucket). Tags: atp.Status=draft | Note: this parameter maps to IEEE802.1Q parameter "ieee8021PSFPFlowMeterCBS".
              integer EthSwtFlowMeteringCIR: 0..4294967295, post-build-variant-value=true, set at link in variant link-time / post-build in variant post-build / pre-compile in variant pre-compile  # Committed Information Rate (accepted rate in green token bucket) in bits per second. Tags: atp.Status=draft | Note: this parameter maps to IEEE802.1Q parameter "ieee8021PSFPFlowMeterCIR".
              enumeration EthSwtFlowMeteringColorMode: post-build-variant-value=true, set at link in variant link-time / post-build in variant post-build / pre-compile in variant pre-compile  # Parameter that defines if color-aware or color-blind mode is used. The mode indicates if a color that might be assigned at ingress is used to chose the bucket from which to take tokens; only green and yellow can be assigned; basically, in color-blind mode, all frames are treated like green frames. Tags: atp.Status=draft | Note: this parameter maps to IEEE802.1Q parameter "ieee8021PSFPFlowMeterCM".
                ETHSWT_COLOR_AWARE  # Tags: atp.Status=draft
                ETHSWT_COLOR_BLIND  # Tags: atp.Status=draft
              integer EthSwtFlowMeteringEBS: 0..255, post-build-variant-value=true, set at link in variant link-time / post-build in variant post-build / pre-compile in variant pre-compile  # Excess burst size (accepted burst size in yellow token bucket). Tags: atp.Status=draft | Note: this parameter maps to IEEE802.1Q parameter "ieee8021PSFPFlowMeterEBS".
              integer EthSwtFlowMeteringEIR: 0..4294967295, post-build-variant-value=true, set at link in variant link-time / post-build in variant post-build / pre-compile in variant pre-compile  # Excess Information Rate (accepted rate in yellow token bucket) in bits per second. Tags: atp.Status=draft | Note: this parameter maps to IEEE802.1Q parameter "ieee8021PSFPFlowMeterEIR".
          container EthSwtStreamFilterTable [0..1]: multiplicity set at pre-compile  # EthSwtStreamFilterTable represents a table of stream filter configurations, where each stream filter configuration (table entry) could reference a EthSwtFilterMaxSduSizeEntry, EthSwtFlowMeteringEntry and EthSwtStreamGateEntry. Tags: atp.Status=draft
            container EthSwtStreamFilterEntry [1..*]: multiplicity set at link in variant link-time / post-build in variant post-build / pre-compile in variant pre-compile, post-build-variant-multiplicity=true  # This container represents a stream filter, where EthSwtStreamFilterPriority and EthSwtAssignedStreamHandle are used to detect a matching Ethernet frame. Tags: atp.Status=draft
              integer EthSwtStreamFilterEntryPosition: 0..65535, scope=ECU, post-build-variant-value=true, set at link in variant link-time / post-build in variant post-build / pre-compile in variant pre-compile  # Specifies the position as unique ID within an ordered list of EthSwtStreamFilterEntrys. The ordered list shall start with 0 and continue as linear list with no gaps. Tags: atp.Status=draft | Note: The list is processed in ascending order. The instance of EthSwtStreamFilterEntry with position 0 is processed first.
              integer EthSwtStreamFilterPriority: 0..7, post-build-variant-value=true, set at link in variant link-time / post-build in variant post-build / pre-compile in variant pre-compile  # This parameter represents an assigned priority of this stream filter, which is used to detect a matching Ethernet frame. Tags: atp.Status=draft
              reference EthSwtAtsInstanceEntryRef [0..1]: multiplicity set at link in variant link-time / post-build in variant post-build / pre-compile in variant pre-compile, post-build-variant-multiplicity=true, post-build-variant-value=true, set at link in variant link-time / post-build in variant post-build / pre-compile in variant pre-compile, destination=EthSwtAtsInstanceEntry  # Reference to an entry of an ATS table, where the entry represents a configuration for asynchronous traffic shaping. Tags: atp.Status=draft
              reference EthSwtFilterMaxSduSizeRef [0..1]: multiplicity set at link in variant link-time / post-build in variant post-build / pre-compile in variant pre-compile, post-build-variant-multiplicity=true, post-build-variant-value=true, set at link in variant link-time / post-build in variant post-build / pre-compile in variant pre-compile, destination=EthSwtFilterMaxSduSizeEntry  # Reference to an entry of a max-sdu-size table, where the entry represents a particular value. Tags: atp.Status=draft
              reference EthSwtFlowMeteringEntryRef [0..1]: multiplicity set at link in variant link-time / post-build in variant post-build / pre-compile in variant pre-compile, post-build-variant-multiplicity=true, post-build-variant-value=true, set at link in variant link-time / post-build in variant post-build / pre-compile in variant pre-compile, destination=EthSwtFlowMeteringEntry  # Reference to an entry of a flow metering table, where the entry represents a configuration for flow metering. Tags: atp.Status=draft
              reference EthSwtStreamGateEntryRef [0..1]: multiplicity set at pre-compile, post-build-variant-value=true, set at link in variant link-time / post-build in variant post-build / pre-compile in variant pre-compile, destination=EthSwtStreamGateEntry  # Reference to an entry of a gate table, where the entry represents a configuration for a gate. Tags: atp.Status=draft
              container EthSwtAssignedStreamHandle  # This container represents an assigned stream handle id of this stream filter, which is used to detect a matching Ethernet frame. The EthSwtAssignedStreamHandle could represent a list of assigned stream handle ids. Tags: atp.Status=draft | Additionally it could set a wildcard flag (EthSwtStreamHandleIdWildcard), where any assigned stream handle id carried by an Ethernet frame would match to this stream filter.
                integer EthSwtStreamHandleId [0..*]: 0..65535, multiplicity set at link in variant link-time / post-build in variant post-build / pre-compile in variant pre-compile, post-build-variant-multiplicity=true, post-build-variant-value=true, set at link in variant link-time / post-build in variant post-build / pre-compile in variant pre-compile  # Assigned stream handle id of this stream filter, which is used for evaluation of a matching Ethernet frame. Tags: atp.Status=draft
                boolean EthSwtStreamHandleIdWildcard: post-build-variant-value=true, set at link in variant link-time / post-build in variant post-build / pre-compile in variant pre-compile  # Defines whether this EthSwtAssignedStreamHandle includes the wildcard. Tags: atp.Status=draft
          container EthSwtStreamGateTable [0..1]: multiplicity set at pre-compile  # EthSwtStreamGateTable represents a table of stream gate configurations, where each stream gate configuration (table entry) could be referenced by a EthSwtStreamFilterEntry. Tags: atp.Status=draft
            container EthSwtStreamGateEntry [1..*]: multiplicity set at link in variant link-time / post-build in variant post-build / pre-compile in variant pre-compile, post-build-variant-multiplicity=true  # Configuration of a stream gate. Tags: atp.Status=draft
              integer EthSwtStreamGateIPV: 0..4294967295, post-build-variant-value=true, set at link in variant link-time / post-build in variant post-build / pre-compile in variant pre-compile  # Internal Priority Value (IPV), a priority value that determines the assigned traffic class. Tags: atp.Status=draft | Note: The upper value is limited by the configured used internal priority value of the this Ethernet switch (EthSwtUsedInternalPriorityUpperValue). The remaining value range shall be ignored.
      container EthSwtPort [1..*]: multiplicity set at link in variant link-time / post-build in variant post-build / pre-compile in variant pre-compile, post-build-variant-multiplicity=true  # Configuration of one Ethernet Switch Port.
        boolean EthSwtFramePreemptionEnable: post-build-variant-value=true, set at link in variant link-time / post-build in variant post-build / pre-compile in variant pre-compile, default-value=false  # Configures whether frame preemption for this EthSwtPort is enabled. Tags: atp.Status=draft | If the Ethernet switch hardware supports frame preemption and this parameter is set TRUE, then frame preemption for the corresponding EthSwtPort is enabled. If for some traffic class(es) EthSwtTrafficClassToPreemptionStatusAssignment at the egress port queue is additionally configured to ETHSWT_TRAFFIC_CLASS_PREEMPTABLE, then frame preemption for the respective traffic class(es) at the correponding EthSwtEgressPort is possible.
        integer EthSwtPortIdx: 0..255, scope=ECU, set at pre-compile, symbolic-name-value=true, with-auto=true  # Specifies the instance ID of the configured Ethernet Switch Port.
        integer EthSwtPortInterPacketGap [0..1]: 0..10000, multiplicity set at link in variant link-time+post-build / pre-compile in variant pre-compile, set at link in variant link-time+post-build / pre-compile in variant pre-compile, default-value=12  # This parameter defines the transmit Inter-Packet Gap (IPG) (also called interframe gap (IFG)) between transmitted Ethernet packets in "byte times". This parameter can only exist if the hardware and driver support setting the IPG.
        enumeration EthSwtPortMacLayerSpeed [0..1]: {ETH_MAC_LAYER_SPEED_100M, ETH_MAC_LAYER_SPEED_10G, ETH_MAC_LAYER_SPEED_10M, ETH_MAC_LAYER_SPEED_1G, ETH_MAC_LAYER_SPEED_2500M, ETH_MAC_LAYER_SPEED_5G}, scope=ECU, multiplicity set at link in variant link-time+post-build / pre-compile in variant pre-compile, post-build-variant-multiplicity=true, post-build-variant-value=true, set at link in variant link-time+post-build / pre-compile in variant pre-compile  # Defines the baud rate of the MAC layer.
        enumeration EthSwtPortMacLayerSubType [0..1]: {REDUCED, REVERSED, SERIAL, STANDARD, UNIVERSAL_SERIAL}, scope=ECU, multiplicity set at link in variant link-time+post-build / pre-compile in variant pre-compile, post-build-variant-multiplicity=true, post-build-variant-value=true, set at link in variant link-time+post-build / pre-compile in variant pre-compile  # Defines the MAC layer subtype of this EthSwtPort.
        enumeration EthSwtPortMacLayerType [0..1]: {ETHSWT_PORT_MAC_LAYER_TYPE_XGMII, ETHSWT_PORT_MAC_LAYER_TYPE_XMII, ETHSWT_PORT_MAC_LAYER_TYPE_XXGMII}, scope=ECU, multiplicity set at link in variant link-time+post-build / pre-compile in variant pre-compile, post-build-variant-multiplicity=true, post-build-variant-value=true, set at link in variant link-time+post-build / pre-compile in variant pre-compile  # Defines the MAC layer type of this EthSwtPort.
        enumeration EthSwtPortPhysicalLayerType [0..1]: {ETHSWT_PORT_10000BASE_T1, ETHSWT_PORT_1000BASE_T, ETHSWT_PORT_1000BASE_T1, ETHSWT_PORT_100BASE_T1, ETHSWT_PORT_100BASE_TX, ETHSWT_PORT_10BASE_T1S, ETHSWT_PORT_2500BASE_T1, ETHSWT_PORT_5000BASE_T1}, scope=ECU, multiplicity set at link in variant link-time+post-build / pre-compile in variant pre-compile, post-build-variant-multiplicity=true, post-build-variant-value=true, set at link in variant link-time+post-build / pre-compile in variant pre-compile  # Defines the physical layer type of this EthSwtPort.
        enumeration EthSwtPortRole [0..1]: {ETHSWT_HOST_PORT, ETHSWT_UP_LINK_PORT}, multiplicity set at link in variant link-time / post-build in variant post-build / pre-compile in variant pre-compile, post-build-variant-multiplicity=true, post-build-variant-value=true, set at link in variant link-time / post-build in variant post-build / pre-compile in variant pre-compile  # Set a special role of the Ethernet switch port. It is either a host port or a up link port. If not configured it is a standard port.
        boolean EthSwtPortTimeStampSupport: post-build-variant-value=true, set at link in variant link-time / post-build in variant post-build / pre-compile in variant pre-compile  # Enables/Disables the Switch-port specific timestamping.
        reference EthSwtPortTrcvRef [0..1]: scope=ECU, multiplicity set at link in variant link-time+post-build / pre-compile in variant pre-compile, post-build-variant-multiplicity=true, post-build-variant-value=true, set at link in variant link-time / post-build in variant post-build / pre-compile in variant pre-compile, requires-symbolic-name-value=true, destination=EthTrcvConfig  # Reference to the Ethernet transceiver driver this EthSwtPort is connected with.
        container EthSwtPortEgress  # Configuration of one Ethernet Switch Port Egress behavior.
          integer EthSwtPortDefaultTrafficClass: 0..65535, post-build-variant-value=true, set at link in variant link-time / post-build in variant post-build / pre-compile in variant pre-compile, default-value=1  # Represents the default traffic class assignment. All Ethernet frames, where the priority associated with this Ethernet frame is not available in a EthSwtPortTrafficClassAssignment of this egress port, are assigned to the default traffic class. Tags: atp.Status=draft
          reference EthSwtPortEgressLastSchedulerRef: post-build-variant-value=true, set at link in variant link-time / post-build in variant post-build / pre-compile in variant pre-compile, destination=EthSwtPortEgressScheduler  # Reference to the port scheduler which is the last in the egress port structure.
          container EthSwtPortEgressScheduler [1..*]: multiplicity set at link in variant link-time / post-build in variant post-build / pre-compile in variant pre-compile, post-build-variant-multiplicity=true  # Represents a Scheduler in the egress port.
            enumeration EthSwtPortSchedulerAlgorithm: {ETHSWT_SCHEDULER_ENHANCED_TRAFFIC_SHAPER, ETHSWT_SCHEDULER_STRICT_PRIORITY}, post-build-variant-value=true, set at link in variant link-time / post-build in variant post-build / pre-compile in variant pre-compile  # Defines the scheduler algorithm.
            container EthSwtPortEgressSchedulerPredecessor [1..*]: multiplicity set at link in variant link-time / post-build in variant post-build / pre-compile in variant pre-compile, post-build-variant-multiplicity=true  # Defines an ordered list of predecessors for this scheduler.
              integer EthSwtPortSchedulerPredecessorOrder: 0..18446744073709551615, scope=ECU, post-build-variant-value=true, set at link in variant link-time / post-build in variant post-build / pre-compile in variant pre-compile  # Defines the order of the scheduler predecessors. | This value has to be understood as a relative value, i.e. the value shows only the relative ordering of the elements. The highest value has the highest priority and gaps are allowed (not dense based). The values need to be unique within one EthSwtPortScheduler.
              choice reference EthSwtPortEgressPredecessorRef: post-build-variant-value=true, set at link in variant link-time / post-build in variant post-build / pre-compile in variant pre-compile, destination=[EthSwtPortEgressScheduler, EthSwtPortFifo, EthSwtPortQueue, EthSwtPortShaper]  # Choice reference to the scheduler predecessor.
          container EthSwtPortFifo [1..*]: multiplicity set at link in variant link-time / post-build in variant post-build / pre-compile in variant pre-compile, post-build-variant-multiplicity=true  # Represents a Fifo in the egress port. Tags: atp.Status=obsolete
            integer EthSwtPortEgressFifoIdx: 0..18446744073709551615, scope=ECU, post-build-variant-value=true, set at pre-compile  # Specifies the instance ID of the fifo of the configured Ethernet switch egress port Tags: atp.Status=obsolete
            integer EthSwtPortFifoMinimumLength [0..1]: 0..18446744073709551615, scope=ECU, multiplicity set at link in variant link-time / post-build in variant post-build / pre-compile in variant pre-compile, post-build-variant-multiplicity=true, post-build-variant-value=true, set at link in variant link-time / post-build in variant post-build / pre-compile in variant pre-compile  # FIFO minimum length in Byte. This assignment is used to configure a guaranteed size of a configured FIFO. Tags: atp.Status=obsolete
            integer EthSwtPortFifoTrafficClassAssignment [0..8]: 0..7, scope=ECU, post-build-variant-value=true, set at link in variant link-time / post-build in variant post-build / pre-compile in variant pre-compile  # Defines which traffic classes are assigned to this Fifo. Tags: atp.Status=obsolete
          container EthSwtPortPriorityToTrafficClassAssignment [1..65535]: multiplicity set at pre-compile  # Defines a priority based traffic class assignment. All Ethernet frames with a specific priority (EthSwtPortPriorityToTrafficClassAssignmentPriority) arriving at the egress side within the forwarding process, shall be assigned to the corresponding traffic class (EthSwtPortPriorityToTrafficClassAssignmentTrafficClass). Tags: atp.Status=draft
            integer EthSwtPortPriorityToTrafficClassAssignmentPriority: 0..4294967295, set at pre-compile  # Defines the priority derived from the Ethernet frame, which is used to determine the corresponding traffic class, where this Ethernet frame shall be assigned to. The upper value range is restricted to the configured value of EthSwtUsedInternalPriorityUpperValue. Tags: atp.Status=draft
            integer EthSwtPortPriorityToTrafficClassAssignmentTrafficClass: 0..65535, set at pre-compile  # Defines the traffic class value where an Ethernet frame, with the corresponding priority, is assigned to. The upper value range is restricted to the configured value of EthSwtUsedTrafficClassUpperValue. Tags: atp.Status=draft
          container EthSwtPortQueue [1..65535]: multiplicity set at link in variant link-time / post-build in variant post-build / pre-compile in variant pre-compile, post-build-variant-multiplicity=true  # Represents a Queue at the egress port. Tags: atp.Status=draft
            integer EthSwtPortEgressQueueIdx: 0..7, post-build-variant-value=true, set at link in variant link-time / post-build in variant post-build / pre-compile in variant pre-compile  # Specifies the instance ID of the queue of the configured Ethernet switch egress port. Tags: atp.Status=draft
            integer EthSwtPortQueueMinimumLength [0..1]: 0..18446744073709551615, multiplicity set at link in variant link-time / post-build in variant post-build / pre-compile in variant pre-compile, post-build-variant-multiplicity=true, post-build-variant-value=true, set at link in variant link-time / post-build in variant post-build / pre-compile in variant pre-compile  # Queue minimum length in Byte. This assignment is used to configure a guaranteed size Tags: atp.Status=draft | of a configured Queue.
            integer EthSwtPortQueueTrafficClassAssignment: 0..65535, post-build-variant-value=true, set at link in variant link-time / post-build in variant post-build / pre-compile in variant pre-compile  # Defines the traffic class where this egress port queue is assigned to. All Ethernet frames which arrive at the corresponding egress port are considered to be enqueued in this egress port queue, where the assigned traffic class of the Ethernet frame match to the assigned traffic class of this egress port queue. Tags: atp.Status=draft
            enumeration EthSwtTrafficClassToPreemptionStatusAssignment: post-build-variant-value=true, set at link in variant link-time / post-build in variant post-build / pre-compile in variant pre-compile, default-value=ETHSWT_TRAFFIC_CLASS_EXPRESS  # Defines the preemption status for the traffic class which is derived from the priority via EthSwtPortPriorityToTrafficClassAssignment. Tags: atp.Status=draft | If this parameter is set to ETHSWT_TRAFFIC_CLASS_PREEMPTABLE, then the Ethernet frames assigned to the corresponding traffic class could be preempted within the transmission process. If set to ETHSWT_TRAFFIC_CLASS_EXPRESS, then the Ethernet frames assigned to the corresponding traffic class will never be preempted.
              ETHSWT_TRAFFIC_CLASS_EXPRESS  # Tags: atp.Status=draft
              ETHSWT_TRAFFIC_CLASS_PREEMPTABLE  # Tags: atp.Status=draft
            container EthSwtPortEgressQueueTransmissionSelection  # Represents the transmission selection of an egress port queue. Tags: atp.Status=draft
              enumeration EthSwtPortEgressQueueTransmissionSelectionAlgorithm: post-build-variant-value=true, set at link in variant link-time / post-build in variant post-build / pre-compile in variant pre-compile, default-value=ETHSWT_TRANSMISSION_SELECTION_ALGORITHM_UNSHAPED  # Represents the transmission selection algorithm of an egress port queue. Tags: atp.Status=draft
                ETHSWT_TRANSMISSION_SELECTION_ALGORITHM_ATS  # Tags: atp.Status=draft
                ETHSWT_TRANSMISSION_SELECTION_ALGORITHM_CBS  # Tags: atp.Status=draft
                ETHSWT_TRANSMISSION_SELECTION_ALGORITHM_ETS  # Tags: atp.Status=draft
                ETHSWT_TRANSMISSION_SELECTION_ALGORITHM_UNSHAPED  # Tags: atp.Status=draft
              container EthSwtPortEgressQueueTransmissionSelectionCBSConfig [0..1]: multiplicity set at link in variant link-time / post-build in variant post-build / pre-compile in variant pre-compile, post-build-variant-multiplicity=true  # Represents the configuration of a credit based shaper transmission selection algorithm of an egress port queue. Tags: atp.Status=draft | This configuration is used if the EthSwtPortEgressQueueTransmissionSelectionAlgorithm is set to ETHSWT_TRANSMISSION_SELECTION_ALGORITHM_CBS.
                integer EthSwtPortEgressQueueCreditBasedShaperIdleSlope: 0..18446744073709551615, post-build-variant-value=true, set at link in variant link-time / post-build in variant post-build / pre-compile in variant pre-compile  # Defines the increase of credit in bits per second for the AVB shaper. Tags: atp.Status=draft | Note: this parameter maps to IEEE802.1Q parameter "ieee8021FqtssAdminIdleSlopeMs" and "ieee8021FqtssAdminIdleSlopeLs". Note: If the value exceeds the available bandwidth according the configured EthSwtPortPhysicalLayerType, the CBS becomes ineffective.
                integer EthSwtPortEgressQueueCreditBasedShaperLowerBoundary [0..1]: 0..18446744073709551615, multiplicity set at pre-compile, post-build-variant-value=true, set at link in variant link-time / post-build in variant post-build / pre-compile in variant pre-compile  # Defines the lower credit boundary for the Credit Based Shaper. Tags: atp.Status=draft
                integer EthSwtPortEgressQueueCreditBasedShaperUpperBoundary [0..1]: 0..18446744073709551615, multiplicity set at pre-compile, post-build-variant-value=true, set at link in variant link-time / post-build in variant post-build / pre-compile in variant pre-compile  # Defines the upper credit boundary for the Credit Based Shaper. Tags: atp.Status=draft
              container EthSwtPortEgressQueueTransmissionSelectionETSConfig [0..1]: multiplicity set at pre-compile  # Represents the configuration of an enhanced transmission selection algorithm of an egress port queue. This configuration is used if the EthSwtPortEgressQueueTransmissionSelectionAlgorithm is set to ETHSWT_SCHEDULER_ENHANCED_TRAFFIC_SHAPER. The subordinated configuration parameters allow to configure the ETS in different variants to support commonly used scheduler algorithms (e.g. weighted round robin). Tags: atp.Status=draft
                integer EthSwtETSConfigAvailableBandwidthInPercent [0..1]: 0..100, multiplicity set at pre-compile, set at pre-compile, default-value=30  # Represents the configuration of an enhanced transmission selection algorithm for one egress port queue, where the available bandwidth is configured in percent. The percent value represents the available bandwidth for emission opportunities to transmit Ethernet frames calculated in bits. Tags: atp.Status=draft | The resolution is 1%.
                integer EthSwtETSConfigAvailableBandwidthInWeightValue [0..1]: 1..255, multiplicity set at pre-compile, set at pre-compile, default-value=1  # Represents the configuration of an enhanced transmission selection algorithm of an egress port queue, where the available bandwidth is configured as weight value. The weight value represents the number of emission opportunities to transmit Ethernet frames. Tags: atp.Status=draft
          container EthSwtPortShaper [0..*]: multiplicity set at link in variant link-time / post-build in variant post-build / pre-compile in variant pre-compile, post-build-variant-multiplicity=true  # Represents a Shaper in the egress port. Tags: atp.Status=obsolete
            integer EthSwtPortShaperIdleSlope [0..1]: 0..18446744073709551615, post-build-variant-value=true, set at link in variant link-time / post-build in variant post-build / pre-compile in variant pre-compile  # Defines the increase of credit in bits per second for the AVB shaper. Tags: atp.Status=obsolete
            reference EthSwtPortEgressPredecessorFifoRef: post-build-variant-value=true, set at link in variant link-time / post-build in variant post-build / pre-compile in variant pre-compile, destination=EthSwtPortFifo  # Reference to the fifo which is the predecessor for this shaper. Tags: atp.Status=obsolete
        container EthSwtPortIngress  # Configuration of one Ethernet Switch Port ingress behavior.
          integer EthSwtPortIngressDefaultPriority [0..1]: 0..7, multiplicity set at link in variant link-time / post-build in variant post-build / pre-compile in variant pre-compile, post-build-variant-multiplicity=true, post-build-variant-value=true, set at link in variant link-time / post-build in variant post-build / pre-compile in variant pre-compile, default-value=0  # Default priority for ingress.
          integer EthSwtPortIngressDefaultVlan [0..1]: 0..4094, multiplicity set at link in variant link-time / post-build in variant post-build / pre-compile in variant pre-compile, post-build-variant-multiplicity=true, post-build-variant-value=true, set at link in variant link-time / post-build in variant post-build / pre-compile in variant pre-compile, default-value=1  # Default VLAN for ingress.
          boolean EthSwtPortIngressDropUntagged: post-build-variant-value=true, set at link in variant link-time / post-build in variant post-build / pre-compile in variant pre-compile, default-value=false  # Defines the ingress behavior for untagged frames.
          container EthSwtPortIngressScheduler [0..*]: multiplicity set at link in variant link-time / post-build in variant post-build / pre-compile in variant pre-compile, post-build-variant-multiplicity=true  # Represents a Scheduler configuration at an ingress port. Tags: atp.Status=draft
          container EthSwtPortIngressVlanTranslationTable  # This container defines 0..* entries of the form (IngressVlanID, TranslatedVlanID) that define the ingress Vlan translation. The IngressVlanID is the VlanID read from the incoming frame upon reception (ingress), which is replaced by the corresponding TranslatedVlanID upon ingress Vlan translation.
            container EthSwtPortIngressVlanTranslationTableEntry [0..*]: multiplicity set at link in variant link-time / post-build in variant post-build / pre-compile in variant pre-compile, post-build-variant-multiplicity=true  # This container defines the mapping between the IngressVlanID (VlanID read from the received frame upon ingress) and the corresponding TranslatedVlanID upon ingress Vlan translation.
              integer EthSwtIngressVlanId [0..1]: 0..4095, scope=ECU, multiplicity set at link in variant link-time / post-build in variant post-build / pre-compile in variant pre-compile, post-build-variant-multiplicity=true, post-build-variant-value=true, set at link in variant link-time / post-build in variant post-build / pre-compile in variant pre-compile  # Incoming VlanID from received frame.
              integer EthSwtTranslatedVlanId [0..1]: 0..4095, scope=ECU, multiplicity set at link in variant link-time / post-build in variant post-build / pre-compile in variant pre-compile, post-build-variant-multiplicity=true, post-build-variant-value=true, set at link in variant link-time / post-build in variant post-build / pre-compile in variant pre-compile  # Mapped VlanID after ingress Vlan translation.
          container EthSwtPortPolicer [0..32760]: multiplicity set at link in variant link-time / post-build in variant post-build / pre-compile in variant pre-compile, post-build-variant-multiplicity=true  # Definition of Rate Policing parameters. Tags: atp.Status=obsolete
            integer EthSwtPortRatePolicedByteCount: 1..18446744073709551615, post-build-variant-value=true, set at link in variant link-time / post-build in variant post-build / pre-compile in variant pre-compile  # Amount of Byte Counts (excluding Header information) which can be received in a configured EthSwtPortRatePolicedTimeInterval. Tags: atp.Status=obsolete
            integer EthSwtPortRatePolicedPriority [0..1]: 0..7, multiplicity set at link in variant link-time / post-build in variant post-build / pre-compile in variant pre-compile, post-build-variant-multiplicity=true, post-build-variant-value=true, set at link in variant link-time / post-build in variant post-build / pre-compile in variant pre-compile  # Defines the priority which this rate policy shall be limited on. If no priority is given this rate policy is not considering priority. Tags: atp.Status=obsolete
            float EthSwtPortRatePolicedTimeInterval: 0..INF, post-build-variant-value=true, set at link in variant link-time / post-build in variant post-build / pre-compile in variant pre-compile  # Time interval in seconds where a configured EthSwtPortRatePolicedByteCount can be received without a rate limitation. Tags: atp.Status=obsolete
            enumeration EthSwtPortRateViolationAction: post-build-variant-value=true, set at link in variant link-time / post-build in variant post-build / pre-compile in variant pre-compile  # Action to be taken when the rate policy criteria defined for this EthSwtPortPolicer are met. Tags: atp.Status=obsolete
              BLOCK_SOURCE  # Tags: atp.Status=obsolete
              DROP_FRAME  # Tags: atp.Status=obsolete
            reference EthSwtRateVlanMembershipRef [0..4095]: multiplicity set at link in variant link-time / post-build in variant post-build / pre-compile in variant pre-compile, post-build-variant-multiplicity=true, post-build-variant-value=true, set at link in variant link-time / post-build in variant post-build / pre-compile in variant pre-compile, destination=EthSwtVlanMembership  # References the Vlans this rate policy shall apply to. Tags: atp.Status=obsolete | If no EthSwtRateVlanMembershipRef is configured the rate policing applies only on the configured EthSwtPortRatePolicedPriority. This element is obsolete and will be removed in a future revision.
          container EthSwtPortPriorityRegeneration [8..8]: multiplicity set at pre-compile  # Defines a priority regeneration where the EthSwtPortPriorityRegenerationIngressPCP is replaced by EthSwtPortPriorityRegenerationRegeneratedPriority. | The EthSwtPortPriorityRegeneration is mandatory and shall always be available. An EthSwtPortPriorityRegeneration shall have 8 mappings, one for each priority. Rational: an Ethernet switch always performs a priority regeneration.
            integer EthSwtPortPriorityRegenerationIngressPCP: 0..7, scope=ECU, post-build-variant-value=true, set at link in variant link-time / post-build in variant post-build / pre-compile in variant pre-compile  # PCP (VLAN-priority) in the incoming message.
            integer EthSwtPortPriorityRegenerationRegeneratedPriority: 0..7, scope=ECU, post-build-variant-value=true, set at link in variant link-time / post-build in variant post-build / pre-compile in variant pre-compile  # Message priority the incoming message will be tagged with.
      container EthSwtSpi [0..1]: multiplicity set at pre-compile, post-build-variant-multiplicity=true  # Configuration of one Ethernet Switch SPI access (if SPI is used).
        container EthSwtSpiSequence [1..*]: multiplicity set at pre-compile, post-build-variant-multiplicity=true  # Container gives EthSwt driver information about one SPI sequence. | One SPI sequence used by EthSwt driver is in exclusive use for it. No other driver is allowed to access this sequence. EthSwt driver may use one sequence to access n EthSwt hardware chips of the same type or n sequences are used to access one single EthSwt hardware chip. If a EthSwt hardware has no SPI interface, there is no instance of this container.
          boolean EthSwtSpiAccessSynchronous [0..1]: scope=ECU, multiplicity set at pre-compile, post-build-variant-multiplicity=true, post-build-variant-value=true, set at pre-compile  # This parameter is used to define whether the access to the Spi sequence is synchronous or asynchronous. | true: SPI access is synchronous. false: SPI access is asynchronous.
          reference EthSwtSpiSequenceName [0..*]: scope=ECU, multiplicity set at pre-compile, post-build-variant-multiplicity=true, post-build-variant-value=true, set at pre-compile, requires-symbolic-name-value=true, destination=SpiSequence  # Reference to a Spi sequence configuration container.
      container EthSwtStreamIdentificationTable [0..1]: multiplicity set at link in variant link-time / post-build in variant post-build / pre-compile in variant pre-compile, post-build-variant-multiplicity=true  # Configuration of a stream identification table. Tags: atp.Status=draft
        container EthSwtStreamIdentificationEntry [0..*]: multiplicity set at link in variant link-time / post-build in variant post-build / pre-compile in variant pre-compile, post-build-variant-multiplicity=true  # Configuration of a stream identification. Tags: atp.Status=draft
          integer EthSwtStreamHandleAssignment: 0..65535, post-build-variant-value=true, set at link in variant link-time / post-build in variant post-build / pre-compile in variant pre-compile  # Assigment of this stream identification to an stream filter entry. Tags: atp.Status=draft
          integer EthSwtStreamIdentificationPosition: 0..65535, scope=ECU, post-build-variant-value=true, set at link in variant link-time / post-build in variant post-build / pre-compile in variant pre-compile  # Specifies the position as unique ID within an ordered list of EthSwtStreamIdentificationEntrys. The ordered list shall start with 0 and continue as linear list with no gaps. Tags: atp.Status=draft | Note: The list is processed in ascending order. The instance of EthSwtStreamIdentificationEntry with position 0 is processed first.
          reference EthSwtPortEgressStreamIdentificationEgressPortRef [0..*]: multiplicity set at link in variant link-time / post-build in variant post-build / pre-compile in variant pre-compile, post-build-variant-multiplicity=true, post-build-variant-value=true, set at link in variant link-time / post-build in variant post-build / pre-compile in variant pre-compile, destination=EthSwtPortEgress  # Reference to the egress ports this stream identification applies to. Tags: atp.Status=draft
          reference EthSwtStreamIdentificationIngressPortRef [0..*]: multiplicity set at link in variant link-time / post-build in variant post-build / pre-compile in variant pre-compile, post-build-variant-multiplicity=true, post-build-variant-value=true, set at link in variant link-time / post-build in variant post-build / pre-compile in variant pre-compile, destination=EthSwtPortIngress  # Reference to the ingress ports this stream identification applies to. Tags: atp.Status=draft
          container EthSwtStreamFilterAction [0..1]: multiplicity set at link in variant link-time / post-build in variant post-build / pre-compile in variant pre-compile, post-build-variant-multiplicity=true  # Configuration of a stream filter action. Tags: atp.Status=draft
            boolean EthSwtStreamFilterActionBlockSource: post-build-variant-value=true, set at link in variant link-time / post-build in variant post-build / pre-compile in variant pre-compile  # Enables Blocking all frames from the MAC address. Tags: atp.Status=draft
            boolean EthSwtStreamFilterActionDropFrame: post-build-variant-value=true, set at link in variant link-time / post-build in variant post-build / pre-compile in variant pre-compile  # Enables Drop Frame action. Tags: atp.Status=draft
            container EthSwtStreamFilterActionDestinationPortModification [0..1]: multiplicity set at link in variant link-time / post-build in variant post-build / pre-compile in variant pre-compile, post-build-variant-multiplicity=true  # Defines the action to modify the destination port(s) determined by the frame forwarding process for an particular Ethernet frame. Either the egress destination of an Ethernet frame is extended or overwritten. Tags: atp.Status=draft
              enumeration EthSwtStreamFilterActionDestinationPortModificationType: post-build-variant-value=true, set at link in variant link-time / post-build in variant post-build / pre-compile in variant pre-compile  # Defines the method to modify the egress destination. Either overwrite or extend the egress destination. Tags: atp.Status=draft
                ETHSWT_STREAM_EGRESS_DESTINATION_EXTEND  # Tags: atp.Status=draft
                ETHSWT_STREAM_EGRESS_DESTINATION_LIMIT  # Tags: atp.Status=draft
                ETHSWT_STREAM_EGRESS_DESTINATION_OVERWRITE  # Tags: atp.Status=draft
              reference EthSwtStreamFilterActionDestinationPortModificationEgressPortRef [1..*]: multiplicity set at link in variant link-time / post-build in variant post-build / pre-compile in variant pre-compile, post-build-variant-multiplicity=true, post-build-variant-value=true, set at link in variant link-time / post-build in variant post-build / pre-compile in variant pre-compile, destination=EthSwtPortEgress  # Defines a set of destination ports (egress ports) used for the modification of the egress destination of an Ethernet frame. Tags: atp.Status=draft
            container EthSwtStreamFilterActionVlanModification [0..1]: multiplicity set at link in variant link-time / post-build in variant post-build / pre-compile in variant pre-compile, post-build-variant-multiplicity=true  # Defines the action to modify the VLAN-ID within a VLAN-tag of an Ethernet frame. Tags: atp.Status=draft
              integer EthSwtStreamFilterActionVlanModificationVlanId: 0..4094, post-build-variant-value=true, set at link in variant link-time / post-build in variant post-build / pre-compile in variant pre-compile  # Defines the VLAN-ID to modify the existing VLAN-ID within the VLAN-tag of an Ethernet frame. Tags: atp.Status=draft
          container EthSwtStreamFilterRule  # Configuration of a filter rule. Tags: atp.Status=draft
            integer EthSwtStreamFilterEtherType [0..*]: 0..65535, multiplicity set at pre-compile, set at pre-compile  # Definition of the filter Ether Type. Tags: atp.Status=draft
            integer EthSwtStreamFilterVlanId [0..*]: 0..4094, multiplicity set at pre-compile, set at pre-compile  # Definition of the filter VLAN-ID. Tags: atp.Status=draft
            integer EthSwtStreamFilterVlanPriority [0..*]: 0..7, multiplicity set at pre-compile, set at pre-compile  # Definition of the filter VLAN Priority. Tags: atp.Status=draft
            container EthSwtStreamFilterIEEE1722StreamId [0..1]: post-build-variant-multiplicity=true  # Definition of the filter IEEE1722 Stream Id. Specifies a 64 bit Stream Id. Please note: According to IEEE802.1Q specification, the 48 most significant bits represents a source MAC address and the 16 least significant bits a unique id. AUTOSAR deviates from this definition and allow to have any kind of MAC address (e.g. source or destination or MAC multicast address)
              string EthSwtStreamFilterStreamMacId: post-build-variant-value=true, set at link in variant link-time / post-build in variant post-build / pre-compile in variant pre-compile, max-length=17, min-length=17, regular-expression=([0-9a-fA-F]{2}:){5}[0-9a-fA-F]{2}  # Specifies the 48-bit physical address (MAC address) part of the IEEE1722 Stream Id.
              integer EthSwtStreamFilterStreamUniqueId: 0..65535, multiplicity set at pre-compile, post-build-variant-value=true, set at link in variant link-time / post-build in variant post-build / pre-compile in variant pre-compile, default-value=0  # Specifies the 16-bit unique part of the IEEE1722 Stream Id.
            container EthSwtStreamFilterIPDestAddress [0..*]: multiplicity set at link in variant link-time / post-build in variant post-build / pre-compile in variant pre-compile, post-build-variant-multiplicity=true  # Configuration of one IP destination filter. Tags: atp.Status=draft
              string EthSwtStreamFilterIPAddressKey: post-build-variant-value=true, set at link in variant link-time / post-build in variant post-build / pre-compile in variant pre-compile  # IP address key pattern. Tags: atp.Status=draft
              string EthSwtStreamFilterIPAddressMask: post-build-variant-value=true, set at link in variant link-time / post-build in variant post-build / pre-compile in variant pre-compile  # IP address mask pattern. Tags: atp.Status=draft
            container EthSwtStreamFilterIPSrcAddress [0..*]: multiplicity set at link in variant link-time / post-build in variant post-build / pre-compile in variant pre-compile, post-build-variant-multiplicity=true  # Configuration of one IP source filter. Tags: atp.Status=draft
              string EthSwtStreamFilterIPAddressKey: post-build-variant-value=true, set at link in variant link-time / post-build in variant post-build / pre-compile in variant pre-compile  # IP address key pattern. Tags: atp.Status=draft
              string EthSwtStreamFilterIPAddressMask: post-build-variant-value=true, set at link in variant link-time / post-build in variant post-build / pre-compile in variant pre-compile  # IP address mask pattern. Tags: atp.Status=draft
            container EthSwtStreamFilterMACDestAddress [0..*]: multiplicity set at link in variant link-time / post-build in variant post-build / pre-compile in variant pre-compile, post-build-variant-multiplicity=true  # Configuration of one MAC destination filter. Tags: atp.Status=draft
              string EthSwtStreamFilterMACAddressKey: post-build-variant-value=true, set at link in variant link-time / post-build in variant post-build / pre-compile in variant pre-compile, max-length=17, min-length=17, regular-expression=([0-9a-fA-F]\{2}:)\{5}[0-9a-fA-F]\{2}  # Specifies the 48-bit physical address (MAC address) key value. Tags: atp.Status=draft
              string EthSwtStreamFilterMACAddressMask: post-build-variant-value=true, set at link in variant link-time / post-build in variant post-build / pre-compile in variant pre-compile, max-length=17, min-length=17, regular-expression=([0-9a-fA-F]\{2}:)\{5}[0-9a-fA-F]\{2}  # Specifies the 48-bit physical address (MAC address) mask value. Tags: atp.Status=draft
            container EthSwtStreamFilterMACSrcAddress [0..*]: multiplicity set at link in variant link-time / post-build in variant post-build / pre-compile in variant pre-compile, post-build-variant-multiplicity=true  # Configuration of one MAC source filter. Tags: atp.Status=draft
              string EthSwtStreamFilterMACAddressKey: post-build-variant-value=true, set at link in variant link-time / post-build in variant post-build / pre-compile in variant pre-compile, max-length=17, min-length=17, regular-expression=([0-9a-fA-F]\{2}:)\{5}[0-9a-fA-F]\{2}  # Specifies the 48-bit physical address (MAC address) key value. Tags: atp.Status=draft
              string EthSwtStreamFilterMACAddressMask: post-build-variant-value=true, set at link in variant link-time / post-build in variant post-build / pre-compile in variant pre-compile, max-length=17, min-length=17, regular-expression=([0-9a-fA-F]\{2}:)\{5}[0-9a-fA-F]\{2}  # Specifies the 48-bit physical address (MAC address) mask value. Tags: atp.Status=draft
            container EthSwtStreamFilterTcpDestPort [0..*]: multiplicity set at link in variant link-time / post-build in variant post-build / pre-compile in variant pre-compile, post-build-variant-multiplicity=true  # Configuration of a TCP destination port filter. Tags: atp.Status=draft
              integer EthSwtStreamFilterPortLowerValue: 0..65535, set at pre-compile  # Definition of the filter port lower value. Tags: atp.Status=draft
              integer EthSwtStreamFilterPortUpperValue: 0..65535, set at pre-compile  # Definition of the filter port upper value. Tags: atp.Status=draft
            container EthSwtStreamFilterTcpSrcPort [0..*]: multiplicity set at link in variant link-time / post-build in variant post-build / pre-compile in variant pre-compile, post-build-variant-multiplicity=true  # Configuration of a TCP source port filter. Tags: atp.Status=draft
              integer EthSwtStreamFilterPortLowerValue: 0..65535, set at pre-compile  # Definition of the filter port lower value. Tags: atp.Status=draft
              integer EthSwtStreamFilterPortUpperValue: 0..65535, set at pre-compile  # Definition of the filter port upper value. Tags: atp.Status=draft
            container EthSwtStreamFilterUdpDestPort [0..*]: multiplicity set at link in variant link-time / post-build in variant post-build / pre-compile in variant pre-compile, post-build-variant-multiplicity=true  # Configuration of a UDP destination port filter. Tags: atp.Status=draft
              integer EthSwtStreamFilterPortLowerValue: 0..65535, set at pre-compile  # Definition of the filter port lower value. Tags: atp.Status=draft
              integer EthSwtStreamFilterPortUpperValue: 0..65535, set at pre-compile  # Definition of the filter port upper value. Tags: atp.Status=draft
            container EthSwtStreamFilterUdpSrcPort [0..*]: multiplicity set at link in variant link-time / post-build in variant post-build / pre-compile in variant pre-compile, post-build-variant-multiplicity=true  # Configuration of a UDP source port filter. Tags: atp.Status=draft
              integer EthSwtStreamFilterPortLowerValue: 0..65535, set at pre-compile  # Definition of the filter port lower value. Tags: atp.Status=draft
              integer EthSwtStreamFilterPortUpperValue: 0..65535, set at pre-compile  # Definition of the filter port upper value. Tags: atp.Status=draft
      container EthSwtUnknownMacDestAddressConfig [1..*]: multiplicity set at link in variant link-time / post-build in variant post-build / pre-compile in variant pre-compile, post-build-variant-multiplicity=true  # Definition to which EthSwtPorts an Ethernet frame shall be forwarded if the destination MAC address is not present in the address resolution lookup (ARL) table.
        reference EthSwtDestPortsForUnknownMulticastMacDestAddressRef [0..255]: scope=ECU, multiplicity set at link in variant link-time / post-build in variant post-build / pre-compile in variant pre-compile, post-build-variant-multiplicity=true, post-build-variant-value=true, set at link in variant link-time / post-build in variant post-build / pre-compile in variant pre-compile, destination=EthSwtPort  # This parameter specifies the egress ports frames with unknown multicast MAC destination addresses (without a matching ARL entry) are forwarded on. | Note that "Drop Unknown Multicast" behavior can be achieved by not referencing any EthSwtPort.
        reference EthSwtDestPortsForUnknownUnicastMacDestAddressRef [0..255]: scope=ECU, multiplicity set at link in variant link-time / post-build in variant post-build / pre-compile in variant pre-compile, post-build-variant-multiplicity=true, post-build-variant-value=true, set at link in variant link-time / post-build in variant post-build / pre-compile in variant pre-compile, destination=EthSwtPort  # This parameter specifies the egress ports frames with unknown unicast MAC destination addresses (without a matching ARL entry) are forwarded on. | Note that "Flooding" can be achieved by referencing all EthSwtPorts.
        reference EthSwtDestVlanForUnknownMacDestAddressRef [0..4095]: scope=ECU, multiplicity set at link in variant link-time / post-build in variant post-build / pre-compile in variant pre-compile, post-build-variant-multiplicity=true, post-build-variant-value=true, set at link in variant link-time / post-build in variant post-build / pre-compile in variant pre-compile, destination=EthSwtVlanMembership  # Optional reference to a set of VLANs to define that the owning EthSwtUnknownMacDestAddressConfig is applicable for these VLANs only.
      container EthSwtVlanMembership [0..4095]: multiplicity set at link in variant link-time / post-build in variant post-build / pre-compile in variant pre-compile, post-build-variant-multiplicity=true  # Determines the membership of this Ethernet switch and the referenced ports to the virtual network, i.e. frames with this VID can be received and transmitted via the referenced ports.
        integer EthSwtVlanMembershipId: 0..4094, scope=ECU, post-build-variant-value=true, set at link in variant link-time / post-build in variant post-build / pre-compile in variant pre-compile  # Determines the VID of the virtual network this port belongs to.
        container EthSwtVlanMembershipPortRefEntry [0..255]: multiplicity set at link in variant link-time / post-build in variant post-build / pre-compile in variant pre-compile, post-build-variant-multiplicity=true  # Determines the VLAN membership of one referenced ports to the virtual network and the according forwarding type (NOT_SENT, SENT_UNTAGGED, SENT_TAGGED).
          enumeration EthSwtVlanForwardingType: {ETHSWT_NOT_SENT, ETHSWT_SENT_TAGGED, ETHSWT_SENT_UNTAGGED}, scope=ECU, post-build-variant-value=true, set at link in variant link-time / post-build in variant post-build / pre-compile in variant pre-compile  # Defines how the message with a specific VLAN-ID at the referenced port shall be handled.
          reference EthSwtVlanMembershipPortRef: scope=ECU, post-build-variant-value=true, set at link in variant link-time / post-build in variant post-build / pre-compile in variant pre-compile, destination=EthSwtPort  # Reference to one port the VLAN shall be assigned to.
    container EthSwtGeneral  # General configuration of Ethernet Switch Driver module.
      boolean EthSwtCheckWakeupApi: set at pre-compile  # Enables / Disables EthSwt_CheckWakeup API.
      boolean EthSwtDeletePortMirrorConfigurationApi: set at pre-compile  # Enables / Disables EthSwt_DeletePortMirrorConfiguration API
      boolean EthSwtDevErrorDetect: set at pre-compile, default-value=false  # Switches the development error detection and notification on or off. | * true: detection and notification is enabled. * false: detection and notification is disabled.
      boolean EthSwtEnableCableDiagnosticApi: set at pre-compile  # Enable/disable the APIs for cable diagnostic: EthSwt_RunPortCableDiagnostic, EthSwt_GetPortCableDiagnosticsResult
      boolean EthSwtEnableVlanApi: set at pre-compile  # Enables / Disables EthSwt_EnableVLAN API.
      boolean EthSwtGetArlTableApi: set at pre-compile  # Enables / Disables EthSwt_GetArlTable API.
      boolean EthSwtGetBaudRateApi: set at pre-compile  # Enables / Disables EthSwt_GetBaudRate API
      function name EthSwtGetCfgDataRawDone [0..1]: multiplicity set at pre-compile, set at pre-compile  # Defines the function name for <GetCfgDataRawDone>
      boolean EthSwtGetCfgRaw: set at pre-compile  # Disable /Enable support of reading raw data from switch memory
      boolean EthSwtGetCounterValuesApi: set at pre-compile  # Enables / Disables EthSwt_GetCounterValues API
      boolean EthSwtGetDuplexModeApi: set at pre-compile  # Enables / Disables EthSwt_GetDuplexMode API
      boolean EthSwtGetLinkStateApi: set at pre-compile  # Enables / Disables EthSwt_GetLinkState API
      boolean EthSwtGetMacLearningModeApi: set at pre-compile  # Enables / Disables EthSwt_GetMacLearningMode API.
      boolean EthSwtGetMaxQueueBufferFillLevelApi: set at pre-compile  # Enables / Disables EthSwt_GetMaxQueueBufferFillLevel API.
      boolean EthSwtGetPortCableDiagnosticsResultApi: set at pre-compile  # Enables / Disables EthSwt_GetPortCableDiagnosticsResult API
      boolean EthSwtGetPortIdentifierApi: set at pre-compile  # Enables / Disables EthSwt_GetPortIdentifier API
      boolean EthSwtGetPortMacAddrApi: set at pre-compile  # Enables / Disables EthSwt_GetPortMacAddr API.
      boolean EthSwtGetPortMacAddrVlanApi [0..1]: multiplicity set at pre-compile, set at pre-compile  # Enables / Disables EthSwt_GetPortMacAddrVlan API.
      boolean EthSwtGetPortMirrorStateApi: set at pre-compile  # Enables / Disables EthSwt_GetPortMirrorState API
      boolean EthSwtGetPortSignalQualityApi: set at pre-compile  # Enables / Disables EthSwt_GetPortSignalQuality API
      boolean EthSwtGetRxStatsApi: set at pre-compile  # Enables / Disables EthSwt_GetRxStats API.
      boolean EthSwtGetSwitchIdentifierApi: set at pre-compile  # Enables / Disables EthSwt_GetSwitchIdentifier API
      boolean EthSwtGetSwitchPortModeApi: set at pre-compile  # Enables / Disables EthSwt_GetSwitchPortMode API
      boolean EthSwtGetSwitchPortWakeupReasonApi: set at pre-compile  # Enables / Disables EthSwt_GetSwitchPortWakeupReason API.
      boolean EthSwtGetSwitchRegApi: set at pre-compile  # Enables / Disables EthSwt_GetSwitchReg API.
      boolean EthSwtGetTxErrorCounterValuesApi: set at pre-compile, default-value=false  # Enables/Disables Eth_GetTxErrorCounterValues API.
      boolean EthSwtGetTxStatsApi: set at pre-compile, default-value=false  # Enables/Disables Eth_GetTxStats API.
      boolean EthSwtGlobalTimeSupportApi: set at pre-compile  # Enables/Disables the Global Time APIs used amongst others by Global Time Synchronization over Ethernet.
      integer EthSwtIndex: 0..255, set at pre-compile  # Specifies the InstanceId of this module instance. If only one instance is present it shall have the Id 0.
      function name EthSwtLinkDownCallout [0..1]: multiplicity set at pre-compile, set at pre-compile  # Defines the function name for the <EthSwtLinkDownCallout> callout.
      function name EthSwtLinkUpCallout [0..1]: multiplicity set at pre-compile, set at pre-compile  # Defines the function name for the <EthSwtLinkUpCallout> callout.
      boolean EthSwtLowPowerModeSupport [0..1]: multiplicity set at pre-compile, set at pre-compile, default-value=false  # Disable / Enable support of low power mode.
      float EthSwtMainFunctionPeriod: 0..INF, set at pre-compile  # The cycle time of the periodic main function of EthSwt. Defined in seconds .
      boolean EthSwtManagementSupportApi: set at pre-compile  # Enables/Disables the Switch management APIs to support a Switch-port specific communication attribute access.
      boolean EthSwtPersistentConfigurationResult: set at pre-compile  # Enables / Disables the callback API <User>_PersistentConfigurationResult.
      function name EthSwtPersistentConfigurationResultCallback [0..1]: multiplicity set at pre-compile, set at pre-compile  # Defines the function name for <EthSwtPersistentConfigurationResultCallback>.
      string EthSwtPublicCddHeaderFile [0..*]: multiplicity set at pre-compile, set at pre-compile, max-length=32, min-length=1  # Defines header files for callback functions which shall be included in case of CDDs.
      boolean EthSwtReadMmdApi: set at pre-compile, default-value=false  # Enables/Disables EthSwt_ReadMmd
      boolean EthSwtReadPortMirrorConfigurationApi: set at pre-compile  # Enables / Disables EthSwt_ReadPortMirrorConfiguration API
      boolean EthSwtReadTrcvRegisterApi: set at pre-compile  # Enables / Disables EthSwt_ReadTrcvRegister API.
      boolean EthSwtResetConfigurationApi: set at pre-compile  # Enables / Disables EthSwt_ResetConfiguration API.
      boolean EthSwtSetForwardingModeApi: set at pre-compile, default-value=false  # Enables /disables EthSwt_SetForwardingMode API.
      boolean EthSwtSetMacLearningModeApi: set at pre-compile  # Enables / Disables EthSwt_SetMacLearningMode API.
      boolean EthSwtSetPortLoopbackModeApi: set at pre-compile  # Enables / Disables EthSwt_SetPortLoopbackModeApi API
      boolean EthSwtSetPortMirrorStateApi: set at pre-compile  # Enables / Disables EthSwt_SetPortMirrorState API
      boolean EthSwtSetPortTestModeApi: set at pre-compile  # Enables / Disables EthSwt_SetPortTestMode API
      boolean EthSwtSetPortTxModeApi: set at pre-compile  # Enables / Disables EthSwt_SetPortTxModeApi API
      boolean EthSwtSetSwitchPortModeApi: set at pre-compile  # Enables / Disables EthSwt_SetSwitchPortMode API
      boolean EthSwtSetSwitchRegApi: set at pre-compile  # Enables / Disables EthSwt_SetSwitchReg API.
      boolean EthSwtStartSwitchPortAutoNegotiationApi: set at pre-compile  # Enables / Disables EthSwt_StartSwitchPortAutoNegotiation API
      boolean EthSwtStoreConfigurationApi: set at pre-compile  # Enables / Disables EthSwt_StoreConfiguration API.
      boolean EthSwtVerifyConfigApi: set at pre-compile, default-value=false  # Enables /disables EthSwt_VerifyConfig API.
      boolean EthSwtVersionInfoApi: set at pre-compile, default-value=false  # Enables / Disables version info API.
      boolean EthSwtWriteMmdApi: set at pre-compile, default-value=false  # Enables/Disables EthSwt_WriteMmd
      boolean EthSwtWritePortMirrorConfigurationApi: set at pre-compile  # Enables / Disables EthSwt_WritePortMirrorConfiguration API
      boolean EthSwtWriteTrcvRegisterApi: set at pre-compile  # Enables / Disables EthSwt_WriteTrcvRegister API.
      reference EthSwtEcucPartitionRef [0..*]: scope=ECU, multiplicity set at pre-compile, post-build-variant-multiplicity=true, post-build-variant-value=true, set at pre-compile, destination=EcucPartition  # Maps the Ethernet switch driver to zero or multiple ECUC partitions to make the modules API available in this partition.
