AUTOSAR XML (schema 00053)
package /AUTOSAR/EcucDefs
  ecuc definition collection AUTOSARParameterDefinition: module=Fls
  module definition Fls [0..*]: post-build-variant-support=true, variants post-build/pre-compile  # Configuration of the Fls (internal or external flash driver) module. Tags: atp.Status=obsolete | Its multiplicity describes the number of flash drivers present, so there will be one container for each flash driver in the ECUC template. When no flash driver is present then the multiplicity is 0.
    container FlsConfigSet  # Container for runtime configuration parameters of the flash driver. Tags: atp.Status=obsolete | Implementation Type: Fls_ConfigType. This element is obsolete and will be removed in a future revision.
      integer FlsAcErase: 0..4294967295, post-build-variant-value=true, set at post-build in variant post-build / pre-compile in variant pre-compile  # Address offset in RAM to which the erase flash access code shall be loaded. Tags: atp.Status=obsolete | Used as function pointer to access the erase flash access code. This element is obsolete and will be removed in a future revision.
      integer FlsAcWrite: 0..4294967295, post-build-variant-value=true, set at post-build in variant post-build / pre-compile in variant pre-compile  # Address offset in RAM to which the write flash access code shall be loaded. Tags: atp.Status=obsolete | Used as function pointer to access the write flash access code. This element is obsolete and will be removed in a future revision.
      enumeration FlsDefaultMode: post-build-variant-value=true, set at post-build in variant post-build / pre-compile in variant pre-compile, default-value=MEMIF_MODE_SLOW  # This parameter is the default FLS device mode after initialization. Tags: atp.Status=obsolete | Implementation Type: MemIf_ModeType. This element is obsolete and will be removed in a future revision.
        MEMIF_MODE_FAST  # Tags: atp.Status=obsolete
        MEMIF_MODE_SLOW  # Tags: atp.Status=obsolete
      function name FlsJobEndNotification [0..1]: multiplicity set at post-build in variant post-build / pre-compile in variant pre-compile, post-build-variant-multiplicity=true, post-build-variant-value=true, set at post-build in variant post-build / pre-compile in variant pre-compile  # Mapped to the job end notification routine provided by some upper layer module, typically the Fee module. Tags: atp.Status=obsolete
      function name FlsJobErrorNotification [0..1]: multiplicity set at post-build in variant post-build / pre-compile in variant pre-compile, post-build-variant-multiplicity=true, post-build-variant-value=true, set at post-build in variant post-build / pre-compile in variant pre-compile  # Mapped to the job error notification routine provided by some upper layer module, typically the Fee module. Tags: atp.Status=obsolete
      integer FlsMaxReadFastMode: 0..4294967295, post-build-variant-value=true, set at post-build in variant post-build / pre-compile in variant pre-compile  # The maximum number of bytes to read or compare in one cycle of the flash driver's job processing function in fast mode. Tags: atp.Status=obsolete
      integer FlsMaxReadNormalMode: 0..4294967295, post-build-variant-value=true, set at post-build in variant post-build / pre-compile in variant pre-compile  # The maximum number of bytes to read or compare in one cycle of the flash driver's job processing function in normal mode. Tags: atp.Status=obsolete
      integer FlsMaxWriteFastMode: 0..4294967295, post-build-variant-value=true, set at post-build in variant post-build / pre-compile in variant pre-compile  # The maximum number of bytes to write in one cycle of the flash driver's job processing function in fast mode. Tags: atp.Status=obsolete
      integer FlsMaxWriteNormalMode: 0..4294967295, post-build-variant-value=true, set at post-build in variant post-build / pre-compile in variant pre-compile  # The maximum number of bytes to write in one cycle of the flash driver's job processing function in normal mode. Tags: atp.Status=obsolete
      integer FlsProtection: 0..4294967295, post-build-variant-value=true, set at post-build in variant post-build / pre-compile in variant pre-compile  # Erase/write protection settings. Only relevant if supported by hardware. Tags: atp.Status=obsolete
      container FlsExternalDriver [0..1]  # This container is present for external Flash drivers only. Internal Flash drivers do not use the parameter listed in this container, hence its multiplicity is 0 for internal drivers. Tags: atp.Status=obsolete
        reference FlsSpiReference [1..*]: multiplicity set at pre-compile, set at pre-compile, requires-symbolic-name-value=true, destination=SpiSequence  # Reference to SPI sequence (required for external Flash drivers). Tags: atp.Status=obsolete
      container FlsSectorList  # List of flashable sectors and pages. Tags: atp.Status=obsolete
        container FlsSector [1..*]  # Configuration description of a flashable sector Tags: atp.Status=obsolete
          integer FlsNumberOfSectors: 0..65535, set at pre-compile  # Number of continuous sectors with identical values for FlsSectorSize and Tags: atp.Status=obsolete | FlsPageSize. The parameter FlsSectorStartAddress denotes the start address of the first sector. This element is obsolete and will be removed in a future revision.
          integer FlsPageSize: 0..4294967295, set at pre-compile  # Size of one page of this sector. Tags: atp.Status=obsolete | Implementation Type: Fls_LengthType. This element is obsolete and will be removed in a future revision.
          integer FlsSectorSize: 0..4294967295, set at pre-compile  # Size of this sector. Tags: atp.Status=obsolete | Implementation Type: Fls_LengthType. This element is obsolete and will be removed in a future revision.
          integer FlsSectorStartaddress: 0..4294967295, set at pre-compile  # Start address of this sector. Tags: atp.Status=obsolete | Implementation Type: Fls_AddressType. This element is obsolete and will be removed in a future revision.
    container FlsGeneral  # Container for general parameters of the flash driver. These parameters are always pre-compile. Tags: atp.Status=obsolete
      boolean FlsAcLoadOnJobStart: set at pre-compile, default-value=false  # The flash driver shall load the flash access code to RAM whenever an erase or write job is started and unload (overwrite) it after that job has been finished or canceled. Tags: atp.Status=obsolete | true: Flash access code loaded on job start / unloaded on job end or error. false: Flash access code not loaded to / unloaded from RAM at all. This element is obsolete and will be removed in a future revision.
      integer FlsBaseAddress: 0..4294967295, set at pre-compile  # The flash memory start address (see also SWS_Fls_00208 and SWS_Fls_00209). Tags: atp.Status=obsolete | This parameter defines the lower boundary for read / write / erase and compare jobs. This element is obsolete and will be removed in a future revision.
      boolean FlsBlankCheckApi: set at pre-compile, default-value=false  # Compile switch to enable/disable the Fls_BlankCheck function. Tags: atp.Status=obsolete | true: API supported / function provided. false: API not supported / function not provided This element is obsolete and will be removed in a future revision.
      boolean FlsCancelApi: set at pre-compile  # Compile switch to enable and disable the Fls_Cancel function. Tags: atp.Status=obsolete | true: API supported / function provided. false: API not supported / function not provided This element is obsolete and will be removed in a future revision.
      boolean FlsCompareApi: set at pre-compile  # Compile switch to enable and disable the Fls_Compare function. Tags: atp.Status=obsolete | true: API supported / function provided. false: API not supported / function not provided This element is obsolete and will be removed in a future revision.
      boolean FlsDevErrorDetect: set at pre-compile, default-value=false  # Switches the development error detection and notification on or off. Tags: atp.Status=obsolete | * true: detection and notification is enabled. * false: detection and notification is disabled. This element is obsolete and will be removed in a future revision.
      integer FlsDriverIndex: 0..254, scope=ECU, set at pre-compile, symbolic-name-value=true  # Index of the driver, used by FEE. Tags: atp.Status=obsolete
      boolean FlsEraseVerificationEnabled: set at pre-compile, default-value=false  # Compile switch to enable erase verification. Tags: atp.Status=obsolete | true: memory region is checked to be erased. false: memory region is not checked to be erased. This element is obsolete and will be removed in a future revision.
      boolean FlsGetJobResultApi: set at pre-compile  # Compile switch to enable and disable the Fls_GetJobResult function. Tags: atp.Status=obsolete | true: API supported / function provided. false: API not supported / function not provided This element is obsolete and will be removed in a future revision.
      boolean FlsGetStatusApi: set at pre-compile  # Compile switch to enable and disable the Fls_GetStatus function. Tags: atp.Status=obsolete | true: API supported / function provided. false: API not supported / function not provided This element is obsolete and will be removed in a future revision.
      float FlsMainFunctionPeriod: 0..INF, set at pre-compile  # Cycle time of calls of the flash driver's main function (in seconds). Tags: atp.Status=obsolete
      boolean FlsSetModeApi: set at pre-compile  # Compile switch to enable and disable the Fls_SetMode function. Tags: atp.Status=obsolete | true: API supported / function provided. false: API not supported / function not provided This element is obsolete and will be removed in a future revision.
      boolean FlsTimeoutSupervisionEnabled: set at pre-compile, default-value=false  # Compile switch to enable timeout supervision. Tags: atp.Status=obsolete | true: timeout supervision for read/erase/write/compare jobs enabled. false: timeout supervision for read/erase/write/compare jobs disabled. This element is obsolete and will be removed in a future revision.
      integer FlsTotalSize: 0..4294967295, set at pre-compile  # The total amount of flash memory in bytes (see also SWS_Fls_00208 and SWS_Fls_00209). Tags: atp.Status=obsolete | This parameter in conjunction with FLS_BASE_ADDRESS defines the upper boundary for read / write / erase and compare jobs. This element is obsolete and will be removed in a future revision.
      boolean FlsUseInterrupts: set at pre-compile, default-value=false  # Job processing triggered by hardware interrupt. Tags: atp.Status=obsolete | true: Job processing triggered by interrupt (hardware controlled). false: Job processing not triggered by interrupt (software controlled) or the underlying hardware does not support interrupt mode for flash operations. This element is obsolete and will be removed in a future revision.
      boolean FlsVersionInfoApi: set at pre-compile, default-value=false  # Pre-processor switch to enable / disable the API to read out the modules version information. Tags: atp.Status=obsolete | true: Version info API enabled. false: Version info API disabled. This element is obsolete and will be removed in a future revision.
      boolean FlsWriteVerificationEnabled: set at pre-compile, default-value=false  # Compile switch to enable write verification. Tags: atp.Status=obsolete | true: written data is compared directly after write. false: written date is not compared directly after write. This element is obsolete and will be removed in a future revision.
      reference FlsEcucPartitionRef [0..1]: scope=ECU, multiplicity set at pre-compile, post-build-variant-multiplicity=true, post-build-variant-value=true, set at pre-compile, destination=EcucPartition  # Maps the Flash driver to zero or one ECUC partition to make the driver API available in this partition. Tags: atp.Status=obsolete
    container FlsPublishedInformation  # Additional published parameters not covered by CommonPublishedInformation container. Tags: atp.Status=obsolete | Note that these parameters do not have any configuration class setting, since they are published information. This element is obsolete and will be removed in a future revision.
      integer FlsAcLocationErase: 0..4294967295, set at published-information  # Position in RAM, to which the erase flash access code has to be loaded. Tags: atp.Status=obsolete | Only relevant if the erase flash access code is not position independent. If this information is not provided it is assumed that the erase flash access code is position independent and that therefore the RAM position can be freely configured. This element is obsolete and will be removed in a future revision.
      integer FlsAcLocationWrite: 0..4294967295, set at published-information  # Position in RAM, to which the write flash access code has to be loaded. Tags: atp.Status=obsolete | Only relevant if the write flash access code is not position independent. If this information is not provided it is assumed that the write flash access code is position independent and that therefore the RAM position can be freely configured. This element is obsolete and will be removed in a future revision.
      integer FlsAcSizeErase: 0..4294967295, set at published-information  # Number of bytes in RAM needed for the erase flash access code. Tags: atp.Status=obsolete
      integer FlsAcSizeWrite: 0..4294967295, set at published-information  # Number of bytes in RAM needed for the write flash access code. Tags: atp.Status=obsolete
      integer FlsErasedValue: 0..4294967295, set at published-information  # The contents of an erased flash memory cell. Tags: atp.Status=obsolete
      float FlsEraseTime: 0..INF, set at published-information  # Maximum time to erase one complete flash sector. Tags: atp.Status=obsolete
      string FlsExpectedHwId: set at published-information  # Unique identifier of the hardware device that is expected by this driver (the device for which this driver has been implemented). Tags: atp.Status=obsolete | Only relevant for external flash drivers. This element is obsolete and will be removed in a future revision.
      integer FlsSpecifiedEraseCycles: 0..4294967295, set at published-information  # Number of erase cycles specified for the flash device (usually given in the device data sheet). Tags: atp.Status=obsolete | If the number of specified erase cycles depends on the operating environment (temperature, voltage, ...) during reprogramming of the flash device, the minimum number for which a data retention of at least 15 years over the temperature range from -40°C .. +125°C can be guaranteed shall be given. Note: If there are different numbers of specified erase cycles for different flash sectors of the device this parameter has to be extended to a parameter list (similar to the sector list above). This element is obsolete and will be removed in a future revision.
      float FlsWriteTime: 0..INF, set at published-information  # Maximum time to program one complete flash page. Tags: atp.Status=obsolete
