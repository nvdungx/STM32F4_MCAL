AUTOSAR XML (schema 00053)
package /AUTOSAR/EcucDefs
  ecuc definition collection AUTOSARParameterDefinition: module=J1939Nm
  module definition J1939Nm [0..1]: post-build-variant-support=true, variants link-time/post-build/pre-compile  # Configuration of the J1939 Network Management module.
    container J1939NmConfigSet  # This container contains the configuration parameters and sub containers of the AUTOSAR J1939Nm module.
      container J1939NmChannel [1..*]: multiplicity set at link in variant link-time / post-build in variant post-build / pre-compile in variant pre-compile, post-build-variant-multiplicity=true  # Physical CAN channel handled by J1939Nm.
        boolean J1939NmChannelUsesAddressArbitration: post-build-variant-value=true, set at link in variant link-time / post-build in variant post-build / pre-compile in variant pre-compile, default-value=true  # Defines whether the nodes attached to this channel use an initial address claim, and whether they react to contending address claims of other nodes. | True: The initial address claim is sent, and the node reacts to address claims of other nodes. False: The node only sends an address claim upon request, and does not react to other address claims.
        boolean J1939NmChannelUsesDynamicAddressing [0..1]: post-build-variant-value=true, set at link in variant link-time / post-build in variant post-build / pre-compile in variant pre-compile, default-value=false  # Defines whether fully dynamic address resolution according to SAE J1939-81 shall be supported on this channel. | * True: The dynamically allocated addresses on the bus are matched at runtime to the configured addresses (see J1939NmNode.J1939NmNodePreferredAddress and J1939NmExternalNode.J1939NmExternalNodePreferredAddress). J1939NmNodes with J1939NmAddressConfigurationCapability set to J1939NM_AAC will change their addresses dynamically in case of an address conflict. * False: The addresses on the bus resemble the configured addresses. J1939NmAddressConfigurationCapability shall not be set to J1939NM_AAC.
        reference J1939NmComMNetworkHandleRef: set at link in variant link-time+post-build / pre-compile in variant pre-compile, requires-symbolic-name-value=true, destination=ComMChannel  # Reference to the channel defined by the ComMChannel providing access to the unique channel index ComMChannelId.
        container J1939NmNodeSpecificDemEventParameterRefs [0..*]: multiplicity set at link in variant link-time / post-build in variant post-build / pre-compile in variant pre-compile, post-build-variant-multiplicity=true  # Container for the references to DemEventParameter elements related to one J1939NmNode which shall be invoked using the API Dem_SetEventStatus in case the corresponding error occurs. The EventId is taken from the referenced DemEventParameter's DemEventId symbolic value. The standardized errors are provided in this container and can be extended by vendor-specific error references.
          reference J1939NM_E_ADDRESS_LOST: set at pre-compile, requires-symbolic-name-value=true, destination=DemEventParameter  # Reference to the DemEventParameter which shall be issued when the ECU failed to claim one of its addresses.
          reference J1939NmNodeRef: post-build-variant-value=true, set at link in variant link-time / post-build in variant post-build / pre-compile in variant pre-compile, destination=J1939NmNode  # Reference to J1939NmNode.
        container J1939NmRxPdu  # Contains the configuration of the PDU used to receive the AddressClaimed PG. This PDU consumes a meta data item of type CAN_ID_32.
          integer J1939NmRxPduId: 0..65535, scope=ECU, set at pre-compile, symbolic-name-value=true, with-auto=true  # The PDU identifier used for RxIndication from LSduR.
          reference J1939NmRxPduRef: set at link in variant link-time+post-build / pre-compile in variant pre-compile, destination=Pdu  # Reference to the Pdu object representing the PDU.
        container J1939NmTxPdu  # Contains the configuration of the PDU used to transmit the AddressClaimed PG. This PDU produces a meta data item of type CAN_ID_32.
          integer J1939NmTxPduId: 0..65535, scope=ECU, set at pre-compile, symbolic-name-value=true, with-auto=true  # The PDU identifier used for TxConfirmation from LSduR.
          reference J1939NmTxPduRef: set at link in variant link-time+post-build / pre-compile in variant pre-compile, destination=Pdu  # Reference to the Pdu object representing the PDU.
      container J1939NmExternalNode [0..*]: multiplicity set at pre-compile  # Logical node implemented in another ECU. Configures potential communication partners. If this container is connected to more than one channel, the external ECU is linked to the local ECU by each of these channels.
        integer J1939NmExternalNodeId: 0..65535, scope=ECU, set at pre-compile, symbolic-name-value=true, with-auto=true  # Unique identifier of this external node.
        boolean J1939NmExternalNodeNameArbitraryAddressCapable: post-build-variant-value=true, set at link in variant link-time / post-build in variant post-build / pre-compile in variant pre-compile  # Arbitrary Address Capable field of the NAME of this external node.
        integer J1939NmExternalNodeNameECUInstance: 0..7, post-build-variant-value=true, set at link in variant link-time / post-build in variant post-build / pre-compile in variant pre-compile  # ECU Instance field of the NAME of this external node.
        integer J1939NmExternalNodeNameFunction: 0..255, post-build-variant-value=true, set at link in variant link-time / post-build in variant post-build / pre-compile in variant pre-compile  # Function field of the NAME of this external node.
        integer J1939NmExternalNodeNameFunctionInstance: 0..31, post-build-variant-value=true, set at link in variant link-time / post-build in variant post-build / pre-compile in variant pre-compile  # Function Instance field of the NAME of this external node.
        integer J1939NmExternalNodeNameIdentityNumber: 0..2097151, post-build-variant-value=true, set at link in variant link-time / post-build in variant post-build / pre-compile in variant pre-compile  # Identity Number field of the NAME of this external node.
        integer J1939NmExternalNodeNameIndustryGroup: 0..7, post-build-variant-value=true, set at link in variant link-time / post-build in variant post-build / pre-compile in variant pre-compile  # Industry Group field of the NAME of this external node.
        integer J1939NmExternalNodeNameManufacturerCode: 0..2047, post-build-variant-value=true, set at link in variant link-time / post-build in variant post-build / pre-compile in variant pre-compile  # Manufacturer Code field of the NAME of this external node.
        integer J1939NmExternalNodeNameVehicleSystem: 0..127, post-build-variant-value=true, set at link in variant link-time / post-build in variant post-build / pre-compile in variant pre-compile  # Vehicle System field of the NAME of this external node.
        integer J1939NmExternalNodeNameVehicleSystemInstance: 0..15, post-build-variant-value=true, set at link in variant link-time / post-build in variant post-build / pre-compile in variant pre-compile  # Vehicle System Instance field of the NAME of this external node.
        integer J1939NmExternalNodePreferredAddress: 0..253, scope=ECU, post-build-variant-value=true, set at link in variant link-time / post-build in variant post-build / pre-compile in variant pre-compile  # Source address of this external node.
        reference J1939NmExternalNodeChannelRef [1..*]: multiplicity set at link in variant link-time / post-build in variant post-build / pre-compile in variant pre-compile, post-build-variant-multiplicity=true, post-build-variant-value=true, set at link in variant link-time / post-build in variant post-build / pre-compile in variant pre-compile, destination=J1939NmChannel  # Reference to the channels of the local ECU this external node has access to.
        reference J1939NmExternalNodeGatewayedChannelRef [0..*]: multiplicity set at link in variant link-time / post-build in variant post-build / pre-compile in variant pre-compile, post-build-variant-multiplicity=true, post-build-variant-value=true, set at link in variant link-time / post-build in variant post-build / pre-compile in variant pre-compile, destination=J1939NmChannel  # Reference to the channels on which messages to/from this external node shall be gatewayed. The address claim from the external node will be replicated on these channels.
      container J1939NmNode [1..*]: multiplicity set at link in variant link-time / post-build in variant post-build / pre-compile in variant pre-compile, post-build-variant-multiplicity=true  # Logical node representing one function handled by J1939Nm.
        enumeration J1939NmAddressConfigurationCapability [0..1]: {J1939NM_AAC, J1939NM_CCA, J1939NM_NCA, J1939NM_SCA, J1939NM_SVCA}, post-build-variant-value=true, set at link in variant link-time / post-build in variant post-build / pre-compile in variant pre-compile, default-value=J1939NM_NCA  # Defines the Address Configuration Capability of the J1939NmNode (corresponding to an SAE J1939 Controller Application, CA).
        integer J1939NmNodeId: 0..255, scope=ECU, set at pre-compile, symbolic-name-value=true, with-auto=true  # Unique identifier of this node.
        boolean J1939NmNodeNameArbitraryAddressCapable: set at pre-compile  # Arbitrary Address Capable field of the NAME of this node.
        integer J1939NmNodeNameECUInstance: 0..7, post-build-variant-value=true, set at link in variant link-time / post-build in variant post-build / pre-compile in variant pre-compile  # ECU Instance field of the NAME of this node.
        integer J1939NmNodeNameFunction: 0..255, post-build-variant-value=true, set at link in variant link-time / post-build in variant post-build / pre-compile in variant pre-compile  # Function field of the NAME of this node.
        integer J1939NmNodeNameFunctionInstance: 0..31, post-build-variant-value=true, set at link in variant link-time / post-build in variant post-build / pre-compile in variant pre-compile  # Function Instance field of the NAME of this node.
        integer J1939NmNodeNameIdentityNumber: 0..2097151, post-build-variant-value=true, set at link in variant link-time / post-build in variant post-build / pre-compile in variant pre-compile  # Identity Number field of the NAME of this node.
        integer J1939NmNodeNameIndustryGroup: 0..7, post-build-variant-value=true, set at link in variant link-time / post-build in variant post-build / pre-compile in variant pre-compile  # Industry Group field of the NAME of this node.
        integer J1939NmNodeNameManufacturerCode: 0..2047, post-build-variant-value=true, set at link in variant link-time / post-build in variant post-build / pre-compile in variant pre-compile  # Manufacturer Code field of the NAME of this node.
        integer J1939NmNodeNameVehicleSystem: 0..127, post-build-variant-value=true, set at link in variant link-time / post-build in variant post-build / pre-compile in variant pre-compile  # Vehicle System field of the NAME of this node.
        integer J1939NmNodeNameVehicleSystemInstance: 0..15, post-build-variant-value=true, set at link in variant link-time / post-build in variant post-build / pre-compile in variant pre-compile  # Vehicle System Instance field of the NAME of this node.
        integer J1939NmNodePreferredAddress: 0..253, scope=ECU, post-build-variant-value=true, set at link in variant link-time / post-build in variant post-build / pre-compile in variant pre-compile  # Source address of this node used for address claiming.
        boolean J1939NmNodeStartUpDelay: set at pre-compile, default-value=true  # If enabled, the node will start communication after a delay of 250ms after transmission of the initial AddressClaimed, depending on the configured J1939NmNodePreferredAddress. If disabled, the node will start communication immediately at network start-up. | Please note: According to J1939/81, the 250ms delay is not required for single address CAs with desired source addresses in the ranges 0..127 or 248..253.
        reference J1939NmNodeChannelRef [1..*]: multiplicity set at link in variant link-time+post-build / pre-compile in variant pre-compile, set at link in variant link-time+post-build / pre-compile in variant pre-compile, destination=J1939NmChannel  # Reference to the channels this node has access to.
      container J1939NmSharedAddressSpace [0..*]: multiplicity set at link in variant link-time / post-build in variant post-build / pre-compile in variant pre-compile, post-build-variant-multiplicity=true  # Set of J1939NmChannels that share a common address space. Address claims will be routed between these channels.
        reference J1939NmSharedChannelRef [2..*]: multiplicity set at link in variant link-time / post-build in variant post-build / pre-compile in variant pre-compile, post-build-variant-multiplicity=true, post-build-variant-value=true, set at link in variant link-time / post-build in variant post-build / pre-compile in variant pre-compile, destination=J1939NmChannel  # Reference to a channel that belongs to the shared address space.
    container J1939NmGeneral  # Contains the general configuration parameters of the module.
      float J1939NmBusOffDelayTickPeriod [0..1]: 0..INF, multiplicity set at link in variant link-time+post-build / pre-compile in variant pre-compile, set at link in variant link-time+post-build / pre-compile in variant pre-compile, default-value=0.02  # Duration of ticks that are used to time BusOff delays after conflicting address claims. This parameter must be synchronized with the main function period of the CAN State Manager.
      boolean J1939NmDevErrorDetect: set at pre-compile, default-value=false  # Switches the development error detection and notification on or off. | * true: detection and notification is enabled. * false: detection and notification is disabled.
      boolean J1939NmGatewaySupport: set at pre-compile  # Enables/disables support for claiming the addresses of routed messages.
      float J1939NmMainFunctionPeriod: 0..INF, scope=ECU, set at link in variant link-time+post-build / pre-compile in variant pre-compile, default-value=0.01  # Call cycle in seconds of J1939Nm_MainFunction.
      function name J1939NmUserCallout [0..1]: multiplicity set at pre-compile, set at pre-compile  # Pre-processor switch for enabling the <User_AddressClaimedIndication> and defining the name of the callout function.
      boolean J1939NmVersionInfoApi: set at pre-compile, default-value=false  # Pre-processor switch for enabling version info API support.
